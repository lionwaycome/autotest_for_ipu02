// *************************************************************************** *
// *                                                                           *
// *                      Mentor Graphics Corporation                          *
// *                          All rights reserved                              *
// *                                                                           *
// *************************************************************************** *
// *                                                                           *
// * Description:         CANDB File                                           *
// * Generated at:        2020-04-14 13:12:04                                  *
// * System:              SDB20010                                             *
// * Variant:             EX11_AVP                                             *
// * Network:             SafetyCANFD1                                         *
// *                                                                           *
// *************************************************************************** *
// *                                                                           *
// *             THIS CONFIGURATION MIGHT CONTAIN SOME ERRORS                  *
// *              IF THE INPUT MODEL WAS NOT PROPERLY FORMED!                  *
// *                    Do Not Use this File directly!                         *
// *                                                                           *
// *************************************************************************** *
VERSION "SafetyCANFD1"

NS_ :

BS_:

BU_:  ASDM ETC FSRL FSRR PAS

BO_ 355 FSRRSafetyCANFD1Frame26: 64 FSRR
 SG_ FrntSideRdrRiObj4_UB : 291|1@0+ (1,0) [0|1] "" ASDM,PAS
 SG_ FrntSideRdrRiObj4Heading : 287|12@0+ (0.1,-180.0) [-180.0|180.0] "Deg" ASDM,PAS
 SG_ FrntSideRdrRiObj4ObjBoxCenterLat : 23|9@0+ (0.1,-25.0) [-25.0|25.0] "m" ASDM,PAS
 SG_ FrntSideRdrRiObj4ObjBoxCenterLgt : 30|9@0+ (0.1,-25.0) [-25.0|25.0] "m" ASDM,PAS
 SG_ FrntSideRdrRiObj4ObservationHist : 63|32@0+ (1.0,0.0) [0.0|4294967295.0] "Unitless" ASDM,PAS
 SG_ FrntSideRdrRiObj4RdrObjAx : 7|8@0- (0.1,0.0) [-12.8|12.700000000000001] "m/s^2" ASDM,PAS
 SG_ FrntSideRdrRiObj4RdrObjAy : 15|8@0- (0.1,0.0) [-12.8|12.700000000000001] "m/s^2" ASDM,PAS
 SG_ FrntSideRdrRiObj4RdrObjBoxLength : 37|9@0+ (0.1,0.0) [0.0|50.0] "m" ASDM,PAS
 SG_ FrntSideRdrRiObj4RdrObjBoxWidth : 44|9@0+ (0.1,0.0) [0.0|50.0] "m" ASDM,PAS
 SG_ FrntSideRdrRiObj4RdrObjChks : 95|8@0+ (1.0,0.0) [0.0|255.0] "Unitless" ASDM,PAS
 SG_ FrntSideRdrRiObj4RdrObjCntr : 103|4@0+ (1.0,0.0) [0.0|15.0] "Unitless" ASDM,PAS
 SG_ FrntSideRdrRiObj4RdrObjCoastCnt : 279|5@0+ (1.0,0.0) [0.0|31.0] "Unitless" ASDM,PAS
 SG_ FrntSideRdrRiObj4RdrObjConf : 99|4@0+ (7.0,0.0) [0.0|105.0] "%" ASDM,PAS
 SG_ FrntSideRdrRiObj4RdrObjDx : 191|13@0+ (0.05,-200.0) [-200.0|200.0] "m" ASDM,PAS
 SG_ FrntSideRdrRiObj4RdrObjDxStdDe : 111|8@0+ (0.05,0.0) [0.0|12.700000000000001] "m" ASDM,PAS
 SG_ FrntSideRdrRiObj4RdrObjDy : 119|13@0+ (0.05,-200.0) [-200.0|200.0] "m" ASDM,PAS
 SG_ FrntSideRdrRiObj4RdrObjDyStdDe : 183|8@0+ (0.05,0.0) [0.0|12.700000000000001] "m" ASDM,PAS
 SG_ FrntSideRdrRiObj4RdrObjElevnConf : 223|4@0+ (7.0,0.0) [0.0|105.0] "%" ASDM,PAS
 SG_ FrntSideRdrRiObj4RdrObjElevnSts : 153|2@0+ (1,0) [0|3] "" ASDM,PAS
 SG_ FrntSideRdrRiObj4RdrObjID : 167|8@0+ (1.0,0.0) [0.0|255.0] "Unitless" ASDM,PAS
 SG_ FrntSideRdrRiObj4RdrObjIsInFreeSpace : 192|1@0+ (1,0) [0|1] "" ASDM,PAS
 SG_ FrntSideRdrRiObj4RdrObjMirrProblty : 219|4@0+ (7.0,0.0) [0.0|105.0] "%" ASDM,PAS
 SG_ FrntSideRdrRiObj4RdrObjMtnPat : 122|3@0+ (1,0) [0|7] "" ASDM,PAS
 SG_ FrntSideRdrRiObj4RdrObjNotRealProblty : 231|4@0+ (7.0,0.0) [0.0|105.0] "%" ASDM,PAS
 SG_ FrntSideRdrRiObj4RdrObjStatyCnt : 239|7@0+ (1.0,0.0) [0.0|127.0] "Unitless" ASDM,PAS
 SG_ FrntSideRdrRiObj4RdrObjTiAlv : 247|7@0+ (1.0,0.0) [0.0|127.0] "Unitless" ASDM,PAS
 SG_ FrntSideRdrRiObj4RdrObjTrackSts : 194|2@0+ (1,0) [0|3] "" ASDM,PAS
 SG_ FrntSideRdrRiObj4RdrObjTyp : 51|4@0+ (1,0) [0|15] "" ASDM,PAS
 SG_ FrntSideRdrRiObj4RdrObjTypConfBike : 175|4@0+ (7.0,0.0) [0.0|105.0] "%" ASDM,PAS
 SG_ FrntSideRdrRiObj4RdrObjTypConfPed : 171|4@0+ (7.0,0.0) [0.0|105.0] "%" ASDM,PAS
 SG_ FrntSideRdrRiObj4RdrObjTypConfVeh : 227|4@0+ (7.0,0.0) [0.0|105.0] "%" ASDM,PAS
 SG_ FrntSideRdrRiObj4RdrObjVx : 255|14@0+ (0.02,-128.0) [-128.0|128.0] "m/s" ASDM,PAS
 SG_ FrntSideRdrRiObj4RdrObjVxStdDe : 271|6@0+ (0.05,0.0) [0.0|2.0] "m/s" ASDM,PAS
 SG_ FrntSideRdrRiObj4RdrObjVy : 207|14@0+ (0.02,-128.0) [-128.0|128.0] "m/s" ASDM,PAS
 SG_ FrntSideRdrRiObj4RdrObjVyStdDe : 159|6@0+ (0.05,0.0) [0.0|2.0] "m/s" ASDM,PAS
 SG_ FrntSideRdrRiObj4RelVx : 135|12@0+ (0.02,-35.6) [-35.6|35.6] "m/s" ASDM,PAS
 SG_ FrntSideRdrRiObj4RelVy : 139|12@0+ (0.02,-35.6) [-35.6|35.6] "m/s" ASDM,PAS

BO_ 357 FSRRSafetyCANFD1Frame27: 64 FSRR
 SG_ FrntSideRdrRiObj5_UB : 291|1@0+ (1,0) [0|1] "" ASDM,PAS
 SG_ FrntSideRdrRiObj5Heading : 287|12@0+ (0.1,-180.0) [-180.0|180.0] "Deg" ASDM,PAS
 SG_ FrntSideRdrRiObj5ObjBoxCenterLat : 23|9@0+ (0.1,-25.0) [-25.0|25.0] "m" ASDM,PAS
 SG_ FrntSideRdrRiObj5ObjBoxCenterLgt : 30|9@0+ (0.1,-25.0) [-25.0|25.0] "m" ASDM,PAS
 SG_ FrntSideRdrRiObj5ObservationHist : 63|32@0+ (1.0,0.0) [0.0|4294967295.0] "Unitless" ASDM,PAS
 SG_ FrntSideRdrRiObj5RdrObjAx : 7|8@0- (0.1,0.0) [-12.8|12.700000000000001] "m/s^2" ASDM,PAS
 SG_ FrntSideRdrRiObj5RdrObjAy : 15|8@0- (0.1,0.0) [-12.8|12.700000000000001] "m/s^2" ASDM,PAS
 SG_ FrntSideRdrRiObj5RdrObjBoxLength : 37|9@0+ (0.1,0.0) [0.0|50.0] "m" ASDM,PAS
 SG_ FrntSideRdrRiObj5RdrObjBoxWidth : 44|9@0+ (0.1,0.0) [0.0|50.0] "m" ASDM,PAS
 SG_ FrntSideRdrRiObj5RdrObjChks : 95|8@0+ (1.0,0.0) [0.0|255.0] "Unitless" ASDM,PAS
 SG_ FrntSideRdrRiObj5RdrObjCntr : 103|4@0+ (1.0,0.0) [0.0|15.0] "Unitless" ASDM,PAS
 SG_ FrntSideRdrRiObj5RdrObjCoastCnt : 279|5@0+ (1.0,0.0) [0.0|31.0] "Unitless" ASDM,PAS
 SG_ FrntSideRdrRiObj5RdrObjConf : 99|4@0+ (7.0,0.0) [0.0|105.0] "%" ASDM,PAS
 SG_ FrntSideRdrRiObj5RdrObjDx : 191|13@0+ (0.05,-200.0) [-200.0|200.0] "m" ASDM,PAS
 SG_ FrntSideRdrRiObj5RdrObjDxStdDe : 111|8@0+ (0.05,0.0) [0.0|12.700000000000001] "m" ASDM,PAS
 SG_ FrntSideRdrRiObj5RdrObjDy : 119|13@0+ (0.05,-200.0) [-200.0|200.0] "m" ASDM,PAS
 SG_ FrntSideRdrRiObj5RdrObjDyStdDe : 183|8@0+ (0.05,0.0) [0.0|12.700000000000001] "m" ASDM,PAS
 SG_ FrntSideRdrRiObj5RdrObjElevnConf : 223|4@0+ (7.0,0.0) [0.0|105.0] "%" ASDM,PAS
 SG_ FrntSideRdrRiObj5RdrObjElevnSts : 153|2@0+ (1,0) [0|3] "" ASDM,PAS
 SG_ FrntSideRdrRiObj5RdrObjID : 167|8@0+ (1.0,0.0) [0.0|255.0] "Unitless" ASDM,PAS
 SG_ FrntSideRdrRiObj5RdrObjIsInFreeSpace : 192|1@0+ (1,0) [0|1] "" ASDM,PAS
 SG_ FrntSideRdrRiObj5RdrObjMirrProblty : 219|4@0+ (7.0,0.0) [0.0|105.0] "%" ASDM,PAS
 SG_ FrntSideRdrRiObj5RdrObjMtnPat : 122|3@0+ (1,0) [0|7] "" ASDM,PAS
 SG_ FrntSideRdrRiObj5RdrObjNotRealProblty : 231|4@0+ (7.0,0.0) [0.0|105.0] "%" ASDM,PAS
 SG_ FrntSideRdrRiObj5RdrObjStatyCnt : 239|7@0+ (1.0,0.0) [0.0|127.0] "Unitless" ASDM,PAS
 SG_ FrntSideRdrRiObj5RdrObjTiAlv : 247|7@0+ (1.0,0.0) [0.0|127.0] "Unitless" ASDM,PAS
 SG_ FrntSideRdrRiObj5RdrObjTrackSts : 194|2@0+ (1,0) [0|3] "" ASDM,PAS
 SG_ FrntSideRdrRiObj5RdrObjTyp : 51|4@0+ (1,0) [0|15] "" ASDM,PAS
 SG_ FrntSideRdrRiObj5RdrObjTypConfBike : 175|4@0+ (7.0,0.0) [0.0|105.0] "%" ASDM,PAS
 SG_ FrntSideRdrRiObj5RdrObjTypConfPed : 171|4@0+ (7.0,0.0) [0.0|105.0] "%" ASDM,PAS
 SG_ FrntSideRdrRiObj5RdrObjTypConfVeh : 227|4@0+ (7.0,0.0) [0.0|105.0] "%" ASDM,PAS
 SG_ FrntSideRdrRiObj5RdrObjVx : 255|14@0+ (0.02,-128.0) [-128.0|128.0] "m/s" ASDM,PAS
 SG_ FrntSideRdrRiObj5RdrObjVxStdDe : 271|6@0+ (0.05,0.0) [0.0|2.0] "m/s" ASDM,PAS
 SG_ FrntSideRdrRiObj5RdrObjVy : 207|14@0+ (0.02,-128.0) [-128.0|128.0] "m/s" ASDM,PAS
 SG_ FrntSideRdrRiObj5RdrObjVyStdDe : 159|6@0+ (0.05,0.0) [0.0|2.0] "m/s" ASDM,PAS
 SG_ FrntSideRdrRiObj5RelVx : 135|12@0+ (0.02,-35.6) [-35.6|35.6] "m/s" ASDM,PAS
 SG_ FrntSideRdrRiObj5RelVy : 139|12@0+ (0.02,-35.6) [-35.6|35.6] "m/s" ASDM,PAS

BO_ 359 FSRRSafetyCANFD1Frame28: 64 FSRR
 SG_ FrntSideRdrRiObj6_UB : 291|1@0+ (1,0) [0|1] "" ASDM,PAS
 SG_ FrntSideRdrRiObj6Heading : 287|12@0+ (0.1,-180.0) [-180.0|180.0] "Deg" ASDM,PAS
 SG_ FrntSideRdrRiObj6ObjBoxCenterLat : 23|9@0+ (0.1,-25.0) [-25.0|25.0] "m" ASDM,PAS
 SG_ FrntSideRdrRiObj6ObjBoxCenterLgt : 30|9@0+ (0.1,-25.0) [-25.0|25.0] "m" ASDM,PAS
 SG_ FrntSideRdrRiObj6ObservationHist : 63|32@0+ (1.0,0.0) [0.0|4294967295.0] "Unitless" ASDM,PAS
 SG_ FrntSideRdrRiObj6RdrObjAx : 7|8@0- (0.1,0.0) [-12.8|12.700000000000001] "m/s^2" ASDM,PAS
 SG_ FrntSideRdrRiObj6RdrObjAy : 15|8@0- (0.1,0.0) [-12.8|12.700000000000001] "m/s^2" ASDM,PAS
 SG_ FrntSideRdrRiObj6RdrObjBoxLength : 37|9@0+ (0.1,0.0) [0.0|50.0] "m" ASDM,PAS
 SG_ FrntSideRdrRiObj6RdrObjBoxWidth : 44|9@0+ (0.1,0.0) [0.0|50.0] "m" ASDM,PAS
 SG_ FrntSideRdrRiObj6RdrObjChks : 95|8@0+ (1.0,0.0) [0.0|255.0] "Unitless" ASDM,PAS
 SG_ FrntSideRdrRiObj6RdrObjCntr : 103|4@0+ (1.0,0.0) [0.0|15.0] "Unitless" ASDM,PAS
 SG_ FrntSideRdrRiObj6RdrObjCoastCnt : 279|5@0+ (1.0,0.0) [0.0|31.0] "Unitless" ASDM,PAS
 SG_ FrntSideRdrRiObj6RdrObjConf : 99|4@0+ (7.0,0.0) [0.0|105.0] "%" ASDM,PAS
 SG_ FrntSideRdrRiObj6RdrObjDx : 191|13@0+ (0.05,-200.0) [-200.0|200.0] "m" ASDM,PAS
 SG_ FrntSideRdrRiObj6RdrObjDxStdDe : 111|8@0+ (0.05,0.0) [0.0|12.700000000000001] "m" ASDM,PAS
 SG_ FrntSideRdrRiObj6RdrObjDy : 119|13@0+ (0.05,-200.0) [-200.0|200.0] "m" ASDM,PAS
 SG_ FrntSideRdrRiObj6RdrObjDyStdDe : 183|8@0+ (0.05,0.0) [0.0|12.700000000000001] "m" ASDM,PAS
 SG_ FrntSideRdrRiObj6RdrObjElevnConf : 223|4@0+ (7.0,0.0) [0.0|105.0] "%" ASDM,PAS
 SG_ FrntSideRdrRiObj6RdrObjElevnSts : 153|2@0+ (1,0) [0|3] "" ASDM,PAS
 SG_ FrntSideRdrRiObj6RdrObjID : 167|8@0+ (1.0,0.0) [0.0|255.0] "Unitless" ASDM,PAS
 SG_ FrntSideRdrRiObj6RdrObjIsInFreeSpace : 192|1@0+ (1,0) [0|1] "" ASDM,PAS
 SG_ FrntSideRdrRiObj6RdrObjMirrProblty : 219|4@0+ (7.0,0.0) [0.0|105.0] "%" ASDM,PAS
 SG_ FrntSideRdrRiObj6RdrObjMtnPat : 122|3@0+ (1,0) [0|7] "" ASDM,PAS
 SG_ FrntSideRdrRiObj6RdrObjNotRealProblty : 231|4@0+ (7.0,0.0) [0.0|105.0] "%" ASDM,PAS
 SG_ FrntSideRdrRiObj6RdrObjStatyCnt : 239|7@0+ (1.0,0.0) [0.0|127.0] "Unitless" ASDM,PAS
 SG_ FrntSideRdrRiObj6RdrObjTiAlv : 247|7@0+ (1.0,0.0) [0.0|127.0] "Unitless" ASDM,PAS
 SG_ FrntSideRdrRiObj6RdrObjTrackSts : 194|2@0+ (1,0) [0|3] "" ASDM,PAS
 SG_ FrntSideRdrRiObj6RdrObjTyp : 51|4@0+ (1,0) [0|15] "" ASDM,PAS
 SG_ FrntSideRdrRiObj6RdrObjTypConfBike : 175|4@0+ (7.0,0.0) [0.0|105.0] "%" ASDM,PAS
 SG_ FrntSideRdrRiObj6RdrObjTypConfPed : 171|4@0+ (7.0,0.0) [0.0|105.0] "%" ASDM,PAS
 SG_ FrntSideRdrRiObj6RdrObjTypConfVeh : 227|4@0+ (7.0,0.0) [0.0|105.0] "%" ASDM,PAS
 SG_ FrntSideRdrRiObj6RdrObjVx : 255|14@0+ (0.02,-128.0) [-128.0|128.0] "m/s" ASDM,PAS
 SG_ FrntSideRdrRiObj6RdrObjVxStdDe : 271|6@0+ (0.05,0.0) [0.0|2.0] "m/s" ASDM,PAS
 SG_ FrntSideRdrRiObj6RdrObjVy : 207|14@0+ (0.02,-128.0) [-128.0|128.0] "m/s" ASDM,PAS
 SG_ FrntSideRdrRiObj6RdrObjVyStdDe : 159|6@0+ (0.05,0.0) [0.0|2.0] "m/s" ASDM,PAS
 SG_ FrntSideRdrRiObj6RelVx : 135|12@0+ (0.02,-35.6) [-35.6|35.6] "m/s" ASDM,PAS
 SG_ FrntSideRdrRiObj6RelVy : 139|12@0+ (0.02,-35.6) [-35.6|35.6] "m/s" ASDM,PAS

BO_ 361 FSRRSafetyCANFD1Frame29: 64 FSRR
 SG_ FrntSideRdrRiObj7_UB : 291|1@0+ (1,0) [0|1] "" ASDM,PAS
 SG_ FrntSideRdrRiObj7Heading : 287|12@0+ (0.1,-180.0) [-180.0|180.0] "Deg" ASDM,PAS
 SG_ FrntSideRdrRiObj7ObjBoxCenterLat : 23|9@0+ (0.1,-25.0) [-25.0|25.0] "m" ASDM,PAS
 SG_ FrntSideRdrRiObj7ObjBoxCenterLgt : 30|9@0+ (0.1,-25.0) [-25.0|25.0] "m" ASDM,PAS
 SG_ FrntSideRdrRiObj7ObservationHist : 63|32@0+ (1.0,0.0) [0.0|4294967295.0] "Unitless" ASDM,PAS
 SG_ FrntSideRdrRiObj7RdrObjAx : 7|8@0- (0.1,0.0) [-12.8|12.700000000000001] "m/s^2" ASDM,PAS
 SG_ FrntSideRdrRiObj7RdrObjAy : 15|8@0- (0.1,0.0) [-12.8|12.700000000000001] "m/s^2" ASDM,PAS
 SG_ FrntSideRdrRiObj7RdrObjBoxLength : 37|9@0+ (0.1,0.0) [0.0|50.0] "m" ASDM,PAS
 SG_ FrntSideRdrRiObj7RdrObjBoxWidth : 44|9@0+ (0.1,0.0) [0.0|50.0] "m" ASDM,PAS
 SG_ FrntSideRdrRiObj7RdrObjChks : 95|8@0+ (1.0,0.0) [0.0|255.0] "Unitless" ASDM,PAS
 SG_ FrntSideRdrRiObj7RdrObjCntr : 103|4@0+ (1.0,0.0) [0.0|15.0] "Unitless" ASDM,PAS
 SG_ FrntSideRdrRiObj7RdrObjCoastCnt : 279|5@0+ (1.0,0.0) [0.0|31.0] "Unitless" ASDM,PAS
 SG_ FrntSideRdrRiObj7RdrObjConf : 99|4@0+ (7.0,0.0) [0.0|105.0] "%" ASDM,PAS
 SG_ FrntSideRdrRiObj7RdrObjDx : 191|13@0+ (0.05,-200.0) [-200.0|200.0] "m" ASDM,PAS
 SG_ FrntSideRdrRiObj7RdrObjDxStdDe : 111|8@0+ (0.05,0.0) [0.0|12.700000000000001] "m" ASDM,PAS
 SG_ FrntSideRdrRiObj7RdrObjDy : 119|13@0+ (0.05,-200.0) [-200.0|200.0] "m" ASDM,PAS
 SG_ FrntSideRdrRiObj7RdrObjDyStdDe : 183|8@0+ (0.05,0.0) [0.0|12.700000000000001] "m" ASDM,PAS
 SG_ FrntSideRdrRiObj7RdrObjElevnConf : 223|4@0+ (7.0,0.0) [0.0|105.0] "%" ASDM,PAS
 SG_ FrntSideRdrRiObj7RdrObjElevnSts : 153|2@0+ (1,0) [0|3] "" ASDM,PAS
 SG_ FrntSideRdrRiObj7RdrObjID : 167|8@0+ (1.0,0.0) [0.0|255.0] "Unitless" ASDM,PAS
 SG_ FrntSideRdrRiObj7RdrObjIsInFreeSpace : 192|1@0+ (1,0) [0|1] "" ASDM,PAS
 SG_ FrntSideRdrRiObj7RdrObjMirrProblty : 219|4@0+ (7.0,0.0) [0.0|105.0] "%" ASDM,PAS
 SG_ FrntSideRdrRiObj7RdrObjMtnPat : 122|3@0+ (1,0) [0|7] "" ASDM,PAS
 SG_ FrntSideRdrRiObj7RdrObjNotRealProblty : 231|4@0+ (7.0,0.0) [0.0|105.0] "%" ASDM,PAS
 SG_ FrntSideRdrRiObj7RdrObjStatyCnt : 239|7@0+ (1.0,0.0) [0.0|127.0] "Unitless" ASDM,PAS
 SG_ FrntSideRdrRiObj7RdrObjTiAlv : 247|7@0+ (1.0,0.0) [0.0|127.0] "Unitless" ASDM,PAS
 SG_ FrntSideRdrRiObj7RdrObjTrackSts : 194|2@0+ (1,0) [0|3] "" ASDM,PAS
 SG_ FrntSideRdrRiObj7RdrObjTyp : 51|4@0+ (1,0) [0|15] "" ASDM,PAS
 SG_ FrntSideRdrRiObj7RdrObjTypConfBike : 175|4@0+ (7.0,0.0) [0.0|105.0] "%" ASDM,PAS
 SG_ FrntSideRdrRiObj7RdrObjTypConfPed : 171|4@0+ (7.0,0.0) [0.0|105.0] "%" ASDM,PAS
 SG_ FrntSideRdrRiObj7RdrObjTypConfVeh : 227|4@0+ (7.0,0.0) [0.0|105.0] "%" ASDM,PAS
 SG_ FrntSideRdrRiObj7RdrObjVx : 255|14@0+ (0.02,-128.0) [-128.0|128.0] "m/s" ASDM,PAS
 SG_ FrntSideRdrRiObj7RdrObjVxStdDe : 271|6@0+ (0.05,0.0) [0.0|2.0] "m/s" ASDM,PAS
 SG_ FrntSideRdrRiObj7RdrObjVy : 207|14@0+ (0.02,-128.0) [-128.0|128.0] "m/s" ASDM,PAS
 SG_ FrntSideRdrRiObj7RdrObjVyStdDe : 159|6@0+ (0.05,0.0) [0.0|2.0] "m/s" ASDM,PAS
 SG_ FrntSideRdrRiObj7RelVx : 135|12@0+ (0.02,-35.6) [-35.6|35.6] "m/s" ASDM,PAS
 SG_ FrntSideRdrRiObj7RelVy : 139|12@0+ (0.02,-35.6) [-35.6|35.6] "m/s" ASDM,PAS

BO_ 363 FSRRSafetyCANFD1Frame30: 64 FSRR
 SG_ FrntSideRdrRiObj8_UB : 291|1@0+ (1,0) [0|1] "" ASDM,PAS
 SG_ FrntSideRdrRiObj8Heading : 287|12@0+ (0.1,-180.0) [-180.0|180.0] "Deg" ASDM,PAS
 SG_ FrntSideRdrRiObj8ObjBoxCenterLat : 23|9@0+ (0.1,-25.0) [-25.0|25.0] "m" ASDM,PAS
 SG_ FrntSideRdrRiObj8ObjBoxCenterLgt : 30|9@0+ (0.1,-25.0) [-25.0|25.0] "m" ASDM,PAS
 SG_ FrntSideRdrRiObj8ObservationHist : 63|32@0+ (1.0,0.0) [0.0|4294967295.0] "Unitless" ASDM,PAS
 SG_ FrntSideRdrRiObj8RdrObjAx : 7|8@0- (0.1,0.0) [-12.8|12.700000000000001] "m/s^2" ASDM,PAS
 SG_ FrntSideRdrRiObj8RdrObjAy : 15|8@0- (0.1,0.0) [-12.8|12.700000000000001] "m/s^2" ASDM,PAS
 SG_ FrntSideRdrRiObj8RdrObjBoxLength : 37|9@0+ (0.1,0.0) [0.0|50.0] "m" ASDM,PAS
 SG_ FrntSideRdrRiObj8RdrObjBoxWidth : 44|9@0+ (0.1,0.0) [0.0|50.0] "m" ASDM,PAS
 SG_ FrntSideRdrRiObj8RdrObjChks : 95|8@0+ (1.0,0.0) [0.0|255.0] "Unitless" ASDM,PAS
 SG_ FrntSideRdrRiObj8RdrObjCntr : 103|4@0+ (1.0,0.0) [0.0|15.0] "Unitless" ASDM,PAS
 SG_ FrntSideRdrRiObj8RdrObjCoastCnt : 279|5@0+ (1.0,0.0) [0.0|31.0] "Unitless" ASDM,PAS
 SG_ FrntSideRdrRiObj8RdrObjConf : 99|4@0+ (7.0,0.0) [0.0|105.0] "%" ASDM,PAS
 SG_ FrntSideRdrRiObj8RdrObjDx : 191|13@0+ (0.05,-200.0) [-200.0|200.0] "m" ASDM,PAS
 SG_ FrntSideRdrRiObj8RdrObjDxStdDe : 111|8@0+ (0.05,0.0) [0.0|12.700000000000001] "m" ASDM,PAS
 SG_ FrntSideRdrRiObj8RdrObjDy : 119|13@0+ (0.05,-200.0) [-200.0|200.0] "m" ASDM,PAS
 SG_ FrntSideRdrRiObj8RdrObjDyStdDe : 183|8@0+ (0.05,0.0) [0.0|12.700000000000001] "m" ASDM,PAS
 SG_ FrntSideRdrRiObj8RdrObjElevnConf : 223|4@0+ (7.0,0.0) [0.0|105.0] "%" ASDM,PAS
 SG_ FrntSideRdrRiObj8RdrObjElevnSts : 153|2@0+ (1,0) [0|3] "" ASDM,PAS
 SG_ FrntSideRdrRiObj8RdrObjID : 167|8@0+ (1.0,0.0) [0.0|255.0] "Unitless" ASDM,PAS
 SG_ FrntSideRdrRiObj8RdrObjIsInFreeSpace : 192|1@0+ (1,0) [0|1] "" ASDM,PAS
 SG_ FrntSideRdrRiObj8RdrObjMirrProblty : 219|4@0+ (7.0,0.0) [0.0|105.0] "%" ASDM,PAS
 SG_ FrntSideRdrRiObj8RdrObjMtnPat : 122|3@0+ (1,0) [0|7] "" ASDM,PAS
 SG_ FrntSideRdrRiObj8RdrObjNotRealProblty : 231|4@0+ (7.0,0.0) [0.0|105.0] "%" ASDM,PAS
 SG_ FrntSideRdrRiObj8RdrObjStatyCnt : 239|7@0+ (1.0,0.0) [0.0|127.0] "Unitless" ASDM,PAS
 SG_ FrntSideRdrRiObj8RdrObjTiAlv : 247|7@0+ (1.0,0.0) [0.0|127.0] "Unitless" ASDM,PAS
 SG_ FrntSideRdrRiObj8RdrObjTrackSts : 194|2@0+ (1,0) [0|3] "" ASDM,PAS
 SG_ FrntSideRdrRiObj8RdrObjTyp : 51|4@0+ (1,0) [0|15] "" ASDM,PAS
 SG_ FrntSideRdrRiObj8RdrObjTypConfBike : 175|4@0+ (7.0,0.0) [0.0|105.0] "%" ASDM,PAS
 SG_ FrntSideRdrRiObj8RdrObjTypConfPed : 171|4@0+ (7.0,0.0) [0.0|105.0] "%" ASDM,PAS
 SG_ FrntSideRdrRiObj8RdrObjTypConfVeh : 227|4@0+ (7.0,0.0) [0.0|105.0] "%" ASDM,PAS
 SG_ FrntSideRdrRiObj8RdrObjVx : 255|14@0+ (0.02,-128.0) [-128.0|128.0] "m/s" ASDM,PAS
 SG_ FrntSideRdrRiObj8RdrObjVxStdDe : 271|6@0+ (0.05,0.0) [0.0|2.0] "m/s" ASDM,PAS
 SG_ FrntSideRdrRiObj8RdrObjVy : 207|14@0+ (0.02,-128.0) [-128.0|128.0] "m/s" ASDM,PAS
 SG_ FrntSideRdrRiObj8RdrObjVyStdDe : 159|6@0+ (0.05,0.0) [0.0|2.0] "m/s" ASDM,PAS
 SG_ FrntSideRdrRiObj8RelVx : 135|12@0+ (0.02,-35.6) [-35.6|35.6] "m/s" ASDM,PAS
 SG_ FrntSideRdrRiObj8RelVy : 139|12@0+ (0.02,-35.6) [-35.6|35.6] "m/s" ASDM,PAS

BO_ 365 FSRRSafetyCANFD1Frame31: 64 FSRR
 SG_ FrntSideRdrRiObj9_UB : 291|1@0+ (1,0) [0|1] "" ASDM,PAS
 SG_ FrntSideRdrRiObj9Heading : 287|12@0+ (0.1,-180.0) [-180.0|180.0] "Deg" ASDM,PAS
 SG_ FrntSideRdrRiObj9ObjBoxCenterLat : 23|9@0+ (0.1,-25.0) [-25.0|25.0] "m" ASDM,PAS
 SG_ FrntSideRdrRiObj9ObjBoxCenterLgt : 30|9@0+ (0.1,-25.0) [-25.0|25.0] "m" ASDM,PAS
 SG_ FrntSideRdrRiObj9ObservationHist : 63|32@0+ (1.0,0.0) [0.0|4294967295.0] "Unitless" ASDM,PAS
 SG_ FrntSideRdrRiObj9RdrObjAx : 7|8@0- (0.1,0.0) [-12.8|12.700000000000001] "m/s^2" ASDM,PAS
 SG_ FrntSideRdrRiObj9RdrObjAy : 15|8@0- (0.1,0.0) [-12.8|12.700000000000001] "m/s^2" ASDM,PAS
 SG_ FrntSideRdrRiObj9RdrObjBoxLength : 37|9@0+ (0.1,0.0) [0.0|50.0] "m" ASDM,PAS
 SG_ FrntSideRdrRiObj9RdrObjBoxWidth : 44|9@0+ (0.1,0.0) [0.0|50.0] "m" ASDM,PAS
 SG_ FrntSideRdrRiObj9RdrObjChks : 95|8@0+ (1.0,0.0) [0.0|255.0] "Unitless" ASDM,PAS
 SG_ FrntSideRdrRiObj9RdrObjCntr : 103|4@0+ (1.0,0.0) [0.0|15.0] "Unitless" ASDM,PAS
 SG_ FrntSideRdrRiObj9RdrObjCoastCnt : 279|5@0+ (1.0,0.0) [0.0|31.0] "Unitless" ASDM,PAS
 SG_ FrntSideRdrRiObj9RdrObjConf : 99|4@0+ (7.0,0.0) [0.0|105.0] "%" ASDM,PAS
 SG_ FrntSideRdrRiObj9RdrObjDx : 191|13@0+ (0.05,-200.0) [-200.0|200.0] "m" ASDM,PAS
 SG_ FrntSideRdrRiObj9RdrObjDxStdDe : 111|8@0+ (0.05,0.0) [0.0|12.700000000000001] "m" ASDM,PAS
 SG_ FrntSideRdrRiObj9RdrObjDy : 119|13@0+ (0.05,-200.0) [-200.0|200.0] "m" ASDM,PAS
 SG_ FrntSideRdrRiObj9RdrObjDyStdDe : 183|8@0+ (0.05,0.0) [0.0|12.700000000000001] "m" ASDM,PAS
 SG_ FrntSideRdrRiObj9RdrObjElevnConf : 223|4@0+ (7.0,0.0) [0.0|105.0] "%" ASDM,PAS
 SG_ FrntSideRdrRiObj9RdrObjElevnSts : 153|2@0+ (1,0) [0|3] "" ASDM,PAS
 SG_ FrntSideRdrRiObj9RdrObjID : 167|8@0+ (1.0,0.0) [0.0|255.0] "Unitless" ASDM,PAS
 SG_ FrntSideRdrRiObj9RdrObjIsInFreeSpace : 192|1@0+ (1,0) [0|1] "" ASDM,PAS
 SG_ FrntSideRdrRiObj9RdrObjMirrProblty : 219|4@0+ (7.0,0.0) [0.0|105.0] "%" ASDM,PAS
 SG_ FrntSideRdrRiObj9RdrObjMtnPat : 122|3@0+ (1,0) [0|7] "" ASDM,PAS
 SG_ FrntSideRdrRiObj9RdrObjNotRealProblty : 231|4@0+ (7.0,0.0) [0.0|105.0] "%" ASDM,PAS
 SG_ FrntSideRdrRiObj9RdrObjStatyCnt : 239|7@0+ (1.0,0.0) [0.0|127.0] "Unitless" ASDM,PAS
 SG_ FrntSideRdrRiObj9RdrObjTiAlv : 247|7@0+ (1.0,0.0) [0.0|127.0] "Unitless" ASDM,PAS
 SG_ FrntSideRdrRiObj9RdrObjTrackSts : 194|2@0+ (1,0) [0|3] "" ASDM,PAS
 SG_ FrntSideRdrRiObj9RdrObjTyp : 51|4@0+ (1,0) [0|15] "" ASDM,PAS
 SG_ FrntSideRdrRiObj9RdrObjTypConfBike : 175|4@0+ (7.0,0.0) [0.0|105.0] "%" ASDM,PAS
 SG_ FrntSideRdrRiObj9RdrObjTypConfPed : 171|4@0+ (7.0,0.0) [0.0|105.0] "%" ASDM,PAS
 SG_ FrntSideRdrRiObj9RdrObjTypConfVeh : 227|4@0+ (7.0,0.0) [0.0|105.0] "%" ASDM,PAS
 SG_ FrntSideRdrRiObj9RdrObjVx : 255|14@0+ (0.02,-128.0) [-128.0|128.0] "m/s" ASDM,PAS
 SG_ FrntSideRdrRiObj9RdrObjVxStdDe : 271|6@0+ (0.05,0.0) [0.0|2.0] "m/s" ASDM,PAS
 SG_ FrntSideRdrRiObj9RdrObjVy : 207|14@0+ (0.02,-128.0) [-128.0|128.0] "m/s" ASDM,PAS
 SG_ FrntSideRdrRiObj9RdrObjVyStdDe : 159|6@0+ (0.05,0.0) [0.0|2.0] "m/s" ASDM,PAS
 SG_ FrntSideRdrRiObj9RelVx : 135|12@0+ (0.02,-35.6) [-35.6|35.6] "m/s" ASDM,PAS
 SG_ FrntSideRdrRiObj9RelVy : 139|12@0+ (0.02,-35.6) [-35.6|35.6] "m/s" ASDM,PAS

BO_ 367 FSRRSafetyCANFD1Frame32: 64 FSRR
 SG_ FrntSideRdrRiObj10_UB : 291|1@0+ (1,0) [0|1] "" ASDM,PAS
 SG_ FrntSideRdrRiObj10Heading : 287|12@0+ (0.1,-180.0) [-180.0|180.0] "Deg" ASDM,PAS
 SG_ FrntSideRdrRiObj10ObjBoxCenterLat : 23|9@0+ (0.1,-25.0) [-25.0|25.0] "m" ASDM,PAS
 SG_ FrntSideRdrRiObj10ObjBoxCenterLgt : 30|9@0+ (0.1,-25.0) [-25.0|25.0] "m" ASDM,PAS
 SG_ FrntSideRdrRiObj10ObservationHist : 63|32@0+ (1.0,0.0) [0.0|4294967295.0] "Unitless" ASDM,PAS
 SG_ FrntSideRdrRiObj10RdrObjAx : 7|8@0- (0.1,0.0) [-12.8|12.700000000000001] "m/s^2" ASDM,PAS
 SG_ FrntSideRdrRiObj10RdrObjAy : 15|8@0- (0.1,0.0) [-12.8|12.700000000000001] "m/s^2" ASDM,PAS
 SG_ FrntSideRdrRiObj10RdrObjBoxLength : 37|9@0+ (0.1,0.0) [0.0|50.0] "m" ASDM,PAS
 SG_ FrntSideRdrRiObj10RdrObjBoxWidth : 44|9@0+ (0.1,0.0) [0.0|50.0] "m" ASDM,PAS
 SG_ FrntSideRdrRiObj10RdrObjChks : 95|8@0+ (1.0,0.0) [0.0|255.0] "Unitless" ASDM,PAS
 SG_ FrntSideRdrRiObj10RdrObjCntr : 103|4@0+ (1.0,0.0) [0.0|15.0] "Unitless" ASDM,PAS
 SG_ FrntSideRdrRiObj10RdrObjCoastCnt : 279|5@0+ (1.0,0.0) [0.0|31.0] "Unitless" ASDM,PAS
 SG_ FrntSideRdrRiObj10RdrObjConf : 99|4@0+ (7.0,0.0) [0.0|105.0] "%" ASDM,PAS
 SG_ FrntSideRdrRiObj10RdrObjDx : 191|13@0+ (0.05,-200.0) [-200.0|200.0] "m" ASDM,PAS
 SG_ FrntSideRdrRiObj10RdrObjDxStdDe : 111|8@0+ (0.05,0.0) [0.0|12.700000000000001] "m" ASDM,PAS
 SG_ FrntSideRdrRiObj10RdrObjDy : 119|13@0+ (0.05,-200.0) [-200.0|200.0] "m" ASDM,PAS
 SG_ FrntSideRdrRiObj10RdrObjDyStdDe : 183|8@0+ (0.05,0.0) [0.0|12.700000000000001] "m" ASDM,PAS
 SG_ FrntSideRdrRiObj10RdrObjElevnConf : 223|4@0+ (7.0,0.0) [0.0|105.0] "%" ASDM,PAS
 SG_ FrntSideRdrRiObj10RdrObjElevnSts : 153|2@0+ (1,0) [0|3] "" ASDM,PAS
 SG_ FrntSideRdrRiObj10RdrObjID : 167|8@0+ (1.0,0.0) [0.0|255.0] "Unitless" ASDM,PAS
 SG_ FrntSideRdrRiObj10RdrObjIsInFreeSpace : 192|1@0+ (1,0) [0|1] "" ASDM,PAS
 SG_ FrntSideRdrRiObj10RdrObjMirrProblty : 219|4@0+ (7.0,0.0) [0.0|105.0] "%" ASDM,PAS
 SG_ FrntSideRdrRiObj10RdrObjMtnPat : 122|3@0+ (1,0) [0|7] "" ASDM,PAS
 SG_ FrntSideRdrRiObj10RdrObjNotRealProblty : 231|4@0+ (7.0,0.0) [0.0|105.0] "%" ASDM,PAS
 SG_ FrntSideRdrRiObj10RdrObjStatyCnt : 239|7@0+ (1.0,0.0) [0.0|127.0] "Unitless" ASDM,PAS
 SG_ FrntSideRdrRiObj10RdrObjTiAlv : 247|7@0+ (1.0,0.0) [0.0|127.0] "Unitless" ASDM,PAS
 SG_ FrntSideRdrRiObj10RdrObjTrackSts : 194|2@0+ (1,0) [0|3] "" ASDM,PAS
 SG_ FrntSideRdrRiObj10RdrObjTyp : 51|4@0+ (1,0) [0|15] "" ASDM,PAS
 SG_ FrntSideRdrRiObj10RdrObjTypConfBike : 175|4@0+ (7.0,0.0) [0.0|105.0] "%" ASDM,PAS
 SG_ FrntSideRdrRiObj10RdrObjTypConfPed : 171|4@0+ (7.0,0.0) [0.0|105.0] "%" ASDM,PAS
 SG_ FrntSideRdrRiObj10RdrObjTypConfVeh : 227|4@0+ (7.0,0.0) [0.0|105.0] "%" ASDM,PAS
 SG_ FrntSideRdrRiObj10RdrObjVx : 255|14@0+ (0.02,-128.0) [-128.0|128.0] "m/s" ASDM,PAS
 SG_ FrntSideRdrRiObj10RdrObjVxStdDe : 271|6@0+ (0.05,0.0) [0.0|2.0] "m/s" ASDM,PAS
 SG_ FrntSideRdrRiObj10RdrObjVy : 207|14@0+ (0.02,-128.0) [-128.0|128.0] "m/s" ASDM,PAS
 SG_ FrntSideRdrRiObj10RdrObjVyStdDe : 159|6@0+ (0.05,0.0) [0.0|2.0] "m/s" ASDM,PAS
 SG_ FrntSideRdrRiObj10RelVx : 135|12@0+ (0.02,-35.6) [-35.6|35.6] "m/s" ASDM,PAS
 SG_ FrntSideRdrRiObj10RelVy : 139|12@0+ (0.02,-35.6) [-35.6|35.6] "m/s" ASDM,PAS

BO_ 369 FSRRSafetyCANFD1Frame33: 64 FSRR
 SG_ FrntSideRdrRiObj11_UB : 291|1@0+ (1,0) [0|1] "" ASDM,PAS
 SG_ FrntSideRdrRiObj11Heading : 287|12@0+ (0.1,-180.0) [-180.0|180.0] "Deg" ASDM,PAS
 SG_ FrntSideRdrRiObj11ObjBoxCenterLat : 23|9@0+ (0.1,-25.0) [-25.0|25.0] "m" ASDM,PAS
 SG_ FrntSideRdrRiObj11ObjBoxCenterLgt : 30|9@0+ (0.1,-25.0) [-25.0|25.0] "m" ASDM,PAS
 SG_ FrntSideRdrRiObj11ObservationHist : 63|32@0+ (1.0,0.0) [0.0|4294967295.0] "Unitless" ASDM,PAS
 SG_ FrntSideRdrRiObj11RdrObjAx : 7|8@0- (0.1,0.0) [-12.8|12.700000000000001] "m/s^2" ASDM,PAS
 SG_ FrntSideRdrRiObj11RdrObjAy : 15|8@0- (0.1,0.0) [-12.8|12.700000000000001] "m/s^2" ASDM,PAS
 SG_ FrntSideRdrRiObj11RdrObjBoxLength : 37|9@0+ (0.1,0.0) [0.0|50.0] "m" ASDM,PAS
 SG_ FrntSideRdrRiObj11RdrObjBoxWidth : 44|9@0+ (0.1,0.0) [0.0|50.0] "m" ASDM,PAS
 SG_ FrntSideRdrRiObj11RdrObjChks : 95|8@0+ (1.0,0.0) [0.0|255.0] "Unitless" ASDM,PAS
 SG_ FrntSideRdrRiObj11RdrObjCntr : 103|4@0+ (1.0,0.0) [0.0|15.0] "Unitless" ASDM,PAS
 SG_ FrntSideRdrRiObj11RdrObjCoastCnt : 279|5@0+ (1.0,0.0) [0.0|31.0] "Unitless" ASDM,PAS
 SG_ FrntSideRdrRiObj11RdrObjConf : 99|4@0+ (7.0,0.0) [0.0|105.0] "%" ASDM,PAS
 SG_ FrntSideRdrRiObj11RdrObjDx : 191|13@0+ (0.05,-200.0) [-200.0|200.0] "m" ASDM,PAS
 SG_ FrntSideRdrRiObj11RdrObjDxStdDe : 111|8@0+ (0.05,0.0) [0.0|12.700000000000001] "m" ASDM,PAS
 SG_ FrntSideRdrRiObj11RdrObjDy : 119|13@0+ (0.05,-200.0) [-200.0|200.0] "m" ASDM,PAS
 SG_ FrntSideRdrRiObj11RdrObjDyStdDe : 183|8@0+ (0.05,0.0) [0.0|12.700000000000001] "m" ASDM,PAS
 SG_ FrntSideRdrRiObj11RdrObjElevnConf : 223|4@0+ (7.0,0.0) [0.0|105.0] "%" ASDM,PAS
 SG_ FrntSideRdrRiObj11RdrObjElevnSts : 153|2@0+ (1,0) [0|3] "" ASDM,PAS
 SG_ FrntSideRdrRiObj11RdrObjID : 167|8@0+ (1.0,0.0) [0.0|255.0] "Unitless" ASDM,PAS
 SG_ FrntSideRdrRiObj11RdrObjIsInFreeSpace : 192|1@0+ (1,0) [0|1] "" ASDM,PAS
 SG_ FrntSideRdrRiObj11RdrObjMirrProblty : 219|4@0+ (7.0,0.0) [0.0|105.0] "%" ASDM,PAS
 SG_ FrntSideRdrRiObj11RdrObjMtnPat : 122|3@0+ (1,0) [0|7] "" ASDM,PAS
 SG_ FrntSideRdrRiObj11RdrObjNotRealProblty : 231|4@0+ (7.0,0.0) [0.0|105.0] "%" ASDM,PAS
 SG_ FrntSideRdrRiObj11RdrObjStatyCnt : 239|7@0+ (1.0,0.0) [0.0|127.0] "Unitless" ASDM,PAS
 SG_ FrntSideRdrRiObj11RdrObjTiAlv : 247|7@0+ (1.0,0.0) [0.0|127.0] "Unitless" ASDM,PAS
 SG_ FrntSideRdrRiObj11RdrObjTrackSts : 194|2@0+ (1,0) [0|3] "" ASDM,PAS
 SG_ FrntSideRdrRiObj11RdrObjTyp : 51|4@0+ (1,0) [0|15] "" ASDM,PAS
 SG_ FrntSideRdrRiObj11RdrObjTypConfBike : 175|4@0+ (7.0,0.0) [0.0|105.0] "%" ASDM,PAS
 SG_ FrntSideRdrRiObj11RdrObjTypConfPed : 171|4@0+ (7.0,0.0) [0.0|105.0] "%" ASDM,PAS
 SG_ FrntSideRdrRiObj11RdrObjTypConfVeh : 227|4@0+ (7.0,0.0) [0.0|105.0] "%" ASDM,PAS
 SG_ FrntSideRdrRiObj11RdrObjVx : 255|14@0+ (0.02,-128.0) [-128.0|128.0] "m/s" ASDM,PAS
 SG_ FrntSideRdrRiObj11RdrObjVxStdDe : 271|6@0+ (0.05,0.0) [0.0|2.0] "m/s" ASDM,PAS
 SG_ FrntSideRdrRiObj11RdrObjVy : 207|14@0+ (0.02,-128.0) [-128.0|128.0] "m/s" ASDM,PAS
 SG_ FrntSideRdrRiObj11RdrObjVyStdDe : 159|6@0+ (0.05,0.0) [0.0|2.0] "m/s" ASDM,PAS
 SG_ FrntSideRdrRiObj11RelVx : 135|12@0+ (0.02,-35.6) [-35.6|35.6] "m/s" ASDM,PAS
 SG_ FrntSideRdrRiObj11RelVy : 139|12@0+ (0.02,-35.6) [-35.6|35.6] "m/s" ASDM,PAS

BO_ 371 FSRRSafetyCANFD1Frame34: 64 FSRR
 SG_ FrntSideRdrRiObj12_UB : 291|1@0+ (1,0) [0|1] "" ASDM,PAS
 SG_ FrntSideRdrRiObj12Heading : 287|12@0+ (0.1,-180.0) [-180.0|180.0] "Deg" ASDM,PAS
 SG_ FrntSideRdrRiObj12ObjBoxCenterLat : 23|9@0+ (0.1,-25.0) [-25.0|25.0] "m" ASDM,PAS
 SG_ FrntSideRdrRiObj12ObjBoxCenterLgt : 30|9@0+ (0.1,-25.0) [-25.0|25.0] "m" ASDM,PAS
 SG_ FrntSideRdrRiObj12ObservationHist : 63|32@0+ (1.0,0.0) [0.0|4294967295.0] "Unitless" ASDM,PAS
 SG_ FrntSideRdrRiObj12RdrObjAx : 7|8@0- (0.1,0.0) [-12.8|12.700000000000001] "m/s^2" ASDM,PAS
 SG_ FrntSideRdrRiObj12RdrObjAy : 15|8@0- (0.1,0.0) [-12.8|12.700000000000001] "m/s^2" ASDM,PAS
 SG_ FrntSideRdrRiObj12RdrObjBoxLength : 37|9@0+ (0.1,0.0) [0.0|50.0] "m" ASDM,PAS
 SG_ FrntSideRdrRiObj12RdrObjBoxWidth : 44|9@0+ (0.1,0.0) [0.0|50.0] "m" ASDM,PAS
 SG_ FrntSideRdrRiObj12RdrObjChks : 95|8@0+ (1.0,0.0) [0.0|255.0] "Unitless" ASDM,PAS
 SG_ FrntSideRdrRiObj12RdrObjCntr : 103|4@0+ (1.0,0.0) [0.0|15.0] "Unitless" ASDM,PAS
 SG_ FrntSideRdrRiObj12RdrObjCoastCnt : 279|5@0+ (1.0,0.0) [0.0|31.0] "Unitless" ASDM,PAS
 SG_ FrntSideRdrRiObj12RdrObjConf : 99|4@0+ (7.0,0.0) [0.0|105.0] "%" ASDM,PAS
 SG_ FrntSideRdrRiObj12RdrObjDx : 191|13@0+ (0.05,-200.0) [-200.0|200.0] "m" ASDM,PAS
 SG_ FrntSideRdrRiObj12RdrObjDxStdDe : 111|8@0+ (0.05,0.0) [0.0|12.700000000000001] "m" ASDM,PAS
 SG_ FrntSideRdrRiObj12RdrObjDy : 119|13@0+ (0.05,-200.0) [-200.0|200.0] "m" ASDM,PAS
 SG_ FrntSideRdrRiObj12RdrObjDyStdDe : 183|8@0+ (0.05,0.0) [0.0|12.700000000000001] "m" ASDM,PAS
 SG_ FrntSideRdrRiObj12RdrObjElevnConf : 223|4@0+ (7.0,0.0) [0.0|105.0] "%" ASDM,PAS
 SG_ FrntSideRdrRiObj12RdrObjElevnSts : 153|2@0+ (1,0) [0|3] "" ASDM,PAS
 SG_ FrntSideRdrRiObj12RdrObjID : 167|8@0+ (1.0,0.0) [0.0|255.0] "Unitless" ASDM,PAS
 SG_ FrntSideRdrRiObj12RdrObjIsInFreeSpace : 192|1@0+ (1,0) [0|1] "" ASDM,PAS
 SG_ FrntSideRdrRiObj12RdrObjMirrProblty : 219|4@0+ (7.0,0.0) [0.0|105.0] "%" ASDM,PAS
 SG_ FrntSideRdrRiObj12RdrObjMtnPat : 122|3@0+ (1,0) [0|7] "" ASDM,PAS
 SG_ FrntSideRdrRiObj12RdrObjNotRealProblty : 231|4@0+ (7.0,0.0) [0.0|105.0] "%" ASDM,PAS
 SG_ FrntSideRdrRiObj12RdrObjStatyCnt : 239|7@0+ (1.0,0.0) [0.0|127.0] "Unitless" ASDM,PAS
 SG_ FrntSideRdrRiObj12RdrObjTiAlv : 247|7@0+ (1.0,0.0) [0.0|127.0] "Unitless" ASDM,PAS
 SG_ FrntSideRdrRiObj12RdrObjTrackSts : 194|2@0+ (1,0) [0|3] "" ASDM,PAS
 SG_ FrntSideRdrRiObj12RdrObjTyp : 51|4@0+ (1,0) [0|15] "" ASDM,PAS
 SG_ FrntSideRdrRiObj12RdrObjTypConfBike : 175|4@0+ (7.0,0.0) [0.0|105.0] "%" ASDM,PAS
 SG_ FrntSideRdrRiObj12RdrObjTypConfPed : 171|4@0+ (7.0,0.0) [0.0|105.0] "%" ASDM,PAS
 SG_ FrntSideRdrRiObj12RdrObjTypConfVeh : 227|4@0+ (7.0,0.0) [0.0|105.0] "%" ASDM,PAS
 SG_ FrntSideRdrRiObj12RdrObjVx : 255|14@0+ (0.02,-128.0) [-128.0|128.0] "m/s" ASDM,PAS
 SG_ FrntSideRdrRiObj12RdrObjVxStdDe : 271|6@0+ (0.05,0.0) [0.0|2.0] "m/s" ASDM,PAS
 SG_ FrntSideRdrRiObj12RdrObjVy : 207|14@0+ (0.02,-128.0) [-128.0|128.0] "m/s" ASDM,PAS
 SG_ FrntSideRdrRiObj12RdrObjVyStdDe : 159|6@0+ (0.05,0.0) [0.0|2.0] "m/s" ASDM,PAS
 SG_ FrntSideRdrRiObj12RelVx : 135|12@0+ (0.02,-35.6) [-35.6|35.6] "m/s" ASDM,PAS
 SG_ FrntSideRdrRiObj12RelVy : 139|12@0+ (0.02,-35.6) [-35.6|35.6] "m/s" ASDM,PAS

BO_ 373 FSRRSafetyCANFD1Frame35: 64 FSRR
 SG_ FrntSideRdrRiObj13_UB : 291|1@0+ (1,0) [0|1] "" ASDM,PAS
 SG_ FrntSideRdrRiObj13Heading : 287|12@0+ (0.1,-180.0) [-180.0|180.0] "Deg" ASDM,PAS
 SG_ FrntSideRdrRiObj13ObjBoxCenterLat : 23|9@0+ (0.1,-25.0) [-25.0|25.0] "m" ASDM,PAS
 SG_ FrntSideRdrRiObj13ObjBoxCenterLgt : 30|9@0+ (0.1,-25.0) [-25.0|25.0] "m" ASDM,PAS
 SG_ FrntSideRdrRiObj13ObservationHist : 63|32@0+ (1.0,0.0) [0.0|4294967295.0] "Unitless" ASDM,PAS
 SG_ FrntSideRdrRiObj13RdrObjAx : 7|8@0- (0.1,0.0) [-12.8|12.700000000000001] "m/s^2" ASDM,PAS
 SG_ FrntSideRdrRiObj13RdrObjAy : 15|8@0- (0.1,0.0) [-12.8|12.700000000000001] "m/s^2" ASDM,PAS
 SG_ FrntSideRdrRiObj13RdrObjBoxLength : 37|9@0+ (0.1,0.0) [0.0|50.0] "m" ASDM,PAS
 SG_ FrntSideRdrRiObj13RdrObjBoxWidth : 44|9@0+ (0.1,0.0) [0.0|50.0] "m" ASDM,PAS
 SG_ FrntSideRdrRiObj13RdrObjChks : 95|8@0+ (1.0,0.0) [0.0|255.0] "Unitless" ASDM,PAS
 SG_ FrntSideRdrRiObj13RdrObjCntr : 103|4@0+ (1.0,0.0) [0.0|15.0] "Unitless" ASDM,PAS
 SG_ FrntSideRdrRiObj13RdrObjCoastCnt : 279|5@0+ (1.0,0.0) [0.0|31.0] "Unitless" ASDM,PAS
 SG_ FrntSideRdrRiObj13RdrObjConf : 99|4@0+ (7.0,0.0) [0.0|105.0] "%" ASDM,PAS
 SG_ FrntSideRdrRiObj13RdrObjDx : 191|13@0+ (0.05,-200.0) [-200.0|200.0] "m" ASDM,PAS
 SG_ FrntSideRdrRiObj13RdrObjDxStdDe : 111|8@0+ (0.05,0.0) [0.0|12.700000000000001] "m" ASDM,PAS
 SG_ FrntSideRdrRiObj13RdrObjDy : 119|13@0+ (0.05,-200.0) [-200.0|200.0] "m" ASDM,PAS
 SG_ FrntSideRdrRiObj13RdrObjDyStdDe : 183|8@0+ (0.05,0.0) [0.0|12.700000000000001] "m" ASDM,PAS
 SG_ FrntSideRdrRiObj13RdrObjElevnConf : 223|4@0+ (7.0,0.0) [0.0|105.0] "%" ASDM,PAS
 SG_ FrntSideRdrRiObj13RdrObjElevnSts : 153|2@0+ (1,0) [0|3] "" ASDM,PAS
 SG_ FrntSideRdrRiObj13RdrObjID : 167|8@0+ (1.0,0.0) [0.0|255.0] "Unitless" ASDM,PAS
 SG_ FrntSideRdrRiObj13RdrObjIsInFreeSpace : 192|1@0+ (1,0) [0|1] "" ASDM,PAS
 SG_ FrntSideRdrRiObj13RdrObjMirrProblty : 219|4@0+ (7.0,0.0) [0.0|105.0] "%" ASDM,PAS
 SG_ FrntSideRdrRiObj13RdrObjMtnPat : 122|3@0+ (1,0) [0|7] "" ASDM,PAS
 SG_ FrntSideRdrRiObj13RdrObjNotRealProblty : 231|4@0+ (7.0,0.0) [0.0|105.0] "%" ASDM,PAS
 SG_ FrntSideRdrRiObj13RdrObjStatyCnt : 239|7@0+ (1.0,0.0) [0.0|127.0] "Unitless" ASDM,PAS
 SG_ FrntSideRdrRiObj13RdrObjTiAlv : 247|7@0+ (1.0,0.0) [0.0|127.0] "Unitless" ASDM,PAS
 SG_ FrntSideRdrRiObj13RdrObjTrackSts : 194|2@0+ (1,0) [0|3] "" ASDM,PAS
 SG_ FrntSideRdrRiObj13RdrObjTyp : 51|4@0+ (1,0) [0|15] "" ASDM,PAS
 SG_ FrntSideRdrRiObj13RdrObjTypConfBike : 175|4@0+ (7.0,0.0) [0.0|105.0] "%" ASDM,PAS
 SG_ FrntSideRdrRiObj13RdrObjTypConfPed : 171|4@0+ (7.0,0.0) [0.0|105.0] "%" ASDM,PAS
 SG_ FrntSideRdrRiObj13RdrObjTypConfVeh : 227|4@0+ (7.0,0.0) [0.0|105.0] "%" ASDM,PAS
 SG_ FrntSideRdrRiObj13RdrObjVx : 255|14@0+ (0.02,-128.0) [-128.0|128.0] "m/s" ASDM,PAS
 SG_ FrntSideRdrRiObj13RdrObjVxStdDe : 271|6@0+ (0.05,0.0) [0.0|2.0] "m/s" ASDM,PAS
 SG_ FrntSideRdrRiObj13RdrObjVy : 207|14@0+ (0.02,-128.0) [-128.0|128.0] "m/s" ASDM,PAS
 SG_ FrntSideRdrRiObj13RdrObjVyStdDe : 159|6@0+ (0.05,0.0) [0.0|2.0] "m/s" ASDM,PAS
 SG_ FrntSideRdrRiObj13RelVx : 135|12@0+ (0.02,-35.6) [-35.6|35.6] "m/s" ASDM,PAS
 SG_ FrntSideRdrRiObj13RelVy : 139|12@0+ (0.02,-35.6) [-35.6|35.6] "m/s" ASDM,PAS

BO_ 375 FSRRSafetyCANFD1Frame36: 64 FSRR
 SG_ FrntSideRdrRiObj14_UB : 291|1@0+ (1,0) [0|1] "" ASDM,PAS
 SG_ FrntSideRdrRiObj14Heading : 287|12@0+ (0.1,-180.0) [-180.0|180.0] "Deg" ASDM,PAS
 SG_ FrntSideRdrRiObj14ObjBoxCenterLat : 23|9@0+ (0.1,-25.0) [-25.0|25.0] "m" ASDM,PAS
 SG_ FrntSideRdrRiObj14ObjBoxCenterLgt : 30|9@0+ (0.1,-25.0) [-25.0|25.0] "m" ASDM,PAS
 SG_ FrntSideRdrRiObj14ObservationHist : 63|32@0+ (1.0,0.0) [0.0|4294967295.0] "Unitless" ASDM,PAS
 SG_ FrntSideRdrRiObj14RdrObjAx : 7|8@0- (0.1,0.0) [-12.8|12.700000000000001] "m/s^2" ASDM,PAS
 SG_ FrntSideRdrRiObj14RdrObjAy : 15|8@0- (0.1,0.0) [-12.8|12.700000000000001] "m/s^2" ASDM,PAS
 SG_ FrntSideRdrRiObj14RdrObjBoxLength : 37|9@0+ (0.1,0.0) [0.0|50.0] "m" ASDM,PAS
 SG_ FrntSideRdrRiObj14RdrObjBoxWidth : 44|9@0+ (0.1,0.0) [0.0|50.0] "m" ASDM,PAS
 SG_ FrntSideRdrRiObj14RdrObjChks : 95|8@0+ (1.0,0.0) [0.0|255.0] "Unitless" ASDM,PAS
 SG_ FrntSideRdrRiObj14RdrObjCntr : 103|4@0+ (1.0,0.0) [0.0|15.0] "Unitless" ASDM,PAS
 SG_ FrntSideRdrRiObj14RdrObjCoastCnt : 279|5@0+ (1.0,0.0) [0.0|31.0] "Unitless" ASDM,PAS
 SG_ FrntSideRdrRiObj14RdrObjConf : 99|4@0+ (7.0,0.0) [0.0|105.0] "%" ASDM,PAS
 SG_ FrntSideRdrRiObj14RdrObjDx : 191|13@0+ (0.05,-200.0) [-200.0|200.0] "m" ASDM,PAS
 SG_ FrntSideRdrRiObj14RdrObjDxStdDe : 111|8@0+ (0.05,0.0) [0.0|12.700000000000001] "m" ASDM,PAS
 SG_ FrntSideRdrRiObj14RdrObjDy : 119|13@0+ (0.05,-200.0) [-200.0|200.0] "m" ASDM,PAS
 SG_ FrntSideRdrRiObj14RdrObjDyStdDe : 183|8@0+ (0.05,0.0) [0.0|12.700000000000001] "m" ASDM,PAS
 SG_ FrntSideRdrRiObj14RdrObjElevnConf : 223|4@0+ (7.0,0.0) [0.0|105.0] "%" ASDM,PAS
 SG_ FrntSideRdrRiObj14RdrObjElevnSts : 153|2@0+ (1,0) [0|3] "" ASDM,PAS
 SG_ FrntSideRdrRiObj14RdrObjID : 167|8@0+ (1.0,0.0) [0.0|255.0] "Unitless" ASDM,PAS
 SG_ FrntSideRdrRiObj14RdrObjIsInFreeSpace : 192|1@0+ (1,0) [0|1] "" ASDM,PAS
 SG_ FrntSideRdrRiObj14RdrObjMirrProblty : 219|4@0+ (7.0,0.0) [0.0|105.0] "%" ASDM,PAS
 SG_ FrntSideRdrRiObj14RdrObjMtnPat : 122|3@0+ (1,0) [0|7] "" ASDM,PAS
 SG_ FrntSideRdrRiObj14RdrObjNotRealProblty : 231|4@0+ (7.0,0.0) [0.0|105.0] "%" ASDM,PAS
 SG_ FrntSideRdrRiObj14RdrObjStatyCnt : 239|7@0+ (1.0,0.0) [0.0|127.0] "Unitless" ASDM,PAS
 SG_ FrntSideRdrRiObj14RdrObjTiAlv : 247|7@0+ (1.0,0.0) [0.0|127.0] "Unitless" ASDM,PAS
 SG_ FrntSideRdrRiObj14RdrObjTrackSts : 194|2@0+ (1,0) [0|3] "" ASDM,PAS
 SG_ FrntSideRdrRiObj14RdrObjTyp : 51|4@0+ (1,0) [0|15] "" ASDM,PAS
 SG_ FrntSideRdrRiObj14RdrObjTypConfBike : 175|4@0+ (7.0,0.0) [0.0|105.0] "%" ASDM,PAS
 SG_ FrntSideRdrRiObj14RdrObjTypConfPed : 171|4@0+ (7.0,0.0) [0.0|105.0] "%" ASDM,PAS
 SG_ FrntSideRdrRiObj14RdrObjTypConfVeh : 227|4@0+ (7.0,0.0) [0.0|105.0] "%" ASDM,PAS
 SG_ FrntSideRdrRiObj14RdrObjVx : 255|14@0+ (0.02,-128.0) [-128.0|128.0] "m/s" ASDM,PAS
 SG_ FrntSideRdrRiObj14RdrObjVxStdDe : 271|6@0+ (0.05,0.0) [0.0|2.0] "m/s" ASDM,PAS
 SG_ FrntSideRdrRiObj14RdrObjVy : 207|14@0+ (0.02,-128.0) [-128.0|128.0] "m/s" ASDM,PAS
 SG_ FrntSideRdrRiObj14RdrObjVyStdDe : 159|6@0+ (0.05,0.0) [0.0|2.0] "m/s" ASDM,PAS
 SG_ FrntSideRdrRiObj14RelVx : 135|12@0+ (0.02,-35.6) [-35.6|35.6] "m/s" ASDM,PAS
 SG_ FrntSideRdrRiObj14RelVy : 139|12@0+ (0.02,-35.6) [-35.6|35.6] "m/s" ASDM,PAS

BO_ 377 FSRRSafetyCANFD1Frame37: 64 FSRR
 SG_ FrntSideRdrRiObj15_UB : 291|1@0+ (1,0) [0|1] "" ASDM,PAS
 SG_ FrntSideRdrRiObj15Heading : 287|12@0+ (0.1,-180.0) [-180.0|180.0] "Deg" ASDM,PAS
 SG_ FrntSideRdrRiObj15ObjBoxCenterLat : 23|9@0+ (0.1,-25.0) [-25.0|25.0] "m" ASDM,PAS
 SG_ FrntSideRdrRiObj15ObjBoxCenterLgt : 30|9@0+ (0.1,-25.0) [-25.0|25.0] "m" ASDM,PAS
 SG_ FrntSideRdrRiObj15ObservationHist : 63|32@0+ (1.0,0.0) [0.0|4294967295.0] "Unitless" ASDM,PAS
 SG_ FrntSideRdrRiObj15RdrObjAx : 7|8@0- (0.1,0.0) [-12.8|12.700000000000001] "m/s^2" ASDM,PAS
 SG_ FrntSideRdrRiObj15RdrObjAy : 15|8@0- (0.1,0.0) [-12.8|12.700000000000001] "m/s^2" ASDM,PAS
 SG_ FrntSideRdrRiObj15RdrObjBoxLength : 37|9@0+ (0.1,0.0) [0.0|50.0] "m" ASDM,PAS
 SG_ FrntSideRdrRiObj15RdrObjBoxWidth : 44|9@0+ (0.1,0.0) [0.0|50.0] "m" ASDM,PAS
 SG_ FrntSideRdrRiObj15RdrObjChks : 95|8@0+ (1.0,0.0) [0.0|255.0] "Unitless" ASDM,PAS
 SG_ FrntSideRdrRiObj15RdrObjCntr : 103|4@0+ (1.0,0.0) [0.0|15.0] "Unitless" ASDM,PAS
 SG_ FrntSideRdrRiObj15RdrObjCoastCnt : 279|5@0+ (1.0,0.0) [0.0|31.0] "Unitless" ASDM,PAS
 SG_ FrntSideRdrRiObj15RdrObjConf : 99|4@0+ (7.0,0.0) [0.0|105.0] "%" ASDM,PAS
 SG_ FrntSideRdrRiObj15RdrObjDx : 191|13@0+ (0.05,-200.0) [-200.0|200.0] "m" ASDM,PAS
 SG_ FrntSideRdrRiObj15RdrObjDxStdDe : 111|8@0+ (0.05,0.0) [0.0|12.700000000000001] "m" ASDM,PAS
 SG_ FrntSideRdrRiObj15RdrObjDy : 119|13@0+ (0.05,-200.0) [-200.0|200.0] "m" ASDM,PAS
 SG_ FrntSideRdrRiObj15RdrObjDyStdDe : 183|8@0+ (0.05,0.0) [0.0|12.700000000000001] "m" ASDM,PAS
 SG_ FrntSideRdrRiObj15RdrObjElevnConf : 223|4@0+ (7.0,0.0) [0.0|105.0] "%" ASDM,PAS
 SG_ FrntSideRdrRiObj15RdrObjElevnSts : 153|2@0+ (1,0) [0|3] "" ASDM,PAS
 SG_ FrntSideRdrRiObj15RdrObjID : 167|8@0+ (1.0,0.0) [0.0|255.0] "Unitless" ASDM,PAS
 SG_ FrntSideRdrRiObj15RdrObjIsInFreeSpace : 192|1@0+ (1,0) [0|1] "" ASDM,PAS
 SG_ FrntSideRdrRiObj15RdrObjMirrProblty : 219|4@0+ (7.0,0.0) [0.0|105.0] "%" ASDM,PAS
 SG_ FrntSideRdrRiObj15RdrObjMtnPat : 122|3@0+ (1,0) [0|7] "" ASDM,PAS
 SG_ FrntSideRdrRiObj15RdrObjNotRealProblty : 231|4@0+ (7.0,0.0) [0.0|105.0] "%" ASDM,PAS
 SG_ FrntSideRdrRiObj15RdrObjStatyCnt : 239|7@0+ (1.0,0.0) [0.0|127.0] "Unitless" ASDM,PAS
 SG_ FrntSideRdrRiObj15RdrObjTiAlv : 247|7@0+ (1.0,0.0) [0.0|127.0] "Unitless" ASDM,PAS
 SG_ FrntSideRdrRiObj15RdrObjTrackSts : 194|2@0+ (1,0) [0|3] "" ASDM,PAS
 SG_ FrntSideRdrRiObj15RdrObjTyp : 51|4@0+ (1,0) [0|15] "" ASDM,PAS
 SG_ FrntSideRdrRiObj15RdrObjTypConfBike : 175|4@0+ (7.0,0.0) [0.0|105.0] "%" ASDM,PAS
 SG_ FrntSideRdrRiObj15RdrObjTypConfPed : 171|4@0+ (7.0,0.0) [0.0|105.0] "%" ASDM,PAS
 SG_ FrntSideRdrRiObj15RdrObjTypConfVeh : 227|4@0+ (7.0,0.0) [0.0|105.0] "%" ASDM,PAS
 SG_ FrntSideRdrRiObj15RdrObjVx : 255|14@0+ (0.02,-128.0) [-128.0|128.0] "m/s" ASDM,PAS
 SG_ FrntSideRdrRiObj15RdrObjVxStdDe : 271|6@0+ (0.05,0.0) [0.0|2.0] "m/s" ASDM,PAS
 SG_ FrntSideRdrRiObj15RdrObjVy : 207|14@0+ (0.02,-128.0) [-128.0|128.0] "m/s" ASDM,PAS
 SG_ FrntSideRdrRiObj15RdrObjVyStdDe : 159|6@0+ (0.05,0.0) [0.0|2.0] "m/s" ASDM,PAS
 SG_ FrntSideRdrRiObj15RelVx : 135|12@0+ (0.02,-35.6) [-35.6|35.6] "m/s" ASDM,PAS
 SG_ FrntSideRdrRiObj15RelVy : 139|12@0+ (0.02,-35.6) [-35.6|35.6] "m/s" ASDM,PAS

BO_ 1282 FsrrSafetyCanFD1NMFr: 8 FSRR
 SG_ PNC16_FSRR : 16|1@0+ (1,0) [0|0] "" FSRL
 SG_ PNC17_FSRR : 17|1@0+ (1,0) [0|0] "" FSRL
 SG_ PNC18_FSRR : 18|1@0+ (1,0) [0|0] "" FSRL
 SG_ PNC19_FSRR : 19|1@0+ (1,0) [0|0] "" FSRL
 SG_ PNC20_FSRR : 20|1@0+ (1,0) [0|0] "" FSRL
 SG_ PNC21_FSRR : 21|1@0+ (1,0) [0|0] "" FSRL
 SG_ PNC22_FSRR : 22|1@0+ (1,0) [0|0] "" FSRL
 SG_ PNC23_FSRR : 23|1@0+ (1,0) [0|0] "" FSRL
 SG_ PNC24_FSRR : 24|1@0+ (1,0) [0|0] "" FSRL
 SG_ PNC25_FSRR : 25|1@0+ (1,0) [0|0] "" FSRL
 SG_ PNC26_FSRR : 26|1@0+ (1,0) [0|0] "" FSRL
 SG_ PNC27_FSRR : 27|1@0+ (1,0) [0|0] "" FSRL
 SG_ PNC28_FSRR : 28|1@0+ (1,0) [0|0] "" FSRL
 SG_ PNC29_FSRR : 29|1@0+ (1,0) [0|0] "" FSRL
 SG_ PNC30_FSRR : 30|1@0+ (1,0) [0|0] "" FSRL
 SG_ PNC31_FSRR : 31|1@0+ (1,0) [0|0] "" FSRL
 SG_ PNC32_FSRR : 32|1@0+ (1,0) [0|0] "" FSRL
 SG_ PNC33_FSRR : 33|1@0+ (1,0) [0|0] "" FSRL
 SG_ PNC34_FSRR : 34|1@0+ (1,0) [0|0] "" FSRL
 SG_ PNC35_FSRR : 35|1@0+ (1,0) [0|0] "" FSRL
 SG_ PNC36_FSRR : 36|1@0+ (1,0) [0|0] "" FSRL
 SG_ PNC37_FSRR : 37|1@0+ (1,0) [0|0] "" FSRL
 SG_ PNC38_FSRR : 38|1@0+ (1,0) [0|0] "" FSRL
 SG_ PNC39_FSRR : 39|1@0+ (1,0) [0|0] "" FSRL
 SG_ NM_PNI_FSRR : 14|1@0+ (1,0) [0|0] "" FSRL
 SG_ NM_AW_FSRR : 12|1@0+ (1,0) [0|0] "" FSRL
 SG_ NM_CS_FSRR : 11|1@0+ (1,0) [0|0] "" FSRL
 SG_ NM_RMR_FSRR : 8|1@0+ (1,0) [0|0] "" FSRL
 SG_ NM_NodeID_FSRR : 7|8@0+ (1,0) [0|0] "" FSRL

BO_ 1584 FsrrToAsdmSafetyCanFD1DiagResFrame: 64 FSRR
 SG_ FsrrToAsdmSafetyCanFD1DiagResNpdu : 7|512@0+ (1,0) [0|0] "" ASDM

BO_ 1416 FsrrtoEtcXcpFr01: 8 FSRR

BO_ 1428 FsrrtoEtcXcpFr02: 8 FSRR

CM_ SG_ 355 FrntSideRdrRiObj4Heading "Refer to the data element description in ReSideRdrRiObj1 with the same data element name";
CM_ SG_ 355 FrntSideRdrRiObj4ObjBoxCenterLat "Box center y coordinate (relative closest point)";
CM_ SG_ 355 FrntSideRdrRiObj4ObjBoxCenterLgt "Box center x coordinate (relative closest point)";
CM_ SG_ 355 FrntSideRdrRiObj4ObservationHist "Refer to the data element description in ReSideRdrRiObj1 with the same data element name";
CM_ SG_ 355 FrntSideRdrRiObj4RdrObjAx "Refer to the data element description in FrntSideRdrLeObj1 with the same data element name.";
CM_ SG_ 355 FrntSideRdrRiObj4RdrObjAy "Refer to the data element description in FrntSideRdrLeObj1 with the same data element name.";
CM_ SG_ 355 FrntSideRdrRiObj4RdrObjBoxLength "Box length (box extent that is parallel to objects heading angle)";
CM_ SG_ 355 FrntSideRdrRiObj4RdrObjBoxWidth "Box width (box extent that is perpendicular to objects heading angle)";
CM_ SG_ 355 FrntSideRdrRiObj4RdrObjChks "Refer to the data element description in FrntSideRdrLeObj1 with the same data element name.";
CM_ SG_ 355 FrntSideRdrRiObj4RdrObjCntr "Refer to the data element description in FrntSideRdrLeObj1 with the same data element name.";
CM_ SG_ 355 FrntSideRdrRiObj4RdrObjCoastCnt "Refer to the data element description in FrntSideRdrLeObj1 with the same data element name.";
CM_ SG_ 355 FrntSideRdrRiObj4RdrObjConf "Refer to the data element description in FrntSideRdrLeObj1 with the same data element name.";
CM_ SG_ 355 FrntSideRdrRiObj4RdrObjDx "Refer to the data element description in FrntSideRdrLeObj1 with the same data element name.";
CM_ SG_ 355 FrntSideRdrRiObj4RdrObjDxStdDe "Refer to the data element description in FrntSideRdrLeObj1 with the same data element name.";
CM_ SG_ 355 FrntSideRdrRiObj4RdrObjDy "Refer to the data element description in FrntSideRdrLeObj1 with the same data element name.";
CM_ SG_ 355 FrntSideRdrRiObj4RdrObjDyStdDe "Refer to the data element description in FrntSideRdrLeObj1 with the same data element name.";
CM_ SG_ 355 FrntSideRdrRiObj4RdrObjElevnConf "Refer to the data element description in FrntSideRdrLeObj1 with the same data element name.";
CM_ SG_ 355 FrntSideRdrRiObj4RdrObjElevnSts "Refer to the data element description in FrntSideRdrLeObj1 with the same data element name.";
CM_ SG_ 355 FrntSideRdrRiObj4RdrObjID "Refer to the data element description in FrntSideRdrLeObj1 with the same data element name.";
CM_ SG_ 355 FrntSideRdrRiObj4RdrObjIsInFreeSpace "Refer to the data element description in FrntSideRdrLeObj1 with the same data element name.";
CM_ SG_ 355 FrntSideRdrRiObj4RdrObjMirrProblty "Refer to the data element description in FrntSideRdrLeObj1 with the same data element name.";
CM_ SG_ 355 FrntSideRdrRiObj4RdrObjMtnPat "Refer to the data element description in FrntSideRdrLeObj1 with the same data element name.";
CM_ SG_ 355 FrntSideRdrRiObj4RdrObjNotRealProblty "Refer to the data element description in FrntSideRdrLeObj1 with the same data element name.";
CM_ SG_ 355 FrntSideRdrRiObj4RdrObjStatyCnt "Refer to the data element description in FrntSideRdrLeObj1 with the same data element name.";
CM_ SG_ 355 FrntSideRdrRiObj4RdrObjTiAlv "Refer to the data element description in FrntSideRdrLeObj1 with the same data element name.";
CM_ SG_ 355 FrntSideRdrRiObj4RdrObjTrackSts "Refer to the data element description in FrntSideRdrLeObj1 with the same data element name.";
CM_ SG_ 355 FrntSideRdrRiObj4RdrObjTyp "Refer to the data element description in FrntSideRdrLeObj1 with the same data element name.";
CM_ SG_ 355 FrntSideRdrRiObj4RdrObjTypConfBike "Refer to the data element description in FrntSideRdrLeObj1 with the same data element name.";
CM_ SG_ 355 FrntSideRdrRiObj4RdrObjTypConfPed "Refer to the data element description in FrntSideRdrLeObj1 with the same data element name.";
CM_ SG_ 355 FrntSideRdrRiObj4RdrObjTypConfVeh "Refer to the data element description in FrntSideRdrLeObj1 with the same data element name.";
CM_ SG_ 355 FrntSideRdrRiObj4RdrObjVx "Refer to the data element description in FrntSideRdrLeObj1 with the same data element name.";
CM_ SG_ 355 FrntSideRdrRiObj4RdrObjVxStdDe "Refer to the data element description in FrntSideRdrLeObj1 with the same data element name.";
CM_ SG_ 355 FrntSideRdrRiObj4RdrObjVy "Refer to the data element description in FrntSideRdrLeObj1 with the same data element name.";
CM_ SG_ 355 FrntSideRdrRiObj4RdrObjVyStdDe "Refer to the data element description in FrntSideRdrLeObj1 with the same data element name.";
CM_ SG_ 355 FrntSideRdrRiObj4RelVx "Refer to the data element description in ReSideRdrRiObj1 with the same data element name";
CM_ SG_ 355 FrntSideRdrRiObj4RelVy "Refer to the data element description in ReSideRdrRiObj1 with the same data element name";
CM_ SG_ 357 FrntSideRdrRiObj5Heading "Refer to the data element description in ReSideRdrRiObj1 with the same data element name";
CM_ SG_ 357 FrntSideRdrRiObj5ObjBoxCenterLat "Box center y coordinate (relative closest point)";
CM_ SG_ 357 FrntSideRdrRiObj5ObjBoxCenterLgt "Box center x coordinate (relative closest point)";
CM_ SG_ 357 FrntSideRdrRiObj5ObservationHist "Refer to the data element description in ReSideRdrRiObj1 with the same data element name";
CM_ SG_ 357 FrntSideRdrRiObj5RdrObjAx "Refer to the data element description in FrntSideRdrLeObj1 with the same data element name.";
CM_ SG_ 357 FrntSideRdrRiObj5RdrObjAy "Refer to the data element description in FrntSideRdrLeObj1 with the same data element name.";
CM_ SG_ 357 FrntSideRdrRiObj5RdrObjBoxLength "Box length (box extent that is parallel to objects heading angle)";
CM_ SG_ 357 FrntSideRdrRiObj5RdrObjBoxWidth "Box width (box extent that is perpendicular to objects heading angle)";
CM_ SG_ 357 FrntSideRdrRiObj5RdrObjChks "Refer to the data element description in FrntSideRdrLeObj1 with the same data element name.";
CM_ SG_ 357 FrntSideRdrRiObj5RdrObjCntr "Refer to the data element description in FrntSideRdrLeObj1 with the same data element name.";
CM_ SG_ 357 FrntSideRdrRiObj5RdrObjCoastCnt "Refer to the data element description in FrntSideRdrLeObj1 with the same data element name.";
CM_ SG_ 357 FrntSideRdrRiObj5RdrObjConf "Refer to the data element description in FrntSideRdrLeObj1 with the same data element name.";
CM_ SG_ 357 FrntSideRdrRiObj5RdrObjDx "Refer to the data element description in FrntSideRdrLeObj1 with the same data element name.";
CM_ SG_ 357 FrntSideRdrRiObj5RdrObjDxStdDe "Refer to the data element description in FrntSideRdrLeObj1 with the same data element name.";
CM_ SG_ 357 FrntSideRdrRiObj5RdrObjDy "Refer to the data element description in FrntSideRdrLeObj1 with the same data element name.";
CM_ SG_ 357 FrntSideRdrRiObj5RdrObjDyStdDe "Refer to the data element description in FrntSideRdrLeObj1 with the same data element name.";
CM_ SG_ 357 FrntSideRdrRiObj5RdrObjElevnConf "Refer to the data element description in FrntSideRdrLeObj1 with the same data element name.";
CM_ SG_ 357 FrntSideRdrRiObj5RdrObjElevnSts "Refer to the data element description in FrntSideRdrLeObj1 with the same data element name.";
CM_ SG_ 357 FrntSideRdrRiObj5RdrObjID "Refer to the data element description in FrntSideRdrLeObj1 with the same data element name.";
CM_ SG_ 357 FrntSideRdrRiObj5RdrObjIsInFreeSpace "Refer to the data element description in FrntSideRdrLeObj1 with the same data element name.";
CM_ SG_ 357 FrntSideRdrRiObj5RdrObjMirrProblty "Refer to the data element description in FrntSideRdrLeObj1 with the same data element name.";
CM_ SG_ 357 FrntSideRdrRiObj5RdrObjMtnPat "Refer to the data element description in FrntSideRdrLeObj1 with the same data element name.";
CM_ SG_ 357 FrntSideRdrRiObj5RdrObjNotRealProblty "Refer to the data element description in FrntSideRdrLeObj1 with the same data element name.";
CM_ SG_ 357 FrntSideRdrRiObj5RdrObjStatyCnt "Refer to the data element description in FrntSideRdrLeObj1 with the same data element name.";
CM_ SG_ 357 FrntSideRdrRiObj5RdrObjTiAlv "Refer to the data element description in FrntSideRdrLeObj1 with the same data element name.";
CM_ SG_ 357 FrntSideRdrRiObj5RdrObjTrackSts "Refer to the data element description in FrntSideRdrLeObj1 with the same data element name.";
CM_ SG_ 357 FrntSideRdrRiObj5RdrObjTyp "Refer to the data element description in FrntSideRdrLeObj1 with the same data element name.";
CM_ SG_ 357 FrntSideRdrRiObj5RdrObjTypConfBike "Refer to the data element description in FrntSideRdrLeObj1 with the same data element name.";
CM_ SG_ 357 FrntSideRdrRiObj5RdrObjTypConfPed "Refer to the data element description in FrntSideRdrLeObj1 with the same data element name.";
CM_ SG_ 357 FrntSideRdrRiObj5RdrObjTypConfVeh "Refer to the data element description in FrntSideRdrLeObj1 with the same data element name.";
CM_ SG_ 357 FrntSideRdrRiObj5RdrObjVx "Refer to the data element description in FrntSideRdrLeObj1 with the same data element name.";
CM_ SG_ 357 FrntSideRdrRiObj5RdrObjVxStdDe "Refer to the data element description in FrntSideRdrLeObj1 with the same data element name.";
CM_ SG_ 357 FrntSideRdrRiObj5RdrObjVy "Refer to the data element description in FrntSideRdrLeObj1 with the same data element name.";
CM_ SG_ 357 FrntSideRdrRiObj5RdrObjVyStdDe "Refer to the data element description in FrntSideRdrLeObj1 with the same data element name.";
CM_ SG_ 357 FrntSideRdrRiObj5RelVx "Refer to the data element description in ReSideRdrRiObj1 with the same data element name";
CM_ SG_ 357 FrntSideRdrRiObj5RelVy "Refer to the data element description in ReSideRdrRiObj1 with the same data element name";
CM_ SG_ 359 FrntSideRdrRiObj6Heading "Refer to the data element description in ReSideRdrRiObj1 with the same data element name";
CM_ SG_ 359 FrntSideRdrRiObj6ObjBoxCenterLat "Box center y coordinate (relative closest point)";
CM_ SG_ 359 FrntSideRdrRiObj6ObjBoxCenterLgt "Box center x coordinate (relative closest point)";
CM_ SG_ 359 FrntSideRdrRiObj6ObservationHist "Refer to the data element description in ReSideRdrRiObj1 with the same data element name";
CM_ SG_ 359 FrntSideRdrRiObj6RdrObjAx "Refer to the data element description in FrntSideRdrLeObj1 with the same data element name.";
CM_ SG_ 359 FrntSideRdrRiObj6RdrObjAy "Refer to the data element description in FrntSideRdrLeObj1 with the same data element name.";
CM_ SG_ 359 FrntSideRdrRiObj6RdrObjBoxLength "Box length (box extent that is parallel to objects heading angle)";
CM_ SG_ 359 FrntSideRdrRiObj6RdrObjBoxWidth "Box width (box extent that is perpendicular to objects heading angle)";
CM_ SG_ 359 FrntSideRdrRiObj6RdrObjChks "Refer to the data element description in FrntSideRdrLeObj1 with the same data element name.";
CM_ SG_ 359 FrntSideRdrRiObj6RdrObjCntr "Refer to the data element description in FrntSideRdrLeObj1 with the same data element name.";
CM_ SG_ 359 FrntSideRdrRiObj6RdrObjCoastCnt "Refer to the data element description in FrntSideRdrLeObj1 with the same data element name.";
CM_ SG_ 359 FrntSideRdrRiObj6RdrObjConf "Refer to the data element description in FrntSideRdrLeObj1 with the same data element name.";
CM_ SG_ 359 FrntSideRdrRiObj6RdrObjDx "Refer to the data element description in FrntSideRdrLeObj1 with the same data element name.";
CM_ SG_ 359 FrntSideRdrRiObj6RdrObjDxStdDe "Refer to the data element description in FrntSideRdrLeObj1 with the same data element name.";
CM_ SG_ 359 FrntSideRdrRiObj6RdrObjDy "Refer to the data element description in FrntSideRdrLeObj1 with the same data element name.";
CM_ SG_ 359 FrntSideRdrRiObj6RdrObjDyStdDe "Refer to the data element description in FrntSideRdrLeObj1 with the same data element name.";
CM_ SG_ 359 FrntSideRdrRiObj6RdrObjElevnConf "Refer to the data element description in FrntSideRdrLeObj1 with the same data element name.";
CM_ SG_ 359 FrntSideRdrRiObj6RdrObjElevnSts "Refer to the data element description in FrntSideRdrLeObj1 with the same data element name.";
CM_ SG_ 359 FrntSideRdrRiObj6RdrObjID "Refer to the data element description in FrntSideRdrLeObj1 with the same data element name.";
CM_ SG_ 359 FrntSideRdrRiObj6RdrObjIsInFreeSpace "Refer to the data element description in FrntSideRdrLeObj1 with the same data element name.";
CM_ SG_ 359 FrntSideRdrRiObj6RdrObjMirrProblty "Refer to the data element description in FrntSideRdrLeObj1 with the same data element name.";
CM_ SG_ 359 FrntSideRdrRiObj6RdrObjMtnPat "Refer to the data element description in FrntSideRdrLeObj1 with the same data element name.";
CM_ SG_ 359 FrntSideRdrRiObj6RdrObjNotRealProblty "Refer to the data element description in FrntSideRdrLeObj1 with the same data element name.";
CM_ SG_ 359 FrntSideRdrRiObj6RdrObjStatyCnt "Refer to the data element description in FrntSideRdrLeObj1 with the same data element name.";
CM_ SG_ 359 FrntSideRdrRiObj6RdrObjTiAlv "Refer to the data element description in FrntSideRdrLeObj1 with the same data element name.";
CM_ SG_ 359 FrntSideRdrRiObj6RdrObjTrackSts "Refer to the data element description in FrntSideRdrLeObj1 with the same data element name.";
CM_ SG_ 359 FrntSideRdrRiObj6RdrObjTyp "Refer to the data element description in FrntSideRdrLeObj1 with the same data element name.";
CM_ SG_ 359 FrntSideRdrRiObj6RdrObjTypConfBike "Refer to the data element description in FrntSideRdrLeObj1 with the same data element name.";
CM_ SG_ 359 FrntSideRdrRiObj6RdrObjTypConfPed "Refer to the data element description in FrntSideRdrLeObj1 with the same data element name.";
CM_ SG_ 359 FrntSideRdrRiObj6RdrObjTypConfVeh "Refer to the data element description in FrntSideRdrLeObj1 with the same data element name.";
CM_ SG_ 359 FrntSideRdrRiObj6RdrObjVx "Refer to the data element description in FrntSideRdrLeObj1 with the same data element name.";
CM_ SG_ 359 FrntSideRdrRiObj6RdrObjVxStdDe "Refer to the data element description in FrntSideRdrLeObj1 with the same data element name.";
CM_ SG_ 359 FrntSideRdrRiObj6RdrObjVy "Refer to the data element description in FrntSideRdrLeObj1 with the same data element name.";
CM_ SG_ 359 FrntSideRdrRiObj6RdrObjVyStdDe "Refer to the data element description in FrntSideRdrLeObj1 with the same data element name.";
CM_ SG_ 359 FrntSideRdrRiObj6RelVx "Refer to the data element description in ReSideRdrRiObj1 with the same data element name";
CM_ SG_ 359 FrntSideRdrRiObj6RelVy "Refer to the data element description in ReSideRdrRiObj1 with the same data element name";
CM_ SG_ 361 FrntSideRdrRiObj7Heading "Refer to the data element description in ReSideRdrRiObj1 with the same data element name";
CM_ SG_ 361 FrntSideRdrRiObj7ObjBoxCenterLat "Box center y coordinate (relative closest point)";
CM_ SG_ 361 FrntSideRdrRiObj7ObjBoxCenterLgt "Box center x coordinate (relative closest point)";
CM_ SG_ 361 FrntSideRdrRiObj7ObservationHist "Refer to the data element description in ReSideRdrRiObj1 with the same data element name";
CM_ SG_ 361 FrntSideRdrRiObj7RdrObjAx "Refer to the data element description in FrntSideRdrLeObj1 with the same data element name.";
CM_ SG_ 361 FrntSideRdrRiObj7RdrObjAy "Refer to the data element description in FrntSideRdrLeObj1 with the same data element name.";
CM_ SG_ 361 FrntSideRdrRiObj7RdrObjBoxLength "Box length (box extent that is parallel to objects heading angle)";
CM_ SG_ 361 FrntSideRdrRiObj7RdrObjBoxWidth "Box width (box extent that is perpendicular to objects heading angle)";
CM_ SG_ 361 FrntSideRdrRiObj7RdrObjChks "Refer to the data element description in FrntSideRdrLeObj1 with the same data element name.";
CM_ SG_ 361 FrntSideRdrRiObj7RdrObjCntr "Refer to the data element description in FrntSideRdrLeObj1 with the same data element name.";
CM_ SG_ 361 FrntSideRdrRiObj7RdrObjCoastCnt "Refer to the data element description in FrntSideRdrLeObj1 with the same data element name.";
CM_ SG_ 361 FrntSideRdrRiObj7RdrObjConf "Refer to the data element description in FrntSideRdrLeObj1 with the same data element name.";
CM_ SG_ 361 FrntSideRdrRiObj7RdrObjDx "Refer to the data element description in FrntSideRdrLeObj1 with the same data element name.";
CM_ SG_ 361 FrntSideRdrRiObj7RdrObjDxStdDe "Refer to the data element description in FrntSideRdrLeObj1 with the same data element name.";
CM_ SG_ 361 FrntSideRdrRiObj7RdrObjDy "Refer to the data element description in FrntSideRdrLeObj1 with the same data element name.";
CM_ SG_ 361 FrntSideRdrRiObj7RdrObjDyStdDe "Refer to the data element description in FrntSideRdrLeObj1 with the same data element name.";
CM_ SG_ 361 FrntSideRdrRiObj7RdrObjElevnConf "Refer to the data element description in FrntSideRdrLeObj1 with the same data element name.";
CM_ SG_ 361 FrntSideRdrRiObj7RdrObjElevnSts "Refer to the data element description in FrntSideRdrLeObj1 with the same data element name.";
CM_ SG_ 361 FrntSideRdrRiObj7RdrObjID "Refer to the data element description in FrntSideRdrLeObj1 with the same data element name.";
CM_ SG_ 361 FrntSideRdrRiObj7RdrObjIsInFreeSpace "Refer to the data element description in FrntSideRdrLeObj1 with the same data element name.";
CM_ SG_ 361 FrntSideRdrRiObj7RdrObjMirrProblty "Refer to the data element description in FrntSideRdrLeObj1 with the same data element name.";
CM_ SG_ 361 FrntSideRdrRiObj7RdrObjMtnPat "Refer to the data element description in FrntSideRdrLeObj1 with the same data element name.";
CM_ SG_ 361 FrntSideRdrRiObj7RdrObjNotRealProblty "Refer to the data element description in FrntSideRdrLeObj1 with the same data element name.";
CM_ SG_ 361 FrntSideRdrRiObj7RdrObjStatyCnt "Refer to the data element description in FrntSideRdrLeObj1 with the same data element name.";
CM_ SG_ 361 FrntSideRdrRiObj7RdrObjTiAlv "Refer to the data element description in FrntSideRdrLeObj1 with the same data element name.";
CM_ SG_ 361 FrntSideRdrRiObj7RdrObjTrackSts "Refer to the data element description in FrntSideRdrLeObj1 with the same data element name.";
CM_ SG_ 361 FrntSideRdrRiObj7RdrObjTyp "Refer to the data element description in FrntSideRdrLeObj1 with the same data element name.";
CM_ SG_ 361 FrntSideRdrRiObj7RdrObjTypConfBike "Refer to the data element description in FrntSideRdrLeObj1 with the same data element name.";
CM_ SG_ 361 FrntSideRdrRiObj7RdrObjTypConfPed "Refer to the data element description in FrntSideRdrLeObj1 with the same data element name.";
CM_ SG_ 361 FrntSideRdrRiObj7RdrObjTypConfVeh "Refer to the data element description in FrntSideRdrLeObj1 with the same data element name.";
CM_ SG_ 361 FrntSideRdrRiObj7RdrObjVx "Refer to the data element description in FrntSideRdrLeObj1 with the same data element name.";
CM_ SG_ 361 FrntSideRdrRiObj7RdrObjVxStdDe "Refer to the data element description in FrntSideRdrLeObj1 with the same data element name.";
CM_ SG_ 361 FrntSideRdrRiObj7RdrObjVy "Refer to the data element description in FrntSideRdrLeObj1 with the same data element name.";
CM_ SG_ 361 FrntSideRdrRiObj7RdrObjVyStdDe "Refer to the data element description in FrntSideRdrLeObj1 with the same data element name.";
CM_ SG_ 361 FrntSideRdrRiObj7RelVx "Refer to the data element description in ReSideRdrRiObj1 with the same data element name";
CM_ SG_ 361 FrntSideRdrRiObj7RelVy "Refer to the data element description in ReSideRdrRiObj1 with the same data element name";
CM_ SG_ 363 FrntSideRdrRiObj8Heading "Refer to the data element description in ReSideRdrRiObj1 with the same data element name";
CM_ SG_ 363 FrntSideRdrRiObj8ObjBoxCenterLat "Box center y coordinate (relative closest point)";
CM_ SG_ 363 FrntSideRdrRiObj8ObjBoxCenterLgt "Box center x coordinate (relative closest point)";
CM_ SG_ 363 FrntSideRdrRiObj8ObservationHist "Refer to the data element description in ReSideRdrRiObj1 with the same data element name";
CM_ SG_ 363 FrntSideRdrRiObj8RdrObjAx "Refer to the data element description in FrntSideRdrLeObj1 with the same data element name.";
CM_ SG_ 363 FrntSideRdrRiObj8RdrObjAy "Refer to the data element description in FrntSideRdrLeObj1 with the same data element name.";
CM_ SG_ 363 FrntSideRdrRiObj8RdrObjBoxLength "Box length (box extent that is parallel to objects heading angle)";
CM_ SG_ 363 FrntSideRdrRiObj8RdrObjBoxWidth "Box width (box extent that is perpendicular to objects heading angle)";
CM_ SG_ 363 FrntSideRdrRiObj8RdrObjChks "Refer to the data element description in FrntSideRdrLeObj1 with the same data element name.";
CM_ SG_ 363 FrntSideRdrRiObj8RdrObjCntr "Refer to the data element description in FrntSideRdrLeObj1 with the same data element name.";
CM_ SG_ 363 FrntSideRdrRiObj8RdrObjCoastCnt "Refer to the data element description in FrntSideRdrLeObj1 with the same data element name.";
CM_ SG_ 363 FrntSideRdrRiObj8RdrObjConf "Refer to the data element description in FrntSideRdrLeObj1 with the same data element name.";
CM_ SG_ 363 FrntSideRdrRiObj8RdrObjDx "Refer to the data element description in FrntSideRdrLeObj1 with the same data element name.";
CM_ SG_ 363 FrntSideRdrRiObj8RdrObjDxStdDe "Refer to the data element description in FrntSideRdrLeObj1 with the same data element name.";
CM_ SG_ 363 FrntSideRdrRiObj8RdrObjDy "Refer to the data element description in FrntSideRdrLeObj1 with the same data element name.";
CM_ SG_ 363 FrntSideRdrRiObj8RdrObjDyStdDe "Refer to the data element description in FrntSideRdrLeObj1 with the same data element name.";
CM_ SG_ 363 FrntSideRdrRiObj8RdrObjElevnConf "Refer to the data element description in FrntSideRdrLeObj1 with the same data element name.";
CM_ SG_ 363 FrntSideRdrRiObj8RdrObjElevnSts "Refer to the data element description in FrntSideRdrLeObj1 with the same data element name.";
CM_ SG_ 363 FrntSideRdrRiObj8RdrObjID "Refer to the data element description in FrntSideRdrLeObj1 with the same data element name.";
CM_ SG_ 363 FrntSideRdrRiObj8RdrObjIsInFreeSpace "Refer to the data element description in FrntSideRdrLeObj1 with the same data element name.";
CM_ SG_ 363 FrntSideRdrRiObj8RdrObjMirrProblty "Refer to the data element description in FrntSideRdrLeObj1 with the same data element name.";
CM_ SG_ 363 FrntSideRdrRiObj8RdrObjMtnPat "Refer to the data element description in FrntSideRdrLeObj1 with the same data element name.";
CM_ SG_ 363 FrntSideRdrRiObj8RdrObjNotRealProblty "Refer to the data element description in FrntSideRdrLeObj1 with the same data element name.";
CM_ SG_ 363 FrntSideRdrRiObj8RdrObjStatyCnt "Refer to the data element description in FrntSideRdrLeObj1 with the same data element name.";
CM_ SG_ 363 FrntSideRdrRiObj8RdrObjTiAlv "Refer to the data element description in FrntSideRdrLeObj1 with the same data element name.";
CM_ SG_ 363 FrntSideRdrRiObj8RdrObjTrackSts "Refer to the data element description in FrntSideRdrLeObj1 with the same data element name.";
CM_ SG_ 363 FrntSideRdrRiObj8RdrObjTyp "Refer to the data element description in FrntSideRdrLeObj1 with the same data element name.";
CM_ SG_ 363 FrntSideRdrRiObj8RdrObjTypConfBike "Refer to the data element description in FrntSideRdrLeObj1 with the same data element name.";
CM_ SG_ 363 FrntSideRdrRiObj8RdrObjTypConfPed "Refer to the data element description in FrntSideRdrLeObj1 with the same data element name.";
CM_ SG_ 363 FrntSideRdrRiObj8RdrObjTypConfVeh "Refer to the data element description in FrntSideRdrLeObj1 with the same data element name.";
CM_ SG_ 363 FrntSideRdrRiObj8RdrObjVx "Refer to the data element description in FrntSideRdrLeObj1 with the same data element name.";
CM_ SG_ 363 FrntSideRdrRiObj8RdrObjVxStdDe "Refer to the data element description in FrntSideRdrLeObj1 with the same data element name.";
CM_ SG_ 363 FrntSideRdrRiObj8RdrObjVy "Refer to the data element description in FrntSideRdrLeObj1 with the same data element name.";
CM_ SG_ 363 FrntSideRdrRiObj8RdrObjVyStdDe "Refer to the data element description in FrntSideRdrLeObj1 with the same data element name.";
CM_ SG_ 363 FrntSideRdrRiObj8RelVx "Refer to the data element description in ReSideRdrRiObj1 with the same data element name";
CM_ SG_ 363 FrntSideRdrRiObj8RelVy "Refer to the data element description in ReSideRdrRiObj1 with the same data element name";
CM_ SG_ 365 FrntSideRdrRiObj9Heading "Refer to the data element description in ReSideRdrRiObj1 with the same data element name";
CM_ SG_ 365 FrntSideRdrRiObj9ObjBoxCenterLat "Box center y coordinate (relative closest point)";
CM_ SG_ 365 FrntSideRdrRiObj9ObjBoxCenterLgt "Box center x coordinate (relative closest point)";
CM_ SG_ 365 FrntSideRdrRiObj9ObservationHist "Refer to the data element description in ReSideRdrRiObj1 with the same data element name";
CM_ SG_ 365 FrntSideRdrRiObj9RdrObjAx "Refer to the data element description in FrntSideRdrLeObj1 with the same data element name.";
CM_ SG_ 365 FrntSideRdrRiObj9RdrObjAy "Refer to the data element description in FrntSideRdrLeObj1 with the same data element name.";
CM_ SG_ 365 FrntSideRdrRiObj9RdrObjBoxLength "Box length (box extent that is parallel to objects heading angle)";
CM_ SG_ 365 FrntSideRdrRiObj9RdrObjBoxWidth "Box width (box extent that is perpendicular to objects heading angle)";
CM_ SG_ 365 FrntSideRdrRiObj9RdrObjChks "Refer to the data element description in FrntSideRdrLeObj1 with the same data element name.";
CM_ SG_ 365 FrntSideRdrRiObj9RdrObjCntr "Refer to the data element description in FrntSideRdrLeObj1 with the same data element name.";
CM_ SG_ 365 FrntSideRdrRiObj9RdrObjCoastCnt "Refer to the data element description in FrntSideRdrLeObj1 with the same data element name.";
CM_ SG_ 365 FrntSideRdrRiObj9RdrObjConf "Refer to the data element description in FrntSideRdrLeObj1 with the same data element name.";
CM_ SG_ 365 FrntSideRdrRiObj9RdrObjDx "Refer to the data element description in FrntSideRdrLeObj1 with the same data element name.";
CM_ SG_ 365 FrntSideRdrRiObj9RdrObjDxStdDe "Refer to the data element description in FrntSideRdrLeObj1 with the same data element name.";
CM_ SG_ 365 FrntSideRdrRiObj9RdrObjDy "Refer to the data element description in FrntSideRdrLeObj1 with the same data element name.";
CM_ SG_ 365 FrntSideRdrRiObj9RdrObjDyStdDe "Refer to the data element description in FrntSideRdrLeObj1 with the same data element name.";
CM_ SG_ 365 FrntSideRdrRiObj9RdrObjElevnConf "Refer to the data element description in FrntSideRdrLeObj1 with the same data element name.";
CM_ SG_ 365 FrntSideRdrRiObj9RdrObjElevnSts "Refer to the data element description in FrntSideRdrLeObj1 with the same data element name.";
CM_ SG_ 365 FrntSideRdrRiObj9RdrObjID "Refer to the data element description in FrntSideRdrLeObj1 with the same data element name.";
CM_ SG_ 365 FrntSideRdrRiObj9RdrObjIsInFreeSpace "Refer to the data element description in FrntSideRdrLeObj1 with the same data element name.";
CM_ SG_ 365 FrntSideRdrRiObj9RdrObjMirrProblty "Refer to the data element description in FrntSideRdrLeObj1 with the same data element name.";
CM_ SG_ 365 FrntSideRdrRiObj9RdrObjMtnPat "Refer to the data element description in FrntSideRdrLeObj1 with the same data element name.";
CM_ SG_ 365 FrntSideRdrRiObj9RdrObjNotRealProblty "Refer to the data element description in FrntSideRdrLeObj1 with the same data element name.";
CM_ SG_ 365 FrntSideRdrRiObj9RdrObjStatyCnt "Refer to the data element description in FrntSideRdrLeObj1 with the same data element name.";
CM_ SG_ 365 FrntSideRdrRiObj9RdrObjTiAlv "Refer to the data element description in FrntSideRdrLeObj1 with the same data element name.";
CM_ SG_ 365 FrntSideRdrRiObj9RdrObjTrackSts "Refer to the data element description in FrntSideRdrLeObj1 with the same data element name.";
CM_ SG_ 365 FrntSideRdrRiObj9RdrObjTyp "Refer to the data element description in FrntSideRdrLeObj1 with the same data element name.";
CM_ SG_ 365 FrntSideRdrRiObj9RdrObjTypConfBike "Refer to the data element description in FrntSideRdrLeObj1 with the same data element name.";
CM_ SG_ 365 FrntSideRdrRiObj9RdrObjTypConfPed "Refer to the data element description in FrntSideRdrLeObj1 with the same data element name.";
CM_ SG_ 365 FrntSideRdrRiObj9RdrObjTypConfVeh "Refer to the data element description in FrntSideRdrLeObj1 with the same data element name.";
CM_ SG_ 365 FrntSideRdrRiObj9RdrObjVx "Refer to the data element description in FrntSideRdrLeObj1 with the same data element name.";
CM_ SG_ 365 FrntSideRdrRiObj9RdrObjVxStdDe "Refer to the data element description in FrntSideRdrLeObj1 with the same data element name.";
CM_ SG_ 365 FrntSideRdrRiObj9RdrObjVy "Refer to the data element description in FrntSideRdrLeObj1 with the same data element name.";
CM_ SG_ 365 FrntSideRdrRiObj9RdrObjVyStdDe "Refer to the data element description in FrntSideRdrLeObj1 with the same data element name.";
CM_ SG_ 365 FrntSideRdrRiObj9RelVx "Refer to the data element description in ReSideRdrRiObj1 with the same data element name";
CM_ SG_ 365 FrntSideRdrRiObj9RelVy "Refer to the data element description in ReSideRdrRiObj1 with the same data element name";
CM_ SG_ 367 FrntSideRdrRiObj10Heading "Refer to the data element description in ReSideRdrRiObj1 with the same data element name";
CM_ SG_ 367 FrntSideRdrRiObj10ObjBoxCenterLat "Box center y coordinate (relative closest point)";
CM_ SG_ 367 FrntSideRdrRiObj10ObjBoxCenterLgt "Box center x coordinate (relative closest point)";
CM_ SG_ 367 FrntSideRdrRiObj10ObservationHist "Refer to the data element description in ReSideRdrRiObj1 with the same data element name";
CM_ SG_ 367 FrntSideRdrRiObj10RdrObjAx "Refer to the data element description in FrntSideRdrLeObj1 with the same data element name.";
CM_ SG_ 367 FrntSideRdrRiObj10RdrObjAy "Refer to the data element description in FrntSideRdrLeObj1 with the same data element name.";
CM_ SG_ 367 FrntSideRdrRiObj10RdrObjBoxLength "Box length (box extent that is parallel to objects heading angle)";
CM_ SG_ 367 FrntSideRdrRiObj10RdrObjBoxWidth "Box width (box extent that is perpendicular to objects heading angle)";
CM_ SG_ 367 FrntSideRdrRiObj10RdrObjChks "Refer to the data element description in FrntSideRdrLeObj1 with the same data element name.";
CM_ SG_ 367 FrntSideRdrRiObj10RdrObjCntr "Refer to the data element description in FrntSideRdrLeObj1 with the same data element name.";
CM_ SG_ 367 FrntSideRdrRiObj10RdrObjCoastCnt "Refer to the data element description in FrntSideRdrLeObj1 with the same data element name.";
CM_ SG_ 367 FrntSideRdrRiObj10RdrObjConf "Refer to the data element description in FrntSideRdrLeObj1 with the same data element name.";
CM_ SG_ 367 FrntSideRdrRiObj10RdrObjDx "Refer to the data element description in FrntSideRdrLeObj1 with the same data element name.";
CM_ SG_ 367 FrntSideRdrRiObj10RdrObjDxStdDe "Refer to the data element description in FrntSideRdrLeObj1 with the same data element name.";
CM_ SG_ 367 FrntSideRdrRiObj10RdrObjDy "Refer to the data element description in FrntSideRdrLeObj1 with the same data element name.";
CM_ SG_ 367 FrntSideRdrRiObj10RdrObjDyStdDe "Refer to the data element description in FrntSideRdrLeObj1 with the same data element name.";
CM_ SG_ 367 FrntSideRdrRiObj10RdrObjElevnConf "Refer to the data element description in FrntSideRdrLeObj1 with the same data element name.";
CM_ SG_ 367 FrntSideRdrRiObj10RdrObjElevnSts "Refer to the data element description in FrntSideRdrLeObj1 with the same data element name.";
CM_ SG_ 367 FrntSideRdrRiObj10RdrObjID "Refer to the data element description in FrntSideRdrLeObj1 with the same data element name.";
CM_ SG_ 367 FrntSideRdrRiObj10RdrObjIsInFreeSpace "Refer to the data element description in FrntSideRdrLeObj1 with the same data element name.";
CM_ SG_ 367 FrntSideRdrRiObj10RdrObjMirrProblty "Refer to the data element description in FrntSideRdrLeObj1 with the same data element name.";
CM_ SG_ 367 FrntSideRdrRiObj10RdrObjMtnPat "Refer to the data element description in FrntSideRdrLeObj1 with the same data element name.";
CM_ SG_ 367 FrntSideRdrRiObj10RdrObjNotRealProblty "Refer to the data element description in FrntSideRdrLeObj1 with the same data element name.";
CM_ SG_ 367 FrntSideRdrRiObj10RdrObjStatyCnt "Refer to the data element description in FrntSideRdrLeObj1 with the same data element name.";
CM_ SG_ 367 FrntSideRdrRiObj10RdrObjTiAlv "Refer to the data element description in FrntSideRdrLeObj1 with the same data element name.";
CM_ SG_ 367 FrntSideRdrRiObj10RdrObjTrackSts "Refer to the data element description in FrntSideRdrLeObj1 with the same data element name.";
CM_ SG_ 367 FrntSideRdrRiObj10RdrObjTyp "Refer to the data element description in FrntSideRdrLeObj1 with the same data element name.";
CM_ SG_ 367 FrntSideRdrRiObj10RdrObjTypConfBike "Refer to the data element description in FrntSideRdrLeObj1 with the same data element name.";
CM_ SG_ 367 FrntSideRdrRiObj10RdrObjTypConfPed "Refer to the data element description in FrntSideRdrLeObj1 with the same data element name.";
CM_ SG_ 367 FrntSideRdrRiObj10RdrObjTypConfVeh "Refer to the data element description in FrntSideRdrLeObj1 with the same data element name.";
CM_ SG_ 367 FrntSideRdrRiObj10RdrObjVx "Refer to the data element description in FrntSideRdrLeObj1 with the same data element name.";
CM_ SG_ 367 FrntSideRdrRiObj10RdrObjVxStdDe "Refer to the data element description in FrntSideRdrLeObj1 with the same data element name.";
CM_ SG_ 367 FrntSideRdrRiObj10RdrObjVy "Refer to the data element description in FrntSideRdrLeObj1 with the same data element name.";
CM_ SG_ 367 FrntSideRdrRiObj10RdrObjVyStdDe "Refer to the data element description in FrntSideRdrLeObj1 with the same data element name.";
CM_ SG_ 367 FrntSideRdrRiObj10RelVx "Refer to the data element description in ReSideRdrRiObj1 with the same data element name";
CM_ SG_ 367 FrntSideRdrRiObj10RelVy "Refer to the data element description in ReSideRdrRiObj1 with the same data element name";
CM_ SG_ 369 FrntSideRdrRiObj11Heading "Refer to the data element description in ReSideRdrRiObj1 with the same data element name";
CM_ SG_ 369 FrntSideRdrRiObj11ObjBoxCenterLat "Box center y coordinate (relative closest point)";
CM_ SG_ 369 FrntSideRdrRiObj11ObjBoxCenterLgt "Box center x coordinate (relative closest point)";
CM_ SG_ 369 FrntSideRdrRiObj11ObservationHist "Refer to the data element description in ReSideRdrRiObj1 with the same data element name";
CM_ SG_ 369 FrntSideRdrRiObj11RdrObjAx "Refer to the data element description in FrntSideRdrLeObj1 with the same data element name.";
CM_ SG_ 369 FrntSideRdrRiObj11RdrObjAy "Refer to the data element description in FrntSideRdrLeObj1 with the same data element name.";
CM_ SG_ 369 FrntSideRdrRiObj11RdrObjBoxLength "Box length (box extent that is parallel to objects heading angle)";
CM_ SG_ 369 FrntSideRdrRiObj11RdrObjBoxWidth "Box width (box extent that is perpendicular to objects heading angle)";
CM_ SG_ 369 FrntSideRdrRiObj11RdrObjChks "Refer to the data element description in FrntSideRdrLeObj1 with the same data element name.";
CM_ SG_ 369 FrntSideRdrRiObj11RdrObjCntr "Refer to the data element description in FrntSideRdrLeObj1 with the same data element name.";
CM_ SG_ 369 FrntSideRdrRiObj11RdrObjCoastCnt "Refer to the data element description in FrntSideRdrLeObj1 with the same data element name.";
CM_ SG_ 369 FrntSideRdrRiObj11RdrObjConf "Refer to the data element description in FrntSideRdrLeObj1 with the same data element name.";
CM_ SG_ 369 FrntSideRdrRiObj11RdrObjDx "Refer to the data element description in FrntSideRdrLeObj1 with the same data element name.";
CM_ SG_ 369 FrntSideRdrRiObj11RdrObjDxStdDe "Refer to the data element description in FrntSideRdrLeObj1 with the same data element name.";
CM_ SG_ 369 FrntSideRdrRiObj11RdrObjDy "Refer to the data element description in FrntSideRdrLeObj1 with the same data element name.";
CM_ SG_ 369 FrntSideRdrRiObj11RdrObjDyStdDe "Refer to the data element description in FrntSideRdrLeObj1 with the same data element name.";
CM_ SG_ 369 FrntSideRdrRiObj11RdrObjElevnConf "Refer to the data element description in FrntSideRdrLeObj1 with the same data element name.";
CM_ SG_ 369 FrntSideRdrRiObj11RdrObjElevnSts "Refer to the data element description in FrntSideRdrLeObj1 with the same data element name.";
CM_ SG_ 369 FrntSideRdrRiObj11RdrObjID "Refer to the data element description in FrntSideRdrLeObj1 with the same data element name.";
CM_ SG_ 369 FrntSideRdrRiObj11RdrObjIsInFreeSpace "Refer to the data element description in FrntSideRdrLeObj1 with the same data element name.";
CM_ SG_ 369 FrntSideRdrRiObj11RdrObjMirrProblty "Refer to the data element description in FrntSideRdrLeObj1 with the same data element name.";
CM_ SG_ 369 FrntSideRdrRiObj11RdrObjMtnPat "Refer to the data element description in FrntSideRdrLeObj1 with the same data element name.";
CM_ SG_ 369 FrntSideRdrRiObj11RdrObjNotRealProblty "Refer to the data element description in FrntSideRdrLeObj1 with the same data element name.";
CM_ SG_ 369 FrntSideRdrRiObj11RdrObjStatyCnt "Refer to the data element description in FrntSideRdrLeObj1 with the same data element name.";
CM_ SG_ 369 FrntSideRdrRiObj11RdrObjTiAlv "Refer to the data element description in FrntSideRdrLeObj1 with the same data element name.";
CM_ SG_ 369 FrntSideRdrRiObj11RdrObjTrackSts "Refer to the data element description in FrntSideRdrLeObj1 with the same data element name.";
CM_ SG_ 369 FrntSideRdrRiObj11RdrObjTyp "Refer to the data element description in FrntSideRdrLeObj1 with the same data element name.";
CM_ SG_ 369 FrntSideRdrRiObj11RdrObjTypConfBike "Refer to the data element description in FrntSideRdrLeObj1 with the same data element name.";
CM_ SG_ 369 FrntSideRdrRiObj11RdrObjTypConfPed "Refer to the data element description in FrntSideRdrLeObj1 with the same data element name.";
CM_ SG_ 369 FrntSideRdrRiObj11RdrObjTypConfVeh "Refer to the data element description in FrntSideRdrLeObj1 with the same data element name.";
CM_ SG_ 369 FrntSideRdrRiObj11RdrObjVx "Refer to the data element description in FrntSideRdrLeObj1 with the same data element name.";
CM_ SG_ 369 FrntSideRdrRiObj11RdrObjVxStdDe "Refer to the data element description in FrntSideRdrLeObj1 with the same data element name.";
CM_ SG_ 369 FrntSideRdrRiObj11RdrObjVy "Refer to the data element description in FrntSideRdrLeObj1 with the same data element name.";
CM_ SG_ 369 FrntSideRdrRiObj11RdrObjVyStdDe "Refer to the data element description in FrntSideRdrLeObj1 with the same data element name.";
CM_ SG_ 369 FrntSideRdrRiObj11RelVx "Refer to the data element description in ReSideRdrRiObj1 with the same data element name";
CM_ SG_ 369 FrntSideRdrRiObj11RelVy "Refer to the data element description in ReSideRdrRiObj1 with the same data element name";
CM_ SG_ 371 FrntSideRdrRiObj12Heading "Refer to the data element description in ReSideRdrRiObj1 with the same data element name";
CM_ SG_ 371 FrntSideRdrRiObj12ObjBoxCenterLat "Box center y coordinate (relative closest point)";
CM_ SG_ 371 FrntSideRdrRiObj12ObjBoxCenterLgt "Box center x coordinate (relative closest point)";
CM_ SG_ 371 FrntSideRdrRiObj12ObservationHist "Refer to the data element description in ReSideRdrRiObj1 with the same data element name";
CM_ SG_ 371 FrntSideRdrRiObj12RdrObjAx "Refer to the data element description in FrntSideRdrLeObj1 with the same data element name.";
CM_ SG_ 371 FrntSideRdrRiObj12RdrObjAy "Refer to the data element description in FrntSideRdrLeObj1 with the same data element name.";
CM_ SG_ 371 FrntSideRdrRiObj12RdrObjBoxLength "Box length (box extent that is parallel to objects heading angle)";
CM_ SG_ 371 FrntSideRdrRiObj12RdrObjBoxWidth "Box width (box extent that is perpendicular to objects heading angle)";
CM_ SG_ 371 FrntSideRdrRiObj12RdrObjChks "Refer to the data element description in FrntSideRdrLeObj1 with the same data element name.";
CM_ SG_ 371 FrntSideRdrRiObj12RdrObjCntr "Refer to the data element description in FrntSideRdrLeObj1 with the same data element name.";
CM_ SG_ 371 FrntSideRdrRiObj12RdrObjCoastCnt "Refer to the data element description in FrntSideRdrLeObj1 with the same data element name.";
CM_ SG_ 371 FrntSideRdrRiObj12RdrObjConf "Refer to the data element description in FrntSideRdrLeObj1 with the same data element name.";
CM_ SG_ 371 FrntSideRdrRiObj12RdrObjDx "Refer to the data element description in FrntSideRdrLeObj1 with the same data element name.";
CM_ SG_ 371 FrntSideRdrRiObj12RdrObjDxStdDe "Refer to the data element description in FrntSideRdrLeObj1 with the same data element name.";
CM_ SG_ 371 FrntSideRdrRiObj12RdrObjDy "Refer to the data element description in FrntSideRdrLeObj1 with the same data element name.";
CM_ SG_ 371 FrntSideRdrRiObj12RdrObjDyStdDe "Refer to the data element description in FrntSideRdrLeObj1 with the same data element name.";
CM_ SG_ 371 FrntSideRdrRiObj12RdrObjElevnConf "Refer to the data element description in FrntSideRdrLeObj1 with the same data element name.";
CM_ SG_ 371 FrntSideRdrRiObj12RdrObjElevnSts "Refer to the data element description in FrntSideRdrLeObj1 with the same data element name.";
CM_ SG_ 371 FrntSideRdrRiObj12RdrObjID "Refer to the data element description in FrntSideRdrLeObj1 with the same data element name.";
CM_ SG_ 371 FrntSideRdrRiObj12RdrObjIsInFreeSpace "Refer to the data element description in FrntSideRdrLeObj1 with the same data element name.";
CM_ SG_ 371 FrntSideRdrRiObj12RdrObjMirrProblty "Refer to the data element description in FrntSideRdrLeObj1 with the same data element name.";
CM_ SG_ 371 FrntSideRdrRiObj12RdrObjMtnPat "Refer to the data element description in FrntSideRdrLeObj1 with the same data element name.";
CM_ SG_ 371 FrntSideRdrRiObj12RdrObjNotRealProblty "Refer to the data element description in FrntSideRdrLeObj1 with the same data element name.";
CM_ SG_ 371 FrntSideRdrRiObj12RdrObjStatyCnt "Refer to the data element description in FrntSideRdrLeObj1 with the same data element name.";
CM_ SG_ 371 FrntSideRdrRiObj12RdrObjTiAlv "Refer to the data element description in FrntSideRdrLeObj1 with the same data element name.";
CM_ SG_ 371 FrntSideRdrRiObj12RdrObjTrackSts "Refer to the data element description in FrntSideRdrLeObj1 with the same data element name.";
CM_ SG_ 371 FrntSideRdrRiObj12RdrObjTyp "Refer to the data element description in FrntSideRdrLeObj1 with the same data element name.";
CM_ SG_ 371 FrntSideRdrRiObj12RdrObjTypConfBike "Refer to the data element description in FrntSideRdrLeObj1 with the same data element name.";
CM_ SG_ 371 FrntSideRdrRiObj12RdrObjTypConfPed "Refer to the data element description in FrntSideRdrLeObj1 with the same data element name.";
CM_ SG_ 371 FrntSideRdrRiObj12RdrObjTypConfVeh "Refer to the data element description in FrntSideRdrLeObj1 with the same data element name.";
CM_ SG_ 371 FrntSideRdrRiObj12RdrObjVx "Refer to the data element description in FrntSideRdrLeObj1 with the same data element name.";
CM_ SG_ 371 FrntSideRdrRiObj12RdrObjVxStdDe "Refer to the data element description in FrntSideRdrLeObj1 with the same data element name.";
CM_ SG_ 371 FrntSideRdrRiObj12RdrObjVy "Refer to the data element description in FrntSideRdrLeObj1 with the same data element name.";
CM_ SG_ 371 FrntSideRdrRiObj12RdrObjVyStdDe "Refer to the data element description in FrntSideRdrLeObj1 with the same data element name.";
CM_ SG_ 371 FrntSideRdrRiObj12RelVx "Refer to the data element description in ReSideRdrRiObj1 with the same data element name";
CM_ SG_ 371 FrntSideRdrRiObj12RelVy "Refer to the data element description in ReSideRdrRiObj1 with the same data element name";
CM_ SG_ 373 FrntSideRdrRiObj13Heading "Refer to the data element description in ReSideRdrRiObj1 with the same data element name";
CM_ SG_ 373 FrntSideRdrRiObj13ObjBoxCenterLat "Box center y coordinate (relative closest point)";
CM_ SG_ 373 FrntSideRdrRiObj13ObjBoxCenterLgt "Box center x coordinate (relative closest point)";
CM_ SG_ 373 FrntSideRdrRiObj13ObservationHist "Refer to the data element description in ReSideRdrRiObj1 with the same data element name";
CM_ SG_ 373 FrntSideRdrRiObj13RdrObjAx "Refer to the data element description in FrntSideRdrLeObj1 with the same data element name.";
CM_ SG_ 373 FrntSideRdrRiObj13RdrObjAy "Refer to the data element description in FrntSideRdrLeObj1 with the same data element name.";
CM_ SG_ 373 FrntSideRdrRiObj13RdrObjBoxLength "Box length (box extent that is parallel to objects heading angle)";
CM_ SG_ 373 FrntSideRdrRiObj13RdrObjBoxWidth "Box width (box extent that is perpendicular to objects heading angle)";
CM_ SG_ 373 FrntSideRdrRiObj13RdrObjChks "Refer to the data element description in FrntSideRdrLeObj1 with the same data element name.";
CM_ SG_ 373 FrntSideRdrRiObj13RdrObjCntr "Refer to the data element description in FrntSideRdrLeObj1 with the same data element name.";
CM_ SG_ 373 FrntSideRdrRiObj13RdrObjCoastCnt "Refer to the data element description in FrntSideRdrLeObj1 with the same data element name.";
CM_ SG_ 373 FrntSideRdrRiObj13RdrObjConf "Refer to the data element description in FrntSideRdrLeObj1 with the same data element name.";
CM_ SG_ 373 FrntSideRdrRiObj13RdrObjDx "Refer to the data element description in FrntSideRdrLeObj1 with the same data element name.";
CM_ SG_ 373 FrntSideRdrRiObj13RdrObjDxStdDe "Refer to the data element description in FrntSideRdrLeObj1 with the same data element name.";
CM_ SG_ 373 FrntSideRdrRiObj13RdrObjDy "Refer to the data element description in FrntSideRdrLeObj1 with the same data element name.";
CM_ SG_ 373 FrntSideRdrRiObj13RdrObjDyStdDe "Refer to the data element description in FrntSideRdrLeObj1 with the same data element name.";
CM_ SG_ 373 FrntSideRdrRiObj13RdrObjElevnConf "Refer to the data element description in FrntSideRdrLeObj1 with the same data element name.";
CM_ SG_ 373 FrntSideRdrRiObj13RdrObjElevnSts "Refer to the data element description in FrntSideRdrLeObj1 with the same data element name.";
CM_ SG_ 373 FrntSideRdrRiObj13RdrObjID "Refer to the data element description in FrntSideRdrLeObj1 with the same data element name.";
CM_ SG_ 373 FrntSideRdrRiObj13RdrObjIsInFreeSpace "Refer to the data element description in FrntSideRdrLeObj1 with the same data element name.";
CM_ SG_ 373 FrntSideRdrRiObj13RdrObjMirrProblty "Refer to the data element description in FrntSideRdrLeObj1 with the same data element name.";
CM_ SG_ 373 FrntSideRdrRiObj13RdrObjMtnPat "Refer to the data element description in FrntSideRdrLeObj1 with the same data element name.";
CM_ SG_ 373 FrntSideRdrRiObj13RdrObjNotRealProblty "Refer to the data element description in FrntSideRdrLeObj1 with the same data element name.";
CM_ SG_ 373 FrntSideRdrRiObj13RdrObjStatyCnt "Refer to the data element description in FrntSideRdrLeObj1 with the same data element name.";
CM_ SG_ 373 FrntSideRdrRiObj13RdrObjTiAlv "Refer to the data element description in FrntSideRdrLeObj1 with the same data element name.";
CM_ SG_ 373 FrntSideRdrRiObj13RdrObjTrackSts "Refer to the data element description in FrntSideRdrLeObj1 with the same data element name.";
CM_ SG_ 373 FrntSideRdrRiObj13RdrObjTyp "Refer to the data element description in FrntSideRdrLeObj1 with the same data element name.";
CM_ SG_ 373 FrntSideRdrRiObj13RdrObjTypConfBike "Refer to the data element description in FrntSideRdrLeObj1 with the same data element name.";
CM_ SG_ 373 FrntSideRdrRiObj13RdrObjTypConfPed "Refer to the data element description in FrntSideRdrLeObj1 with the same data element name.";
CM_ SG_ 373 FrntSideRdrRiObj13RdrObjTypConfVeh "Refer to the data element description in FrntSideRdrLeObj1 with the same data element name.";
CM_ SG_ 373 FrntSideRdrRiObj13RdrObjVx "Refer to the data element description in FrntSideRdrLeObj1 with the same data element name.";
CM_ SG_ 373 FrntSideRdrRiObj13RdrObjVxStdDe "Refer to the data element description in FrntSideRdrLeObj1 with the same data element name.";
CM_ SG_ 373 FrntSideRdrRiObj13RdrObjVy "Refer to the data element description in FrntSideRdrLeObj1 with the same data element name.";
CM_ SG_ 373 FrntSideRdrRiObj13RdrObjVyStdDe "Refer to the data element description in FrntSideRdrLeObj1 with the same data element name.";
CM_ SG_ 373 FrntSideRdrRiObj13RelVx "Refer to the data element description in ReSideRdrRiObj1 with the same data element name";
CM_ SG_ 373 FrntSideRdrRiObj13RelVy "Refer to the data element description in ReSideRdrRiObj1 with the same data element name";
CM_ SG_ 375 FrntSideRdrRiObj14Heading "Refer to the data element description in ReSideRdrRiObj1 with the same data element name";
CM_ SG_ 375 FrntSideRdrRiObj14ObjBoxCenterLat "Box center y coordinate (relative closest point)";
CM_ SG_ 375 FrntSideRdrRiObj14ObjBoxCenterLgt "Box center x coordinate (relative closest point)";
CM_ SG_ 375 FrntSideRdrRiObj14ObservationHist "Refer to the data element description in ReSideRdrRiObj1 with the same data element name";
CM_ SG_ 375 FrntSideRdrRiObj14RdrObjAx "Refer to the data element description in FrntSideRdrLeObj1 with the same data element name.";
CM_ SG_ 375 FrntSideRdrRiObj14RdrObjAy "Refer to the data element description in FrntSideRdrLeObj1 with the same data element name.";
CM_ SG_ 375 FrntSideRdrRiObj14RdrObjBoxLength "Box length (box extent that is parallel to objects heading angle)";
CM_ SG_ 375 FrntSideRdrRiObj14RdrObjBoxWidth "Box width (box extent that is perpendicular to objects heading angle)";
CM_ SG_ 375 FrntSideRdrRiObj14RdrObjChks "Refer to the data element description in FrntSideRdrLeObj1 with the same data element name.";
CM_ SG_ 375 FrntSideRdrRiObj14RdrObjCntr "Refer to the data element description in FrntSideRdrLeObj1 with the same data element name.";
CM_ SG_ 375 FrntSideRdrRiObj14RdrObjCoastCnt "Refer to the data element description in FrntSideRdrLeObj1 with the same data element name.";
CM_ SG_ 375 FrntSideRdrRiObj14RdrObjConf "Refer to the data element description in FrntSideRdrLeObj1 with the same data element name.";
CM_ SG_ 375 FrntSideRdrRiObj14RdrObjDx "Refer to the data element description in FrntSideRdrLeObj1 with the same data element name.";
CM_ SG_ 375 FrntSideRdrRiObj14RdrObjDxStdDe "Refer to the data element description in FrntSideRdrLeObj1 with the same data element name.";
CM_ SG_ 375 FrntSideRdrRiObj14RdrObjDy "Refer to the data element description in FrntSideRdrLeObj1 with the same data element name.";
CM_ SG_ 375 FrntSideRdrRiObj14RdrObjDyStdDe "Refer to the data element description in FrntSideRdrLeObj1 with the same data element name.";
CM_ SG_ 375 FrntSideRdrRiObj14RdrObjElevnConf "Refer to the data element description in FrntSideRdrLeObj1 with the same data element name.";
CM_ SG_ 375 FrntSideRdrRiObj14RdrObjElevnSts "Refer to the data element description in FrntSideRdrLeObj1 with the same data element name.";
CM_ SG_ 375 FrntSideRdrRiObj14RdrObjID "Refer to the data element description in FrntSideRdrLeObj1 with the same data element name.";
CM_ SG_ 375 FrntSideRdrRiObj14RdrObjIsInFreeSpace "Refer to the data element description in FrntSideRdrLeObj1 with the same data element name.";
CM_ SG_ 375 FrntSideRdrRiObj14RdrObjMirrProblty "Refer to the data element description in FrntSideRdrLeObj1 with the same data element name.";
CM_ SG_ 375 FrntSideRdrRiObj14RdrObjMtnPat "Refer to the data element description in FrntSideRdrLeObj1 with the same data element name.";
CM_ SG_ 375 FrntSideRdrRiObj14RdrObjNotRealProblty "Refer to the data element description in FrntSideRdrLeObj1 with the same data element name.";
CM_ SG_ 375 FrntSideRdrRiObj14RdrObjStatyCnt "Refer to the data element description in FrntSideRdrLeObj1 with the same data element name.";
CM_ SG_ 375 FrntSideRdrRiObj14RdrObjTiAlv "Refer to the data element description in FrntSideRdrLeObj1 with the same data element name.";
CM_ SG_ 375 FrntSideRdrRiObj14RdrObjTrackSts "Refer to the data element description in FrntSideRdrLeObj1 with the same data element name.";
CM_ SG_ 375 FrntSideRdrRiObj14RdrObjTyp "Refer to the data element description in FrntSideRdrLeObj1 with the same data element name.";
CM_ SG_ 375 FrntSideRdrRiObj14RdrObjTypConfBike "Refer to the data element description in FrntSideRdrLeObj1 with the same data element name.";
CM_ SG_ 375 FrntSideRdrRiObj14RdrObjTypConfPed "Refer to the data element description in FrntSideRdrLeObj1 with the same data element name.";
CM_ SG_ 375 FrntSideRdrRiObj14RdrObjTypConfVeh "Refer to the data element description in FrntSideRdrLeObj1 with the same data element name.";
CM_ SG_ 375 FrntSideRdrRiObj14RdrObjVx "Refer to the data element description in FrntSideRdrLeObj1 with the same data element name.";
CM_ SG_ 375 FrntSideRdrRiObj14RdrObjVxStdDe "Refer to the data element description in FrntSideRdrLeObj1 with the same data element name.";
CM_ SG_ 375 FrntSideRdrRiObj14RdrObjVy "Refer to the data element description in FrntSideRdrLeObj1 with the same data element name.";
CM_ SG_ 375 FrntSideRdrRiObj14RdrObjVyStdDe "Refer to the data element description in FrntSideRdrLeObj1 with the same data element name.";
CM_ SG_ 375 FrntSideRdrRiObj14RelVx "Refer to the data element description in ReSideRdrRiObj1 with the same data element name";
CM_ SG_ 375 FrntSideRdrRiObj14RelVy "Refer to the data element description in ReSideRdrRiObj1 with the same data element name";
CM_ SG_ 377 FrntSideRdrRiObj15Heading "Refer to the data element description in ReSideRdrRiObj1 with the same data element name";
CM_ SG_ 377 FrntSideRdrRiObj15ObjBoxCenterLat "Box center y coordinate (relative closest point)";
CM_ SG_ 377 FrntSideRdrRiObj15ObjBoxCenterLgt "Box center x coordinate (relative closest point)";
CM_ SG_ 377 FrntSideRdrRiObj15ObservationHist "Refer to the data element description in ReSideRdrRiObj1 with the same data element name";
CM_ SG_ 377 FrntSideRdrRiObj15RdrObjAx "Refer to the data element description in FrntSideRdrLeObj1 with the same data element name.";
CM_ SG_ 377 FrntSideRdrRiObj15RdrObjAy "Refer to the data element description in FrntSideRdrLeObj1 with the same data element name.";
CM_ SG_ 377 FrntSideRdrRiObj15RdrObjBoxLength "Box length (box extent that is parallel to objects heading angle)";
CM_ SG_ 377 FrntSideRdrRiObj15RdrObjBoxWidth "Box width (box extent that is perpendicular to objects heading angle)";
CM_ SG_ 377 FrntSideRdrRiObj15RdrObjChks "Refer to the data element description in FrntSideRdrLeObj1 with the same data element name.";
CM_ SG_ 377 FrntSideRdrRiObj15RdrObjCntr "Refer to the data element description in FrntSideRdrLeObj1 with the same data element name.";
CM_ SG_ 377 FrntSideRdrRiObj15RdrObjCoastCnt "Refer to the data element description in FrntSideRdrLeObj1 with the same data element name.";
CM_ SG_ 377 FrntSideRdrRiObj15RdrObjConf "Refer to the data element description in FrntSideRdrLeObj1 with the same data element name.";
CM_ SG_ 377 FrntSideRdrRiObj15RdrObjDx "Refer to the data element description in FrntSideRdrLeObj1 with the same data element name.";
CM_ SG_ 377 FrntSideRdrRiObj15RdrObjDxStdDe "Refer to the data element description in FrntSideRdrLeObj1 with the same data element name.";
CM_ SG_ 377 FrntSideRdrRiObj15RdrObjDy "Refer to the data element description in FrntSideRdrLeObj1 with the same data element name.";
CM_ SG_ 377 FrntSideRdrRiObj15RdrObjDyStdDe "Refer to the data element description in FrntSideRdrLeObj1 with the same data element name.";
CM_ SG_ 377 FrntSideRdrRiObj15RdrObjElevnConf "Refer to the data element description in FrntSideRdrLeObj1 with the same data element name.";
CM_ SG_ 377 FrntSideRdrRiObj15RdrObjElevnSts "Refer to the data element description in FrntSideRdrLeObj1 with the same data element name.";
CM_ SG_ 377 FrntSideRdrRiObj15RdrObjID "Refer to the data element description in FrntSideRdrLeObj1 with the same data element name.";
CM_ SG_ 377 FrntSideRdrRiObj15RdrObjIsInFreeSpace "Refer to the data element description in FrntSideRdrLeObj1 with the same data element name.";
CM_ SG_ 377 FrntSideRdrRiObj15RdrObjMirrProblty "Refer to the data element description in FrntSideRdrLeObj1 with the same data element name.";
CM_ SG_ 377 FrntSideRdrRiObj15RdrObjMtnPat "Refer to the data element description in FrntSideRdrLeObj1 with the same data element name.";
CM_ SG_ 377 FrntSideRdrRiObj15RdrObjNotRealProblty "Refer to the data element description in FrntSideRdrLeObj1 with the same data element name.";
CM_ SG_ 377 FrntSideRdrRiObj15RdrObjStatyCnt "Refer to the data element description in FrntSideRdrLeObj1 with the same data element name.";
CM_ SG_ 377 FrntSideRdrRiObj15RdrObjTiAlv "Refer to the data element description in FrntSideRdrLeObj1 with the same data element name.";
CM_ SG_ 377 FrntSideRdrRiObj15RdrObjTrackSts "Refer to the data element description in FrntSideRdrLeObj1 with the same data element name.";
CM_ SG_ 377 FrntSideRdrRiObj15RdrObjTyp "Refer to the data element description in FrntSideRdrLeObj1 with the same data element name.";
CM_ SG_ 377 FrntSideRdrRiObj15RdrObjTypConfBike "Refer to the data element description in FrntSideRdrLeObj1 with the same data element name.";
CM_ SG_ 377 FrntSideRdrRiObj15RdrObjTypConfPed "Refer to the data element description in FrntSideRdrLeObj1 with the same data element name.";
CM_ SG_ 377 FrntSideRdrRiObj15RdrObjTypConfVeh "Refer to the data element description in FrntSideRdrLeObj1 with the same data element name.";
CM_ SG_ 377 FrntSideRdrRiObj15RdrObjVx "Refer to the data element description in FrntSideRdrLeObj1 with the same data element name.";
CM_ SG_ 377 FrntSideRdrRiObj15RdrObjVxStdDe "Refer to the data element description in FrntSideRdrLeObj1 with the same data element name.";
CM_ SG_ 377 FrntSideRdrRiObj15RdrObjVy "Refer to the data element description in FrntSideRdrLeObj1 with the same data element name.";
CM_ SG_ 377 FrntSideRdrRiObj15RdrObjVyStdDe "Refer to the data element description in FrntSideRdrLeObj1 with the same data element name.";
CM_ SG_ 377 FrntSideRdrRiObj15RelVx "Refer to the data element description in ReSideRdrRiObj1 with the same data element name";
CM_ SG_ 377 FrntSideRdrRiObj15RelVy "Refer to the data element description in ReSideRdrRiObj1 with the same data element name";
BA_DEF_ BO_ "VFrameFormat" ENUM "StandardCAN","ExtendedCAN","reserved","J1939PG","reserved","reserved","reserved","reserved","reserved","reserved","reserved","reserved","reserved","reserved","StandardCAN_FD","ExtendedCAN_FD";
BA_DEF_ BO_ "CANFD_BRS" ENUM "0","1";
BA_DEF_ BO_ "GenMsgSendType" ENUM "cyclic", "spontaneous", "not-used", "not-used", "not-used", "cyclicAndSpontaneous", "not-used", "cyclicIfActive", "NoMsgSendType"; // [us]
BA_DEF_ BO_ "GenMsgCycleTime" INT 0 65536; // [ms]
BA_DEF_ BO_ "GenMsgStartDelayTime" INT 0 65536; // [ms]
BA_DEF_ BO_ "GenMsgDelayTime" INT 0 65536; // [ms]
BA_DEF_ SG_ "GenSigSendType" ENUM "Cyclic","OnWrite","OnWriteWithRepetition","OnChange","OnChangeWithRepetition","IfActive","IfActiveWithRepetition","NoSigSendType";
BA_DEF_ SG_ "GenSigStartValue" HEX 0 80000000;
BA_DEF_ BO_ "GenMsgILSupport" ENUM "No","Yes";
BA_DEF_ BO_ "NmAsrMessage" ENUM "No","Yes";
BA_DEF_ SG_ "GenSigFuncType" ENUM "NoFunction","n/a","n/a","n/a","n/a","n/a","n/a","n/a","n/a","n/a","n/a","n/a","n/a","n/a","n/a","CHK","CNTR","n/a","n/a","n/a","CNTR_AR_01","CRC_AR_01_BOTH","CRC_AR_01_ALT","CRC_AR_01_LOW","CRC_AR_01_NIBBLE","CNTR_AR_04","CRC_AR_04A","CNTR_AR_05","CRC_AR_05";
BA_DEF_ SG_ "GenSigDataID" STRING;

BA_DEF_DEF_ "VFrameFormat" "J1939PG";
BA_DEF_DEF_ "CANFD_BRS" "1";
BA_DEF_DEF_ "GenSigStartValue" 0;
BA_DEF_DEF_ "GenSigSendType" "NoSigSendType";
BA_DEF_DEF_ "GenMsgCycleTime" 0;
BA_DEF_DEF_ "GenMsgDelayTime" 0;
BA_DEF_DEF_ "GenMsgStartDelayTime" 0;
BA_DEF_DEF_ "GenMsgSendType" "NoMsgSendType";
BA_DEF_DEF_ "GenMsgILSupport" "Yes";
BA_DEF_DEF_ "NmAsrMessage" "No";
BA_DEF_DEF_ "GenSigFuncType" "NoFunction";
BA_DEF_DEF_ "GenSigDataID" "";
// Frame: FSRRSafetyCANFD1Frame26
BA_ "VFrameFormat" BO_ 355 14;
BA_ "GenMsgSendType" BO_ 355 0;
BA_ "GenMsgCycleTime" BO_ 355 50.000;
BA_ "GenSigStartValue" SG_ 355 FrntSideRdrRiObj4Heading 1800;
BA_ "GenSigSendType" SG_ 355 FrntSideRdrRiObj4Heading 0;
BA_ "GenSigStartValue" SG_ 355 FrntSideRdrRiObj4ObjBoxCenterLat 250;
BA_ "GenSigSendType" SG_ 355 FrntSideRdrRiObj4ObjBoxCenterLat 0;
BA_ "GenSigStartValue" SG_ 355 FrntSideRdrRiObj4ObjBoxCenterLgt 250;
BA_ "GenSigSendType" SG_ 355 FrntSideRdrRiObj4ObjBoxCenterLgt 0;
BA_ "GenSigSendType" SG_ 355 FrntSideRdrRiObj4ObservationHist 0;
BA_ "GenSigSendType" SG_ 355 FrntSideRdrRiObj4RdrObjAx 0;
BA_ "GenSigSendType" SG_ 355 FrntSideRdrRiObj4RdrObjAy 0;
BA_ "GenSigSendType" SG_ 355 FrntSideRdrRiObj4RdrObjBoxLength 0;
BA_ "GenSigSendType" SG_ 355 FrntSideRdrRiObj4RdrObjBoxWidth 0;
BA_ "GenSigSendType" SG_ 355 FrntSideRdrRiObj4RdrObjChks 0;
BA_ "GenSigFuncType" SG_ 355 FrntSideRdrRiObj4RdrObjChks 15;
BA_ "GenSigDataID" SG_ 355 FrntSideRdrRiObj4RdrObjChks "0x966";
BA_ "GenSigSendType" SG_ 355 FrntSideRdrRiObj4RdrObjCntr 0;
BA_ "GenSigFuncType" SG_ 355 FrntSideRdrRiObj4RdrObjCntr 16;
BA_ "GenSigStartValue" SG_ 355 FrntSideRdrRiObj4RdrObjCoastCnt 31;
BA_ "GenSigSendType" SG_ 355 FrntSideRdrRiObj4RdrObjCoastCnt 0;
BA_ "GenSigSendType" SG_ 355 FrntSideRdrRiObj4RdrObjConf 0;
BA_ "GenSigSendType" SG_ 355 FrntSideRdrRiObj4RdrObjDx 0;
BA_ "GenSigSendType" SG_ 355 FrntSideRdrRiObj4RdrObjDxStdDe 0;
BA_ "GenSigStartValue" SG_ 355 FrntSideRdrRiObj4RdrObjDy 4000;
BA_ "GenSigSendType" SG_ 355 FrntSideRdrRiObj4RdrObjDy 0;
BA_ "GenSigSendType" SG_ 355 FrntSideRdrRiObj4RdrObjDyStdDe 0;
BA_ "GenSigSendType" SG_ 355 FrntSideRdrRiObj4RdrObjElevnConf 0;
BA_ "GenSigSendType" SG_ 355 FrntSideRdrRiObj4RdrObjElevnSts 0;
BA_ "GenSigSendType" SG_ 355 FrntSideRdrRiObj4RdrObjID 0;
BA_ "GenSigStartValue" SG_ 355 FrntSideRdrRiObj4RdrObjIsInFreeSpace 1;
BA_ "GenSigSendType" SG_ 355 FrntSideRdrRiObj4RdrObjIsInFreeSpace 0;
BA_ "GenSigSendType" SG_ 355 FrntSideRdrRiObj4RdrObjMirrProblty 0;
BA_ "GenSigStartValue" SG_ 355 FrntSideRdrRiObj4RdrObjMtnPat 3;
BA_ "GenSigSendType" SG_ 355 FrntSideRdrRiObj4RdrObjMtnPat 0;
BA_ "GenSigSendType" SG_ 355 FrntSideRdrRiObj4RdrObjNotRealProblty 0;
BA_ "GenSigSendType" SG_ 355 FrntSideRdrRiObj4RdrObjStatyCnt 0;
BA_ "GenSigSendType" SG_ 355 FrntSideRdrRiObj4RdrObjTiAlv 0;
BA_ "GenSigSendType" SG_ 355 FrntSideRdrRiObj4RdrObjTrackSts 0;
BA_ "GenSigSendType" SG_ 355 FrntSideRdrRiObj4RdrObjTyp 0;
BA_ "GenSigSendType" SG_ 355 FrntSideRdrRiObj4RdrObjTypConfBike 0;
BA_ "GenSigSendType" SG_ 355 FrntSideRdrRiObj4RdrObjTypConfPed 0;
BA_ "GenSigSendType" SG_ 355 FrntSideRdrRiObj4RdrObjTypConfVeh 0;
BA_ "GenSigStartValue" SG_ 355 FrntSideRdrRiObj4RdrObjVx 6400;
BA_ "GenSigSendType" SG_ 355 FrntSideRdrRiObj4RdrObjVx 0;
BA_ "GenSigSendType" SG_ 355 FrntSideRdrRiObj4RdrObjVxStdDe 0;
BA_ "GenSigStartValue" SG_ 355 FrntSideRdrRiObj4RdrObjVy 6400;
BA_ "GenSigSendType" SG_ 355 FrntSideRdrRiObj4RdrObjVy 0;
BA_ "GenSigSendType" SG_ 355 FrntSideRdrRiObj4RdrObjVyStdDe 0;
BA_ "GenSigStartValue" SG_ 355 FrntSideRdrRiObj4RelVx 1780;
BA_ "GenSigSendType" SG_ 355 FrntSideRdrRiObj4RelVx 0;
BA_ "GenSigStartValue" SG_ 355 FrntSideRdrRiObj4RelVy 1780;
BA_ "GenSigSendType" SG_ 355 FrntSideRdrRiObj4RelVy 0;
// Frame: FSRRSafetyCANFD1Frame27
BA_ "VFrameFormat" BO_ 357 14;
BA_ "GenMsgSendType" BO_ 357 0;
BA_ "GenMsgCycleTime" BO_ 357 50.000;
BA_ "GenSigStartValue" SG_ 357 FrntSideRdrRiObj5Heading 1800;
BA_ "GenSigSendType" SG_ 357 FrntSideRdrRiObj5Heading 0;
BA_ "GenSigStartValue" SG_ 357 FrntSideRdrRiObj5ObjBoxCenterLat 250;
BA_ "GenSigSendType" SG_ 357 FrntSideRdrRiObj5ObjBoxCenterLat 0;
BA_ "GenSigStartValue" SG_ 357 FrntSideRdrRiObj5ObjBoxCenterLgt 250;
BA_ "GenSigSendType" SG_ 357 FrntSideRdrRiObj5ObjBoxCenterLgt 0;
BA_ "GenSigSendType" SG_ 357 FrntSideRdrRiObj5ObservationHist 0;
BA_ "GenSigSendType" SG_ 357 FrntSideRdrRiObj5RdrObjAx 0;
BA_ "GenSigSendType" SG_ 357 FrntSideRdrRiObj5RdrObjAy 0;
BA_ "GenSigSendType" SG_ 357 FrntSideRdrRiObj5RdrObjBoxLength 0;
BA_ "GenSigSendType" SG_ 357 FrntSideRdrRiObj5RdrObjBoxWidth 0;
BA_ "GenSigSendType" SG_ 357 FrntSideRdrRiObj5RdrObjChks 0;
BA_ "GenSigFuncType" SG_ 357 FrntSideRdrRiObj5RdrObjChks 15;
BA_ "GenSigDataID" SG_ 357 FrntSideRdrRiObj5RdrObjChks "0x967";
BA_ "GenSigSendType" SG_ 357 FrntSideRdrRiObj5RdrObjCntr 0;
BA_ "GenSigFuncType" SG_ 357 FrntSideRdrRiObj5RdrObjCntr 16;
BA_ "GenSigStartValue" SG_ 357 FrntSideRdrRiObj5RdrObjCoastCnt 31;
BA_ "GenSigSendType" SG_ 357 FrntSideRdrRiObj5RdrObjCoastCnt 0;
BA_ "GenSigSendType" SG_ 357 FrntSideRdrRiObj5RdrObjConf 0;
BA_ "GenSigSendType" SG_ 357 FrntSideRdrRiObj5RdrObjDx 0;
BA_ "GenSigSendType" SG_ 357 FrntSideRdrRiObj5RdrObjDxStdDe 0;
BA_ "GenSigStartValue" SG_ 357 FrntSideRdrRiObj5RdrObjDy 4000;
BA_ "GenSigSendType" SG_ 357 FrntSideRdrRiObj5RdrObjDy 0;
BA_ "GenSigSendType" SG_ 357 FrntSideRdrRiObj5RdrObjDyStdDe 0;
BA_ "GenSigSendType" SG_ 357 FrntSideRdrRiObj5RdrObjElevnConf 0;
BA_ "GenSigSendType" SG_ 357 FrntSideRdrRiObj5RdrObjElevnSts 0;
BA_ "GenSigSendType" SG_ 357 FrntSideRdrRiObj5RdrObjID 0;
BA_ "GenSigStartValue" SG_ 357 FrntSideRdrRiObj5RdrObjIsInFreeSpace 1;
BA_ "GenSigSendType" SG_ 357 FrntSideRdrRiObj5RdrObjIsInFreeSpace 0;
BA_ "GenSigSendType" SG_ 357 FrntSideRdrRiObj5RdrObjMirrProblty 0;
BA_ "GenSigStartValue" SG_ 357 FrntSideRdrRiObj5RdrObjMtnPat 3;
BA_ "GenSigSendType" SG_ 357 FrntSideRdrRiObj5RdrObjMtnPat 0;
BA_ "GenSigSendType" SG_ 357 FrntSideRdrRiObj5RdrObjNotRealProblty 0;
BA_ "GenSigSendType" SG_ 357 FrntSideRdrRiObj5RdrObjStatyCnt 0;
BA_ "GenSigSendType" SG_ 357 FrntSideRdrRiObj5RdrObjTiAlv 0;
BA_ "GenSigSendType" SG_ 357 FrntSideRdrRiObj5RdrObjTrackSts 0;
BA_ "GenSigSendType" SG_ 357 FrntSideRdrRiObj5RdrObjTyp 0;
BA_ "GenSigSendType" SG_ 357 FrntSideRdrRiObj5RdrObjTypConfBike 0;
BA_ "GenSigSendType" SG_ 357 FrntSideRdrRiObj5RdrObjTypConfPed 0;
BA_ "GenSigSendType" SG_ 357 FrntSideRdrRiObj5RdrObjTypConfVeh 0;
BA_ "GenSigStartValue" SG_ 357 FrntSideRdrRiObj5RdrObjVx 6400;
BA_ "GenSigSendType" SG_ 357 FrntSideRdrRiObj5RdrObjVx 0;
BA_ "GenSigSendType" SG_ 357 FrntSideRdrRiObj5RdrObjVxStdDe 0;
BA_ "GenSigStartValue" SG_ 357 FrntSideRdrRiObj5RdrObjVy 6400;
BA_ "GenSigSendType" SG_ 357 FrntSideRdrRiObj5RdrObjVy 0;
BA_ "GenSigSendType" SG_ 357 FrntSideRdrRiObj5RdrObjVyStdDe 0;
BA_ "GenSigStartValue" SG_ 357 FrntSideRdrRiObj5RelVx 1780;
BA_ "GenSigSendType" SG_ 357 FrntSideRdrRiObj5RelVx 0;
BA_ "GenSigStartValue" SG_ 357 FrntSideRdrRiObj5RelVy 1780;
BA_ "GenSigSendType" SG_ 357 FrntSideRdrRiObj5RelVy 0;
// Frame: FSRRSafetyCANFD1Frame28
BA_ "VFrameFormat" BO_ 359 14;
BA_ "GenMsgSendType" BO_ 359 0;
BA_ "GenMsgCycleTime" BO_ 359 50.000;
BA_ "GenSigStartValue" SG_ 359 FrntSideRdrRiObj6Heading 1800;
BA_ "GenSigSendType" SG_ 359 FrntSideRdrRiObj6Heading 0;
BA_ "GenSigStartValue" SG_ 359 FrntSideRdrRiObj6ObjBoxCenterLat 250;
BA_ "GenSigSendType" SG_ 359 FrntSideRdrRiObj6ObjBoxCenterLat 0;
BA_ "GenSigStartValue" SG_ 359 FrntSideRdrRiObj6ObjBoxCenterLgt 250;
BA_ "GenSigSendType" SG_ 359 FrntSideRdrRiObj6ObjBoxCenterLgt 0;
BA_ "GenSigSendType" SG_ 359 FrntSideRdrRiObj6ObservationHist 0;
BA_ "GenSigSendType" SG_ 359 FrntSideRdrRiObj6RdrObjAx 0;
BA_ "GenSigSendType" SG_ 359 FrntSideRdrRiObj6RdrObjAy 0;
BA_ "GenSigSendType" SG_ 359 FrntSideRdrRiObj6RdrObjBoxLength 0;
BA_ "GenSigSendType" SG_ 359 FrntSideRdrRiObj6RdrObjBoxWidth 0;
BA_ "GenSigSendType" SG_ 359 FrntSideRdrRiObj6RdrObjChks 0;
BA_ "GenSigFuncType" SG_ 359 FrntSideRdrRiObj6RdrObjChks 15;
BA_ "GenSigDataID" SG_ 359 FrntSideRdrRiObj6RdrObjChks "0x968";
BA_ "GenSigSendType" SG_ 359 FrntSideRdrRiObj6RdrObjCntr 0;
BA_ "GenSigFuncType" SG_ 359 FrntSideRdrRiObj6RdrObjCntr 16;
BA_ "GenSigStartValue" SG_ 359 FrntSideRdrRiObj6RdrObjCoastCnt 31;
BA_ "GenSigSendType" SG_ 359 FrntSideRdrRiObj6RdrObjCoastCnt 0;
BA_ "GenSigSendType" SG_ 359 FrntSideRdrRiObj6RdrObjConf 0;
BA_ "GenSigSendType" SG_ 359 FrntSideRdrRiObj6RdrObjDx 0;
BA_ "GenSigSendType" SG_ 359 FrntSideRdrRiObj6RdrObjDxStdDe 0;
BA_ "GenSigStartValue" SG_ 359 FrntSideRdrRiObj6RdrObjDy 4000;
BA_ "GenSigSendType" SG_ 359 FrntSideRdrRiObj6RdrObjDy 0;
BA_ "GenSigSendType" SG_ 359 FrntSideRdrRiObj6RdrObjDyStdDe 0;
BA_ "GenSigSendType" SG_ 359 FrntSideRdrRiObj6RdrObjElevnConf 0;
BA_ "GenSigSendType" SG_ 359 FrntSideRdrRiObj6RdrObjElevnSts 0;
BA_ "GenSigSendType" SG_ 359 FrntSideRdrRiObj6RdrObjID 0;
BA_ "GenSigStartValue" SG_ 359 FrntSideRdrRiObj6RdrObjIsInFreeSpace 1;
BA_ "GenSigSendType" SG_ 359 FrntSideRdrRiObj6RdrObjIsInFreeSpace 0;
BA_ "GenSigSendType" SG_ 359 FrntSideRdrRiObj6RdrObjMirrProblty 0;
BA_ "GenSigStartValue" SG_ 359 FrntSideRdrRiObj6RdrObjMtnPat 3;
BA_ "GenSigSendType" SG_ 359 FrntSideRdrRiObj6RdrObjMtnPat 0;
BA_ "GenSigSendType" SG_ 359 FrntSideRdrRiObj6RdrObjNotRealProblty 0;
BA_ "GenSigSendType" SG_ 359 FrntSideRdrRiObj6RdrObjStatyCnt 0;
BA_ "GenSigSendType" SG_ 359 FrntSideRdrRiObj6RdrObjTiAlv 0;
BA_ "GenSigSendType" SG_ 359 FrntSideRdrRiObj6RdrObjTrackSts 0;
BA_ "GenSigSendType" SG_ 359 FrntSideRdrRiObj6RdrObjTyp 0;
BA_ "GenSigSendType" SG_ 359 FrntSideRdrRiObj6RdrObjTypConfBike 0;
BA_ "GenSigSendType" SG_ 359 FrntSideRdrRiObj6RdrObjTypConfPed 0;
BA_ "GenSigSendType" SG_ 359 FrntSideRdrRiObj6RdrObjTypConfVeh 0;
BA_ "GenSigStartValue" SG_ 359 FrntSideRdrRiObj6RdrObjVx 6400;
BA_ "GenSigSendType" SG_ 359 FrntSideRdrRiObj6RdrObjVx 0;
BA_ "GenSigSendType" SG_ 359 FrntSideRdrRiObj6RdrObjVxStdDe 0;
BA_ "GenSigStartValue" SG_ 359 FrntSideRdrRiObj6RdrObjVy 6400;
BA_ "GenSigSendType" SG_ 359 FrntSideRdrRiObj6RdrObjVy 0;
BA_ "GenSigSendType" SG_ 359 FrntSideRdrRiObj6RdrObjVyStdDe 0;
BA_ "GenSigStartValue" SG_ 359 FrntSideRdrRiObj6RelVx 1780;
BA_ "GenSigSendType" SG_ 359 FrntSideRdrRiObj6RelVx 0;
BA_ "GenSigStartValue" SG_ 359 FrntSideRdrRiObj6RelVy 1780;
BA_ "GenSigSendType" SG_ 359 FrntSideRdrRiObj6RelVy 0;
// Frame: FSRRSafetyCANFD1Frame29
BA_ "VFrameFormat" BO_ 361 14;
BA_ "GenMsgSendType" BO_ 361 0;
BA_ "GenMsgCycleTime" BO_ 361 50.000;
BA_ "GenSigStartValue" SG_ 361 FrntSideRdrRiObj7Heading 1800;
BA_ "GenSigSendType" SG_ 361 FrntSideRdrRiObj7Heading 0;
BA_ "GenSigStartValue" SG_ 361 FrntSideRdrRiObj7ObjBoxCenterLat 250;
BA_ "GenSigSendType" SG_ 361 FrntSideRdrRiObj7ObjBoxCenterLat 0;
BA_ "GenSigStartValue" SG_ 361 FrntSideRdrRiObj7ObjBoxCenterLgt 250;
BA_ "GenSigSendType" SG_ 361 FrntSideRdrRiObj7ObjBoxCenterLgt 0;
BA_ "GenSigSendType" SG_ 361 FrntSideRdrRiObj7ObservationHist 0;
BA_ "GenSigSendType" SG_ 361 FrntSideRdrRiObj7RdrObjAx 0;
BA_ "GenSigSendType" SG_ 361 FrntSideRdrRiObj7RdrObjAy 0;
BA_ "GenSigSendType" SG_ 361 FrntSideRdrRiObj7RdrObjBoxLength 0;
BA_ "GenSigSendType" SG_ 361 FrntSideRdrRiObj7RdrObjBoxWidth 0;
BA_ "GenSigSendType" SG_ 361 FrntSideRdrRiObj7RdrObjChks 0;
BA_ "GenSigFuncType" SG_ 361 FrntSideRdrRiObj7RdrObjChks 15;
BA_ "GenSigDataID" SG_ 361 FrntSideRdrRiObj7RdrObjChks "0x969";
BA_ "GenSigSendType" SG_ 361 FrntSideRdrRiObj7RdrObjCntr 0;
BA_ "GenSigFuncType" SG_ 361 FrntSideRdrRiObj7RdrObjCntr 16;
BA_ "GenSigStartValue" SG_ 361 FrntSideRdrRiObj7RdrObjCoastCnt 31;
BA_ "GenSigSendType" SG_ 361 FrntSideRdrRiObj7RdrObjCoastCnt 0;
BA_ "GenSigSendType" SG_ 361 FrntSideRdrRiObj7RdrObjConf 0;
BA_ "GenSigSendType" SG_ 361 FrntSideRdrRiObj7RdrObjDx 0;
BA_ "GenSigSendType" SG_ 361 FrntSideRdrRiObj7RdrObjDxStdDe 0;
BA_ "GenSigStartValue" SG_ 361 FrntSideRdrRiObj7RdrObjDy 4000;
BA_ "GenSigSendType" SG_ 361 FrntSideRdrRiObj7RdrObjDy 0;
BA_ "GenSigSendType" SG_ 361 FrntSideRdrRiObj7RdrObjDyStdDe 0;
BA_ "GenSigSendType" SG_ 361 FrntSideRdrRiObj7RdrObjElevnConf 0;
BA_ "GenSigSendType" SG_ 361 FrntSideRdrRiObj7RdrObjElevnSts 0;
BA_ "GenSigSendType" SG_ 361 FrntSideRdrRiObj7RdrObjID 0;
BA_ "GenSigStartValue" SG_ 361 FrntSideRdrRiObj7RdrObjIsInFreeSpace 1;
BA_ "GenSigSendType" SG_ 361 FrntSideRdrRiObj7RdrObjIsInFreeSpace 0;
BA_ "GenSigSendType" SG_ 361 FrntSideRdrRiObj7RdrObjMirrProblty 0;
BA_ "GenSigStartValue" SG_ 361 FrntSideRdrRiObj7RdrObjMtnPat 3;
BA_ "GenSigSendType" SG_ 361 FrntSideRdrRiObj7RdrObjMtnPat 0;
BA_ "GenSigSendType" SG_ 361 FrntSideRdrRiObj7RdrObjNotRealProblty 0;
BA_ "GenSigSendType" SG_ 361 FrntSideRdrRiObj7RdrObjStatyCnt 0;
BA_ "GenSigSendType" SG_ 361 FrntSideRdrRiObj7RdrObjTiAlv 0;
BA_ "GenSigSendType" SG_ 361 FrntSideRdrRiObj7RdrObjTrackSts 0;
BA_ "GenSigSendType" SG_ 361 FrntSideRdrRiObj7RdrObjTyp 0;
BA_ "GenSigSendType" SG_ 361 FrntSideRdrRiObj7RdrObjTypConfBike 0;
BA_ "GenSigSendType" SG_ 361 FrntSideRdrRiObj7RdrObjTypConfPed 0;
BA_ "GenSigSendType" SG_ 361 FrntSideRdrRiObj7RdrObjTypConfVeh 0;
BA_ "GenSigStartValue" SG_ 361 FrntSideRdrRiObj7RdrObjVx 6400;
BA_ "GenSigSendType" SG_ 361 FrntSideRdrRiObj7RdrObjVx 0;
BA_ "GenSigSendType" SG_ 361 FrntSideRdrRiObj7RdrObjVxStdDe 0;
BA_ "GenSigStartValue" SG_ 361 FrntSideRdrRiObj7RdrObjVy 6400;
BA_ "GenSigSendType" SG_ 361 FrntSideRdrRiObj7RdrObjVy 0;
BA_ "GenSigSendType" SG_ 361 FrntSideRdrRiObj7RdrObjVyStdDe 0;
BA_ "GenSigStartValue" SG_ 361 FrntSideRdrRiObj7RelVx 1780;
BA_ "GenSigSendType" SG_ 361 FrntSideRdrRiObj7RelVx 0;
BA_ "GenSigStartValue" SG_ 361 FrntSideRdrRiObj7RelVy 1780;
BA_ "GenSigSendType" SG_ 361 FrntSideRdrRiObj7RelVy 0;
// Frame: FSRRSafetyCANFD1Frame30
BA_ "VFrameFormat" BO_ 363 14;
BA_ "GenMsgSendType" BO_ 363 0;
BA_ "GenMsgCycleTime" BO_ 363 50.000;
BA_ "GenSigStartValue" SG_ 363 FrntSideRdrRiObj8Heading 1800;
BA_ "GenSigSendType" SG_ 363 FrntSideRdrRiObj8Heading 0;
BA_ "GenSigStartValue" SG_ 363 FrntSideRdrRiObj8ObjBoxCenterLat 250;
BA_ "GenSigSendType" SG_ 363 FrntSideRdrRiObj8ObjBoxCenterLat 0;
BA_ "GenSigStartValue" SG_ 363 FrntSideRdrRiObj8ObjBoxCenterLgt 250;
BA_ "GenSigSendType" SG_ 363 FrntSideRdrRiObj8ObjBoxCenterLgt 0;
BA_ "GenSigSendType" SG_ 363 FrntSideRdrRiObj8ObservationHist 0;
BA_ "GenSigSendType" SG_ 363 FrntSideRdrRiObj8RdrObjAx 0;
BA_ "GenSigSendType" SG_ 363 FrntSideRdrRiObj8RdrObjAy 0;
BA_ "GenSigSendType" SG_ 363 FrntSideRdrRiObj8RdrObjBoxLength 0;
BA_ "GenSigSendType" SG_ 363 FrntSideRdrRiObj8RdrObjBoxWidth 0;
BA_ "GenSigSendType" SG_ 363 FrntSideRdrRiObj8RdrObjChks 0;
BA_ "GenSigFuncType" SG_ 363 FrntSideRdrRiObj8RdrObjChks 15;
BA_ "GenSigDataID" SG_ 363 FrntSideRdrRiObj8RdrObjChks "0x96A";
BA_ "GenSigSendType" SG_ 363 FrntSideRdrRiObj8RdrObjCntr 0;
BA_ "GenSigFuncType" SG_ 363 FrntSideRdrRiObj8RdrObjCntr 16;
BA_ "GenSigStartValue" SG_ 363 FrntSideRdrRiObj8RdrObjCoastCnt 31;
BA_ "GenSigSendType" SG_ 363 FrntSideRdrRiObj8RdrObjCoastCnt 0;
BA_ "GenSigSendType" SG_ 363 FrntSideRdrRiObj8RdrObjConf 0;
BA_ "GenSigSendType" SG_ 363 FrntSideRdrRiObj8RdrObjDx 0;
BA_ "GenSigSendType" SG_ 363 FrntSideRdrRiObj8RdrObjDxStdDe 0;
BA_ "GenSigStartValue" SG_ 363 FrntSideRdrRiObj8RdrObjDy 4000;
BA_ "GenSigSendType" SG_ 363 FrntSideRdrRiObj8RdrObjDy 0;
BA_ "GenSigSendType" SG_ 363 FrntSideRdrRiObj8RdrObjDyStdDe 0;
BA_ "GenSigSendType" SG_ 363 FrntSideRdrRiObj8RdrObjElevnConf 0;
BA_ "GenSigSendType" SG_ 363 FrntSideRdrRiObj8RdrObjElevnSts 0;
BA_ "GenSigSendType" SG_ 363 FrntSideRdrRiObj8RdrObjID 0;
BA_ "GenSigStartValue" SG_ 363 FrntSideRdrRiObj8RdrObjIsInFreeSpace 1;
BA_ "GenSigSendType" SG_ 363 FrntSideRdrRiObj8RdrObjIsInFreeSpace 0;
BA_ "GenSigSendType" SG_ 363 FrntSideRdrRiObj8RdrObjMirrProblty 0;
BA_ "GenSigStartValue" SG_ 363 FrntSideRdrRiObj8RdrObjMtnPat 3;
BA_ "GenSigSendType" SG_ 363 FrntSideRdrRiObj8RdrObjMtnPat 0;
BA_ "GenSigSendType" SG_ 363 FrntSideRdrRiObj8RdrObjNotRealProblty 0;
BA_ "GenSigSendType" SG_ 363 FrntSideRdrRiObj8RdrObjStatyCnt 0;
BA_ "GenSigSendType" SG_ 363 FrntSideRdrRiObj8RdrObjTiAlv 0;
BA_ "GenSigSendType" SG_ 363 FrntSideRdrRiObj8RdrObjTrackSts 0;
BA_ "GenSigSendType" SG_ 363 FrntSideRdrRiObj8RdrObjTyp 0;
BA_ "GenSigSendType" SG_ 363 FrntSideRdrRiObj8RdrObjTypConfBike 0;
BA_ "GenSigSendType" SG_ 363 FrntSideRdrRiObj8RdrObjTypConfPed 0;
BA_ "GenSigSendType" SG_ 363 FrntSideRdrRiObj8RdrObjTypConfVeh 0;
BA_ "GenSigStartValue" SG_ 363 FrntSideRdrRiObj8RdrObjVx 6400;
BA_ "GenSigSendType" SG_ 363 FrntSideRdrRiObj8RdrObjVx 0;
BA_ "GenSigSendType" SG_ 363 FrntSideRdrRiObj8RdrObjVxStdDe 0;
BA_ "GenSigStartValue" SG_ 363 FrntSideRdrRiObj8RdrObjVy 6400;
BA_ "GenSigSendType" SG_ 363 FrntSideRdrRiObj8RdrObjVy 0;
BA_ "GenSigSendType" SG_ 363 FrntSideRdrRiObj8RdrObjVyStdDe 0;
BA_ "GenSigStartValue" SG_ 363 FrntSideRdrRiObj8RelVx 1780;
BA_ "GenSigSendType" SG_ 363 FrntSideRdrRiObj8RelVx 0;
BA_ "GenSigStartValue" SG_ 363 FrntSideRdrRiObj8RelVy 1780;
BA_ "GenSigSendType" SG_ 363 FrntSideRdrRiObj8RelVy 0;
// Frame: FSRRSafetyCANFD1Frame31
BA_ "VFrameFormat" BO_ 365 14;
BA_ "GenMsgSendType" BO_ 365 0;
BA_ "GenMsgCycleTime" BO_ 365 50.000;
BA_ "GenSigStartValue" SG_ 365 FrntSideRdrRiObj9Heading 1800;
BA_ "GenSigSendType" SG_ 365 FrntSideRdrRiObj9Heading 0;
BA_ "GenSigStartValue" SG_ 365 FrntSideRdrRiObj9ObjBoxCenterLat 250;
BA_ "GenSigSendType" SG_ 365 FrntSideRdrRiObj9ObjBoxCenterLat 0;
BA_ "GenSigStartValue" SG_ 365 FrntSideRdrRiObj9ObjBoxCenterLgt 250;
BA_ "GenSigSendType" SG_ 365 FrntSideRdrRiObj9ObjBoxCenterLgt 0;
BA_ "GenSigSendType" SG_ 365 FrntSideRdrRiObj9ObservationHist 0;
BA_ "GenSigSendType" SG_ 365 FrntSideRdrRiObj9RdrObjAx 0;
BA_ "GenSigSendType" SG_ 365 FrntSideRdrRiObj9RdrObjAy 0;
BA_ "GenSigSendType" SG_ 365 FrntSideRdrRiObj9RdrObjBoxLength 0;
BA_ "GenSigSendType" SG_ 365 FrntSideRdrRiObj9RdrObjBoxWidth 0;
BA_ "GenSigSendType" SG_ 365 FrntSideRdrRiObj9RdrObjChks 0;
BA_ "GenSigFuncType" SG_ 365 FrntSideRdrRiObj9RdrObjChks 15;
BA_ "GenSigDataID" SG_ 365 FrntSideRdrRiObj9RdrObjChks "0x96B";
BA_ "GenSigSendType" SG_ 365 FrntSideRdrRiObj9RdrObjCntr 0;
BA_ "GenSigFuncType" SG_ 365 FrntSideRdrRiObj9RdrObjCntr 16;
BA_ "GenSigStartValue" SG_ 365 FrntSideRdrRiObj9RdrObjCoastCnt 31;
BA_ "GenSigSendType" SG_ 365 FrntSideRdrRiObj9RdrObjCoastCnt 0;
BA_ "GenSigSendType" SG_ 365 FrntSideRdrRiObj9RdrObjConf 0;
BA_ "GenSigSendType" SG_ 365 FrntSideRdrRiObj9RdrObjDx 0;
BA_ "GenSigSendType" SG_ 365 FrntSideRdrRiObj9RdrObjDxStdDe 0;
BA_ "GenSigStartValue" SG_ 365 FrntSideRdrRiObj9RdrObjDy 4000;
BA_ "GenSigSendType" SG_ 365 FrntSideRdrRiObj9RdrObjDy 0;
BA_ "GenSigSendType" SG_ 365 FrntSideRdrRiObj9RdrObjDyStdDe 0;
BA_ "GenSigSendType" SG_ 365 FrntSideRdrRiObj9RdrObjElevnConf 0;
BA_ "GenSigSendType" SG_ 365 FrntSideRdrRiObj9RdrObjElevnSts 0;
BA_ "GenSigSendType" SG_ 365 FrntSideRdrRiObj9RdrObjID 0;
BA_ "GenSigStartValue" SG_ 365 FrntSideRdrRiObj9RdrObjIsInFreeSpace 1;
BA_ "GenSigSendType" SG_ 365 FrntSideRdrRiObj9RdrObjIsInFreeSpace 0;
BA_ "GenSigSendType" SG_ 365 FrntSideRdrRiObj9RdrObjMirrProblty 0;
BA_ "GenSigStartValue" SG_ 365 FrntSideRdrRiObj9RdrObjMtnPat 3;
BA_ "GenSigSendType" SG_ 365 FrntSideRdrRiObj9RdrObjMtnPat 0;
BA_ "GenSigSendType" SG_ 365 FrntSideRdrRiObj9RdrObjNotRealProblty 0;
BA_ "GenSigSendType" SG_ 365 FrntSideRdrRiObj9RdrObjStatyCnt 0;
BA_ "GenSigSendType" SG_ 365 FrntSideRdrRiObj9RdrObjTiAlv 0;
BA_ "GenSigSendType" SG_ 365 FrntSideRdrRiObj9RdrObjTrackSts 0;
BA_ "GenSigSendType" SG_ 365 FrntSideRdrRiObj9RdrObjTyp 0;
BA_ "GenSigSendType" SG_ 365 FrntSideRdrRiObj9RdrObjTypConfBike 0;
BA_ "GenSigSendType" SG_ 365 FrntSideRdrRiObj9RdrObjTypConfPed 0;
BA_ "GenSigSendType" SG_ 365 FrntSideRdrRiObj9RdrObjTypConfVeh 0;
BA_ "GenSigStartValue" SG_ 365 FrntSideRdrRiObj9RdrObjVx 6400;
BA_ "GenSigSendType" SG_ 365 FrntSideRdrRiObj9RdrObjVx 0;
BA_ "GenSigSendType" SG_ 365 FrntSideRdrRiObj9RdrObjVxStdDe 0;
BA_ "GenSigStartValue" SG_ 365 FrntSideRdrRiObj9RdrObjVy 6400;
BA_ "GenSigSendType" SG_ 365 FrntSideRdrRiObj9RdrObjVy 0;
BA_ "GenSigSendType" SG_ 365 FrntSideRdrRiObj9RdrObjVyStdDe 0;
BA_ "GenSigStartValue" SG_ 365 FrntSideRdrRiObj9RelVx 1780;
BA_ "GenSigSendType" SG_ 365 FrntSideRdrRiObj9RelVx 0;
BA_ "GenSigStartValue" SG_ 365 FrntSideRdrRiObj9RelVy 1780;
BA_ "GenSigSendType" SG_ 365 FrntSideRdrRiObj9RelVy 0;
// Frame: FSRRSafetyCANFD1Frame32
BA_ "VFrameFormat" BO_ 367 14;
BA_ "GenMsgSendType" BO_ 367 0;
BA_ "GenMsgCycleTime" BO_ 367 50.000;
BA_ "GenSigStartValue" SG_ 367 FrntSideRdrRiObj10Heading 1800;
BA_ "GenSigSendType" SG_ 367 FrntSideRdrRiObj10Heading 0;
BA_ "GenSigStartValue" SG_ 367 FrntSideRdrRiObj10ObjBoxCenterLat 250;
BA_ "GenSigSendType" SG_ 367 FrntSideRdrRiObj10ObjBoxCenterLat 0;
BA_ "GenSigStartValue" SG_ 367 FrntSideRdrRiObj10ObjBoxCenterLgt 250;
BA_ "GenSigSendType" SG_ 367 FrntSideRdrRiObj10ObjBoxCenterLgt 0;
BA_ "GenSigSendType" SG_ 367 FrntSideRdrRiObj10ObservationHist 0;
BA_ "GenSigSendType" SG_ 367 FrntSideRdrRiObj10RdrObjAx 0;
BA_ "GenSigSendType" SG_ 367 FrntSideRdrRiObj10RdrObjAy 0;
BA_ "GenSigSendType" SG_ 367 FrntSideRdrRiObj10RdrObjBoxLength 0;
BA_ "GenSigSendType" SG_ 367 FrntSideRdrRiObj10RdrObjBoxWidth 0;
BA_ "GenSigSendType" SG_ 367 FrntSideRdrRiObj10RdrObjChks 0;
BA_ "GenSigFuncType" SG_ 367 FrntSideRdrRiObj10RdrObjChks 15;
BA_ "GenSigDataID" SG_ 367 FrntSideRdrRiObj10RdrObjChks "0x96C";
BA_ "GenSigSendType" SG_ 367 FrntSideRdrRiObj10RdrObjCntr 0;
BA_ "GenSigFuncType" SG_ 367 FrntSideRdrRiObj10RdrObjCntr 16;
BA_ "GenSigStartValue" SG_ 367 FrntSideRdrRiObj10RdrObjCoastCnt 31;
BA_ "GenSigSendType" SG_ 367 FrntSideRdrRiObj10RdrObjCoastCnt 0;
BA_ "GenSigSendType" SG_ 367 FrntSideRdrRiObj10RdrObjConf 0;
BA_ "GenSigSendType" SG_ 367 FrntSideRdrRiObj10RdrObjDx 0;
BA_ "GenSigSendType" SG_ 367 FrntSideRdrRiObj10RdrObjDxStdDe 0;
BA_ "GenSigStartValue" SG_ 367 FrntSideRdrRiObj10RdrObjDy 4000;
BA_ "GenSigSendType" SG_ 367 FrntSideRdrRiObj10RdrObjDy 0;
BA_ "GenSigSendType" SG_ 367 FrntSideRdrRiObj10RdrObjDyStdDe 0;
BA_ "GenSigSendType" SG_ 367 FrntSideRdrRiObj10RdrObjElevnConf 0;
BA_ "GenSigSendType" SG_ 367 FrntSideRdrRiObj10RdrObjElevnSts 0;
BA_ "GenSigSendType" SG_ 367 FrntSideRdrRiObj10RdrObjID 0;
BA_ "GenSigStartValue" SG_ 367 FrntSideRdrRiObj10RdrObjIsInFreeSpace 1;
BA_ "GenSigSendType" SG_ 367 FrntSideRdrRiObj10RdrObjIsInFreeSpace 0;
BA_ "GenSigSendType" SG_ 367 FrntSideRdrRiObj10RdrObjMirrProblty 0;
BA_ "GenSigStartValue" SG_ 367 FrntSideRdrRiObj10RdrObjMtnPat 3;
BA_ "GenSigSendType" SG_ 367 FrntSideRdrRiObj10RdrObjMtnPat 0;
BA_ "GenSigSendType" SG_ 367 FrntSideRdrRiObj10RdrObjNotRealProblty 0;
BA_ "GenSigSendType" SG_ 367 FrntSideRdrRiObj10RdrObjStatyCnt 0;
BA_ "GenSigSendType" SG_ 367 FrntSideRdrRiObj10RdrObjTiAlv 0;
BA_ "GenSigSendType" SG_ 367 FrntSideRdrRiObj10RdrObjTrackSts 0;
BA_ "GenSigSendType" SG_ 367 FrntSideRdrRiObj10RdrObjTyp 0;
BA_ "GenSigSendType" SG_ 367 FrntSideRdrRiObj10RdrObjTypConfBike 0;
BA_ "GenSigSendType" SG_ 367 FrntSideRdrRiObj10RdrObjTypConfPed 0;
BA_ "GenSigSendType" SG_ 367 FrntSideRdrRiObj10RdrObjTypConfVeh 0;
BA_ "GenSigStartValue" SG_ 367 FrntSideRdrRiObj10RdrObjVx 6400;
BA_ "GenSigSendType" SG_ 367 FrntSideRdrRiObj10RdrObjVx 0;
BA_ "GenSigSendType" SG_ 367 FrntSideRdrRiObj10RdrObjVxStdDe 0;
BA_ "GenSigStartValue" SG_ 367 FrntSideRdrRiObj10RdrObjVy 6400;
BA_ "GenSigSendType" SG_ 367 FrntSideRdrRiObj10RdrObjVy 0;
BA_ "GenSigSendType" SG_ 367 FrntSideRdrRiObj10RdrObjVyStdDe 0;
BA_ "GenSigStartValue" SG_ 367 FrntSideRdrRiObj10RelVx 1780;
BA_ "GenSigSendType" SG_ 367 FrntSideRdrRiObj10RelVx 0;
BA_ "GenSigStartValue" SG_ 367 FrntSideRdrRiObj10RelVy 1780;
BA_ "GenSigSendType" SG_ 367 FrntSideRdrRiObj10RelVy 0;
// Frame: FSRRSafetyCANFD1Frame33
BA_ "VFrameFormat" BO_ 369 14;
BA_ "GenMsgSendType" BO_ 369 0;
BA_ "GenMsgCycleTime" BO_ 369 50.000;
BA_ "GenSigStartValue" SG_ 369 FrntSideRdrRiObj11Heading 1800;
BA_ "GenSigSendType" SG_ 369 FrntSideRdrRiObj11Heading 0;
BA_ "GenSigStartValue" SG_ 369 FrntSideRdrRiObj11ObjBoxCenterLat 250;
BA_ "GenSigSendType" SG_ 369 FrntSideRdrRiObj11ObjBoxCenterLat 0;
BA_ "GenSigStartValue" SG_ 369 FrntSideRdrRiObj11ObjBoxCenterLgt 250;
BA_ "GenSigSendType" SG_ 369 FrntSideRdrRiObj11ObjBoxCenterLgt 0;
BA_ "GenSigSendType" SG_ 369 FrntSideRdrRiObj11ObservationHist 0;
BA_ "GenSigSendType" SG_ 369 FrntSideRdrRiObj11RdrObjAx 0;
BA_ "GenSigSendType" SG_ 369 FrntSideRdrRiObj11RdrObjAy 0;
BA_ "GenSigSendType" SG_ 369 FrntSideRdrRiObj11RdrObjBoxLength 0;
BA_ "GenSigSendType" SG_ 369 FrntSideRdrRiObj11RdrObjBoxWidth 0;
BA_ "GenSigSendType" SG_ 369 FrntSideRdrRiObj11RdrObjChks 0;
BA_ "GenSigFuncType" SG_ 369 FrntSideRdrRiObj11RdrObjChks 15;
BA_ "GenSigDataID" SG_ 369 FrntSideRdrRiObj11RdrObjChks "0x96D";
BA_ "GenSigSendType" SG_ 369 FrntSideRdrRiObj11RdrObjCntr 0;
BA_ "GenSigFuncType" SG_ 369 FrntSideRdrRiObj11RdrObjCntr 16;
BA_ "GenSigStartValue" SG_ 369 FrntSideRdrRiObj11RdrObjCoastCnt 31;
BA_ "GenSigSendType" SG_ 369 FrntSideRdrRiObj11RdrObjCoastCnt 0;
BA_ "GenSigSendType" SG_ 369 FrntSideRdrRiObj11RdrObjConf 0;
BA_ "GenSigSendType" SG_ 369 FrntSideRdrRiObj11RdrObjDx 0;
BA_ "GenSigSendType" SG_ 369 FrntSideRdrRiObj11RdrObjDxStdDe 0;
BA_ "GenSigStartValue" SG_ 369 FrntSideRdrRiObj11RdrObjDy 4000;
BA_ "GenSigSendType" SG_ 369 FrntSideRdrRiObj11RdrObjDy 0;
BA_ "GenSigSendType" SG_ 369 FrntSideRdrRiObj11RdrObjDyStdDe 0;
BA_ "GenSigSendType" SG_ 369 FrntSideRdrRiObj11RdrObjElevnConf 0;
BA_ "GenSigSendType" SG_ 369 FrntSideRdrRiObj11RdrObjElevnSts 0;
BA_ "GenSigSendType" SG_ 369 FrntSideRdrRiObj11RdrObjID 0;
BA_ "GenSigStartValue" SG_ 369 FrntSideRdrRiObj11RdrObjIsInFreeSpace 1;
BA_ "GenSigSendType" SG_ 369 FrntSideRdrRiObj11RdrObjIsInFreeSpace 0;
BA_ "GenSigSendType" SG_ 369 FrntSideRdrRiObj11RdrObjMirrProblty 0;
BA_ "GenSigStartValue" SG_ 369 FrntSideRdrRiObj11RdrObjMtnPat 3;
BA_ "GenSigSendType" SG_ 369 FrntSideRdrRiObj11RdrObjMtnPat 0;
BA_ "GenSigSendType" SG_ 369 FrntSideRdrRiObj11RdrObjNotRealProblty 0;
BA_ "GenSigSendType" SG_ 369 FrntSideRdrRiObj11RdrObjStatyCnt 0;
BA_ "GenSigSendType" SG_ 369 FrntSideRdrRiObj11RdrObjTiAlv 0;
BA_ "GenSigSendType" SG_ 369 FrntSideRdrRiObj11RdrObjTrackSts 0;
BA_ "GenSigSendType" SG_ 369 FrntSideRdrRiObj11RdrObjTyp 0;
BA_ "GenSigSendType" SG_ 369 FrntSideRdrRiObj11RdrObjTypConfBike 0;
BA_ "GenSigSendType" SG_ 369 FrntSideRdrRiObj11RdrObjTypConfPed 0;
BA_ "GenSigSendType" SG_ 369 FrntSideRdrRiObj11RdrObjTypConfVeh 0;
BA_ "GenSigStartValue" SG_ 369 FrntSideRdrRiObj11RdrObjVx 6400;
BA_ "GenSigSendType" SG_ 369 FrntSideRdrRiObj11RdrObjVx 0;
BA_ "GenSigSendType" SG_ 369 FrntSideRdrRiObj11RdrObjVxStdDe 0;
BA_ "GenSigStartValue" SG_ 369 FrntSideRdrRiObj11RdrObjVy 6400;
BA_ "GenSigSendType" SG_ 369 FrntSideRdrRiObj11RdrObjVy 0;
BA_ "GenSigSendType" SG_ 369 FrntSideRdrRiObj11RdrObjVyStdDe 0;
BA_ "GenSigStartValue" SG_ 369 FrntSideRdrRiObj11RelVx 1780;
BA_ "GenSigSendType" SG_ 369 FrntSideRdrRiObj11RelVx 0;
BA_ "GenSigStartValue" SG_ 369 FrntSideRdrRiObj11RelVy 1780;
BA_ "GenSigSendType" SG_ 369 FrntSideRdrRiObj11RelVy 0;
// Frame: FSRRSafetyCANFD1Frame34
BA_ "VFrameFormat" BO_ 371 14;
BA_ "GenMsgSendType" BO_ 371 0;
BA_ "GenMsgCycleTime" BO_ 371 50.000;
BA_ "GenSigStartValue" SG_ 371 FrntSideRdrRiObj12Heading 1800;
BA_ "GenSigSendType" SG_ 371 FrntSideRdrRiObj12Heading 0;
BA_ "GenSigStartValue" SG_ 371 FrntSideRdrRiObj12ObjBoxCenterLat 250;
BA_ "GenSigSendType" SG_ 371 FrntSideRdrRiObj12ObjBoxCenterLat 0;
BA_ "GenSigStartValue" SG_ 371 FrntSideRdrRiObj12ObjBoxCenterLgt 250;
BA_ "GenSigSendType" SG_ 371 FrntSideRdrRiObj12ObjBoxCenterLgt 0;
BA_ "GenSigSendType" SG_ 371 FrntSideRdrRiObj12ObservationHist 0;
BA_ "GenSigSendType" SG_ 371 FrntSideRdrRiObj12RdrObjAx 0;
BA_ "GenSigSendType" SG_ 371 FrntSideRdrRiObj12RdrObjAy 0;
BA_ "GenSigSendType" SG_ 371 FrntSideRdrRiObj12RdrObjBoxLength 0;
BA_ "GenSigSendType" SG_ 371 FrntSideRdrRiObj12RdrObjBoxWidth 0;
BA_ "GenSigSendType" SG_ 371 FrntSideRdrRiObj12RdrObjChks 0;
BA_ "GenSigFuncType" SG_ 371 FrntSideRdrRiObj12RdrObjChks 15;
BA_ "GenSigDataID" SG_ 371 FrntSideRdrRiObj12RdrObjChks "0x96E";
BA_ "GenSigSendType" SG_ 371 FrntSideRdrRiObj12RdrObjCntr 0;
BA_ "GenSigFuncType" SG_ 371 FrntSideRdrRiObj12RdrObjCntr 16;
BA_ "GenSigStartValue" SG_ 371 FrntSideRdrRiObj12RdrObjCoastCnt 31;
BA_ "GenSigSendType" SG_ 371 FrntSideRdrRiObj12RdrObjCoastCnt 0;
BA_ "GenSigSendType" SG_ 371 FrntSideRdrRiObj12RdrObjConf 0;
BA_ "GenSigSendType" SG_ 371 FrntSideRdrRiObj12RdrObjDx 0;
BA_ "GenSigSendType" SG_ 371 FrntSideRdrRiObj12RdrObjDxStdDe 0;
BA_ "GenSigStartValue" SG_ 371 FrntSideRdrRiObj12RdrObjDy 4000;
BA_ "GenSigSendType" SG_ 371 FrntSideRdrRiObj12RdrObjDy 0;
BA_ "GenSigSendType" SG_ 371 FrntSideRdrRiObj12RdrObjDyStdDe 0;
BA_ "GenSigSendType" SG_ 371 FrntSideRdrRiObj12RdrObjElevnConf 0;
BA_ "GenSigSendType" SG_ 371 FrntSideRdrRiObj12RdrObjElevnSts 0;
BA_ "GenSigSendType" SG_ 371 FrntSideRdrRiObj12RdrObjID 0;
BA_ "GenSigStartValue" SG_ 371 FrntSideRdrRiObj12RdrObjIsInFreeSpace 1;
BA_ "GenSigSendType" SG_ 371 FrntSideRdrRiObj12RdrObjIsInFreeSpace 0;
BA_ "GenSigSendType" SG_ 371 FrntSideRdrRiObj12RdrObjMirrProblty 0;
BA_ "GenSigStartValue" SG_ 371 FrntSideRdrRiObj12RdrObjMtnPat 3;
BA_ "GenSigSendType" SG_ 371 FrntSideRdrRiObj12RdrObjMtnPat 0;
BA_ "GenSigSendType" SG_ 371 FrntSideRdrRiObj12RdrObjNotRealProblty 0;
BA_ "GenSigSendType" SG_ 371 FrntSideRdrRiObj12RdrObjStatyCnt 0;
BA_ "GenSigSendType" SG_ 371 FrntSideRdrRiObj12RdrObjTiAlv 0;
BA_ "GenSigSendType" SG_ 371 FrntSideRdrRiObj12RdrObjTrackSts 0;
BA_ "GenSigSendType" SG_ 371 FrntSideRdrRiObj12RdrObjTyp 0;
BA_ "GenSigSendType" SG_ 371 FrntSideRdrRiObj12RdrObjTypConfBike 0;
BA_ "GenSigSendType" SG_ 371 FrntSideRdrRiObj12RdrObjTypConfPed 0;
BA_ "GenSigSendType" SG_ 371 FrntSideRdrRiObj12RdrObjTypConfVeh 0;
BA_ "GenSigStartValue" SG_ 371 FrntSideRdrRiObj12RdrObjVx 6400;
BA_ "GenSigSendType" SG_ 371 FrntSideRdrRiObj12RdrObjVx 0;
BA_ "GenSigSendType" SG_ 371 FrntSideRdrRiObj12RdrObjVxStdDe 0;
BA_ "GenSigStartValue" SG_ 371 FrntSideRdrRiObj12RdrObjVy 6400;
BA_ "GenSigSendType" SG_ 371 FrntSideRdrRiObj12RdrObjVy 0;
BA_ "GenSigSendType" SG_ 371 FrntSideRdrRiObj12RdrObjVyStdDe 0;
BA_ "GenSigStartValue" SG_ 371 FrntSideRdrRiObj12RelVx 1780;
BA_ "GenSigSendType" SG_ 371 FrntSideRdrRiObj12RelVx 0;
BA_ "GenSigStartValue" SG_ 371 FrntSideRdrRiObj12RelVy 1780;
BA_ "GenSigSendType" SG_ 371 FrntSideRdrRiObj12RelVy 0;
// Frame: FSRRSafetyCANFD1Frame35
BA_ "VFrameFormat" BO_ 373 14;
BA_ "GenMsgSendType" BO_ 373 0;
BA_ "GenMsgCycleTime" BO_ 373 50.000;
BA_ "GenSigStartValue" SG_ 373 FrntSideRdrRiObj13Heading 1800;
BA_ "GenSigSendType" SG_ 373 FrntSideRdrRiObj13Heading 0;
BA_ "GenSigStartValue" SG_ 373 FrntSideRdrRiObj13ObjBoxCenterLat 250;
BA_ "GenSigSendType" SG_ 373 FrntSideRdrRiObj13ObjBoxCenterLat 0;
BA_ "GenSigStartValue" SG_ 373 FrntSideRdrRiObj13ObjBoxCenterLgt 250;
BA_ "GenSigSendType" SG_ 373 FrntSideRdrRiObj13ObjBoxCenterLgt 0;
BA_ "GenSigSendType" SG_ 373 FrntSideRdrRiObj13ObservationHist 0;
BA_ "GenSigSendType" SG_ 373 FrntSideRdrRiObj13RdrObjAx 0;
BA_ "GenSigSendType" SG_ 373 FrntSideRdrRiObj13RdrObjAy 0;
BA_ "GenSigSendType" SG_ 373 FrntSideRdrRiObj13RdrObjBoxLength 0;
BA_ "GenSigSendType" SG_ 373 FrntSideRdrRiObj13RdrObjBoxWidth 0;
BA_ "GenSigSendType" SG_ 373 FrntSideRdrRiObj13RdrObjChks 0;
BA_ "GenSigFuncType" SG_ 373 FrntSideRdrRiObj13RdrObjChks 15;
BA_ "GenSigDataID" SG_ 373 FrntSideRdrRiObj13RdrObjChks "0x96F";
BA_ "GenSigSendType" SG_ 373 FrntSideRdrRiObj13RdrObjCntr 0;
BA_ "GenSigFuncType" SG_ 373 FrntSideRdrRiObj13RdrObjCntr 16;
BA_ "GenSigStartValue" SG_ 373 FrntSideRdrRiObj13RdrObjCoastCnt 31;
BA_ "GenSigSendType" SG_ 373 FrntSideRdrRiObj13RdrObjCoastCnt 0;
BA_ "GenSigSendType" SG_ 373 FrntSideRdrRiObj13RdrObjConf 0;
BA_ "GenSigSendType" SG_ 373 FrntSideRdrRiObj13RdrObjDx 0;
BA_ "GenSigSendType" SG_ 373 FrntSideRdrRiObj13RdrObjDxStdDe 0;
BA_ "GenSigStartValue" SG_ 373 FrntSideRdrRiObj13RdrObjDy 4000;
BA_ "GenSigSendType" SG_ 373 FrntSideRdrRiObj13RdrObjDy 0;
BA_ "GenSigSendType" SG_ 373 FrntSideRdrRiObj13RdrObjDyStdDe 0;
BA_ "GenSigSendType" SG_ 373 FrntSideRdrRiObj13RdrObjElevnConf 0;
BA_ "GenSigSendType" SG_ 373 FrntSideRdrRiObj13RdrObjElevnSts 0;
BA_ "GenSigSendType" SG_ 373 FrntSideRdrRiObj13RdrObjID 0;
BA_ "GenSigStartValue" SG_ 373 FrntSideRdrRiObj13RdrObjIsInFreeSpace 1;
BA_ "GenSigSendType" SG_ 373 FrntSideRdrRiObj13RdrObjIsInFreeSpace 0;
BA_ "GenSigSendType" SG_ 373 FrntSideRdrRiObj13RdrObjMirrProblty 0;
BA_ "GenSigStartValue" SG_ 373 FrntSideRdrRiObj13RdrObjMtnPat 3;
BA_ "GenSigSendType" SG_ 373 FrntSideRdrRiObj13RdrObjMtnPat 0;
BA_ "GenSigSendType" SG_ 373 FrntSideRdrRiObj13RdrObjNotRealProblty 0;
BA_ "GenSigSendType" SG_ 373 FrntSideRdrRiObj13RdrObjStatyCnt 0;
BA_ "GenSigSendType" SG_ 373 FrntSideRdrRiObj13RdrObjTiAlv 0;
BA_ "GenSigSendType" SG_ 373 FrntSideRdrRiObj13RdrObjTrackSts 0;
BA_ "GenSigSendType" SG_ 373 FrntSideRdrRiObj13RdrObjTyp 0;
BA_ "GenSigSendType" SG_ 373 FrntSideRdrRiObj13RdrObjTypConfBike 0;
BA_ "GenSigSendType" SG_ 373 FrntSideRdrRiObj13RdrObjTypConfPed 0;
BA_ "GenSigSendType" SG_ 373 FrntSideRdrRiObj13RdrObjTypConfVeh 0;
BA_ "GenSigStartValue" SG_ 373 FrntSideRdrRiObj13RdrObjVx 6400;
BA_ "GenSigSendType" SG_ 373 FrntSideRdrRiObj13RdrObjVx 0;
BA_ "GenSigSendType" SG_ 373 FrntSideRdrRiObj13RdrObjVxStdDe 0;
BA_ "GenSigStartValue" SG_ 373 FrntSideRdrRiObj13RdrObjVy 6400;
BA_ "GenSigSendType" SG_ 373 FrntSideRdrRiObj13RdrObjVy 0;
BA_ "GenSigSendType" SG_ 373 FrntSideRdrRiObj13RdrObjVyStdDe 0;
BA_ "GenSigStartValue" SG_ 373 FrntSideRdrRiObj13RelVx 1780;
BA_ "GenSigSendType" SG_ 373 FrntSideRdrRiObj13RelVx 0;
BA_ "GenSigStartValue" SG_ 373 FrntSideRdrRiObj13RelVy 1780;
BA_ "GenSigSendType" SG_ 373 FrntSideRdrRiObj13RelVy 0;
// Frame: FSRRSafetyCANFD1Frame36
BA_ "VFrameFormat" BO_ 375 14;
BA_ "GenMsgSendType" BO_ 375 0;
BA_ "GenMsgCycleTime" BO_ 375 50.000;
BA_ "GenSigStartValue" SG_ 375 FrntSideRdrRiObj14Heading 1800;
BA_ "GenSigSendType" SG_ 375 FrntSideRdrRiObj14Heading 0;
BA_ "GenSigStartValue" SG_ 375 FrntSideRdrRiObj14ObjBoxCenterLat 250;
BA_ "GenSigSendType" SG_ 375 FrntSideRdrRiObj14ObjBoxCenterLat 0;
BA_ "GenSigStartValue" SG_ 375 FrntSideRdrRiObj14ObjBoxCenterLgt 250;
BA_ "GenSigSendType" SG_ 375 FrntSideRdrRiObj14ObjBoxCenterLgt 0;
BA_ "GenSigSendType" SG_ 375 FrntSideRdrRiObj14ObservationHist 0;
BA_ "GenSigSendType" SG_ 375 FrntSideRdrRiObj14RdrObjAx 0;
BA_ "GenSigSendType" SG_ 375 FrntSideRdrRiObj14RdrObjAy 0;
BA_ "GenSigSendType" SG_ 375 FrntSideRdrRiObj14RdrObjBoxLength 0;
BA_ "GenSigSendType" SG_ 375 FrntSideRdrRiObj14RdrObjBoxWidth 0;
BA_ "GenSigSendType" SG_ 375 FrntSideRdrRiObj14RdrObjChks 0;
BA_ "GenSigFuncType" SG_ 375 FrntSideRdrRiObj14RdrObjChks 15;
BA_ "GenSigDataID" SG_ 375 FrntSideRdrRiObj14RdrObjChks "0x970";
BA_ "GenSigSendType" SG_ 375 FrntSideRdrRiObj14RdrObjCntr 0;
BA_ "GenSigFuncType" SG_ 375 FrntSideRdrRiObj14RdrObjCntr 16;
BA_ "GenSigStartValue" SG_ 375 FrntSideRdrRiObj14RdrObjCoastCnt 31;
BA_ "GenSigSendType" SG_ 375 FrntSideRdrRiObj14RdrObjCoastCnt 0;
BA_ "GenSigSendType" SG_ 375 FrntSideRdrRiObj14RdrObjConf 0;
BA_ "GenSigSendType" SG_ 375 FrntSideRdrRiObj14RdrObjDx 0;
BA_ "GenSigSendType" SG_ 375 FrntSideRdrRiObj14RdrObjDxStdDe 0;
BA_ "GenSigStartValue" SG_ 375 FrntSideRdrRiObj14RdrObjDy 4000;
BA_ "GenSigSendType" SG_ 375 FrntSideRdrRiObj14RdrObjDy 0;
BA_ "GenSigSendType" SG_ 375 FrntSideRdrRiObj14RdrObjDyStdDe 0;
BA_ "GenSigSendType" SG_ 375 FrntSideRdrRiObj14RdrObjElevnConf 0;
BA_ "GenSigSendType" SG_ 375 FrntSideRdrRiObj14RdrObjElevnSts 0;
BA_ "GenSigSendType" SG_ 375 FrntSideRdrRiObj14RdrObjID 0;
BA_ "GenSigStartValue" SG_ 375 FrntSideRdrRiObj14RdrObjIsInFreeSpace 1;
BA_ "GenSigSendType" SG_ 375 FrntSideRdrRiObj14RdrObjIsInFreeSpace 0;
BA_ "GenSigSendType" SG_ 375 FrntSideRdrRiObj14RdrObjMirrProblty 0;
BA_ "GenSigStartValue" SG_ 375 FrntSideRdrRiObj14RdrObjMtnPat 3;
BA_ "GenSigSendType" SG_ 375 FrntSideRdrRiObj14RdrObjMtnPat 0;
BA_ "GenSigSendType" SG_ 375 FrntSideRdrRiObj14RdrObjNotRealProblty 0;
BA_ "GenSigSendType" SG_ 375 FrntSideRdrRiObj14RdrObjStatyCnt 0;
BA_ "GenSigSendType" SG_ 375 FrntSideRdrRiObj14RdrObjTiAlv 0;
BA_ "GenSigSendType" SG_ 375 FrntSideRdrRiObj14RdrObjTrackSts 0;
BA_ "GenSigSendType" SG_ 375 FrntSideRdrRiObj14RdrObjTyp 0;
BA_ "GenSigSendType" SG_ 375 FrntSideRdrRiObj14RdrObjTypConfBike 0;
BA_ "GenSigSendType" SG_ 375 FrntSideRdrRiObj14RdrObjTypConfPed 0;
BA_ "GenSigSendType" SG_ 375 FrntSideRdrRiObj14RdrObjTypConfVeh 0;
BA_ "GenSigStartValue" SG_ 375 FrntSideRdrRiObj14RdrObjVx 6400;
BA_ "GenSigSendType" SG_ 375 FrntSideRdrRiObj14RdrObjVx 0;
BA_ "GenSigSendType" SG_ 375 FrntSideRdrRiObj14RdrObjVxStdDe 0;
BA_ "GenSigStartValue" SG_ 375 FrntSideRdrRiObj14RdrObjVy 6400;
BA_ "GenSigSendType" SG_ 375 FrntSideRdrRiObj14RdrObjVy 0;
BA_ "GenSigSendType" SG_ 375 FrntSideRdrRiObj14RdrObjVyStdDe 0;
BA_ "GenSigStartValue" SG_ 375 FrntSideRdrRiObj14RelVx 1780;
BA_ "GenSigSendType" SG_ 375 FrntSideRdrRiObj14RelVx 0;
BA_ "GenSigStartValue" SG_ 375 FrntSideRdrRiObj14RelVy 1780;
BA_ "GenSigSendType" SG_ 375 FrntSideRdrRiObj14RelVy 0;
// Frame: FSRRSafetyCANFD1Frame37
BA_ "VFrameFormat" BO_ 377 14;
BA_ "GenMsgSendType" BO_ 377 0;
BA_ "GenMsgCycleTime" BO_ 377 50.000;
BA_ "GenSigStartValue" SG_ 377 FrntSideRdrRiObj15Heading 1800;
BA_ "GenSigSendType" SG_ 377 FrntSideRdrRiObj15Heading 0;
BA_ "GenSigStartValue" SG_ 377 FrntSideRdrRiObj15ObjBoxCenterLat 250;
BA_ "GenSigSendType" SG_ 377 FrntSideRdrRiObj15ObjBoxCenterLat 0;
BA_ "GenSigStartValue" SG_ 377 FrntSideRdrRiObj15ObjBoxCenterLgt 250;
BA_ "GenSigSendType" SG_ 377 FrntSideRdrRiObj15ObjBoxCenterLgt 0;
BA_ "GenSigSendType" SG_ 377 FrntSideRdrRiObj15ObservationHist 0;
BA_ "GenSigSendType" SG_ 377 FrntSideRdrRiObj15RdrObjAx 0;
BA_ "GenSigSendType" SG_ 377 FrntSideRdrRiObj15RdrObjAy 0;
BA_ "GenSigSendType" SG_ 377 FrntSideRdrRiObj15RdrObjBoxLength 0;
BA_ "GenSigSendType" SG_ 377 FrntSideRdrRiObj15RdrObjBoxWidth 0;
BA_ "GenSigSendType" SG_ 377 FrntSideRdrRiObj15RdrObjChks 0;
BA_ "GenSigFuncType" SG_ 377 FrntSideRdrRiObj15RdrObjChks 15;
BA_ "GenSigDataID" SG_ 377 FrntSideRdrRiObj15RdrObjChks "0x971";
BA_ "GenSigSendType" SG_ 377 FrntSideRdrRiObj15RdrObjCntr 0;
BA_ "GenSigFuncType" SG_ 377 FrntSideRdrRiObj15RdrObjCntr 16;
BA_ "GenSigStartValue" SG_ 377 FrntSideRdrRiObj15RdrObjCoastCnt 31;
BA_ "GenSigSendType" SG_ 377 FrntSideRdrRiObj15RdrObjCoastCnt 0;
BA_ "GenSigSendType" SG_ 377 FrntSideRdrRiObj15RdrObjConf 0;
BA_ "GenSigSendType" SG_ 377 FrntSideRdrRiObj15RdrObjDx 0;
BA_ "GenSigSendType" SG_ 377 FrntSideRdrRiObj15RdrObjDxStdDe 0;
BA_ "GenSigStartValue" SG_ 377 FrntSideRdrRiObj15RdrObjDy 4000;
BA_ "GenSigSendType" SG_ 377 FrntSideRdrRiObj15RdrObjDy 0;
BA_ "GenSigSendType" SG_ 377 FrntSideRdrRiObj15RdrObjDyStdDe 0;
BA_ "GenSigSendType" SG_ 377 FrntSideRdrRiObj15RdrObjElevnConf 0;
BA_ "GenSigSendType" SG_ 377 FrntSideRdrRiObj15RdrObjElevnSts 0;
BA_ "GenSigSendType" SG_ 377 FrntSideRdrRiObj15RdrObjID 0;
BA_ "GenSigStartValue" SG_ 377 FrntSideRdrRiObj15RdrObjIsInFreeSpace 1;
BA_ "GenSigSendType" SG_ 377 FrntSideRdrRiObj15RdrObjIsInFreeSpace 0;
BA_ "GenSigSendType" SG_ 377 FrntSideRdrRiObj15RdrObjMirrProblty 0;
BA_ "GenSigStartValue" SG_ 377 FrntSideRdrRiObj15RdrObjMtnPat 3;
BA_ "GenSigSendType" SG_ 377 FrntSideRdrRiObj15RdrObjMtnPat 0;
BA_ "GenSigSendType" SG_ 377 FrntSideRdrRiObj15RdrObjNotRealProblty 0;
BA_ "GenSigSendType" SG_ 377 FrntSideRdrRiObj15RdrObjStatyCnt 0;
BA_ "GenSigSendType" SG_ 377 FrntSideRdrRiObj15RdrObjTiAlv 0;
BA_ "GenSigSendType" SG_ 377 FrntSideRdrRiObj15RdrObjTrackSts 0;
BA_ "GenSigSendType" SG_ 377 FrntSideRdrRiObj15RdrObjTyp 0;
BA_ "GenSigSendType" SG_ 377 FrntSideRdrRiObj15RdrObjTypConfBike 0;
BA_ "GenSigSendType" SG_ 377 FrntSideRdrRiObj15RdrObjTypConfPed 0;
BA_ "GenSigSendType" SG_ 377 FrntSideRdrRiObj15RdrObjTypConfVeh 0;
BA_ "GenSigStartValue" SG_ 377 FrntSideRdrRiObj15RdrObjVx 6400;
BA_ "GenSigSendType" SG_ 377 FrntSideRdrRiObj15RdrObjVx 0;
BA_ "GenSigSendType" SG_ 377 FrntSideRdrRiObj15RdrObjVxStdDe 0;
BA_ "GenSigStartValue" SG_ 377 FrntSideRdrRiObj15RdrObjVy 6400;
BA_ "GenSigSendType" SG_ 377 FrntSideRdrRiObj15RdrObjVy 0;
BA_ "GenSigSendType" SG_ 377 FrntSideRdrRiObj15RdrObjVyStdDe 0;
BA_ "GenSigStartValue" SG_ 377 FrntSideRdrRiObj15RelVx 1780;
BA_ "GenSigSendType" SG_ 377 FrntSideRdrRiObj15RelVx 0;
BA_ "GenSigStartValue" SG_ 377 FrntSideRdrRiObj15RelVy 1780;
BA_ "GenSigSendType" SG_ 377 FrntSideRdrRiObj15RelVy 0;
// Frame: FsrrSafetyCanFD1NMFr
BA_ "VFrameFormat" BO_ 1282 0;
BA_ "GenMsgSendType" BO_ 1282 1;
BA_ "GenMsgDelayTime" BO_ 1282 20.000;
BA_ "GenMsgILSupport" BO_ 1282 0;
BA_ "NmAsrMessage" BO_ 1282 1;
// Frame: FsrrToAsdmSafetyCanFD1DiagResFrame
BA_ "VFrameFormat" BO_ 1584 14;
BA_ "GenMsgSendType" BO_ 1584 1;
BA_ "GenMsgDelayTime" BO_ 1584 5.000;
// Frame: FsrrtoEtcXcpFr01
BA_ "VFrameFormat" BO_ 1416 0;
BA_ "GenMsgSendType" BO_ 1416 1;
BA_ "GenMsgDelayTime" BO_ 1416 5.000;
// Frame: FsrrtoEtcXcpFr02
BA_ "VFrameFormat" BO_ 1428 0;
BA_ "GenMsgSendType" BO_ 1428 1;
BA_ "GenMsgDelayTime" BO_ 1428 5.000;
VAL_ 355 FrntSideRdrRiObj4RdrObjElevnSts 0 "RdrObjElevnSts_Unknown" 1 "RdrObjElevnSts_OverRidable" 2 "RdrObjElevnSts_Rlv" 3 "RdrObjElevnSts_UnderRidable";
VAL_ 355 FrntSideRdrRiObj4RdrObjIsInFreeSpace 0 "YesNo2_No" 1 "YesNo2_Yes";
VAL_ 355 FrntSideRdrRiObj4RdrObjMtnPat 0 "RdrObjMtnPat_Ukwn" 1 "RdrObjMtnPat_Staty" 2 "RdrObjMtnPat_StatyFromMovg" 3 "RdrObjMtnPat_Movg" 4 "RdrObjMtnPat_Receding" 5 "RdrObjMtnPat_Oncoming" 6 "RdrObjMtnPat_CrossingFromLe" 7 "RdrObjMtnPat_CrossingFromRi";
VAL_ 355 FrntSideRdrRiObj4RdrObjTrackSts 0 "RdrObjTrackSts_Invld" 1 "RdrObjTrackSts_Updated" 2 "RdrObjTrackSts_New" 3 "RdrObjTrackSts_Coasted";
VAL_ 355 FrntSideRdrRiObj4RdrObjTyp 0 "RdrObjTyp_Ukwn" 1 "RdrObjTyp_Car" 2 "RdrObjTyp_MotorCycle" 3 "RdrObjTyp_Truck" 4 "RdrObjTyp_Ped" 5 "RdrObjTyp_ObstdVert1" 6 "RdrObjTyp_ObstdVert2" 7 "RdrObjTyp_Anim" 8 "RdrObjTyp_ObjGen" 9 "RdrObjTyp_Bicycle" 10 "RdrObjTyp_VehofUkwnClass" 11 "RdrObjTyp_Reserved";
VAL_ 357 FrntSideRdrRiObj5RdrObjElevnSts 0 "RdrObjElevnSts_Unknown" 1 "RdrObjElevnSts_OverRidable" 2 "RdrObjElevnSts_Rlv" 3 "RdrObjElevnSts_UnderRidable";
VAL_ 357 FrntSideRdrRiObj5RdrObjIsInFreeSpace 0 "YesNo2_No" 1 "YesNo2_Yes";
VAL_ 357 FrntSideRdrRiObj5RdrObjMtnPat 0 "RdrObjMtnPat_Ukwn" 1 "RdrObjMtnPat_Staty" 2 "RdrObjMtnPat_StatyFromMovg" 3 "RdrObjMtnPat_Movg" 4 "RdrObjMtnPat_Receding" 5 "RdrObjMtnPat_Oncoming" 6 "RdrObjMtnPat_CrossingFromLe" 7 "RdrObjMtnPat_CrossingFromRi";
VAL_ 357 FrntSideRdrRiObj5RdrObjTrackSts 0 "RdrObjTrackSts_Invld" 1 "RdrObjTrackSts_Updated" 2 "RdrObjTrackSts_New" 3 "RdrObjTrackSts_Coasted";
VAL_ 357 FrntSideRdrRiObj5RdrObjTyp 0 "RdrObjTyp_Ukwn" 1 "RdrObjTyp_Car" 2 "RdrObjTyp_MotorCycle" 3 "RdrObjTyp_Truck" 4 "RdrObjTyp_Ped" 5 "RdrObjTyp_ObstdVert1" 6 "RdrObjTyp_ObstdVert2" 7 "RdrObjTyp_Anim" 8 "RdrObjTyp_ObjGen" 9 "RdrObjTyp_Bicycle" 10 "RdrObjTyp_VehofUkwnClass" 11 "RdrObjTyp_Reserved";
VAL_ 359 FrntSideRdrRiObj6RdrObjElevnSts 0 "RdrObjElevnSts_Unknown" 1 "RdrObjElevnSts_OverRidable" 2 "RdrObjElevnSts_Rlv" 3 "RdrObjElevnSts_UnderRidable";
VAL_ 359 FrntSideRdrRiObj6RdrObjIsInFreeSpace 0 "YesNo2_No" 1 "YesNo2_Yes";
VAL_ 359 FrntSideRdrRiObj6RdrObjMtnPat 0 "RdrObjMtnPat_Ukwn" 1 "RdrObjMtnPat_Staty" 2 "RdrObjMtnPat_StatyFromMovg" 3 "RdrObjMtnPat_Movg" 4 "RdrObjMtnPat_Receding" 5 "RdrObjMtnPat_Oncoming" 6 "RdrObjMtnPat_CrossingFromLe" 7 "RdrObjMtnPat_CrossingFromRi";
VAL_ 359 FrntSideRdrRiObj6RdrObjTrackSts 0 "RdrObjTrackSts_Invld" 1 "RdrObjTrackSts_Updated" 2 "RdrObjTrackSts_New" 3 "RdrObjTrackSts_Coasted";
VAL_ 359 FrntSideRdrRiObj6RdrObjTyp 0 "RdrObjTyp_Ukwn" 1 "RdrObjTyp_Car" 2 "RdrObjTyp_MotorCycle" 3 "RdrObjTyp_Truck" 4 "RdrObjTyp_Ped" 5 "RdrObjTyp_ObstdVert1" 6 "RdrObjTyp_ObstdVert2" 7 "RdrObjTyp_Anim" 8 "RdrObjTyp_ObjGen" 9 "RdrObjTyp_Bicycle" 10 "RdrObjTyp_VehofUkwnClass" 11 "RdrObjTyp_Reserved";
VAL_ 361 FrntSideRdrRiObj7RdrObjElevnSts 0 "RdrObjElevnSts_Unknown" 1 "RdrObjElevnSts_OverRidable" 2 "RdrObjElevnSts_Rlv" 3 "RdrObjElevnSts_UnderRidable";
VAL_ 361 FrntSideRdrRiObj7RdrObjIsInFreeSpace 0 "YesNo2_No" 1 "YesNo2_Yes";
VAL_ 361 FrntSideRdrRiObj7RdrObjMtnPat 0 "RdrObjMtnPat_Ukwn" 1 "RdrObjMtnPat_Staty" 2 "RdrObjMtnPat_StatyFromMovg" 3 "RdrObjMtnPat_Movg" 4 "RdrObjMtnPat_Receding" 5 "RdrObjMtnPat_Oncoming" 6 "RdrObjMtnPat_CrossingFromLe" 7 "RdrObjMtnPat_CrossingFromRi";
VAL_ 361 FrntSideRdrRiObj7RdrObjTrackSts 0 "RdrObjTrackSts_Invld" 1 "RdrObjTrackSts_Updated" 2 "RdrObjTrackSts_New" 3 "RdrObjTrackSts_Coasted";
VAL_ 361 FrntSideRdrRiObj7RdrObjTyp 0 "RdrObjTyp_Ukwn" 1 "RdrObjTyp_Car" 2 "RdrObjTyp_MotorCycle" 3 "RdrObjTyp_Truck" 4 "RdrObjTyp_Ped" 5 "RdrObjTyp_ObstdVert1" 6 "RdrObjTyp_ObstdVert2" 7 "RdrObjTyp_Anim" 8 "RdrObjTyp_ObjGen" 9 "RdrObjTyp_Bicycle" 10 "RdrObjTyp_VehofUkwnClass" 11 "RdrObjTyp_Reserved";
VAL_ 363 FrntSideRdrRiObj8RdrObjElevnSts 0 "RdrObjElevnSts_Unknown" 1 "RdrObjElevnSts_OverRidable" 2 "RdrObjElevnSts_Rlv" 3 "RdrObjElevnSts_UnderRidable";
VAL_ 363 FrntSideRdrRiObj8RdrObjIsInFreeSpace 0 "YesNo2_No" 1 "YesNo2_Yes";
VAL_ 363 FrntSideRdrRiObj8RdrObjMtnPat 0 "RdrObjMtnPat_Ukwn" 1 "RdrObjMtnPat_Staty" 2 "RdrObjMtnPat_StatyFromMovg" 3 "RdrObjMtnPat_Movg" 4 "RdrObjMtnPat_Receding" 5 "RdrObjMtnPat_Oncoming" 6 "RdrObjMtnPat_CrossingFromLe" 7 "RdrObjMtnPat_CrossingFromRi";
VAL_ 363 FrntSideRdrRiObj8RdrObjTrackSts 0 "RdrObjTrackSts_Invld" 1 "RdrObjTrackSts_Updated" 2 "RdrObjTrackSts_New" 3 "RdrObjTrackSts_Coasted";
VAL_ 363 FrntSideRdrRiObj8RdrObjTyp 0 "RdrObjTyp_Ukwn" 1 "RdrObjTyp_Car" 2 "RdrObjTyp_MotorCycle" 3 "RdrObjTyp_Truck" 4 "RdrObjTyp_Ped" 5 "RdrObjTyp_ObstdVert1" 6 "RdrObjTyp_ObstdVert2" 7 "RdrObjTyp_Anim" 8 "RdrObjTyp_ObjGen" 9 "RdrObjTyp_Bicycle" 10 "RdrObjTyp_VehofUkwnClass" 11 "RdrObjTyp_Reserved";
VAL_ 365 FrntSideRdrRiObj9RdrObjElevnSts 0 "RdrObjElevnSts_Unknown" 1 "RdrObjElevnSts_OverRidable" 2 "RdrObjElevnSts_Rlv" 3 "RdrObjElevnSts_UnderRidable";
VAL_ 365 FrntSideRdrRiObj9RdrObjIsInFreeSpace 0 "YesNo2_No" 1 "YesNo2_Yes";
VAL_ 365 FrntSideRdrRiObj9RdrObjMtnPat 0 "RdrObjMtnPat_Ukwn" 1 "RdrObjMtnPat_Staty" 2 "RdrObjMtnPat_StatyFromMovg" 3 "RdrObjMtnPat_Movg" 4 "RdrObjMtnPat_Receding" 5 "RdrObjMtnPat_Oncoming" 6 "RdrObjMtnPat_CrossingFromLe" 7 "RdrObjMtnPat_CrossingFromRi";
VAL_ 365 FrntSideRdrRiObj9RdrObjTrackSts 0 "RdrObjTrackSts_Invld" 1 "RdrObjTrackSts_Updated" 2 "RdrObjTrackSts_New" 3 "RdrObjTrackSts_Coasted";
VAL_ 365 FrntSideRdrRiObj9RdrObjTyp 0 "RdrObjTyp_Ukwn" 1 "RdrObjTyp_Car" 2 "RdrObjTyp_MotorCycle" 3 "RdrObjTyp_Truck" 4 "RdrObjTyp_Ped" 5 "RdrObjTyp_ObstdVert1" 6 "RdrObjTyp_ObstdVert2" 7 "RdrObjTyp_Anim" 8 "RdrObjTyp_ObjGen" 9 "RdrObjTyp_Bicycle" 10 "RdrObjTyp_VehofUkwnClass" 11 "RdrObjTyp_Reserved";
VAL_ 367 FrntSideRdrRiObj10RdrObjElevnSts 0 "RdrObjElevnSts_Unknown" 1 "RdrObjElevnSts_OverRidable" 2 "RdrObjElevnSts_Rlv" 3 "RdrObjElevnSts_UnderRidable";
VAL_ 367 FrntSideRdrRiObj10RdrObjIsInFreeSpace 0 "YesNo2_No" 1 "YesNo2_Yes";
VAL_ 367 FrntSideRdrRiObj10RdrObjMtnPat 0 "RdrObjMtnPat_Ukwn" 1 "RdrObjMtnPat_Staty" 2 "RdrObjMtnPat_StatyFromMovg" 3 "RdrObjMtnPat_Movg" 4 "RdrObjMtnPat_Receding" 5 "RdrObjMtnPat_Oncoming" 6 "RdrObjMtnPat_CrossingFromLe" 7 "RdrObjMtnPat_CrossingFromRi";
VAL_ 367 FrntSideRdrRiObj10RdrObjTrackSts 0 "RdrObjTrackSts_Invld" 1 "RdrObjTrackSts_Updated" 2 "RdrObjTrackSts_New" 3 "RdrObjTrackSts_Coasted";
VAL_ 367 FrntSideRdrRiObj10RdrObjTyp 0 "RdrObjTyp_Ukwn" 1 "RdrObjTyp_Car" 2 "RdrObjTyp_MotorCycle" 3 "RdrObjTyp_Truck" 4 "RdrObjTyp_Ped" 5 "RdrObjTyp_ObstdVert1" 6 "RdrObjTyp_ObstdVert2" 7 "RdrObjTyp_Anim" 8 "RdrObjTyp_ObjGen" 9 "RdrObjTyp_Bicycle" 10 "RdrObjTyp_VehofUkwnClass" 11 "RdrObjTyp_Reserved";
VAL_ 369 FrntSideRdrRiObj11RdrObjElevnSts 0 "RdrObjElevnSts_Unknown" 1 "RdrObjElevnSts_OverRidable" 2 "RdrObjElevnSts_Rlv" 3 "RdrObjElevnSts_UnderRidable";
VAL_ 369 FrntSideRdrRiObj11RdrObjIsInFreeSpace 0 "YesNo2_No" 1 "YesNo2_Yes";
VAL_ 369 FrntSideRdrRiObj11RdrObjMtnPat 0 "RdrObjMtnPat_Ukwn" 1 "RdrObjMtnPat_Staty" 2 "RdrObjMtnPat_StatyFromMovg" 3 "RdrObjMtnPat_Movg" 4 "RdrObjMtnPat_Receding" 5 "RdrObjMtnPat_Oncoming" 6 "RdrObjMtnPat_CrossingFromLe" 7 "RdrObjMtnPat_CrossingFromRi";
VAL_ 369 FrntSideRdrRiObj11RdrObjTrackSts 0 "RdrObjTrackSts_Invld" 1 "RdrObjTrackSts_Updated" 2 "RdrObjTrackSts_New" 3 "RdrObjTrackSts_Coasted";
VAL_ 369 FrntSideRdrRiObj11RdrObjTyp 0 "RdrObjTyp_Ukwn" 1 "RdrObjTyp_Car" 2 "RdrObjTyp_MotorCycle" 3 "RdrObjTyp_Truck" 4 "RdrObjTyp_Ped" 5 "RdrObjTyp_ObstdVert1" 6 "RdrObjTyp_ObstdVert2" 7 "RdrObjTyp_Anim" 8 "RdrObjTyp_ObjGen" 9 "RdrObjTyp_Bicycle" 10 "RdrObjTyp_VehofUkwnClass" 11 "RdrObjTyp_Reserved";
VAL_ 371 FrntSideRdrRiObj12RdrObjElevnSts 0 "RdrObjElevnSts_Unknown" 1 "RdrObjElevnSts_OverRidable" 2 "RdrObjElevnSts_Rlv" 3 "RdrObjElevnSts_UnderRidable";
VAL_ 371 FrntSideRdrRiObj12RdrObjIsInFreeSpace 0 "YesNo2_No" 1 "YesNo2_Yes";
VAL_ 371 FrntSideRdrRiObj12RdrObjMtnPat 0 "RdrObjMtnPat_Ukwn" 1 "RdrObjMtnPat_Staty" 2 "RdrObjMtnPat_StatyFromMovg" 3 "RdrObjMtnPat_Movg" 4 "RdrObjMtnPat_Receding" 5 "RdrObjMtnPat_Oncoming" 6 "RdrObjMtnPat_CrossingFromLe" 7 "RdrObjMtnPat_CrossingFromRi";
VAL_ 371 FrntSideRdrRiObj12RdrObjTrackSts 0 "RdrObjTrackSts_Invld" 1 "RdrObjTrackSts_Updated" 2 "RdrObjTrackSts_New" 3 "RdrObjTrackSts_Coasted";
VAL_ 371 FrntSideRdrRiObj12RdrObjTyp 0 "RdrObjTyp_Ukwn" 1 "RdrObjTyp_Car" 2 "RdrObjTyp_MotorCycle" 3 "RdrObjTyp_Truck" 4 "RdrObjTyp_Ped" 5 "RdrObjTyp_ObstdVert1" 6 "RdrObjTyp_ObstdVert2" 7 "RdrObjTyp_Anim" 8 "RdrObjTyp_ObjGen" 9 "RdrObjTyp_Bicycle" 10 "RdrObjTyp_VehofUkwnClass" 11 "RdrObjTyp_Reserved";
VAL_ 373 FrntSideRdrRiObj13RdrObjElevnSts 0 "RdrObjElevnSts_Unknown" 1 "RdrObjElevnSts_OverRidable" 2 "RdrObjElevnSts_Rlv" 3 "RdrObjElevnSts_UnderRidable";
VAL_ 373 FrntSideRdrRiObj13RdrObjIsInFreeSpace 0 "YesNo2_No" 1 "YesNo2_Yes";
VAL_ 373 FrntSideRdrRiObj13RdrObjMtnPat 0 "RdrObjMtnPat_Ukwn" 1 "RdrObjMtnPat_Staty" 2 "RdrObjMtnPat_StatyFromMovg" 3 "RdrObjMtnPat_Movg" 4 "RdrObjMtnPat_Receding" 5 "RdrObjMtnPat_Oncoming" 6 "RdrObjMtnPat_CrossingFromLe" 7 "RdrObjMtnPat_CrossingFromRi";
VAL_ 373 FrntSideRdrRiObj13RdrObjTrackSts 0 "RdrObjTrackSts_Invld" 1 "RdrObjTrackSts_Updated" 2 "RdrObjTrackSts_New" 3 "RdrObjTrackSts_Coasted";
VAL_ 373 FrntSideRdrRiObj13RdrObjTyp 0 "RdrObjTyp_Ukwn" 1 "RdrObjTyp_Car" 2 "RdrObjTyp_MotorCycle" 3 "RdrObjTyp_Truck" 4 "RdrObjTyp_Ped" 5 "RdrObjTyp_ObstdVert1" 6 "RdrObjTyp_ObstdVert2" 7 "RdrObjTyp_Anim" 8 "RdrObjTyp_ObjGen" 9 "RdrObjTyp_Bicycle" 10 "RdrObjTyp_VehofUkwnClass" 11 "RdrObjTyp_Reserved";
VAL_ 375 FrntSideRdrRiObj14RdrObjElevnSts 0 "RdrObjElevnSts_Unknown" 1 "RdrObjElevnSts_OverRidable" 2 "RdrObjElevnSts_Rlv" 3 "RdrObjElevnSts_UnderRidable";
VAL_ 375 FrntSideRdrRiObj14RdrObjIsInFreeSpace 0 "YesNo2_No" 1 "YesNo2_Yes";
VAL_ 375 FrntSideRdrRiObj14RdrObjMtnPat 0 "RdrObjMtnPat_Ukwn" 1 "RdrObjMtnPat_Staty" 2 "RdrObjMtnPat_StatyFromMovg" 3 "RdrObjMtnPat_Movg" 4 "RdrObjMtnPat_Receding" 5 "RdrObjMtnPat_Oncoming" 6 "RdrObjMtnPat_CrossingFromLe" 7 "RdrObjMtnPat_CrossingFromRi";
VAL_ 375 FrntSideRdrRiObj14RdrObjTrackSts 0 "RdrObjTrackSts_Invld" 1 "RdrObjTrackSts_Updated" 2 "RdrObjTrackSts_New" 3 "RdrObjTrackSts_Coasted";
VAL_ 375 FrntSideRdrRiObj14RdrObjTyp 0 "RdrObjTyp_Ukwn" 1 "RdrObjTyp_Car" 2 "RdrObjTyp_MotorCycle" 3 "RdrObjTyp_Truck" 4 "RdrObjTyp_Ped" 5 "RdrObjTyp_ObstdVert1" 6 "RdrObjTyp_ObstdVert2" 7 "RdrObjTyp_Anim" 8 "RdrObjTyp_ObjGen" 9 "RdrObjTyp_Bicycle" 10 "RdrObjTyp_VehofUkwnClass" 11 "RdrObjTyp_Reserved";
VAL_ 377 FrntSideRdrRiObj15RdrObjElevnSts 0 "RdrObjElevnSts_Unknown" 1 "RdrObjElevnSts_OverRidable" 2 "RdrObjElevnSts_Rlv" 3 "RdrObjElevnSts_UnderRidable";
VAL_ 377 FrntSideRdrRiObj15RdrObjIsInFreeSpace 0 "YesNo2_No" 1 "YesNo2_Yes";
VAL_ 377 FrntSideRdrRiObj15RdrObjMtnPat 0 "RdrObjMtnPat_Ukwn" 1 "RdrObjMtnPat_Staty" 2 "RdrObjMtnPat_StatyFromMovg" 3 "RdrObjMtnPat_Movg" 4 "RdrObjMtnPat_Receding" 5 "RdrObjMtnPat_Oncoming" 6 "RdrObjMtnPat_CrossingFromLe" 7 "RdrObjMtnPat_CrossingFromRi";
VAL_ 377 FrntSideRdrRiObj15RdrObjTrackSts 0 "RdrObjTrackSts_Invld" 1 "RdrObjTrackSts_Updated" 2 "RdrObjTrackSts_New" 3 "RdrObjTrackSts_Coasted";
VAL_ 377 FrntSideRdrRiObj15RdrObjTyp 0 "RdrObjTyp_Ukwn" 1 "RdrObjTyp_Car" 2 "RdrObjTyp_MotorCycle" 3 "RdrObjTyp_Truck" 4 "RdrObjTyp_Ped" 5 "RdrObjTyp_ObstdVert1" 6 "RdrObjTyp_ObstdVert2" 7 "RdrObjTyp_Anim" 8 "RdrObjTyp_ObjGen" 9 "RdrObjTyp_Bicycle" 10 "RdrObjTyp_VehofUkwnClass" 11 "RdrObjTyp_Reserved";
SIG_GROUP_ 367 FrntSideRdrRiObj10 1 : FrntSideRdrRiObj10Heading FrntSideRdrRiObj10ObjBoxCenterLat FrntSideRdrRiObj10ObjBoxCenterLgt FrntSideRdrRiObj10ObservationHist FrntSideRdrRiObj10RdrObjAx FrntSideRdrRiObj10RdrObjAy FrntSideRdrRiObj10RdrObjBoxLength FrntSideRdrRiObj10RdrObjBoxWidth FrntSideRdrRiObj10RdrObjChks FrntSideRdrRiObj10RdrObjCntr FrntSideRdrRiObj10RdrObjCoastCnt FrntSideRdrRiObj10RdrObjConf FrntSideRdrRiObj10RdrObjDx FrntSideRdrRiObj10RdrObjDxStdDe FrntSideRdrRiObj10RdrObjDy FrntSideRdrRiObj10RdrObjDyStdDe FrntSideRdrRiObj10RdrObjElevnConf FrntSideRdrRiObj10RdrObjElevnSts FrntSideRdrRiObj10RdrObjID FrntSideRdrRiObj10RdrObjIsInFreeSpace FrntSideRdrRiObj10RdrObjMirrProblty FrntSideRdrRiObj10RdrObjMtnPat FrntSideRdrRiObj10RdrObjNotRealProblty FrntSideRdrRiObj10RdrObjStatyCnt FrntSideRdrRiObj10RdrObjTiAlv FrntSideRdrRiObj10RdrObjTrackSts FrntSideRdrRiObj10RdrObjTyp FrntSideRdrRiObj10RdrObjTypConfBike FrntSideRdrRiObj10RdrObjTypConfPed FrntSideRdrRiObj10RdrObjTypConfVeh FrntSideRdrRiObj10RdrObjVx FrntSideRdrRiObj10RdrObjVxStdDe FrntSideRdrRiObj10RdrObjVy FrntSideRdrRiObj10RdrObjVyStdDe FrntSideRdrRiObj10RelVx FrntSideRdrRiObj10RelVy;
SIG_GROUP_ 369 FrntSideRdrRiObj11 1 : FrntSideRdrRiObj11Heading FrntSideRdrRiObj11ObjBoxCenterLat FrntSideRdrRiObj11ObjBoxCenterLgt FrntSideRdrRiObj11ObservationHist FrntSideRdrRiObj11RdrObjAx FrntSideRdrRiObj11RdrObjAy FrntSideRdrRiObj11RdrObjBoxLength FrntSideRdrRiObj11RdrObjBoxWidth FrntSideRdrRiObj11RdrObjChks FrntSideRdrRiObj11RdrObjCntr FrntSideRdrRiObj11RdrObjCoastCnt FrntSideRdrRiObj11RdrObjConf FrntSideRdrRiObj11RdrObjDx FrntSideRdrRiObj11RdrObjDxStdDe FrntSideRdrRiObj11RdrObjDy FrntSideRdrRiObj11RdrObjDyStdDe FrntSideRdrRiObj11RdrObjElevnConf FrntSideRdrRiObj11RdrObjElevnSts FrntSideRdrRiObj11RdrObjID FrntSideRdrRiObj11RdrObjIsInFreeSpace FrntSideRdrRiObj11RdrObjMirrProblty FrntSideRdrRiObj11RdrObjMtnPat FrntSideRdrRiObj11RdrObjNotRealProblty FrntSideRdrRiObj11RdrObjStatyCnt FrntSideRdrRiObj11RdrObjTiAlv FrntSideRdrRiObj11RdrObjTrackSts FrntSideRdrRiObj11RdrObjTyp FrntSideRdrRiObj11RdrObjTypConfBike FrntSideRdrRiObj11RdrObjTypConfPed FrntSideRdrRiObj11RdrObjTypConfVeh FrntSideRdrRiObj11RdrObjVx FrntSideRdrRiObj11RdrObjVxStdDe FrntSideRdrRiObj11RdrObjVy FrntSideRdrRiObj11RdrObjVyStdDe FrntSideRdrRiObj11RelVx FrntSideRdrRiObj11RelVy;
SIG_GROUP_ 371 FrntSideRdrRiObj12 1 : FrntSideRdrRiObj12Heading FrntSideRdrRiObj12ObjBoxCenterLat FrntSideRdrRiObj12ObjBoxCenterLgt FrntSideRdrRiObj12ObservationHist FrntSideRdrRiObj12RdrObjAx FrntSideRdrRiObj12RdrObjAy FrntSideRdrRiObj12RdrObjBoxLength FrntSideRdrRiObj12RdrObjBoxWidth FrntSideRdrRiObj12RdrObjChks FrntSideRdrRiObj12RdrObjCntr FrntSideRdrRiObj12RdrObjCoastCnt FrntSideRdrRiObj12RdrObjConf FrntSideRdrRiObj12RdrObjDx FrntSideRdrRiObj12RdrObjDxStdDe FrntSideRdrRiObj12RdrObjDy FrntSideRdrRiObj12RdrObjDyStdDe FrntSideRdrRiObj12RdrObjElevnConf FrntSideRdrRiObj12RdrObjElevnSts FrntSideRdrRiObj12RdrObjID FrntSideRdrRiObj12RdrObjIsInFreeSpace FrntSideRdrRiObj12RdrObjMirrProblty FrntSideRdrRiObj12RdrObjMtnPat FrntSideRdrRiObj12RdrObjNotRealProblty FrntSideRdrRiObj12RdrObjStatyCnt FrntSideRdrRiObj12RdrObjTiAlv FrntSideRdrRiObj12RdrObjTrackSts FrntSideRdrRiObj12RdrObjTyp FrntSideRdrRiObj12RdrObjTypConfBike FrntSideRdrRiObj12RdrObjTypConfPed FrntSideRdrRiObj12RdrObjTypConfVeh FrntSideRdrRiObj12RdrObjVx FrntSideRdrRiObj12RdrObjVxStdDe FrntSideRdrRiObj12RdrObjVy FrntSideRdrRiObj12RdrObjVyStdDe FrntSideRdrRiObj12RelVx FrntSideRdrRiObj12RelVy;
SIG_GROUP_ 373 FrntSideRdrRiObj13 1 : FrntSideRdrRiObj13Heading FrntSideRdrRiObj13ObjBoxCenterLat FrntSideRdrRiObj13ObjBoxCenterLgt FrntSideRdrRiObj13ObservationHist FrntSideRdrRiObj13RdrObjAx FrntSideRdrRiObj13RdrObjAy FrntSideRdrRiObj13RdrObjBoxLength FrntSideRdrRiObj13RdrObjBoxWidth FrntSideRdrRiObj13RdrObjChks FrntSideRdrRiObj13RdrObjCntr FrntSideRdrRiObj13RdrObjCoastCnt FrntSideRdrRiObj13RdrObjConf FrntSideRdrRiObj13RdrObjDx FrntSideRdrRiObj13RdrObjDxStdDe FrntSideRdrRiObj13RdrObjDy FrntSideRdrRiObj13RdrObjDyStdDe FrntSideRdrRiObj13RdrObjElevnConf FrntSideRdrRiObj13RdrObjElevnSts FrntSideRdrRiObj13RdrObjID FrntSideRdrRiObj13RdrObjIsInFreeSpace FrntSideRdrRiObj13RdrObjMirrProblty FrntSideRdrRiObj13RdrObjMtnPat FrntSideRdrRiObj13RdrObjNotRealProblty FrntSideRdrRiObj13RdrObjStatyCnt FrntSideRdrRiObj13RdrObjTiAlv FrntSideRdrRiObj13RdrObjTrackSts FrntSideRdrRiObj13RdrObjTyp FrntSideRdrRiObj13RdrObjTypConfBike FrntSideRdrRiObj13RdrObjTypConfPed FrntSideRdrRiObj13RdrObjTypConfVeh FrntSideRdrRiObj13RdrObjVx FrntSideRdrRiObj13RdrObjVxStdDe FrntSideRdrRiObj13RdrObjVy FrntSideRdrRiObj13RdrObjVyStdDe FrntSideRdrRiObj13RelVx FrntSideRdrRiObj13RelVy;
SIG_GROUP_ 375 FrntSideRdrRiObj14 1 : FrntSideRdrRiObj14Heading FrntSideRdrRiObj14ObjBoxCenterLat FrntSideRdrRiObj14ObjBoxCenterLgt FrntSideRdrRiObj14ObservationHist FrntSideRdrRiObj14RdrObjAx FrntSideRdrRiObj14RdrObjAy FrntSideRdrRiObj14RdrObjBoxLength FrntSideRdrRiObj14RdrObjBoxWidth FrntSideRdrRiObj14RdrObjChks FrntSideRdrRiObj14RdrObjCntr FrntSideRdrRiObj14RdrObjCoastCnt FrntSideRdrRiObj14RdrObjConf FrntSideRdrRiObj14RdrObjDx FrntSideRdrRiObj14RdrObjDxStdDe FrntSideRdrRiObj14RdrObjDy FrntSideRdrRiObj14RdrObjDyStdDe FrntSideRdrRiObj14RdrObjElevnConf FrntSideRdrRiObj14RdrObjElevnSts FrntSideRdrRiObj14RdrObjID FrntSideRdrRiObj14RdrObjIsInFreeSpace FrntSideRdrRiObj14RdrObjMirrProblty FrntSideRdrRiObj14RdrObjMtnPat FrntSideRdrRiObj14RdrObjNotRealProblty FrntSideRdrRiObj14RdrObjStatyCnt FrntSideRdrRiObj14RdrObjTiAlv FrntSideRdrRiObj14RdrObjTrackSts FrntSideRdrRiObj14RdrObjTyp FrntSideRdrRiObj14RdrObjTypConfBike FrntSideRdrRiObj14RdrObjTypConfPed FrntSideRdrRiObj14RdrObjTypConfVeh FrntSideRdrRiObj14RdrObjVx FrntSideRdrRiObj14RdrObjVxStdDe FrntSideRdrRiObj14RdrObjVy FrntSideRdrRiObj14RdrObjVyStdDe FrntSideRdrRiObj14RelVx FrntSideRdrRiObj14RelVy;
SIG_GROUP_ 377 FrntSideRdrRiObj15 1 : FrntSideRdrRiObj15Heading FrntSideRdrRiObj15ObjBoxCenterLat FrntSideRdrRiObj15ObjBoxCenterLgt FrntSideRdrRiObj15ObservationHist FrntSideRdrRiObj15RdrObjAx FrntSideRdrRiObj15RdrObjAy FrntSideRdrRiObj15RdrObjBoxLength FrntSideRdrRiObj15RdrObjBoxWidth FrntSideRdrRiObj15RdrObjChks FrntSideRdrRiObj15RdrObjCntr FrntSideRdrRiObj15RdrObjCoastCnt FrntSideRdrRiObj15RdrObjConf FrntSideRdrRiObj15RdrObjDx FrntSideRdrRiObj15RdrObjDxStdDe FrntSideRdrRiObj15RdrObjDy FrntSideRdrRiObj15RdrObjDyStdDe FrntSideRdrRiObj15RdrObjElevnConf FrntSideRdrRiObj15RdrObjElevnSts FrntSideRdrRiObj15RdrObjID FrntSideRdrRiObj15RdrObjIsInFreeSpace FrntSideRdrRiObj15RdrObjMirrProblty FrntSideRdrRiObj15RdrObjMtnPat FrntSideRdrRiObj15RdrObjNotRealProblty FrntSideRdrRiObj15RdrObjStatyCnt FrntSideRdrRiObj15RdrObjTiAlv FrntSideRdrRiObj15RdrObjTrackSts FrntSideRdrRiObj15RdrObjTyp FrntSideRdrRiObj15RdrObjTypConfBike FrntSideRdrRiObj15RdrObjTypConfPed FrntSideRdrRiObj15RdrObjTypConfVeh FrntSideRdrRiObj15RdrObjVx FrntSideRdrRiObj15RdrObjVxStdDe FrntSideRdrRiObj15RdrObjVy FrntSideRdrRiObj15RdrObjVyStdDe FrntSideRdrRiObj15RelVx FrntSideRdrRiObj15RelVy;
SIG_GROUP_ 355 FrntSideRdrRiObj4 1 : FrntSideRdrRiObj4Heading FrntSideRdrRiObj4ObjBoxCenterLat FrntSideRdrRiObj4ObjBoxCenterLgt FrntSideRdrRiObj4ObservationHist FrntSideRdrRiObj4RdrObjAx FrntSideRdrRiObj4RdrObjAy FrntSideRdrRiObj4RdrObjBoxLength FrntSideRdrRiObj4RdrObjBoxWidth FrntSideRdrRiObj4RdrObjChks FrntSideRdrRiObj4RdrObjCntr FrntSideRdrRiObj4RdrObjCoastCnt FrntSideRdrRiObj4RdrObjConf FrntSideRdrRiObj4RdrObjDx FrntSideRdrRiObj4RdrObjDxStdDe FrntSideRdrRiObj4RdrObjDy FrntSideRdrRiObj4RdrObjDyStdDe FrntSideRdrRiObj4RdrObjElevnConf FrntSideRdrRiObj4RdrObjElevnSts FrntSideRdrRiObj4RdrObjID FrntSideRdrRiObj4RdrObjIsInFreeSpace FrntSideRdrRiObj4RdrObjMirrProblty FrntSideRdrRiObj4RdrObjMtnPat FrntSideRdrRiObj4RdrObjNotRealProblty FrntSideRdrRiObj4RdrObjStatyCnt FrntSideRdrRiObj4RdrObjTiAlv FrntSideRdrRiObj4RdrObjTrackSts FrntSideRdrRiObj4RdrObjTyp FrntSideRdrRiObj4RdrObjTypConfBike FrntSideRdrRiObj4RdrObjTypConfPed FrntSideRdrRiObj4RdrObjTypConfVeh FrntSideRdrRiObj4RdrObjVx FrntSideRdrRiObj4RdrObjVxStdDe FrntSideRdrRiObj4RdrObjVy FrntSideRdrRiObj4RdrObjVyStdDe FrntSideRdrRiObj4RelVx FrntSideRdrRiObj4RelVy;
SIG_GROUP_ 357 FrntSideRdrRiObj5 1 : FrntSideRdrRiObj5Heading FrntSideRdrRiObj5ObjBoxCenterLat FrntSideRdrRiObj5ObjBoxCenterLgt FrntSideRdrRiObj5ObservationHist FrntSideRdrRiObj5RdrObjAx FrntSideRdrRiObj5RdrObjAy FrntSideRdrRiObj5RdrObjBoxLength FrntSideRdrRiObj5RdrObjBoxWidth FrntSideRdrRiObj5RdrObjChks FrntSideRdrRiObj5RdrObjCntr FrntSideRdrRiObj5RdrObjCoastCnt FrntSideRdrRiObj5RdrObjConf FrntSideRdrRiObj5RdrObjDx FrntSideRdrRiObj5RdrObjDxStdDe FrntSideRdrRiObj5RdrObjDy FrntSideRdrRiObj5RdrObjDyStdDe FrntSideRdrRiObj5RdrObjElevnConf FrntSideRdrRiObj5RdrObjElevnSts FrntSideRdrRiObj5RdrObjID FrntSideRdrRiObj5RdrObjIsInFreeSpace FrntSideRdrRiObj5RdrObjMirrProblty FrntSideRdrRiObj5RdrObjMtnPat FrntSideRdrRiObj5RdrObjNotRealProblty FrntSideRdrRiObj5RdrObjStatyCnt FrntSideRdrRiObj5RdrObjTiAlv FrntSideRdrRiObj5RdrObjTrackSts FrntSideRdrRiObj5RdrObjTyp FrntSideRdrRiObj5RdrObjTypConfBike FrntSideRdrRiObj5RdrObjTypConfPed FrntSideRdrRiObj5RdrObjTypConfVeh FrntSideRdrRiObj5RdrObjVx FrntSideRdrRiObj5RdrObjVxStdDe FrntSideRdrRiObj5RdrObjVy FrntSideRdrRiObj5RdrObjVyStdDe FrntSideRdrRiObj5RelVx FrntSideRdrRiObj5RelVy;
SIG_GROUP_ 359 FrntSideRdrRiObj6 1 : FrntSideRdrRiObj6Heading FrntSideRdrRiObj6ObjBoxCenterLat FrntSideRdrRiObj6ObjBoxCenterLgt FrntSideRdrRiObj6ObservationHist FrntSideRdrRiObj6RdrObjAx FrntSideRdrRiObj6RdrObjAy FrntSideRdrRiObj6RdrObjBoxLength FrntSideRdrRiObj6RdrObjBoxWidth FrntSideRdrRiObj6RdrObjChks FrntSideRdrRiObj6RdrObjCntr FrntSideRdrRiObj6RdrObjCoastCnt FrntSideRdrRiObj6RdrObjConf FrntSideRdrRiObj6RdrObjDx FrntSideRdrRiObj6RdrObjDxStdDe FrntSideRdrRiObj6RdrObjDy FrntSideRdrRiObj6RdrObjDyStdDe FrntSideRdrRiObj6RdrObjElevnConf FrntSideRdrRiObj6RdrObjElevnSts FrntSideRdrRiObj6RdrObjID FrntSideRdrRiObj6RdrObjIsInFreeSpace FrntSideRdrRiObj6RdrObjMirrProblty FrntSideRdrRiObj6RdrObjMtnPat FrntSideRdrRiObj6RdrObjNotRealProblty FrntSideRdrRiObj6RdrObjStatyCnt FrntSideRdrRiObj6RdrObjTiAlv FrntSideRdrRiObj6RdrObjTrackSts FrntSideRdrRiObj6RdrObjTyp FrntSideRdrRiObj6RdrObjTypConfBike FrntSideRdrRiObj6RdrObjTypConfPed FrntSideRdrRiObj6RdrObjTypConfVeh FrntSideRdrRiObj6RdrObjVx FrntSideRdrRiObj6RdrObjVxStdDe FrntSideRdrRiObj6RdrObjVy FrntSideRdrRiObj6RdrObjVyStdDe FrntSideRdrRiObj6RelVx FrntSideRdrRiObj6RelVy;
SIG_GROUP_ 361 FrntSideRdrRiObj7 1 : FrntSideRdrRiObj7Heading FrntSideRdrRiObj7ObjBoxCenterLat FrntSideRdrRiObj7ObjBoxCenterLgt FrntSideRdrRiObj7ObservationHist FrntSideRdrRiObj7RdrObjAx FrntSideRdrRiObj7RdrObjAy FrntSideRdrRiObj7RdrObjBoxLength FrntSideRdrRiObj7RdrObjBoxWidth FrntSideRdrRiObj7RdrObjChks FrntSideRdrRiObj7RdrObjCntr FrntSideRdrRiObj7RdrObjCoastCnt FrntSideRdrRiObj7RdrObjConf FrntSideRdrRiObj7RdrObjDx FrntSideRdrRiObj7RdrObjDxStdDe FrntSideRdrRiObj7RdrObjDy FrntSideRdrRiObj7RdrObjDyStdDe FrntSideRdrRiObj7RdrObjElevnConf FrntSideRdrRiObj7RdrObjElevnSts FrntSideRdrRiObj7RdrObjID FrntSideRdrRiObj7RdrObjIsInFreeSpace FrntSideRdrRiObj7RdrObjMirrProblty FrntSideRdrRiObj7RdrObjMtnPat FrntSideRdrRiObj7RdrObjNotRealProblty FrntSideRdrRiObj7RdrObjStatyCnt FrntSideRdrRiObj7RdrObjTiAlv FrntSideRdrRiObj7RdrObjTrackSts FrntSideRdrRiObj7RdrObjTyp FrntSideRdrRiObj7RdrObjTypConfBike FrntSideRdrRiObj7RdrObjTypConfPed FrntSideRdrRiObj7RdrObjTypConfVeh FrntSideRdrRiObj7RdrObjVx FrntSideRdrRiObj7RdrObjVxStdDe FrntSideRdrRiObj7RdrObjVy FrntSideRdrRiObj7RdrObjVyStdDe FrntSideRdrRiObj7RelVx FrntSideRdrRiObj7RelVy;
SIG_GROUP_ 363 FrntSideRdrRiObj8 1 : FrntSideRdrRiObj8Heading FrntSideRdrRiObj8ObjBoxCenterLat FrntSideRdrRiObj8ObjBoxCenterLgt FrntSideRdrRiObj8ObservationHist FrntSideRdrRiObj8RdrObjAx FrntSideRdrRiObj8RdrObjAy FrntSideRdrRiObj8RdrObjBoxLength FrntSideRdrRiObj8RdrObjBoxWidth FrntSideRdrRiObj8RdrObjChks FrntSideRdrRiObj8RdrObjCntr FrntSideRdrRiObj8RdrObjCoastCnt FrntSideRdrRiObj8RdrObjConf FrntSideRdrRiObj8RdrObjDx FrntSideRdrRiObj8RdrObjDxStdDe FrntSideRdrRiObj8RdrObjDy FrntSideRdrRiObj8RdrObjDyStdDe FrntSideRdrRiObj8RdrObjElevnConf FrntSideRdrRiObj8RdrObjElevnSts FrntSideRdrRiObj8RdrObjID FrntSideRdrRiObj8RdrObjIsInFreeSpace FrntSideRdrRiObj8RdrObjMirrProblty FrntSideRdrRiObj8RdrObjMtnPat FrntSideRdrRiObj8RdrObjNotRealProblty FrntSideRdrRiObj8RdrObjStatyCnt FrntSideRdrRiObj8RdrObjTiAlv FrntSideRdrRiObj8RdrObjTrackSts FrntSideRdrRiObj8RdrObjTyp FrntSideRdrRiObj8RdrObjTypConfBike FrntSideRdrRiObj8RdrObjTypConfPed FrntSideRdrRiObj8RdrObjTypConfVeh FrntSideRdrRiObj8RdrObjVx FrntSideRdrRiObj8RdrObjVxStdDe FrntSideRdrRiObj8RdrObjVy FrntSideRdrRiObj8RdrObjVyStdDe FrntSideRdrRiObj8RelVx FrntSideRdrRiObj8RelVy;
SIG_GROUP_ 365 FrntSideRdrRiObj9 1 : FrntSideRdrRiObj9Heading FrntSideRdrRiObj9ObjBoxCenterLat FrntSideRdrRiObj9ObjBoxCenterLgt FrntSideRdrRiObj9ObservationHist FrntSideRdrRiObj9RdrObjAx FrntSideRdrRiObj9RdrObjAy FrntSideRdrRiObj9RdrObjBoxLength FrntSideRdrRiObj9RdrObjBoxWidth FrntSideRdrRiObj9RdrObjChks FrntSideRdrRiObj9RdrObjCntr FrntSideRdrRiObj9RdrObjCoastCnt FrntSideRdrRiObj9RdrObjConf FrntSideRdrRiObj9RdrObjDx FrntSideRdrRiObj9RdrObjDxStdDe FrntSideRdrRiObj9RdrObjDy FrntSideRdrRiObj9RdrObjDyStdDe FrntSideRdrRiObj9RdrObjElevnConf FrntSideRdrRiObj9RdrObjElevnSts FrntSideRdrRiObj9RdrObjID FrntSideRdrRiObj9RdrObjIsInFreeSpace FrntSideRdrRiObj9RdrObjMirrProblty FrntSideRdrRiObj9RdrObjMtnPat FrntSideRdrRiObj9RdrObjNotRealProblty FrntSideRdrRiObj9RdrObjStatyCnt FrntSideRdrRiObj9RdrObjTiAlv FrntSideRdrRiObj9RdrObjTrackSts FrntSideRdrRiObj9RdrObjTyp FrntSideRdrRiObj9RdrObjTypConfBike FrntSideRdrRiObj9RdrObjTypConfPed FrntSideRdrRiObj9RdrObjTypConfVeh FrntSideRdrRiObj9RdrObjVx FrntSideRdrRiObj9RdrObjVxStdDe FrntSideRdrRiObj9RdrObjVy FrntSideRdrRiObj9RdrObjVyStdDe FrntSideRdrRiObj9RelVx FrntSideRdrRiObj9RelVy;
