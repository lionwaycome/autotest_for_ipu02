// *************************************************************************** *
// *                                                                           *
// *                      Mentor Graphics Corporation                          *
// *                          All rights reserved                              *
// *                                                                           *
// *************************************************************************** *
// *                                                                           *
// * Description:         CANDB File                                           *
// * Generated at:        2020-04-14 13:12:04                                  *
// * System:              SDB20010                                             *
// * Variant:             EX11_AVP                                             *
// * Network:             SafetyCANFD1                                         *
// *                                                                           *
// *************************************************************************** *
// *                                                                           *
// *             THIS CONFIGURATION MIGHT CONTAIN SOME ERRORS                  *
// *              IF THE INPUT MODEL WAS NOT PROPERLY FORMED!                  *
// *                    Do Not Use this File directly!                         *
// *                                                                           *
// *************************************************************************** *
VERSION "SafetyCANFD1"

NS_ :

BS_:

BU_:  ASDM ETC FSRL FSRR PAS

BO_ 316 FSRLSafetyCANFD1Frame07: 64 FSRL
 SG_ FrntSideRdrLeDetn37_UB : 74|1@0+ (1,0) [0|1] "" ASDM,PAS
 SG_ FrntSideRdrLeDetn37RdrDetnAzi : 31|11@0+ (0.1,-90.0) [-90.0|90.0] "Deg" ASDM,PAS
 SG_ FrntSideRdrLeDetn37RdrDetnChks : 7|8@0+ (1.0,0.0) [0.0|255.0] "Unitless" ASDM,PAS
 SG_ FrntSideRdrLeDetn37RdrDetnCntr : 15|4@0+ (1.0,0.0) [0.0|15.0] "Unitless" ASDM,PAS
 SG_ FrntSideRdrLeDetn37RdrDetnConf : 71|7@0+ (1.0,0.0) [0.0|100.0] "%" ASDM,PAS
 SG_ FrntSideRdrLeDetn37RdrDetnElevn : 79|5@0+ (1.0,-15.0) [-15.0|15.0] "Deg" ASDM,PAS
 SG_ FrntSideRdrLeDetn37RdrDetnPwr : 8|9@0+ (0.1,0.0) [0.0|51.1] "dB" ASDM,PAS
 SG_ FrntSideRdrLeDetn37RdrDetnRng : 55|14@0+ (0.02,-1.0) [-1.0|200.0] "m" ASDM,PAS
 SG_ FrntSideRdrLeDetn37RdrDetnRngV : 36|13@0+ (0.02,-80.0) [-80.0|80.0] "m/s" ASDM,PAS
 SG_ FrntSideRdrLeDetn37RdrDetnSts : 11|2@0+ (1,0) [0|3] "" ASDM,PAS
 SG_ FrntSideRdrLeDetn38_UB : 154|1@0+ (1,0) [0|1] "" ASDM,PAS
 SG_ FrntSideRdrLeDetn38RdrDetnAzi : 119|11@0+ (0.1,-90.0) [-90.0|90.0] "Deg" ASDM,PAS
 SG_ FrntSideRdrLeDetn38RdrDetnChks : 87|8@0+ (1.0,0.0) [0.0|255.0] "Unitless" ASDM,PAS
 SG_ FrntSideRdrLeDetn38RdrDetnCntr : 95|4@0+ (1.0,0.0) [0.0|15.0] "Unitless" ASDM,PAS
 SG_ FrntSideRdrLeDetn38RdrDetnConf : 111|7@0+ (1.0,0.0) [0.0|100.0] "%" ASDM,PAS
 SG_ FrntSideRdrLeDetn38RdrDetnElevn : 159|5@0+ (1.0,-15.0) [-15.0|15.0] "Deg" ASDM,PAS
 SG_ FrntSideRdrLeDetn38RdrDetnPwr : 89|9@0+ (0.1,0.0) [0.0|51.1] "dB" ASDM,PAS
 SG_ FrntSideRdrLeDetn38RdrDetnRng : 143|14@0+ (0.02,-1.0) [-1.0|200.0] "m" ASDM,PAS
 SG_ FrntSideRdrLeDetn38RdrDetnRngV : 124|13@0+ (0.02,-80.0) [-80.0|80.0] "m/s" ASDM,PAS
 SG_ FrntSideRdrLeDetn38RdrDetnSts : 91|2@0+ (1,0) [0|3] "" ASDM,PAS
 SG_ FrntSideRdrLeDetn39_UB : 234|1@0+ (1,0) [0|1] "" ASDM,PAS
 SG_ FrntSideRdrLeDetn39RdrDetnAzi : 199|11@0+ (0.1,-90.0) [-90.0|90.0] "Deg" ASDM,PAS
 SG_ FrntSideRdrLeDetn39RdrDetnChks : 167|8@0+ (1.0,0.0) [0.0|255.0] "Unitless" ASDM,PAS
 SG_ FrntSideRdrLeDetn39RdrDetnCntr : 175|4@0+ (1.0,0.0) [0.0|15.0] "Unitless" ASDM,PAS
 SG_ FrntSideRdrLeDetn39RdrDetnConf : 191|7@0+ (1.0,0.0) [0.0|100.0] "%" ASDM,PAS
 SG_ FrntSideRdrLeDetn39RdrDetnElevn : 239|5@0+ (1.0,-15.0) [-15.0|15.0] "Deg" ASDM,PAS
 SG_ FrntSideRdrLeDetn39RdrDetnPwr : 169|9@0+ (0.1,0.0) [0.0|51.1] "dB" ASDM,PAS
 SG_ FrntSideRdrLeDetn39RdrDetnRng : 223|14@0+ (0.02,-1.0) [-1.0|200.0] "m" ASDM,PAS
 SG_ FrntSideRdrLeDetn39RdrDetnRngV : 204|13@0+ (0.02,-80.0) [-80.0|80.0] "m/s" ASDM,PAS
 SG_ FrntSideRdrLeDetn39RdrDetnSts : 171|2@0+ (1,0) [0|3] "" ASDM,PAS
 SG_ FrntSideRdrLeDetn40_UB : 314|1@0+ (1,0) [0|1] "" ASDM,PAS
 SG_ FrntSideRdrLeDetn40RdrDetnAzi : 287|11@0+ (0.1,-90.0) [-90.0|90.0] "Deg" ASDM,PAS
 SG_ FrntSideRdrLeDetn40RdrDetnChks : 247|8@0+ (1.0,0.0) [0.0|255.0] "Unitless" ASDM,PAS
 SG_ FrntSideRdrLeDetn40RdrDetnCntr : 255|4@0+ (1.0,0.0) [0.0|15.0] "Unitless" ASDM,PAS
 SG_ FrntSideRdrLeDetn40RdrDetnConf : 311|7@0+ (1.0,0.0) [0.0|100.0] "%" ASDM,PAS
 SG_ FrntSideRdrLeDetn40RdrDetnElevn : 319|5@0+ (1.0,-15.0) [-15.0|15.0] "Deg" ASDM,PAS
 SG_ FrntSideRdrLeDetn40RdrDetnPwr : 249|9@0+ (0.1,0.0) [0.0|51.1] "dB" ASDM,PAS
 SG_ FrntSideRdrLeDetn40RdrDetnRng : 271|14@0+ (0.02,-1.0) [-1.0|200.0] "m" ASDM,PAS
 SG_ FrntSideRdrLeDetn40RdrDetnRngV : 292|13@0+ (0.02,-80.0) [-80.0|80.0] "m/s" ASDM,PAS
 SG_ FrntSideRdrLeDetn40RdrDetnSts : 251|2@0+ (1,0) [0|3] "" ASDM,PAS
 SG_ FrntSideRdrLeDetn41_UB : 394|1@0+ (1,0) [0|1] "" ASDM,PAS
 SG_ FrntSideRdrLeDetn41RdrDetnAzi : 367|11@0+ (0.1,-90.0) [-90.0|90.0] "Deg" ASDM,PAS
 SG_ FrntSideRdrLeDetn41RdrDetnChks : 327|8@0+ (1.0,0.0) [0.0|255.0] "Unitless" ASDM,PAS
 SG_ FrntSideRdrLeDetn41RdrDetnCntr : 335|4@0+ (1.0,0.0) [0.0|15.0] "Unitless" ASDM,PAS
 SG_ FrntSideRdrLeDetn41RdrDetnConf : 391|7@0+ (1.0,0.0) [0.0|100.0] "%" ASDM,PAS
 SG_ FrntSideRdrLeDetn41RdrDetnElevn : 399|5@0+ (1.0,-15.0) [-15.0|15.0] "Deg" ASDM,PAS
 SG_ FrntSideRdrLeDetn41RdrDetnPwr : 329|9@0+ (0.1,0.0) [0.0|51.1] "dB" ASDM,PAS
 SG_ FrntSideRdrLeDetn41RdrDetnRng : 351|14@0+ (0.02,-1.0) [-1.0|200.0] "m" ASDM,PAS
 SG_ FrntSideRdrLeDetn41RdrDetnRngV : 372|13@0+ (0.02,-80.0) [-80.0|80.0] "m/s" ASDM,PAS
 SG_ FrntSideRdrLeDetn41RdrDetnSts : 331|2@0+ (1,0) [0|3] "" ASDM,PAS
 SG_ FrntSideRdrLeDetn42_UB : 474|1@0+ (1,0) [0|1] "" ASDM,PAS
 SG_ FrntSideRdrLeDetn42RdrDetnAzi : 447|11@0+ (0.1,-90.0) [-90.0|90.0] "Deg" ASDM,PAS
 SG_ FrntSideRdrLeDetn42RdrDetnChks : 407|8@0+ (1.0,0.0) [0.0|255.0] "Unitless" ASDM,PAS
 SG_ FrntSideRdrLeDetn42RdrDetnCntr : 415|4@0+ (1.0,0.0) [0.0|15.0] "Unitless" ASDM,PAS
 SG_ FrntSideRdrLeDetn42RdrDetnConf : 471|7@0+ (1.0,0.0) [0.0|100.0] "%" ASDM,PAS
 SG_ FrntSideRdrLeDetn42RdrDetnElevn : 479|5@0+ (1.0,-15.0) [-15.0|15.0] "Deg" ASDM,PAS
 SG_ FrntSideRdrLeDetn42RdrDetnPwr : 409|9@0+ (0.1,0.0) [0.0|51.1] "dB" ASDM,PAS
 SG_ FrntSideRdrLeDetn42RdrDetnRng : 431|14@0+ (0.02,-1.0) [-1.0|200.0] "m" ASDM,PAS
 SG_ FrntSideRdrLeDetn42RdrDetnRngV : 452|13@0+ (0.02,-80.0) [-80.0|80.0] "m/s" ASDM,PAS
 SG_ FrntSideRdrLeDetn42RdrDetnSts : 411|2@0+ (1,0) [0|3] "" ASDM,PAS

BO_ 318 FSRLSafetyCANFD1Frame08: 64 FSRL
 SG_ FrntSideRdrLeDetn43_UB : 74|1@0+ (1,0) [0|1] "" ASDM,PAS
 SG_ FrntSideRdrLeDetn43RdrDetnAzi : 31|11@0+ (0.1,-90.0) [-90.0|90.0] "Deg" ASDM,PAS
 SG_ FrntSideRdrLeDetn43RdrDetnChks : 7|8@0+ (1.0,0.0) [0.0|255.0] "Unitless" ASDM,PAS
 SG_ FrntSideRdrLeDetn43RdrDetnCntr : 15|4@0+ (1.0,0.0) [0.0|15.0] "Unitless" ASDM,PAS
 SG_ FrntSideRdrLeDetn43RdrDetnConf : 71|7@0+ (1.0,0.0) [0.0|100.0] "%" ASDM,PAS
 SG_ FrntSideRdrLeDetn43RdrDetnElevn : 79|5@0+ (1.0,-15.0) [-15.0|15.0] "Deg" ASDM,PAS
 SG_ FrntSideRdrLeDetn43RdrDetnPwr : 8|9@0+ (0.1,0.0) [0.0|51.1] "dB" ASDM,PAS
 SG_ FrntSideRdrLeDetn43RdrDetnRng : 55|14@0+ (0.02,-1.0) [-1.0|200.0] "m" ASDM,PAS
 SG_ FrntSideRdrLeDetn43RdrDetnRngV : 36|13@0+ (0.02,-80.0) [-80.0|80.0] "m/s" ASDM,PAS
 SG_ FrntSideRdrLeDetn43RdrDetnSts : 11|2@0+ (1,0) [0|3] "" ASDM,PAS
 SG_ FrntSideRdrLeDetn44_UB : 154|1@0+ (1,0) [0|1] "" ASDM,PAS
 SG_ FrntSideRdrLeDetn44RdrDetnAzi : 119|11@0+ (0.1,-90.0) [-90.0|90.0] "Deg" ASDM,PAS
 SG_ FrntSideRdrLeDetn44RdrDetnChks : 87|8@0+ (1.0,0.0) [0.0|255.0] "Unitless" ASDM,PAS
 SG_ FrntSideRdrLeDetn44RdrDetnCntr : 95|4@0+ (1.0,0.0) [0.0|15.0] "Unitless" ASDM,PAS
 SG_ FrntSideRdrLeDetn44RdrDetnConf : 111|7@0+ (1.0,0.0) [0.0|100.0] "%" ASDM,PAS
 SG_ FrntSideRdrLeDetn44RdrDetnElevn : 159|5@0+ (1.0,-15.0) [-15.0|15.0] "Deg" ASDM,PAS
 SG_ FrntSideRdrLeDetn44RdrDetnPwr : 89|9@0+ (0.1,0.0) [0.0|51.1] "dB" ASDM,PAS
 SG_ FrntSideRdrLeDetn44RdrDetnRng : 143|14@0+ (0.02,-1.0) [-1.0|200.0] "m" ASDM,PAS
 SG_ FrntSideRdrLeDetn44RdrDetnRngV : 124|13@0+ (0.02,-80.0) [-80.0|80.0] "m/s" ASDM,PAS
 SG_ FrntSideRdrLeDetn44RdrDetnSts : 91|2@0+ (1,0) [0|3] "" ASDM,PAS
 SG_ FrntSideRdrLeDetn45_UB : 234|1@0+ (1,0) [0|1] "" ASDM,PAS
 SG_ FrntSideRdrLeDetn45RdrDetnAzi : 199|11@0+ (0.1,-90.0) [-90.0|90.0] "Deg" ASDM,PAS
 SG_ FrntSideRdrLeDetn45RdrDetnChks : 167|8@0+ (1.0,0.0) [0.0|255.0] "Unitless" ASDM,PAS
 SG_ FrntSideRdrLeDetn45RdrDetnCntr : 175|4@0+ (1.0,0.0) [0.0|15.0] "Unitless" ASDM,PAS
 SG_ FrntSideRdrLeDetn45RdrDetnConf : 191|7@0+ (1.0,0.0) [0.0|100.0] "%" ASDM,PAS
 SG_ FrntSideRdrLeDetn45RdrDetnElevn : 239|5@0+ (1.0,-15.0) [-15.0|15.0] "Deg" ASDM,PAS
 SG_ FrntSideRdrLeDetn45RdrDetnPwr : 169|9@0+ (0.1,0.0) [0.0|51.1] "dB" ASDM,PAS
 SG_ FrntSideRdrLeDetn45RdrDetnRng : 223|14@0+ (0.02,-1.0) [-1.0|200.0] "m" ASDM,PAS
 SG_ FrntSideRdrLeDetn45RdrDetnRngV : 204|13@0+ (0.02,-80.0) [-80.0|80.0] "m/s" ASDM,PAS
 SG_ FrntSideRdrLeDetn45RdrDetnSts : 171|2@0+ (1,0) [0|3] "" ASDM,PAS
 SG_ FrntSideRdrLeDetn46_UB : 314|1@0+ (1,0) [0|1] "" ASDM,PAS
 SG_ FrntSideRdrLeDetn46RdrDetnAzi : 287|11@0+ (0.1,-90.0) [-90.0|90.0] "Deg" ASDM,PAS
 SG_ FrntSideRdrLeDetn46RdrDetnChks : 247|8@0+ (1.0,0.0) [0.0|255.0] "Unitless" ASDM,PAS
 SG_ FrntSideRdrLeDetn46RdrDetnCntr : 255|4@0+ (1.0,0.0) [0.0|15.0] "Unitless" ASDM,PAS
 SG_ FrntSideRdrLeDetn46RdrDetnConf : 311|7@0+ (1.0,0.0) [0.0|100.0] "%" ASDM,PAS
 SG_ FrntSideRdrLeDetn46RdrDetnElevn : 319|5@0+ (1.0,-15.0) [-15.0|15.0] "Deg" ASDM,PAS
 SG_ FrntSideRdrLeDetn46RdrDetnPwr : 249|9@0+ (0.1,0.0) [0.0|51.1] "dB" ASDM,PAS
 SG_ FrntSideRdrLeDetn46RdrDetnRng : 271|14@0+ (0.02,-1.0) [-1.0|200.0] "m" ASDM,PAS
 SG_ FrntSideRdrLeDetn46RdrDetnRngV : 292|13@0+ (0.02,-80.0) [-80.0|80.0] "m/s" ASDM,PAS
 SG_ FrntSideRdrLeDetn46RdrDetnSts : 251|2@0+ (1,0) [0|3] "" ASDM,PAS
 SG_ FrntSideRdrLeDetn47_UB : 394|1@0+ (1,0) [0|1] "" ASDM,PAS
 SG_ FrntSideRdrLeDetn47RdrDetnAzi : 367|11@0+ (0.1,-90.0) [-90.0|90.0] "Deg" ASDM,PAS
 SG_ FrntSideRdrLeDetn47RdrDetnChks : 327|8@0+ (1.0,0.0) [0.0|255.0] "Unitless" ASDM,PAS
 SG_ FrntSideRdrLeDetn47RdrDetnCntr : 335|4@0+ (1.0,0.0) [0.0|15.0] "Unitless" ASDM,PAS
 SG_ FrntSideRdrLeDetn47RdrDetnConf : 391|7@0+ (1.0,0.0) [0.0|100.0] "%" ASDM,PAS
 SG_ FrntSideRdrLeDetn47RdrDetnElevn : 399|5@0+ (1.0,-15.0) [-15.0|15.0] "Deg" ASDM,PAS
 SG_ FrntSideRdrLeDetn47RdrDetnPwr : 329|9@0+ (0.1,0.0) [0.0|51.1] "dB" ASDM,PAS
 SG_ FrntSideRdrLeDetn47RdrDetnRng : 351|14@0+ (0.02,-1.0) [-1.0|200.0] "m" ASDM,PAS
 SG_ FrntSideRdrLeDetn47RdrDetnRngV : 372|13@0+ (0.02,-80.0) [-80.0|80.0] "m/s" ASDM,PAS
 SG_ FrntSideRdrLeDetn47RdrDetnSts : 331|2@0+ (1,0) [0|3] "" ASDM,PAS
 SG_ FrntSideRdrLeDetn48_UB : 474|1@0+ (1,0) [0|1] "" ASDM,PAS
 SG_ FrntSideRdrLeDetn48RdrDetnAzi : 447|11@0+ (0.1,-90.0) [-90.0|90.0] "Deg" ASDM,PAS
 SG_ FrntSideRdrLeDetn48RdrDetnChks : 407|8@0+ (1.0,0.0) [0.0|255.0] "Unitless" ASDM,PAS
 SG_ FrntSideRdrLeDetn48RdrDetnCntr : 415|4@0+ (1.0,0.0) [0.0|15.0] "Unitless" ASDM,PAS
 SG_ FrntSideRdrLeDetn48RdrDetnConf : 471|7@0+ (1.0,0.0) [0.0|100.0] "%" ASDM,PAS
 SG_ FrntSideRdrLeDetn48RdrDetnElevn : 479|5@0+ (1.0,-15.0) [-15.0|15.0] "Deg" ASDM,PAS
 SG_ FrntSideRdrLeDetn48RdrDetnPwr : 409|9@0+ (0.1,0.0) [0.0|51.1] "dB" ASDM,PAS
 SG_ FrntSideRdrLeDetn48RdrDetnRng : 431|14@0+ (0.02,-1.0) [-1.0|200.0] "m" ASDM,PAS
 SG_ FrntSideRdrLeDetn48RdrDetnRngV : 452|13@0+ (0.02,-80.0) [-80.0|80.0] "m/s" ASDM,PAS
 SG_ FrntSideRdrLeDetn48RdrDetnSts : 411|2@0+ (1,0) [0|3] "" ASDM,PAS

BO_ 320 FSRLSafetyCANFD1Frame09: 64 FSRL
 SG_ FrntSideRdrLeDetn49_UB : 74|1@0+ (1,0) [0|1] "" ASDM,PAS
 SG_ FrntSideRdrLeDetn49RdrDetnAzi : 31|11@0+ (0.1,-90.0) [-90.0|90.0] "Deg" ASDM,PAS
 SG_ FrntSideRdrLeDetn49RdrDetnChks : 7|8@0+ (1.0,0.0) [0.0|255.0] "Unitless" ASDM,PAS
 SG_ FrntSideRdrLeDetn49RdrDetnCntr : 15|4@0+ (1.0,0.0) [0.0|15.0] "Unitless" ASDM,PAS
 SG_ FrntSideRdrLeDetn49RdrDetnConf : 71|7@0+ (1.0,0.0) [0.0|100.0] "%" ASDM,PAS
 SG_ FrntSideRdrLeDetn49RdrDetnElevn : 79|5@0+ (1.0,-15.0) [-15.0|15.0] "Deg" ASDM,PAS
 SG_ FrntSideRdrLeDetn49RdrDetnPwr : 8|9@0+ (0.1,0.0) [0.0|51.1] "dB" ASDM,PAS
 SG_ FrntSideRdrLeDetn49RdrDetnRng : 55|14@0+ (0.02,-1.0) [-1.0|200.0] "m" ASDM,PAS
 SG_ FrntSideRdrLeDetn49RdrDetnRngV : 36|13@0+ (0.02,-80.0) [-80.0|80.0] "m/s" ASDM,PAS
 SG_ FrntSideRdrLeDetn49RdrDetnSts : 11|2@0+ (1,0) [0|3] "" ASDM,PAS
 SG_ FrntSideRdrLeDetn50_UB : 154|1@0+ (1,0) [0|1] "" ASDM,PAS
 SG_ FrntSideRdrLeDetn50RdrDetnAzi : 119|11@0+ (0.1,-90.0) [-90.0|90.0] "Deg" ASDM,PAS
 SG_ FrntSideRdrLeDetn50RdrDetnChks : 87|8@0+ (1.0,0.0) [0.0|255.0] "Unitless" ASDM,PAS
 SG_ FrntSideRdrLeDetn50RdrDetnCntr : 95|4@0+ (1.0,0.0) [0.0|15.0] "Unitless" ASDM,PAS
 SG_ FrntSideRdrLeDetn50RdrDetnConf : 111|7@0+ (1.0,0.0) [0.0|100.0] "%" ASDM,PAS
 SG_ FrntSideRdrLeDetn50RdrDetnElevn : 159|5@0+ (1.0,-15.0) [-15.0|15.0] "Deg" ASDM,PAS
 SG_ FrntSideRdrLeDetn50RdrDetnPwr : 89|9@0+ (0.1,0.0) [0.0|51.1] "dB" ASDM,PAS
 SG_ FrntSideRdrLeDetn50RdrDetnRng : 143|14@0+ (0.02,-1.0) [-1.0|200.0] "m" ASDM,PAS
 SG_ FrntSideRdrLeDetn50RdrDetnRngV : 124|13@0+ (0.02,-80.0) [-80.0|80.0] "m/s" ASDM,PAS
 SG_ FrntSideRdrLeDetn50RdrDetnSts : 91|2@0+ (1,0) [0|3] "" ASDM,PAS
 SG_ FrntSideRdrLeDetn51_UB : 234|1@0+ (1,0) [0|1] "" ASDM,PAS
 SG_ FrntSideRdrLeDetn51RdrDetnAzi : 199|11@0+ (0.1,-90.0) [-90.0|90.0] "Deg" ASDM,PAS
 SG_ FrntSideRdrLeDetn51RdrDetnChks : 167|8@0+ (1.0,0.0) [0.0|255.0] "Unitless" ASDM,PAS
 SG_ FrntSideRdrLeDetn51RdrDetnCntr : 175|4@0+ (1.0,0.0) [0.0|15.0] "Unitless" ASDM,PAS
 SG_ FrntSideRdrLeDetn51RdrDetnConf : 191|7@0+ (1.0,0.0) [0.0|100.0] "%" ASDM,PAS
 SG_ FrntSideRdrLeDetn51RdrDetnElevn : 239|5@0+ (1.0,-15.0) [-15.0|15.0] "Deg" ASDM,PAS
 SG_ FrntSideRdrLeDetn51RdrDetnPwr : 169|9@0+ (0.1,0.0) [0.0|51.1] "dB" ASDM,PAS
 SG_ FrntSideRdrLeDetn51RdrDetnRng : 223|14@0+ (0.02,-1.0) [-1.0|200.0] "m" ASDM,PAS
 SG_ FrntSideRdrLeDetn51RdrDetnRngV : 204|13@0+ (0.02,-80.0) [-80.0|80.0] "m/s" ASDM,PAS
 SG_ FrntSideRdrLeDetn51RdrDetnSts : 171|2@0+ (1,0) [0|3] "" ASDM,PAS
 SG_ FrntSideRdrLeDetn52_UB : 314|1@0+ (1,0) [0|1] "" ASDM,PAS
 SG_ FrntSideRdrLeDetn52RdrDetnAzi : 287|11@0+ (0.1,-90.0) [-90.0|90.0] "Deg" ASDM,PAS
 SG_ FrntSideRdrLeDetn52RdrDetnChks : 247|8@0+ (1.0,0.0) [0.0|255.0] "Unitless" ASDM,PAS
 SG_ FrntSideRdrLeDetn52RdrDetnCntr : 255|4@0+ (1.0,0.0) [0.0|15.0] "Unitless" ASDM,PAS
 SG_ FrntSideRdrLeDetn52RdrDetnConf : 311|7@0+ (1.0,0.0) [0.0|100.0] "%" ASDM,PAS
 SG_ FrntSideRdrLeDetn52RdrDetnElevn : 319|5@0+ (1.0,-15.0) [-15.0|15.0] "Deg" ASDM,PAS
 SG_ FrntSideRdrLeDetn52RdrDetnPwr : 249|9@0+ (0.1,0.0) [0.0|51.1] "dB" ASDM,PAS
 SG_ FrntSideRdrLeDetn52RdrDetnRng : 271|14@0+ (0.02,-1.0) [-1.0|200.0] "m" ASDM,PAS
 SG_ FrntSideRdrLeDetn52RdrDetnRngV : 292|13@0+ (0.02,-80.0) [-80.0|80.0] "m/s" ASDM,PAS
 SG_ FrntSideRdrLeDetn52RdrDetnSts : 251|2@0+ (1,0) [0|3] "" ASDM,PAS
 SG_ FrntSideRdrLeDetn53_UB : 394|1@0+ (1,0) [0|1] "" ASDM,PAS
 SG_ FrntSideRdrLeDetn53RdrDetnAzi : 367|11@0+ (0.1,-90.0) [-90.0|90.0] "Deg" ASDM,PAS
 SG_ FrntSideRdrLeDetn53RdrDetnChks : 327|8@0+ (1.0,0.0) [0.0|255.0] "Unitless" ASDM,PAS
 SG_ FrntSideRdrLeDetn53RdrDetnCntr : 335|4@0+ (1.0,0.0) [0.0|15.0] "Unitless" ASDM,PAS
 SG_ FrntSideRdrLeDetn53RdrDetnConf : 391|7@0+ (1.0,0.0) [0.0|100.0] "%" ASDM,PAS
 SG_ FrntSideRdrLeDetn53RdrDetnElevn : 399|5@0+ (1.0,-15.0) [-15.0|15.0] "Deg" ASDM,PAS
 SG_ FrntSideRdrLeDetn53RdrDetnPwr : 329|9@0+ (0.1,0.0) [0.0|51.1] "dB" ASDM,PAS
 SG_ FrntSideRdrLeDetn53RdrDetnRng : 351|14@0+ (0.02,-1.0) [-1.0|200.0] "m" ASDM,PAS
 SG_ FrntSideRdrLeDetn53RdrDetnRngV : 372|13@0+ (0.02,-80.0) [-80.0|80.0] "m/s" ASDM,PAS
 SG_ FrntSideRdrLeDetn53RdrDetnSts : 331|2@0+ (1,0) [0|3] "" ASDM,PAS
 SG_ FrntSideRdrLeDetn54_UB : 474|1@0+ (1,0) [0|1] "" ASDM,PAS
 SG_ FrntSideRdrLeDetn54RdrDetnAzi : 447|11@0+ (0.1,-90.0) [-90.0|90.0] "Deg" ASDM,PAS
 SG_ FrntSideRdrLeDetn54RdrDetnChks : 407|8@0+ (1.0,0.0) [0.0|255.0] "Unitless" ASDM,PAS
 SG_ FrntSideRdrLeDetn54RdrDetnCntr : 415|4@0+ (1.0,0.0) [0.0|15.0] "Unitless" ASDM,PAS
 SG_ FrntSideRdrLeDetn54RdrDetnConf : 471|7@0+ (1.0,0.0) [0.0|100.0] "%" ASDM,PAS
 SG_ FrntSideRdrLeDetn54RdrDetnElevn : 479|5@0+ (1.0,-15.0) [-15.0|15.0] "Deg" ASDM,PAS
 SG_ FrntSideRdrLeDetn54RdrDetnPwr : 409|9@0+ (0.1,0.0) [0.0|51.1] "dB" ASDM,PAS
 SG_ FrntSideRdrLeDetn54RdrDetnRng : 431|14@0+ (0.02,-1.0) [-1.0|200.0] "m" ASDM,PAS
 SG_ FrntSideRdrLeDetn54RdrDetnRngV : 452|13@0+ (0.02,-80.0) [-80.0|80.0] "m/s" ASDM,PAS
 SG_ FrntSideRdrLeDetn54RdrDetnSts : 411|2@0+ (1,0) [0|3] "" ASDM,PAS

BO_ 322 FSRLSafetyCANFD1Frame10: 64 FSRL
 SG_ FrntSideRdrLeDetn55_UB : 74|1@0+ (1,0) [0|1] "" ASDM,PAS
 SG_ FrntSideRdrLeDetn55RdrDetnAzi : 31|11@0+ (0.1,-90.0) [-90.0|90.0] "Deg" ASDM,PAS
 SG_ FrntSideRdrLeDetn55RdrDetnChks : 7|8@0+ (1.0,0.0) [0.0|255.0] "Unitless" ASDM,PAS
 SG_ FrntSideRdrLeDetn55RdrDetnCntr : 15|4@0+ (1.0,0.0) [0.0|15.0] "Unitless" ASDM,PAS
 SG_ FrntSideRdrLeDetn55RdrDetnConf : 71|7@0+ (1.0,0.0) [0.0|100.0] "%" ASDM,PAS
 SG_ FrntSideRdrLeDetn55RdrDetnElevn : 79|5@0+ (1.0,-15.0) [-15.0|15.0] "Deg" ASDM,PAS
 SG_ FrntSideRdrLeDetn55RdrDetnPwr : 8|9@0+ (0.1,0.0) [0.0|51.1] "dB" ASDM,PAS
 SG_ FrntSideRdrLeDetn55RdrDetnRng : 55|14@0+ (0.02,-1.0) [-1.0|200.0] "m" ASDM,PAS
 SG_ FrntSideRdrLeDetn55RdrDetnRngV : 36|13@0+ (0.02,-80.0) [-80.0|80.0] "m/s" ASDM,PAS
 SG_ FrntSideRdrLeDetn55RdrDetnSts : 11|2@0+ (1,0) [0|3] "" ASDM,PAS
 SG_ FrntSideRdrLeDetn56_UB : 154|1@0+ (1,0) [0|1] "" ASDM,PAS
 SG_ FrntSideRdrLeDetn56RdrDetnAzi : 119|11@0+ (0.1,-90.0) [-90.0|90.0] "Deg" ASDM,PAS
 SG_ FrntSideRdrLeDetn56RdrDetnChks : 87|8@0+ (1.0,0.0) [0.0|255.0] "Unitless" ASDM,PAS
 SG_ FrntSideRdrLeDetn56RdrDetnCntr : 95|4@0+ (1.0,0.0) [0.0|15.0] "Unitless" ASDM,PAS
 SG_ FrntSideRdrLeDetn56RdrDetnConf : 111|7@0+ (1.0,0.0) [0.0|100.0] "%" ASDM,PAS
 SG_ FrntSideRdrLeDetn56RdrDetnElevn : 159|5@0+ (1.0,-15.0) [-15.0|15.0] "Deg" ASDM,PAS
 SG_ FrntSideRdrLeDetn56RdrDetnPwr : 89|9@0+ (0.1,0.0) [0.0|51.1] "dB" ASDM,PAS
 SG_ FrntSideRdrLeDetn56RdrDetnRng : 143|14@0+ (0.02,-1.0) [-1.0|200.0] "m" ASDM,PAS
 SG_ FrntSideRdrLeDetn56RdrDetnRngV : 124|13@0+ (0.02,-80.0) [-80.0|80.0] "m/s" ASDM,PAS
 SG_ FrntSideRdrLeDetn56RdrDetnSts : 91|2@0+ (1,0) [0|3] "" ASDM,PAS
 SG_ FrntSideRdrLeDetn57_UB : 234|1@0+ (1,0) [0|1] "" ASDM,PAS
 SG_ FrntSideRdrLeDetn57RdrDetnAzi : 199|11@0+ (0.1,-90.0) [-90.0|90.0] "Deg" ASDM,PAS
 SG_ FrntSideRdrLeDetn57RdrDetnChks : 167|8@0+ (1.0,0.0) [0.0|255.0] "Unitless" ASDM,PAS
 SG_ FrntSideRdrLeDetn57RdrDetnCntr : 175|4@0+ (1.0,0.0) [0.0|15.0] "Unitless" ASDM,PAS
 SG_ FrntSideRdrLeDetn57RdrDetnConf : 191|7@0+ (1.0,0.0) [0.0|100.0] "%" ASDM,PAS
 SG_ FrntSideRdrLeDetn57RdrDetnElevn : 239|5@0+ (1.0,-15.0) [-15.0|15.0] "Deg" ASDM,PAS
 SG_ FrntSideRdrLeDetn57RdrDetnPwr : 169|9@0+ (0.1,0.0) [0.0|51.1] "dB" ASDM,PAS
 SG_ FrntSideRdrLeDetn57RdrDetnRng : 223|14@0+ (0.02,-1.0) [-1.0|200.0] "m" ASDM,PAS
 SG_ FrntSideRdrLeDetn57RdrDetnRngV : 204|13@0+ (0.02,-80.0) [-80.0|80.0] "m/s" ASDM,PAS
 SG_ FrntSideRdrLeDetn57RdrDetnSts : 171|2@0+ (1,0) [0|3] "" ASDM,PAS
 SG_ FrntSideRdrLeDetn58_UB : 314|1@0+ (1,0) [0|1] "" ASDM,PAS
 SG_ FrntSideRdrLeDetn58RdrDetnAzi : 287|11@0+ (0.1,-90.0) [-90.0|90.0] "Deg" ASDM,PAS
 SG_ FrntSideRdrLeDetn58RdrDetnChks : 247|8@0+ (1.0,0.0) [0.0|255.0] "Unitless" ASDM,PAS
 SG_ FrntSideRdrLeDetn58RdrDetnCntr : 255|4@0+ (1.0,0.0) [0.0|15.0] "Unitless" ASDM,PAS
 SG_ FrntSideRdrLeDetn58RdrDetnConf : 311|7@0+ (1.0,0.0) [0.0|100.0] "%" ASDM,PAS
 SG_ FrntSideRdrLeDetn58RdrDetnElevn : 319|5@0+ (1.0,-15.0) [-15.0|15.0] "Deg" ASDM,PAS
 SG_ FrntSideRdrLeDetn58RdrDetnPwr : 249|9@0+ (0.1,0.0) [0.0|51.1] "dB" ASDM,PAS
 SG_ FrntSideRdrLeDetn58RdrDetnRng : 271|14@0+ (0.02,-1.0) [-1.0|200.0] "m" ASDM,PAS
 SG_ FrntSideRdrLeDetn58RdrDetnRngV : 292|13@0+ (0.02,-80.0) [-80.0|80.0] "m/s" ASDM,PAS
 SG_ FrntSideRdrLeDetn58RdrDetnSts : 251|2@0+ (1,0) [0|3] "" ASDM,PAS
 SG_ FrntSideRdrLeDetn59_UB : 394|1@0+ (1,0) [0|1] "" ASDM,PAS
 SG_ FrntSideRdrLeDetn59RdrDetnAzi : 367|11@0+ (0.1,-90.0) [-90.0|90.0] "Deg" ASDM,PAS
 SG_ FrntSideRdrLeDetn59RdrDetnChks : 327|8@0+ (1.0,0.0) [0.0|255.0] "Unitless" ASDM,PAS
 SG_ FrntSideRdrLeDetn59RdrDetnCntr : 335|4@0+ (1.0,0.0) [0.0|15.0] "Unitless" ASDM,PAS
 SG_ FrntSideRdrLeDetn59RdrDetnConf : 391|7@0+ (1.0,0.0) [0.0|100.0] "%" ASDM,PAS
 SG_ FrntSideRdrLeDetn59RdrDetnElevn : 399|5@0+ (1.0,-15.0) [-15.0|15.0] "Deg" ASDM,PAS
 SG_ FrntSideRdrLeDetn59RdrDetnPwr : 329|9@0+ (0.1,0.0) [0.0|51.1] "dB" ASDM,PAS
 SG_ FrntSideRdrLeDetn59RdrDetnRng : 351|14@0+ (0.02,-1.0) [-1.0|200.0] "m" ASDM,PAS
 SG_ FrntSideRdrLeDetn59RdrDetnRngV : 372|13@0+ (0.02,-80.0) [-80.0|80.0] "m/s" ASDM,PAS
 SG_ FrntSideRdrLeDetn59RdrDetnSts : 331|2@0+ (1,0) [0|3] "" ASDM,PAS
 SG_ FrntSideRdrLeDetn60_UB : 474|1@0+ (1,0) [0|1] "" ASDM,PAS
 SG_ FrntSideRdrLeDetn60RdrDetnAzi : 447|11@0+ (0.1,-90.0) [-90.0|90.0] "Deg" ASDM,PAS
 SG_ FrntSideRdrLeDetn60RdrDetnChks : 407|8@0+ (1.0,0.0) [0.0|255.0] "Unitless" ASDM,PAS
 SG_ FrntSideRdrLeDetn60RdrDetnCntr : 415|4@0+ (1.0,0.0) [0.0|15.0] "Unitless" ASDM,PAS
 SG_ FrntSideRdrLeDetn60RdrDetnConf : 471|7@0+ (1.0,0.0) [0.0|100.0] "%" ASDM,PAS
 SG_ FrntSideRdrLeDetn60RdrDetnElevn : 479|5@0+ (1.0,-15.0) [-15.0|15.0] "Deg" ASDM,PAS
 SG_ FrntSideRdrLeDetn60RdrDetnPwr : 409|9@0+ (0.1,0.0) [0.0|51.1] "dB" ASDM,PAS
 SG_ FrntSideRdrLeDetn60RdrDetnRng : 431|14@0+ (0.02,-1.0) [-1.0|200.0] "m" ASDM,PAS
 SG_ FrntSideRdrLeDetn60RdrDetnRngV : 452|13@0+ (0.02,-80.0) [-80.0|80.0] "m/s" ASDM,PAS
 SG_ FrntSideRdrLeDetn60RdrDetnSts : 411|2@0+ (1,0) [0|3] "" ASDM,PAS

BO_ 324 FSRLSafetyCANFD1Frame11: 64 FSRL
 SG_ FrntSideRdrLeDetn61_UB : 74|1@0+ (1,0) [0|1] "" ASDM,PAS
 SG_ FrntSideRdrLeDetn61RdrDetnAzi : 31|11@0+ (0.1,-90.0) [-90.0|90.0] "Deg" ASDM,PAS
 SG_ FrntSideRdrLeDetn61RdrDetnChks : 7|8@0+ (1.0,0.0) [0.0|255.0] "Unitless" ASDM,PAS
 SG_ FrntSideRdrLeDetn61RdrDetnCntr : 15|4@0+ (1.0,0.0) [0.0|15.0] "Unitless" ASDM,PAS
 SG_ FrntSideRdrLeDetn61RdrDetnConf : 71|7@0+ (1.0,0.0) [0.0|100.0] "%" ASDM,PAS
 SG_ FrntSideRdrLeDetn61RdrDetnElevn : 79|5@0+ (1.0,-15.0) [-15.0|15.0] "Deg" ASDM,PAS
 SG_ FrntSideRdrLeDetn61RdrDetnPwr : 8|9@0+ (0.1,0.0) [0.0|51.1] "dB" ASDM,PAS
 SG_ FrntSideRdrLeDetn61RdrDetnRng : 55|14@0+ (0.02,-1.0) [-1.0|200.0] "m" ASDM,PAS
 SG_ FrntSideRdrLeDetn61RdrDetnRngV : 36|13@0+ (0.02,-80.0) [-80.0|80.0] "m/s" ASDM,PAS
 SG_ FrntSideRdrLeDetn61RdrDetnSts : 11|2@0+ (1,0) [0|3] "" ASDM,PAS
 SG_ FrntSideRdrLeDetn62_UB : 154|1@0+ (1,0) [0|1] "" ASDM,PAS
 SG_ FrntSideRdrLeDetn62RdrDetnAzi : 119|11@0+ (0.1,-90.0) [-90.0|90.0] "Deg" ASDM,PAS
 SG_ FrntSideRdrLeDetn62RdrDetnChks : 87|8@0+ (1.0,0.0) [0.0|255.0] "Unitless" ASDM,PAS
 SG_ FrntSideRdrLeDetn62RdrDetnCntr : 95|4@0+ (1.0,0.0) [0.0|15.0] "Unitless" ASDM,PAS
 SG_ FrntSideRdrLeDetn62RdrDetnConf : 111|7@0+ (1.0,0.0) [0.0|100.0] "%" ASDM,PAS
 SG_ FrntSideRdrLeDetn62RdrDetnElevn : 159|5@0+ (1.0,-15.0) [-15.0|15.0] "Deg" ASDM,PAS
 SG_ FrntSideRdrLeDetn62RdrDetnPwr : 89|9@0+ (0.1,0.0) [0.0|51.1] "dB" ASDM,PAS
 SG_ FrntSideRdrLeDetn62RdrDetnRng : 143|14@0+ (0.02,-1.0) [-1.0|200.0] "m" ASDM,PAS
 SG_ FrntSideRdrLeDetn62RdrDetnRngV : 124|13@0+ (0.02,-80.0) [-80.0|80.0] "m/s" ASDM,PAS
 SG_ FrntSideRdrLeDetn62RdrDetnSts : 91|2@0+ (1,0) [0|3] "" ASDM,PAS
 SG_ FrntSideRdrLeDetn63_UB : 234|1@0+ (1,0) [0|1] "" ASDM,PAS
 SG_ FrntSideRdrLeDetn63RdrDetnAzi : 199|11@0+ (0.1,-90.0) [-90.0|90.0] "Deg" ASDM,PAS
 SG_ FrntSideRdrLeDetn63RdrDetnChks : 167|8@0+ (1.0,0.0) [0.0|255.0] "Unitless" ASDM,PAS
 SG_ FrntSideRdrLeDetn63RdrDetnCntr : 175|4@0+ (1.0,0.0) [0.0|15.0] "Unitless" ASDM,PAS
 SG_ FrntSideRdrLeDetn63RdrDetnConf : 191|7@0+ (1.0,0.0) [0.0|100.0] "%" ASDM,PAS
 SG_ FrntSideRdrLeDetn63RdrDetnElevn : 239|5@0+ (1.0,-15.0) [-15.0|15.0] "Deg" ASDM,PAS
 SG_ FrntSideRdrLeDetn63RdrDetnPwr : 169|9@0+ (0.1,0.0) [0.0|51.1] "dB" ASDM,PAS
 SG_ FrntSideRdrLeDetn63RdrDetnRng : 223|14@0+ (0.02,-1.0) [-1.0|200.0] "m" ASDM,PAS
 SG_ FrntSideRdrLeDetn63RdrDetnRngV : 204|13@0+ (0.02,-80.0) [-80.0|80.0] "m/s" ASDM,PAS
 SG_ FrntSideRdrLeDetn63RdrDetnSts : 171|2@0+ (1,0) [0|3] "" ASDM,PAS
 SG_ FrntSideRdrLeDetn64_UB : 314|1@0+ (1,0) [0|1] "" ASDM,PAS
 SG_ FrntSideRdrLeDetn64RdrDetnAzi : 287|11@0+ (0.1,-90.0) [-90.0|90.0] "Deg" ASDM,PAS
 SG_ FrntSideRdrLeDetn64RdrDetnChks : 247|8@0+ (1.0,0.0) [0.0|255.0] "Unitless" ASDM,PAS
 SG_ FrntSideRdrLeDetn64RdrDetnCntr : 255|4@0+ (1.0,0.0) [0.0|15.0] "Unitless" ASDM,PAS
 SG_ FrntSideRdrLeDetn64RdrDetnConf : 311|7@0+ (1.0,0.0) [0.0|100.0] "%" ASDM,PAS
 SG_ FrntSideRdrLeDetn64RdrDetnElevn : 319|5@0+ (1.0,-15.0) [-15.0|15.0] "Deg" ASDM,PAS
 SG_ FrntSideRdrLeDetn64RdrDetnPwr : 249|9@0+ (0.1,0.0) [0.0|51.1] "dB" ASDM,PAS
 SG_ FrntSideRdrLeDetn64RdrDetnRng : 271|14@0+ (0.02,-1.0) [-1.0|200.0] "m" ASDM,PAS
 SG_ FrntSideRdrLeDetn64RdrDetnRngV : 292|13@0+ (0.02,-80.0) [-80.0|80.0] "m/s" ASDM,PAS
 SG_ FrntSideRdrLeDetn64RdrDetnSts : 251|2@0+ (1,0) [0|3] "" ASDM,PAS
 SG_ FrntSideRdrLeDetn65_UB : 394|1@0+ (1,0) [0|1] "" ASDM,PAS
 SG_ FrntSideRdrLeDetn65RdrDetnAzi : 367|11@0+ (0.1,-90.0) [-90.0|90.0] "Deg" ASDM,PAS
 SG_ FrntSideRdrLeDetn65RdrDetnChks : 327|8@0+ (1.0,0.0) [0.0|255.0] "Unitless" ASDM,PAS
 SG_ FrntSideRdrLeDetn65RdrDetnCntr : 335|4@0+ (1.0,0.0) [0.0|15.0] "Unitless" ASDM,PAS
 SG_ FrntSideRdrLeDetn65RdrDetnConf : 391|7@0+ (1.0,0.0) [0.0|100.0] "%" ASDM,PAS
 SG_ FrntSideRdrLeDetn65RdrDetnElevn : 399|5@0+ (1.0,-15.0) [-15.0|15.0] "Deg" ASDM,PAS
 SG_ FrntSideRdrLeDetn65RdrDetnPwr : 329|9@0+ (0.1,0.0) [0.0|51.1] "dB" ASDM,PAS
 SG_ FrntSideRdrLeDetn65RdrDetnRng : 351|14@0+ (0.02,-1.0) [-1.0|200.0] "m" ASDM,PAS
 SG_ FrntSideRdrLeDetn65RdrDetnRngV : 372|13@0+ (0.02,-80.0) [-80.0|80.0] "m/s" ASDM,PAS
 SG_ FrntSideRdrLeDetn65RdrDetnSts : 331|2@0+ (1,0) [0|3] "" ASDM,PAS
 SG_ FrntSideRdrLeDetn66_UB : 474|1@0+ (1,0) [0|1] "" ASDM,PAS
 SG_ FrntSideRdrLeDetn66RdrDetnAzi : 447|11@0+ (0.1,-90.0) [-90.0|90.0] "Deg" ASDM,PAS
 SG_ FrntSideRdrLeDetn66RdrDetnChks : 407|8@0+ (1.0,0.0) [0.0|255.0] "Unitless" ASDM,PAS
 SG_ FrntSideRdrLeDetn66RdrDetnCntr : 415|4@0+ (1.0,0.0) [0.0|15.0] "Unitless" ASDM,PAS
 SG_ FrntSideRdrLeDetn66RdrDetnConf : 471|7@0+ (1.0,0.0) [0.0|100.0] "%" ASDM,PAS
 SG_ FrntSideRdrLeDetn66RdrDetnElevn : 479|5@0+ (1.0,-15.0) [-15.0|15.0] "Deg" ASDM,PAS
 SG_ FrntSideRdrLeDetn66RdrDetnPwr : 409|9@0+ (0.1,0.0) [0.0|51.1] "dB" ASDM,PAS
 SG_ FrntSideRdrLeDetn66RdrDetnRng : 431|14@0+ (0.02,-1.0) [-1.0|200.0] "m" ASDM,PAS
 SG_ FrntSideRdrLeDetn66RdrDetnRngV : 452|13@0+ (0.02,-80.0) [-80.0|80.0] "m/s" ASDM,PAS
 SG_ FrntSideRdrLeDetn66RdrDetnSts : 411|2@0+ (1,0) [0|3] "" ASDM,PAS

BO_ 326 FSRLSafetyCANFD1Frame12: 64 FSRL
 SG_ FrntSideRdrLeDetn67_UB : 74|1@0+ (1,0) [0|1] "" ASDM,PAS
 SG_ FrntSideRdrLeDetn67RdrDetnAzi : 31|11@0+ (0.1,-90.0) [-90.0|90.0] "Deg" ASDM,PAS
 SG_ FrntSideRdrLeDetn67RdrDetnChks : 7|8@0+ (1.0,0.0) [0.0|255.0] "Unitless" ASDM,PAS
 SG_ FrntSideRdrLeDetn67RdrDetnCntr : 15|4@0+ (1.0,0.0) [0.0|15.0] "Unitless" ASDM,PAS
 SG_ FrntSideRdrLeDetn67RdrDetnConf : 71|7@0+ (1.0,0.0) [0.0|100.0] "%" ASDM,PAS
 SG_ FrntSideRdrLeDetn67RdrDetnElevn : 79|5@0+ (1.0,-15.0) [-15.0|15.0] "Deg" ASDM,PAS
 SG_ FrntSideRdrLeDetn67RdrDetnPwr : 8|9@0+ (0.1,0.0) [0.0|51.1] "dB" ASDM,PAS
 SG_ FrntSideRdrLeDetn67RdrDetnRng : 55|14@0+ (0.02,-1.0) [-1.0|200.0] "m" ASDM,PAS
 SG_ FrntSideRdrLeDetn67RdrDetnRngV : 36|13@0+ (0.02,-80.0) [-80.0|80.0] "m/s" ASDM,PAS
 SG_ FrntSideRdrLeDetn67RdrDetnSts : 11|2@0+ (1,0) [0|3] "" ASDM,PAS
 SG_ FrntSideRdrLeDetn68_UB : 154|1@0+ (1,0) [0|1] "" ASDM,PAS
 SG_ FrntSideRdrLeDetn68RdrDetnAzi : 119|11@0+ (0.1,-90.0) [-90.0|90.0] "Deg" ASDM,PAS
 SG_ FrntSideRdrLeDetn68RdrDetnChks : 87|8@0+ (1.0,0.0) [0.0|255.0] "Unitless" ASDM,PAS
 SG_ FrntSideRdrLeDetn68RdrDetnCntr : 95|4@0+ (1.0,0.0) [0.0|15.0] "Unitless" ASDM,PAS
 SG_ FrntSideRdrLeDetn68RdrDetnConf : 111|7@0+ (1.0,0.0) [0.0|100.0] "%" ASDM,PAS
 SG_ FrntSideRdrLeDetn68RdrDetnElevn : 159|5@0+ (1.0,-15.0) [-15.0|15.0] "Deg" ASDM,PAS
 SG_ FrntSideRdrLeDetn68RdrDetnPwr : 89|9@0+ (0.1,0.0) [0.0|51.1] "dB" ASDM,PAS
 SG_ FrntSideRdrLeDetn68RdrDetnRng : 143|14@0+ (0.02,-1.0) [-1.0|200.0] "m" ASDM,PAS
 SG_ FrntSideRdrLeDetn68RdrDetnRngV : 124|13@0+ (0.02,-80.0) [-80.0|80.0] "m/s" ASDM,PAS
 SG_ FrntSideRdrLeDetn68RdrDetnSts : 91|2@0+ (1,0) [0|3] "" ASDM,PAS
 SG_ FrntSideRdrLeDetn69_UB : 234|1@0+ (1,0) [0|1] "" ASDM,PAS
 SG_ FrntSideRdrLeDetn69RdrDetnAzi : 199|11@0+ (0.1,-90.0) [-90.0|90.0] "Deg" ASDM,PAS
 SG_ FrntSideRdrLeDetn69RdrDetnChks : 167|8@0+ (1.0,0.0) [0.0|255.0] "Unitless" ASDM,PAS
 SG_ FrntSideRdrLeDetn69RdrDetnCntr : 175|4@0+ (1.0,0.0) [0.0|15.0] "Unitless" ASDM,PAS
 SG_ FrntSideRdrLeDetn69RdrDetnConf : 191|7@0+ (1.0,0.0) [0.0|100.0] "%" ASDM,PAS
 SG_ FrntSideRdrLeDetn69RdrDetnElevn : 239|5@0+ (1.0,-15.0) [-15.0|15.0] "Deg" ASDM,PAS
 SG_ FrntSideRdrLeDetn69RdrDetnPwr : 169|9@0+ (0.1,0.0) [0.0|51.1] "dB" ASDM,PAS
 SG_ FrntSideRdrLeDetn69RdrDetnRng : 223|14@0+ (0.02,-1.0) [-1.0|200.0] "m" ASDM,PAS
 SG_ FrntSideRdrLeDetn69RdrDetnRngV : 204|13@0+ (0.02,-80.0) [-80.0|80.0] "m/s" ASDM,PAS
 SG_ FrntSideRdrLeDetn69RdrDetnSts : 171|2@0+ (1,0) [0|3] "" ASDM,PAS
 SG_ FrntSideRdrLeDetn70_UB : 314|1@0+ (1,0) [0|1] "" ASDM,PAS
 SG_ FrntSideRdrLeDetn70RdrDetnAzi : 287|11@0+ (0.1,-90.0) [-90.0|90.0] "Deg" ASDM,PAS
 SG_ FrntSideRdrLeDetn70RdrDetnChks : 247|8@0+ (1.0,0.0) [0.0|255.0] "Unitless" ASDM,PAS
 SG_ FrntSideRdrLeDetn70RdrDetnCntr : 255|4@0+ (1.0,0.0) [0.0|15.0] "Unitless" ASDM,PAS
 SG_ FrntSideRdrLeDetn70RdrDetnConf : 311|7@0+ (1.0,0.0) [0.0|100.0] "%" ASDM,PAS
 SG_ FrntSideRdrLeDetn70RdrDetnElevn : 319|5@0+ (1.0,-15.0) [-15.0|15.0] "Deg" ASDM,PAS
 SG_ FrntSideRdrLeDetn70RdrDetnPwr : 249|9@0+ (0.1,0.0) [0.0|51.1] "dB" ASDM,PAS
 SG_ FrntSideRdrLeDetn70RdrDetnRng : 271|14@0+ (0.02,-1.0) [-1.0|200.0] "m" ASDM,PAS
 SG_ FrntSideRdrLeDetn70RdrDetnRngV : 292|13@0+ (0.02,-80.0) [-80.0|80.0] "m/s" ASDM,PAS
 SG_ FrntSideRdrLeDetn70RdrDetnSts : 251|2@0+ (1,0) [0|3] "" ASDM,PAS
 SG_ FrntSideRdrLeDetn71_UB : 394|1@0+ (1,0) [0|1] "" ASDM,PAS
 SG_ FrntSideRdrLeDetn71RdrDetnAzi : 367|11@0+ (0.1,-90.0) [-90.0|90.0] "Deg" ASDM,PAS
 SG_ FrntSideRdrLeDetn71RdrDetnChks : 327|8@0+ (1.0,0.0) [0.0|255.0] "Unitless" ASDM,PAS
 SG_ FrntSideRdrLeDetn71RdrDetnCntr : 335|4@0+ (1.0,0.0) [0.0|15.0] "Unitless" ASDM,PAS
 SG_ FrntSideRdrLeDetn71RdrDetnConf : 391|7@0+ (1.0,0.0) [0.0|100.0] "%" ASDM,PAS
 SG_ FrntSideRdrLeDetn71RdrDetnElevn : 399|5@0+ (1.0,-15.0) [-15.0|15.0] "Deg" ASDM,PAS
 SG_ FrntSideRdrLeDetn71RdrDetnPwr : 329|9@0+ (0.1,0.0) [0.0|51.1] "dB" ASDM,PAS
 SG_ FrntSideRdrLeDetn71RdrDetnRng : 351|14@0+ (0.02,-1.0) [-1.0|200.0] "m" ASDM,PAS
 SG_ FrntSideRdrLeDetn71RdrDetnRngV : 372|13@0+ (0.02,-80.0) [-80.0|80.0] "m/s" ASDM,PAS
 SG_ FrntSideRdrLeDetn71RdrDetnSts : 331|2@0+ (1,0) [0|3] "" ASDM,PAS
 SG_ FrntSideRdrLeDetn72_UB : 474|1@0+ (1,0) [0|1] "" ASDM,PAS
 SG_ FrntSideRdrLeDetn72RdrDetnAzi : 447|11@0+ (0.1,-90.0) [-90.0|90.0] "Deg" ASDM,PAS
 SG_ FrntSideRdrLeDetn72RdrDetnChks : 407|8@0+ (1.0,0.0) [0.0|255.0] "Unitless" ASDM,PAS
 SG_ FrntSideRdrLeDetn72RdrDetnCntr : 415|4@0+ (1.0,0.0) [0.0|15.0] "Unitless" ASDM,PAS
 SG_ FrntSideRdrLeDetn72RdrDetnConf : 471|7@0+ (1.0,0.0) [0.0|100.0] "%" ASDM,PAS
 SG_ FrntSideRdrLeDetn72RdrDetnElevn : 479|5@0+ (1.0,-15.0) [-15.0|15.0] "Deg" ASDM,PAS
 SG_ FrntSideRdrLeDetn72RdrDetnPwr : 409|9@0+ (0.1,0.0) [0.0|51.1] "dB" ASDM,PAS
 SG_ FrntSideRdrLeDetn72RdrDetnRng : 431|14@0+ (0.02,-1.0) [-1.0|200.0] "m" ASDM,PAS
 SG_ FrntSideRdrLeDetn72RdrDetnRngV : 452|13@0+ (0.02,-80.0) [-80.0|80.0] "m/s" ASDM,PAS
 SG_ FrntSideRdrLeDetn72RdrDetnSts : 411|2@0+ (1,0) [0|3] "" ASDM,PAS

BO_ 328 FSRLSafetyCANFD1Frame13: 64 FSRL
 SG_ FrntSideRdrLeDetn73_UB : 74|1@0+ (1,0) [0|1] "" ASDM,PAS
 SG_ FrntSideRdrLeDetn73RdrDetnAzi : 31|11@0+ (0.1,-90.0) [-90.0|90.0] "Deg" ASDM,PAS
 SG_ FrntSideRdrLeDetn73RdrDetnChks : 7|8@0+ (1.0,0.0) [0.0|255.0] "Unitless" ASDM,PAS
 SG_ FrntSideRdrLeDetn73RdrDetnCntr : 15|4@0+ (1.0,0.0) [0.0|15.0] "Unitless" ASDM,PAS
 SG_ FrntSideRdrLeDetn73RdrDetnConf : 71|7@0+ (1.0,0.0) [0.0|100.0] "%" ASDM,PAS
 SG_ FrntSideRdrLeDetn73RdrDetnElevn : 79|5@0+ (1.0,-15.0) [-15.0|15.0] "Deg" ASDM,PAS
 SG_ FrntSideRdrLeDetn73RdrDetnPwr : 8|9@0+ (0.1,0.0) [0.0|51.1] "dB" ASDM,PAS
 SG_ FrntSideRdrLeDetn73RdrDetnRng : 55|14@0+ (0.02,-1.0) [-1.0|200.0] "m" ASDM,PAS
 SG_ FrntSideRdrLeDetn73RdrDetnRngV : 36|13@0+ (0.02,-80.0) [-80.0|80.0] "m/s" ASDM,PAS
 SG_ FrntSideRdrLeDetn73RdrDetnSts : 11|2@0+ (1,0) [0|3] "" ASDM,PAS
 SG_ FrntSideRdrLeDetn74_UB : 154|1@0+ (1,0) [0|1] "" ASDM,PAS
 SG_ FrntSideRdrLeDetn74RdrDetnAzi : 119|11@0+ (0.1,-90.0) [-90.0|90.0] "Deg" ASDM,PAS
 SG_ FrntSideRdrLeDetn74RdrDetnChks : 87|8@0+ (1.0,0.0) [0.0|255.0] "Unitless" ASDM,PAS
 SG_ FrntSideRdrLeDetn74RdrDetnCntr : 95|4@0+ (1.0,0.0) [0.0|15.0] "Unitless" ASDM,PAS
 SG_ FrntSideRdrLeDetn74RdrDetnConf : 111|7@0+ (1.0,0.0) [0.0|100.0] "%" ASDM,PAS
 SG_ FrntSideRdrLeDetn74RdrDetnElevn : 159|5@0+ (1.0,-15.0) [-15.0|15.0] "Deg" ASDM,PAS
 SG_ FrntSideRdrLeDetn74RdrDetnPwr : 89|9@0+ (0.1,0.0) [0.0|51.1] "dB" ASDM,PAS
 SG_ FrntSideRdrLeDetn74RdrDetnRng : 143|14@0+ (0.02,-1.0) [-1.0|200.0] "m" ASDM,PAS
 SG_ FrntSideRdrLeDetn74RdrDetnRngV : 124|13@0+ (0.02,-80.0) [-80.0|80.0] "m/s" ASDM,PAS
 SG_ FrntSideRdrLeDetn74RdrDetnSts : 91|2@0+ (1,0) [0|3] "" ASDM,PAS
 SG_ FrntSideRdrLeDetn75_UB : 234|1@0+ (1,0) [0|1] "" ASDM,PAS
 SG_ FrntSideRdrLeDetn75RdrDetnAzi : 199|11@0+ (0.1,-90.0) [-90.0|90.0] "Deg" ASDM,PAS
 SG_ FrntSideRdrLeDetn75RdrDetnChks : 167|8@0+ (1.0,0.0) [0.0|255.0] "Unitless" ASDM,PAS
 SG_ FrntSideRdrLeDetn75RdrDetnCntr : 175|4@0+ (1.0,0.0) [0.0|15.0] "Unitless" ASDM,PAS
 SG_ FrntSideRdrLeDetn75RdrDetnConf : 191|7@0+ (1.0,0.0) [0.0|100.0] "%" ASDM,PAS
 SG_ FrntSideRdrLeDetn75RdrDetnElevn : 239|5@0+ (1.0,-15.0) [-15.0|15.0] "Deg" ASDM,PAS
 SG_ FrntSideRdrLeDetn75RdrDetnPwr : 169|9@0+ (0.1,0.0) [0.0|51.1] "dB" ASDM,PAS
 SG_ FrntSideRdrLeDetn75RdrDetnRng : 223|14@0+ (0.02,-1.0) [-1.0|200.0] "m" ASDM,PAS
 SG_ FrntSideRdrLeDetn75RdrDetnRngV : 204|13@0+ (0.02,-80.0) [-80.0|80.0] "m/s" ASDM,PAS
 SG_ FrntSideRdrLeDetn75RdrDetnSts : 171|2@0+ (1,0) [0|3] "" ASDM,PAS
 SG_ FrntSideRdrLeDetn76_UB : 314|1@0+ (1,0) [0|1] "" ASDM,PAS
 SG_ FrntSideRdrLeDetn76RdrDetnAzi : 287|11@0+ (0.1,-90.0) [-90.0|90.0] "Deg" ASDM,PAS
 SG_ FrntSideRdrLeDetn76RdrDetnChks : 247|8@0+ (1.0,0.0) [0.0|255.0] "Unitless" ASDM,PAS
 SG_ FrntSideRdrLeDetn76RdrDetnCntr : 255|4@0+ (1.0,0.0) [0.0|15.0] "Unitless" ASDM,PAS
 SG_ FrntSideRdrLeDetn76RdrDetnConf : 311|7@0+ (1.0,0.0) [0.0|100.0] "%" ASDM,PAS
 SG_ FrntSideRdrLeDetn76RdrDetnElevn : 319|5@0+ (1.0,-15.0) [-15.0|15.0] "Deg" ASDM,PAS
 SG_ FrntSideRdrLeDetn76RdrDetnPwr : 249|9@0+ (0.1,0.0) [0.0|51.1] "dB" ASDM,PAS
 SG_ FrntSideRdrLeDetn76RdrDetnRng : 271|14@0+ (0.02,-1.0) [-1.0|200.0] "m" ASDM,PAS
 SG_ FrntSideRdrLeDetn76RdrDetnRngV : 292|13@0+ (0.02,-80.0) [-80.0|80.0] "m/s" ASDM,PAS
 SG_ FrntSideRdrLeDetn76RdrDetnSts : 251|2@0+ (1,0) [0|3] "" ASDM,PAS
 SG_ FrntSideRdrLeDetn77_UB : 394|1@0+ (1,0) [0|1] "" ASDM,PAS
 SG_ FrntSideRdrLeDetn77RdrDetnAzi : 367|11@0+ (0.1,-90.0) [-90.0|90.0] "Deg" ASDM,PAS
 SG_ FrntSideRdrLeDetn77RdrDetnChks : 327|8@0+ (1.0,0.0) [0.0|255.0] "Unitless" ASDM,PAS
 SG_ FrntSideRdrLeDetn77RdrDetnCntr : 335|4@0+ (1.0,0.0) [0.0|15.0] "Unitless" ASDM,PAS
 SG_ FrntSideRdrLeDetn77RdrDetnConf : 391|7@0+ (1.0,0.0) [0.0|100.0] "%" ASDM,PAS
 SG_ FrntSideRdrLeDetn77RdrDetnElevn : 399|5@0+ (1.0,-15.0) [-15.0|15.0] "Deg" ASDM,PAS
 SG_ FrntSideRdrLeDetn77RdrDetnPwr : 329|9@0+ (0.1,0.0) [0.0|51.1] "dB" ASDM,PAS
 SG_ FrntSideRdrLeDetn77RdrDetnRng : 351|14@0+ (0.02,-1.0) [-1.0|200.0] "m" ASDM,PAS
 SG_ FrntSideRdrLeDetn77RdrDetnRngV : 372|13@0+ (0.02,-80.0) [-80.0|80.0] "m/s" ASDM,PAS
 SG_ FrntSideRdrLeDetn77RdrDetnSts : 331|2@0+ (1,0) [0|3] "" ASDM,PAS
 SG_ FrntSideRdrLeDetn78_UB : 474|1@0+ (1,0) [0|1] "" ASDM,PAS
 SG_ FrntSideRdrLeDetn78RdrDetnAzi : 447|11@0+ (0.1,-90.0) [-90.0|90.0] "Deg" ASDM,PAS
 SG_ FrntSideRdrLeDetn78RdrDetnChks : 407|8@0+ (1.0,0.0) [0.0|255.0] "Unitless" ASDM,PAS
 SG_ FrntSideRdrLeDetn78RdrDetnCntr : 415|4@0+ (1.0,0.0) [0.0|15.0] "Unitless" ASDM,PAS
 SG_ FrntSideRdrLeDetn78RdrDetnConf : 471|7@0+ (1.0,0.0) [0.0|100.0] "%" ASDM,PAS
 SG_ FrntSideRdrLeDetn78RdrDetnElevn : 479|5@0+ (1.0,-15.0) [-15.0|15.0] "Deg" ASDM,PAS
 SG_ FrntSideRdrLeDetn78RdrDetnPwr : 409|9@0+ (0.1,0.0) [0.0|51.1] "dB" ASDM,PAS
 SG_ FrntSideRdrLeDetn78RdrDetnRng : 431|14@0+ (0.02,-1.0) [-1.0|200.0] "m" ASDM,PAS
 SG_ FrntSideRdrLeDetn78RdrDetnRngV : 452|13@0+ (0.02,-80.0) [-80.0|80.0] "m/s" ASDM,PAS
 SG_ FrntSideRdrLeDetn78RdrDetnSts : 411|2@0+ (1,0) [0|3] "" ASDM,PAS

BO_ 330 FSRLSafetyCANFD1Frame14: 64 FSRL
 SG_ FrntSideRdrLeDetn79_UB : 74|1@0+ (1,0) [0|1] "" ASDM,PAS
 SG_ FrntSideRdrLeDetn79RdrDetnAzi : 31|11@0+ (0.1,-90.0) [-90.0|90.0] "Deg" ASDM,PAS
 SG_ FrntSideRdrLeDetn79RdrDetnChks : 7|8@0+ (1.0,0.0) [0.0|255.0] "Unitless" ASDM,PAS
 SG_ FrntSideRdrLeDetn79RdrDetnCntr : 15|4@0+ (1.0,0.0) [0.0|15.0] "Unitless" ASDM,PAS
 SG_ FrntSideRdrLeDetn79RdrDetnConf : 71|7@0+ (1.0,0.0) [0.0|100.0] "%" ASDM,PAS
 SG_ FrntSideRdrLeDetn79RdrDetnElevn : 79|5@0+ (1.0,-15.0) [-15.0|15.0] "Deg" ASDM,PAS
 SG_ FrntSideRdrLeDetn79RdrDetnPwr : 8|9@0+ (0.1,0.0) [0.0|51.1] "dB" ASDM,PAS
 SG_ FrntSideRdrLeDetn79RdrDetnRng : 55|14@0+ (0.02,-1.0) [-1.0|200.0] "m" ASDM,PAS
 SG_ FrntSideRdrLeDetn79RdrDetnRngV : 36|13@0+ (0.02,-80.0) [-80.0|80.0] "m/s" ASDM,PAS
 SG_ FrntSideRdrLeDetn79RdrDetnSts : 11|2@0+ (1,0) [0|3] "" ASDM,PAS
 SG_ FrntSideRdrLeDetn80_UB : 154|1@0+ (1,0) [0|1] "" ASDM,PAS
 SG_ FrntSideRdrLeDetn80RdrDetnAzi : 119|11@0+ (0.1,-90.0) [-90.0|90.0] "Deg" ASDM,PAS
 SG_ FrntSideRdrLeDetn80RdrDetnChks : 87|8@0+ (1.0,0.0) [0.0|255.0] "Unitless" ASDM,PAS
 SG_ FrntSideRdrLeDetn80RdrDetnCntr : 95|4@0+ (1.0,0.0) [0.0|15.0] "Unitless" ASDM,PAS
 SG_ FrntSideRdrLeDetn80RdrDetnConf : 111|7@0+ (1.0,0.0) [0.0|100.0] "%" ASDM,PAS
 SG_ FrntSideRdrLeDetn80RdrDetnElevn : 159|5@0+ (1.0,-15.0) [-15.0|15.0] "Deg" ASDM,PAS
 SG_ FrntSideRdrLeDetn80RdrDetnPwr : 89|9@0+ (0.1,0.0) [0.0|51.1] "dB" ASDM,PAS
 SG_ FrntSideRdrLeDetn80RdrDetnRng : 143|14@0+ (0.02,-1.0) [-1.0|200.0] "m" ASDM,PAS
 SG_ FrntSideRdrLeDetn80RdrDetnRngV : 124|13@0+ (0.02,-80.0) [-80.0|80.0] "m/s" ASDM,PAS
 SG_ FrntSideRdrLeDetn80RdrDetnSts : 91|2@0+ (1,0) [0|3] "" ASDM,PAS
 SG_ FrntSideRdrLeDetn81_UB : 234|1@0+ (1,0) [0|1] "" ASDM,PAS
 SG_ FrntSideRdrLeDetn81RdrDetnAzi : 199|11@0+ (0.1,-90.0) [-90.0|90.0] "Deg" ASDM,PAS
 SG_ FrntSideRdrLeDetn81RdrDetnChks : 167|8@0+ (1.0,0.0) [0.0|255.0] "Unitless" ASDM,PAS
 SG_ FrntSideRdrLeDetn81RdrDetnCntr : 175|4@0+ (1.0,0.0) [0.0|15.0] "Unitless" ASDM,PAS
 SG_ FrntSideRdrLeDetn81RdrDetnConf : 191|7@0+ (1.0,0.0) [0.0|100.0] "%" ASDM,PAS
 SG_ FrntSideRdrLeDetn81RdrDetnElevn : 239|5@0+ (1.0,-15.0) [-15.0|15.0] "Deg" ASDM,PAS
 SG_ FrntSideRdrLeDetn81RdrDetnPwr : 169|9@0+ (0.1,0.0) [0.0|51.1] "dB" ASDM,PAS
 SG_ FrntSideRdrLeDetn81RdrDetnRng : 223|14@0+ (0.02,-1.0) [-1.0|200.0] "m" ASDM,PAS
 SG_ FrntSideRdrLeDetn81RdrDetnRngV : 204|13@0+ (0.02,-80.0) [-80.0|80.0] "m/s" ASDM,PAS
 SG_ FrntSideRdrLeDetn81RdrDetnSts : 171|2@0+ (1,0) [0|3] "" ASDM,PAS
 SG_ FrntSideRdrLeDetn82_UB : 314|1@0+ (1,0) [0|1] "" ASDM,PAS
 SG_ FrntSideRdrLeDetn82RdrDetnAzi : 287|11@0+ (0.1,-90.0) [-90.0|90.0] "Deg" ASDM,PAS
 SG_ FrntSideRdrLeDetn82RdrDetnChks : 247|8@0+ (1.0,0.0) [0.0|255.0] "Unitless" ASDM,PAS
 SG_ FrntSideRdrLeDetn82RdrDetnCntr : 255|4@0+ (1.0,0.0) [0.0|15.0] "Unitless" ASDM,PAS
 SG_ FrntSideRdrLeDetn82RdrDetnConf : 311|7@0+ (1.0,0.0) [0.0|100.0] "%" ASDM,PAS
 SG_ FrntSideRdrLeDetn82RdrDetnElevn : 319|5@0+ (1.0,-15.0) [-15.0|15.0] "Deg" ASDM,PAS
 SG_ FrntSideRdrLeDetn82RdrDetnPwr : 249|9@0+ (0.1,0.0) [0.0|51.1] "dB" ASDM,PAS
 SG_ FrntSideRdrLeDetn82RdrDetnRng : 271|14@0+ (0.02,-1.0) [-1.0|200.0] "m" ASDM,PAS
 SG_ FrntSideRdrLeDetn82RdrDetnRngV : 292|13@0+ (0.02,-80.0) [-80.0|80.0] "m/s" ASDM,PAS
 SG_ FrntSideRdrLeDetn82RdrDetnSts : 251|2@0+ (1,0) [0|3] "" ASDM,PAS
 SG_ FrntSideRdrLeDetn83_UB : 394|1@0+ (1,0) [0|1] "" ASDM,PAS
 SG_ FrntSideRdrLeDetn83RdrDetnAzi : 367|11@0+ (0.1,-90.0) [-90.0|90.0] "Deg" ASDM,PAS
 SG_ FrntSideRdrLeDetn83RdrDetnChks : 327|8@0+ (1.0,0.0) [0.0|255.0] "Unitless" ASDM,PAS
 SG_ FrntSideRdrLeDetn83RdrDetnCntr : 335|4@0+ (1.0,0.0) [0.0|15.0] "Unitless" ASDM,PAS
 SG_ FrntSideRdrLeDetn83RdrDetnConf : 391|7@0+ (1.0,0.0) [0.0|100.0] "%" ASDM,PAS
 SG_ FrntSideRdrLeDetn83RdrDetnElevn : 399|5@0+ (1.0,-15.0) [-15.0|15.0] "Deg" ASDM,PAS
 SG_ FrntSideRdrLeDetn83RdrDetnPwr : 329|9@0+ (0.1,0.0) [0.0|51.1] "dB" ASDM,PAS
 SG_ FrntSideRdrLeDetn83RdrDetnRng : 351|14@0+ (0.02,-1.0) [-1.0|200.0] "m" ASDM,PAS
 SG_ FrntSideRdrLeDetn83RdrDetnRngV : 372|13@0+ (0.02,-80.0) [-80.0|80.0] "m/s" ASDM,PAS
 SG_ FrntSideRdrLeDetn83RdrDetnSts : 331|2@0+ (1,0) [0|3] "" ASDM,PAS
 SG_ FrntSideRdrLeDetn84_UB : 474|1@0+ (1,0) [0|1] "" ASDM,PAS
 SG_ FrntSideRdrLeDetn84RdrDetnAzi : 447|11@0+ (0.1,-90.0) [-90.0|90.0] "Deg" ASDM,PAS
 SG_ FrntSideRdrLeDetn84RdrDetnChks : 407|8@0+ (1.0,0.0) [0.0|255.0] "Unitless" ASDM,PAS
 SG_ FrntSideRdrLeDetn84RdrDetnCntr : 415|4@0+ (1.0,0.0) [0.0|15.0] "Unitless" ASDM,PAS
 SG_ FrntSideRdrLeDetn84RdrDetnConf : 471|7@0+ (1.0,0.0) [0.0|100.0] "%" ASDM,PAS
 SG_ FrntSideRdrLeDetn84RdrDetnElevn : 479|5@0+ (1.0,-15.0) [-15.0|15.0] "Deg" ASDM,PAS
 SG_ FrntSideRdrLeDetn84RdrDetnPwr : 409|9@0+ (0.1,0.0) [0.0|51.1] "dB" ASDM,PAS
 SG_ FrntSideRdrLeDetn84RdrDetnRng : 431|14@0+ (0.02,-1.0) [-1.0|200.0] "m" ASDM,PAS
 SG_ FrntSideRdrLeDetn84RdrDetnRngV : 452|13@0+ (0.02,-80.0) [-80.0|80.0] "m/s" ASDM,PAS
 SG_ FrntSideRdrLeDetn84RdrDetnSts : 411|2@0+ (1,0) [0|3] "" ASDM,PAS

CM_ SG_ 316 FrntSideRdrLeDetn37RdrDetnAzi "Refer to the data element description in FrntSideRdrLeDetn1 with the same data element name.";
CM_ SG_ 316 FrntSideRdrLeDetn37RdrDetnChks "Refer to the data element description in FrntSideRdrLeDetn1 with the same data element name.";
CM_ SG_ 316 FrntSideRdrLeDetn37RdrDetnCntr "Refer to the data element description in FrntSideRdrLeDetn1 with the same data element name.";
CM_ SG_ 316 FrntSideRdrLeDetn37RdrDetnConf "Refer to the data element description in FrntSideRdrLeDetn1 with the same data element name.";
CM_ SG_ 316 FrntSideRdrLeDetn37RdrDetnElevn "Refer to the data element description in FrntSideRdrLeDetn1 with the same data element name.";
CM_ SG_ 316 FrntSideRdrLeDetn37RdrDetnPwr "Refer to the data element description in FrntSideRdrLeDetn1 with the same data element name.";
CM_ SG_ 316 FrntSideRdrLeDetn37RdrDetnRng "Refer to the data element description in FrntSideRdrLeDetn1 with the same data element name.";
CM_ SG_ 316 FrntSideRdrLeDetn37RdrDetnRngV "Range velocity ";
CM_ SG_ 316 FrntSideRdrLeDetn37RdrDetnSts "Refer to the data element description in FrntSideRdrLeDetn1 with the same data element name.";
CM_ SG_ 316 FrntSideRdrLeDetn38RdrDetnAzi "Refer to the data element description in FrntSideRdrLeDetn1 with the same data element name.";
CM_ SG_ 316 FrntSideRdrLeDetn38RdrDetnChks "Refer to the data element description in FrntSideRdrLeDetn1 with the same data element name.";
CM_ SG_ 316 FrntSideRdrLeDetn38RdrDetnCntr "Refer to the data element description in FrntSideRdrLeDetn1 with the same data element name.";
CM_ SG_ 316 FrntSideRdrLeDetn38RdrDetnConf "Refer to the data element description in FrntSideRdrLeDetn1 with the same data element name.";
CM_ SG_ 316 FrntSideRdrLeDetn38RdrDetnElevn "Refer to the data element description in FrntSideRdrLeDetn1 with the same data element name.";
CM_ SG_ 316 FrntSideRdrLeDetn38RdrDetnPwr "Refer to the data element description in FrntSideRdrLeDetn1 with the same data element name.";
CM_ SG_ 316 FrntSideRdrLeDetn38RdrDetnRng "Refer to the data element description in FrntSideRdrLeDetn1 with the same data element name.";
CM_ SG_ 316 FrntSideRdrLeDetn38RdrDetnRngV "Range velocity ";
CM_ SG_ 316 FrntSideRdrLeDetn38RdrDetnSts "Refer to the data element description in FrntSideRdrLeDetn1 with the same data element name.";
CM_ SG_ 316 FrntSideRdrLeDetn39RdrDetnAzi "Refer to the data element description in FrntSideRdrLeDetn1 with the same data element name.";
CM_ SG_ 316 FrntSideRdrLeDetn39RdrDetnChks "Refer to the data element description in FrntSideRdrLeDetn1 with the same data element name.";
CM_ SG_ 316 FrntSideRdrLeDetn39RdrDetnCntr "Refer to the data element description in FrntSideRdrLeDetn1 with the same data element name.";
CM_ SG_ 316 FrntSideRdrLeDetn39RdrDetnConf "Refer to the data element description in FrntSideRdrLeDetn1 with the same data element name.";
CM_ SG_ 316 FrntSideRdrLeDetn39RdrDetnElevn "Refer to the data element description in FrntSideRdrLeDetn1 with the same data element name.";
CM_ SG_ 316 FrntSideRdrLeDetn39RdrDetnPwr "Refer to the data element description in FrntSideRdrLeDetn1 with the same data element name.";
CM_ SG_ 316 FrntSideRdrLeDetn39RdrDetnRng "Refer to the data element description in FrntSideRdrLeDetn1 with the same data element name.";
CM_ SG_ 316 FrntSideRdrLeDetn39RdrDetnRngV "Range velocity";
CM_ SG_ 316 FrntSideRdrLeDetn39RdrDetnSts "Refer to the data element description in FrntSideRdrLeDetn1 with the same data element name.";
CM_ SG_ 316 FrntSideRdrLeDetn40RdrDetnAzi "Refer to the data element description in FrntSideRdrLeDetn1 with the same data element name.";
CM_ SG_ 316 FrntSideRdrLeDetn40RdrDetnChks "Refer to the data element description in FrntSideRdrLeDetn1 with the same data element name.";
CM_ SG_ 316 FrntSideRdrLeDetn40RdrDetnCntr "Refer to the data element description in FrntSideRdrLeDetn1 with the same data element name.";
CM_ SG_ 316 FrntSideRdrLeDetn40RdrDetnConf "Refer to the data element description in FrntSideRdrLeDetn1 with the same data element name.";
CM_ SG_ 316 FrntSideRdrLeDetn40RdrDetnElevn "Refer to the data element description in FrntSideRdrLeDetn1 with the same data element name.";
CM_ SG_ 316 FrntSideRdrLeDetn40RdrDetnPwr "Refer to the data element description in FrntSideRdrLeDetn1 with the same data element name.";
CM_ SG_ 316 FrntSideRdrLeDetn40RdrDetnRng "Refer to the data element description in FrntSideRdrLeDetn1 with the same data element name.";
CM_ SG_ 316 FrntSideRdrLeDetn40RdrDetnRngV "Range velocity ";
CM_ SG_ 316 FrntSideRdrLeDetn40RdrDetnSts "Refer to the data element description in FrntSideRdrLeDetn1 with the same data element name.";
CM_ SG_ 316 FrntSideRdrLeDetn41RdrDetnAzi "Refer to the data element description in FrntSideRdrLeDetn1 with the same data element name.";
CM_ SG_ 316 FrntSideRdrLeDetn41RdrDetnChks "Refer to the data element description in FrntSideRdrLeDetn1 with the same data element name.";
CM_ SG_ 316 FrntSideRdrLeDetn41RdrDetnCntr "Refer to the data element description in FrntSideRdrLeDetn1 with the same data element name.";
CM_ SG_ 316 FrntSideRdrLeDetn41RdrDetnConf "Refer to the data element description in FrntSideRdrLeDetn1 with the same data element name.";
CM_ SG_ 316 FrntSideRdrLeDetn41RdrDetnElevn "Refer to the data element description in FrntSideRdrLeDetn1 with the same data element name.";
CM_ SG_ 316 FrntSideRdrLeDetn41RdrDetnPwr "Refer to the data element description in FrntSideRdrLeDetn1 with the same data element name.";
CM_ SG_ 316 FrntSideRdrLeDetn41RdrDetnRng "Refer to the data element description in FrntSideRdrLeDetn1 with the same data element name.";
CM_ SG_ 316 FrntSideRdrLeDetn41RdrDetnRngV "Range velocity";
CM_ SG_ 316 FrntSideRdrLeDetn41RdrDetnSts "Refer to the data element description in FrntSideRdrLeDetn1 with the same data element name.";
CM_ SG_ 316 FrntSideRdrLeDetn42RdrDetnAzi "Refer to the data element description in FrntSideRdrLeDetn1 with the same data element name.";
CM_ SG_ 316 FrntSideRdrLeDetn42RdrDetnChks "Refer to the data element description in FrntSideRdrLeDetn1 with the same data element name.";
CM_ SG_ 316 FrntSideRdrLeDetn42RdrDetnCntr "Refer to the data element description in FrntSideRdrLeDetn1 with the same data element name.";
CM_ SG_ 316 FrntSideRdrLeDetn42RdrDetnConf "Refer to the data element description in FrntSideRdrLeDetn1 with the same data element name.";
CM_ SG_ 316 FrntSideRdrLeDetn42RdrDetnElevn "Refer to the data element description in FrntSideRdrLeDetn1 with the same data element name.";
CM_ SG_ 316 FrntSideRdrLeDetn42RdrDetnPwr "Refer to the data element description in FrntSideRdrLeDetn1 with the same data element name.";
CM_ SG_ 316 FrntSideRdrLeDetn42RdrDetnRng "Refer to the data element description in FrntSideRdrLeDetn1 with the same data element name.";
CM_ SG_ 316 FrntSideRdrLeDetn42RdrDetnRngV "Range velocity ";
CM_ SG_ 316 FrntSideRdrLeDetn42RdrDetnSts "Refer to the data element description in FrntSideRdrLeDetn1 with the same data element name.";
CM_ SG_ 318 FrntSideRdrLeDetn43RdrDetnAzi "Refer to the data element description in FrntSideRdrLeDetn1 with the same data element name.";
CM_ SG_ 318 FrntSideRdrLeDetn43RdrDetnChks "Refer to the data element description in FrntSideRdrLeDetn1 with the same data element name.";
CM_ SG_ 318 FrntSideRdrLeDetn43RdrDetnCntr "Refer to the data element description in FrntSideRdrLeDetn1 with the same data element name.";
CM_ SG_ 318 FrntSideRdrLeDetn43RdrDetnConf "Refer to the data element description in FrntSideRdrLeDetn1 with the same data element name.";
CM_ SG_ 318 FrntSideRdrLeDetn43RdrDetnElevn "Refer to the data element description in FrntSideRdrLeDetn1 with the same data element name.";
CM_ SG_ 318 FrntSideRdrLeDetn43RdrDetnPwr "Refer to the data element description in FrntSideRdrLeDetn1 with the same data element name.";
CM_ SG_ 318 FrntSideRdrLeDetn43RdrDetnRng "Refer to the data element description in FrntSideRdrLeDetn1 with the same data element name.";
CM_ SG_ 318 FrntSideRdrLeDetn43RdrDetnRngV "Range velocity ";
CM_ SG_ 318 FrntSideRdrLeDetn43RdrDetnSts "Refer to the data element description in FrntSideRdrLeDetn1 with the same data element name.";
CM_ SG_ 318 FrntSideRdrLeDetn44RdrDetnAzi "Refer to the data element description in FrntSideRdrLeDetn1 with the same data element name.";
CM_ SG_ 318 FrntSideRdrLeDetn44RdrDetnChks "Refer to the data element description in FrntSideRdrLeDetn1 with the same data element name.";
CM_ SG_ 318 FrntSideRdrLeDetn44RdrDetnCntr "Refer to the data element description in FrntSideRdrLeDetn1 with the same data element name.";
CM_ SG_ 318 FrntSideRdrLeDetn44RdrDetnConf "Refer to the data element description in FrntSideRdrLeDetn1 with the same data element name.";
CM_ SG_ 318 FrntSideRdrLeDetn44RdrDetnElevn "Refer to the data element description in FrntSideRdrLeDetn1 with the same data element name.";
CM_ SG_ 318 FrntSideRdrLeDetn44RdrDetnPwr "Refer to the data element description in FrntSideRdrLeDetn1 with the same data element name.";
CM_ SG_ 318 FrntSideRdrLeDetn44RdrDetnRng "Refer to the data element description in FrntSideRdrLeDetn1 with the same data element name.";
CM_ SG_ 318 FrntSideRdrLeDetn44RdrDetnRngV "Range velocity ";
CM_ SG_ 318 FrntSideRdrLeDetn44RdrDetnSts "Refer to the data element description in FrntSideRdrLeDetn1 with the same data element name.";
CM_ SG_ 318 FrntSideRdrLeDetn45RdrDetnAzi "Refer to the data element description in FrntSideRdrLeDetn1 with the same data element name.";
CM_ SG_ 318 FrntSideRdrLeDetn45RdrDetnChks "Refer to the data element description in FrntSideRdrLeDetn1 with the same data element name.";
CM_ SG_ 318 FrntSideRdrLeDetn45RdrDetnCntr "Refer to the data element description in FrntSideRdrLeDetn1 with the same data element name.";
CM_ SG_ 318 FrntSideRdrLeDetn45RdrDetnConf "Refer to the data element description in FrntSideRdrLeDetn1 with the same data element name.";
CM_ SG_ 318 FrntSideRdrLeDetn45RdrDetnElevn "Refer to the data element description in FrntSideRdrLeDetn1 with the same data element name.";
CM_ SG_ 318 FrntSideRdrLeDetn45RdrDetnPwr "Refer to the data element description in FrntSideRdrLeDetn1 with the same data element name.";
CM_ SG_ 318 FrntSideRdrLeDetn45RdrDetnRng "Refer to the data element description in FrntSideRdrLeDetn1 with the same data element name.";
CM_ SG_ 318 FrntSideRdrLeDetn45RdrDetnRngV "Range velocity ";
CM_ SG_ 318 FrntSideRdrLeDetn45RdrDetnSts "Refer to the data element description in FrntSideRdrLeDetn1 with the same data element name.";
CM_ SG_ 318 FrntSideRdrLeDetn46RdrDetnAzi "Refer to the data element description in FrntSideRdrLeDetn1 with the same data element name.";
CM_ SG_ 318 FrntSideRdrLeDetn46RdrDetnChks "Refer to the data element description in FrntSideRdrLeDetn1 with the same data element name.";
CM_ SG_ 318 FrntSideRdrLeDetn46RdrDetnCntr "Refer to the data element description in FrntSideRdrLeDetn1 with the same data element name.";
CM_ SG_ 318 FrntSideRdrLeDetn46RdrDetnConf "Refer to the data element description in FrntSideRdrLeDetn1 with the same data element name.";
CM_ SG_ 318 FrntSideRdrLeDetn46RdrDetnElevn "Refer to the data element description in FrntSideRdrLeDetn1 with the same data element name.";
CM_ SG_ 318 FrntSideRdrLeDetn46RdrDetnPwr "Refer to the data element description in FrntSideRdrLeDetn1 with the same data element name.";
CM_ SG_ 318 FrntSideRdrLeDetn46RdrDetnRng "Refer to the data element description in FrntSideRdrLeDetn1 with the same data element name.";
CM_ SG_ 318 FrntSideRdrLeDetn46RdrDetnRngV "Range Velocity";
CM_ SG_ 318 FrntSideRdrLeDetn46RdrDetnSts "Refer to the data element description in FrntSideRdrLeDetn1 with the same data element name.";
CM_ SG_ 318 FrntSideRdrLeDetn47RdrDetnAzi "Refer to the data element description in FrntSideRdrLeDetn1 with the same data element name.";
CM_ SG_ 318 FrntSideRdrLeDetn47RdrDetnChks "Refer to the data element description in FrntSideRdrLeDetn1 with the same data element name.";
CM_ SG_ 318 FrntSideRdrLeDetn47RdrDetnCntr "Refer to the data element description in FrntSideRdrLeDetn1 with the same data element name.";
CM_ SG_ 318 FrntSideRdrLeDetn47RdrDetnConf "Refer to the data element description in FrntSideRdrLeDetn1 with the same data element name.";
CM_ SG_ 318 FrntSideRdrLeDetn47RdrDetnElevn "Refer to the data element description in FrntSideRdrLeDetn1 with the same data element name.";
CM_ SG_ 318 FrntSideRdrLeDetn47RdrDetnPwr "Refer to the data element description in FrntSideRdrLeDetn1 with the same data element name.";
CM_ SG_ 318 FrntSideRdrLeDetn47RdrDetnRng "Refer to the data element description in FrntSideRdrLeDetn1 with the same data element name.";
CM_ SG_ 318 FrntSideRdrLeDetn47RdrDetnRngV "Range Velocity";
CM_ SG_ 318 FrntSideRdrLeDetn47RdrDetnSts "Refer to the data element description in FrntSideRdrLeDetn1 with the same data element name.";
CM_ SG_ 318 FrntSideRdrLeDetn48RdrDetnAzi "Refer to the data element description in FrntSideRdrLeDetn1 with the same data element name.";
CM_ SG_ 318 FrntSideRdrLeDetn48RdrDetnChks "Refer to the data element description in FrntSideRdrLeDetn1 with the same data element name.";
CM_ SG_ 318 FrntSideRdrLeDetn48RdrDetnCntr "Refer to the data element description in FrntSideRdrLeDetn1 with the same data element name.";
CM_ SG_ 318 FrntSideRdrLeDetn48RdrDetnConf "Refer to the data element description in FrntSideRdrLeDetn1 with the same data element name.";
CM_ SG_ 318 FrntSideRdrLeDetn48RdrDetnElevn "Refer to the data element description in FrntSideRdrLeDetn1 with the same data element name.";
CM_ SG_ 318 FrntSideRdrLeDetn48RdrDetnPwr "Refer to the data element description in FrntSideRdrLeDetn1 with the same data element name.";
CM_ SG_ 318 FrntSideRdrLeDetn48RdrDetnRng "Refer to the data element description in FrntSideRdrLeDetn1 with the same data element name.";
CM_ SG_ 318 FrntSideRdrLeDetn48RdrDetnRngV "Range Velocity";
CM_ SG_ 318 FrntSideRdrLeDetn48RdrDetnSts "Refer to the data element description in FrntSideRdrLeDetn1 with the same data element name.";
CM_ SG_ 320 FrntSideRdrLeDetn49RdrDetnAzi "Refer to the data element description in FrntSideRdrLeDetn1 with the same data element name.";
CM_ SG_ 320 FrntSideRdrLeDetn49RdrDetnChks "Refer to the data element description in FrntSideRdrLeDetn1 with the same data element name.";
CM_ SG_ 320 FrntSideRdrLeDetn49RdrDetnCntr "Refer to the data element description in FrntSideRdrLeDetn1 with the same data element name.";
CM_ SG_ 320 FrntSideRdrLeDetn49RdrDetnConf "Refer to the data element description in FrntSideRdrLeDetn1 with the same data element name.";
CM_ SG_ 320 FrntSideRdrLeDetn49RdrDetnElevn "Refer to the data element description in FrntSideRdrLeDetn1 with the same data element name.";
CM_ SG_ 320 FrntSideRdrLeDetn49RdrDetnPwr "Refer to the data element description in FrntSideRdrLeDetn1 with the same data element name.";
CM_ SG_ 320 FrntSideRdrLeDetn49RdrDetnRng "Refer to the data element description in FrntSideRdrLeDetn1 with the same data element name.";
CM_ SG_ 320 FrntSideRdrLeDetn49RdrDetnRngV "Range Velocity";
CM_ SG_ 320 FrntSideRdrLeDetn49RdrDetnSts "Refer to the data element description in FrntSideRdrLeDetn1 with the same data element name.";
CM_ SG_ 320 FrntSideRdrLeDetn50RdrDetnAzi "Refer to the data element description in FrntSideRdrLeDetn1 with the same data element name.";
CM_ SG_ 320 FrntSideRdrLeDetn50RdrDetnChks "Refer to the data element description in FrntSideRdrLeDetn1 with the same data element name.";
CM_ SG_ 320 FrntSideRdrLeDetn50RdrDetnCntr "Refer to the data element description in FrntSideRdrLeDetn1 with the same data element name.";
CM_ SG_ 320 FrntSideRdrLeDetn50RdrDetnConf "Refer to the data element description in FrntSideRdrLeDetn1 with the same data element name.";
CM_ SG_ 320 FrntSideRdrLeDetn50RdrDetnElevn "Refer to the data element description in FrntSideRdrLeDetn1 with the same data element name.";
CM_ SG_ 320 FrntSideRdrLeDetn50RdrDetnPwr "Refer to the data element description in FrntSideRdrLeDetn1 with the same data element name.";
CM_ SG_ 320 FrntSideRdrLeDetn50RdrDetnRng "Refer to the data element description in FrntSideRdrLeDetn1 with the same data element name.";
CM_ SG_ 320 FrntSideRdrLeDetn50RdrDetnRngV "Range Velocity";
CM_ SG_ 320 FrntSideRdrLeDetn50RdrDetnSts "Refer to the data element description in FrntSideRdrLeDetn1 with the same data element name.";
CM_ SG_ 320 FrntSideRdrLeDetn51RdrDetnAzi "Refer to the data element description in FrntSideRdrLeDetn1 with the same data element name.";
CM_ SG_ 320 FrntSideRdrLeDetn51RdrDetnChks "Refer to the data element description in FrntSideRdrLeDetn1 with the same data element name.";
CM_ SG_ 320 FrntSideRdrLeDetn51RdrDetnCntr "Refer to the data element description in FrntSideRdrLeDetn1 with the same data element name.";
CM_ SG_ 320 FrntSideRdrLeDetn51RdrDetnConf "Refer to the data element description in FrntSideRdrLeDetn1 with the same data element name.";
CM_ SG_ 320 FrntSideRdrLeDetn51RdrDetnElevn "Refer to the data element description in FrntSideRdrLeDetn1 with the same data element name.";
CM_ SG_ 320 FrntSideRdrLeDetn51RdrDetnPwr "Refer to the data element description in FrntSideRdrLeDetn1 with the same data element name.";
CM_ SG_ 320 FrntSideRdrLeDetn51RdrDetnRng "Refer to the data element description in FrntSideRdrLeDetn1 with the same data element name.";
CM_ SG_ 320 FrntSideRdrLeDetn51RdrDetnRngV "Range Velocity";
CM_ SG_ 320 FrntSideRdrLeDetn51RdrDetnSts "Refer to the data element description in FrntSideRdrLeDetn1 with the same data element name.";
CM_ SG_ 320 FrntSideRdrLeDetn52RdrDetnAzi "Refer to the data element description in FrntSideRdrLeDetn1 with the same data element name.";
CM_ SG_ 320 FrntSideRdrLeDetn52RdrDetnChks "Refer to the data element description in FrntSideRdrLeDetn1 with the same data element name.";
CM_ SG_ 320 FrntSideRdrLeDetn52RdrDetnCntr "Refer to the data element description in FrntSideRdrLeDetn1 with the same data element name.";
CM_ SG_ 320 FrntSideRdrLeDetn52RdrDetnConf "Refer to the data element description in FrntSideRdrLeDetn1 with the same data element name.";
CM_ SG_ 320 FrntSideRdrLeDetn52RdrDetnElevn "Refer to the data element description in FrntSideRdrLeDetn1 with the same data element name.";
CM_ SG_ 320 FrntSideRdrLeDetn52RdrDetnPwr "Refer to the data element description in FrntSideRdrLeDetn1 with the same data element name.";
CM_ SG_ 320 FrntSideRdrLeDetn52RdrDetnRng "Refer to the data element description in FrntSideRdrLeDetn1 with the same data element name.";
CM_ SG_ 320 FrntSideRdrLeDetn52RdrDetnRngV "Range Velocity";
CM_ SG_ 320 FrntSideRdrLeDetn52RdrDetnSts "Refer to the data element description in FrntSideRdrLeDetn1 with the same data element name.";
CM_ SG_ 320 FrntSideRdrLeDetn53RdrDetnAzi "Refer to the data element description in FrntSideRdrLeDetn1 with the same data element name.";
CM_ SG_ 320 FrntSideRdrLeDetn53RdrDetnChks "Refer to the data element description in FrntSideRdrLeDetn1 with the same data element name.";
CM_ SG_ 320 FrntSideRdrLeDetn53RdrDetnCntr "Refer to the data element description in FrntSideRdrLeDetn1 with the same data element name.";
CM_ SG_ 320 FrntSideRdrLeDetn53RdrDetnConf "Refer to the data element description in FrntSideRdrLeDetn1 with the same data element name.";
CM_ SG_ 320 FrntSideRdrLeDetn53RdrDetnElevn "Refer to the data element description in FrntSideRdrLeDetn1 with the same data element name.";
CM_ SG_ 320 FrntSideRdrLeDetn53RdrDetnPwr "Refer to the data element description in FrntSideRdrLeDetn1 with the same data element name.";
CM_ SG_ 320 FrntSideRdrLeDetn53RdrDetnRng "Refer to the data element description in FrntSideRdrLeDetn1 with the same data element name.";
CM_ SG_ 320 FrntSideRdrLeDetn53RdrDetnRngV "Range Velocity";
CM_ SG_ 320 FrntSideRdrLeDetn53RdrDetnSts "Refer to the data element description in FrntSideRdrLeDetn1 with the same data element name.";
CM_ SG_ 320 FrntSideRdrLeDetn54RdrDetnAzi "Refer to the data element description in FrntSideRdrLeDetn1 with the same data element name.";
CM_ SG_ 320 FrntSideRdrLeDetn54RdrDetnChks "Refer to the data element description in FrntSideRdrLeDetn1 with the same data element name.";
CM_ SG_ 320 FrntSideRdrLeDetn54RdrDetnCntr "Refer to the data element description in FrntSideRdrLeDetn1 with the same data element name.";
CM_ SG_ 320 FrntSideRdrLeDetn54RdrDetnConf "Refer to the data element description in FrntSideRdrLeDetn1 with the same data element name.";
CM_ SG_ 320 FrntSideRdrLeDetn54RdrDetnElevn "Refer to the data element description in FrntSideRdrLeDetn1 with the same data element name.";
CM_ SG_ 320 FrntSideRdrLeDetn54RdrDetnPwr "Refer to the data element description in FrntSideRdrLeDetn1 with the same data element name.";
CM_ SG_ 320 FrntSideRdrLeDetn54RdrDetnRng "Refer to the data element description in FrntSideRdrLeDetn1 with the same data element name.";
CM_ SG_ 320 FrntSideRdrLeDetn54RdrDetnRngV "Range Velocity";
CM_ SG_ 320 FrntSideRdrLeDetn54RdrDetnSts "Refer to the data element description in FrntSideRdrLeDetn1 with the same data element name.";
CM_ SG_ 322 FrntSideRdrLeDetn55RdrDetnAzi "Refer to the data element description in FrntSideRdrLeDetn1 with the same data element name.";
CM_ SG_ 322 FrntSideRdrLeDetn55RdrDetnChks "Refer to the data element description in FrntSideRdrLeDetn1 with the same data element name.";
CM_ SG_ 322 FrntSideRdrLeDetn55RdrDetnCntr "Refer to the data element description in FrntSideRdrLeDetn1 with the same data element name.";
CM_ SG_ 322 FrntSideRdrLeDetn55RdrDetnConf "Refer to the data element description in FrntSideRdrLeDetn1 with the same data element name.";
CM_ SG_ 322 FrntSideRdrLeDetn55RdrDetnElevn "Refer to the data element description in FrntSideRdrLeDetn1 with the same data element name.";
CM_ SG_ 322 FrntSideRdrLeDetn55RdrDetnPwr "Refer to the data element description in FrntSideRdrLeDetn1 with the same data element name.";
CM_ SG_ 322 FrntSideRdrLeDetn55RdrDetnRng "Refer to the data element description in FrntSideRdrLeDetn1 with the same data element name.";
CM_ SG_ 322 FrntSideRdrLeDetn55RdrDetnRngV "Range Velocity";
CM_ SG_ 322 FrntSideRdrLeDetn55RdrDetnSts "Refer to the data element description in FrntSideRdrLeDetn1 with the same data element name.";
CM_ SG_ 322 FrntSideRdrLeDetn56RdrDetnAzi "Refer to the data element description in FrntSideRdrLeDetn1 with the same data element name.";
CM_ SG_ 322 FrntSideRdrLeDetn56RdrDetnChks "Refer to the data element description in FrntSideRdrLeDetn1 with the same data element name.";
CM_ SG_ 322 FrntSideRdrLeDetn56RdrDetnCntr "Refer to the data element description in FrntSideRdrLeDetn1 with the same data element name.";
CM_ SG_ 322 FrntSideRdrLeDetn56RdrDetnConf "Refer to the data element description in FrntSideRdrLeDetn1 with the same data element name.";
CM_ SG_ 322 FrntSideRdrLeDetn56RdrDetnElevn "Refer to the data element description in FrntSideRdrLeDetn1 with the same data element name.";
CM_ SG_ 322 FrntSideRdrLeDetn56RdrDetnPwr "Refer to the data element description in FrntSideRdrLeDetn1 with the same data element name.";
CM_ SG_ 322 FrntSideRdrLeDetn56RdrDetnRng "Refer to the data element description in FrntSideRdrLeDetn1 with the same data element name.";
CM_ SG_ 322 FrntSideRdrLeDetn56RdrDetnRngV "Range Velocity";
CM_ SG_ 322 FrntSideRdrLeDetn56RdrDetnSts "Refer to the data element description in FrntSideRdrLeDetn1 with the same data element name.";
CM_ SG_ 322 FrntSideRdrLeDetn57RdrDetnAzi "Refer to the data element description in FrntSideRdrLeDetn1 with the same data element name.";
CM_ SG_ 322 FrntSideRdrLeDetn57RdrDetnChks "Refer to the data element description in FrntSideRdrLeDetn1 with the same data element name.";
CM_ SG_ 322 FrntSideRdrLeDetn57RdrDetnCntr "Refer to the data element description in FrntSideRdrLeDetn1 with the same data element name.";
CM_ SG_ 322 FrntSideRdrLeDetn57RdrDetnConf "Refer to the data element description in FrntSideRdrLeDetn1 with the same data element name.";
CM_ SG_ 322 FrntSideRdrLeDetn57RdrDetnElevn "Refer to the data element description in FrntSideRdrLeDetn1 with the same data element name.";
CM_ SG_ 322 FrntSideRdrLeDetn57RdrDetnPwr "Refer to the data element description in FrntSideRdrLeDetn1 with the same data element name.";
CM_ SG_ 322 FrntSideRdrLeDetn57RdrDetnRng "Refer to the data element description in FrntSideRdrLeDetn1 with the same data element name.";
CM_ SG_ 322 FrntSideRdrLeDetn57RdrDetnRngV "Range Velocity";
CM_ SG_ 322 FrntSideRdrLeDetn57RdrDetnSts "Refer to the data element description in FrntSideRdrLeDetn1 with the same data element name.";
CM_ SG_ 322 FrntSideRdrLeDetn58RdrDetnAzi "Refer to the data element description in FrntSideRdrLeDetn1 with the same data element name.";
CM_ SG_ 322 FrntSideRdrLeDetn58RdrDetnChks "Refer to the data element description in FrntSideRdrLeDetn1 with the same data element name.";
CM_ SG_ 322 FrntSideRdrLeDetn58RdrDetnCntr "Refer to the data element description in FrntSideRdrLeDetn1 with the same data element name.";
CM_ SG_ 322 FrntSideRdrLeDetn58RdrDetnConf "Refer to the data element description in FrntSideRdrLeDetn1 with the same data element name.";
CM_ SG_ 322 FrntSideRdrLeDetn58RdrDetnElevn "Refer to the data element description in FrntSideRdrLeDetn1 with the same data element name.";
CM_ SG_ 322 FrntSideRdrLeDetn58RdrDetnPwr "Refer to the data element description in FrntSideRdrLeDetn1 with the same data element name.";
CM_ SG_ 322 FrntSideRdrLeDetn58RdrDetnRng "Refer to the data element description in FrntSideRdrLeDetn1 with the same data element name.";
CM_ SG_ 322 FrntSideRdrLeDetn58RdrDetnRngV "Range Velocity";
CM_ SG_ 322 FrntSideRdrLeDetn58RdrDetnSts "Refer to the data element description in FrntSideRdrLeDetn1 with the same data element name.";
CM_ SG_ 322 FrntSideRdrLeDetn59RdrDetnAzi "Refer to the data element description in FrntSideRdrLeDetn1 with the same data element name.";
CM_ SG_ 322 FrntSideRdrLeDetn59RdrDetnChks "Refer to the data element description in FrntSideRdrLeDetn1 with the same data element name.";
CM_ SG_ 322 FrntSideRdrLeDetn59RdrDetnCntr "Refer to the data element description in FrntSideRdrLeDetn1 with the same data element name.";
CM_ SG_ 322 FrntSideRdrLeDetn59RdrDetnConf "Refer to the data element description in FrntSideRdrLeDetn1 with the same data element name.";
CM_ SG_ 322 FrntSideRdrLeDetn59RdrDetnElevn "Refer to the data element description in FrntSideRdrLeDetn1 with the same data element name.";
CM_ SG_ 322 FrntSideRdrLeDetn59RdrDetnPwr "Refer to the data element description in FrntSideRdrLeDetn1 with the same data element name.";
CM_ SG_ 322 FrntSideRdrLeDetn59RdrDetnRng "Refer to the data element description in FrntSideRdrLeDetn1 with the same data element name.";
CM_ SG_ 322 FrntSideRdrLeDetn59RdrDetnRngV "Range Velocity";
CM_ SG_ 322 FrntSideRdrLeDetn59RdrDetnSts "Refer to the data element description in FrntSideRdrLeDetn1 with the same data element name.";
CM_ SG_ 322 FrntSideRdrLeDetn60RdrDetnAzi "Refer to the data element description in FrntSideRdrLeDetn1 with the same data element name.";
CM_ SG_ 322 FrntSideRdrLeDetn60RdrDetnChks "Refer to the data element description in FrntSideRdrLeDetn1 with the same data element name.";
CM_ SG_ 322 FrntSideRdrLeDetn60RdrDetnCntr "Refer to the data element description in FrntSideRdrLeDetn1 with the same data element name.";
CM_ SG_ 322 FrntSideRdrLeDetn60RdrDetnConf "Refer to the data element description in FrntSideRdrLeDetn1 with the same data element name.";
CM_ SG_ 322 FrntSideRdrLeDetn60RdrDetnElevn "Refer to the data element description in FrntSideRdrLeDetn1 with the same data element name.";
CM_ SG_ 322 FrntSideRdrLeDetn60RdrDetnPwr "Refer to the data element description in FrntSideRdrLeDetn1 with the same data element name.";
CM_ SG_ 322 FrntSideRdrLeDetn60RdrDetnRng "Refer to the data element description in FrntSideRdrLeDetn1 with the same data element name.";
CM_ SG_ 322 FrntSideRdrLeDetn60RdrDetnRngV "Range Velocity
";
CM_ SG_ 322 FrntSideRdrLeDetn60RdrDetnSts "Refer to the data element description in FrntSideRdrLeDetn1 with the same data element name.";
CM_ SG_ 324 FrntSideRdrLeDetn61RdrDetnAzi "Refer to the data element description in FrntSideRdrLeDetn1 with the same data element name.";
CM_ SG_ 324 FrntSideRdrLeDetn61RdrDetnChks "Refer to the data element description in FrntSideRdrLeDetn1 with the same data element name.";
CM_ SG_ 324 FrntSideRdrLeDetn61RdrDetnCntr "Refer to the data element description in FrntSideRdrLeDetn1 with the same data element name.";
CM_ SG_ 324 FrntSideRdrLeDetn61RdrDetnConf "Refer to the data element description in FrntSideRdrLeDetn1 with the same data element name.";
CM_ SG_ 324 FrntSideRdrLeDetn61RdrDetnElevn "Refer to the data element description in FrntSideRdrLeDetn1 with the same data element name.";
CM_ SG_ 324 FrntSideRdrLeDetn61RdrDetnPwr "Refer to the data element description in FrntSideRdrLeDetn1 with the same data element name.";
CM_ SG_ 324 FrntSideRdrLeDetn61RdrDetnRng "Refer to the data element description in FrntSideRdrLeDetn1 with the same data element name.";
CM_ SG_ 324 FrntSideRdrLeDetn61RdrDetnRngV "Range Velocity";
CM_ SG_ 324 FrntSideRdrLeDetn61RdrDetnSts "Refer to the data element description in FrntSideRdrLeDetn1 with the same data element name.";
CM_ SG_ 324 FrntSideRdrLeDetn62RdrDetnAzi "Refer to the data element description in FrntSideRdrLeDetn1 with the same data element name.";
CM_ SG_ 324 FrntSideRdrLeDetn62RdrDetnChks "Refer to the data element description in FrntSideRdrLeDetn1 with the same data element name.";
CM_ SG_ 324 FrntSideRdrLeDetn62RdrDetnCntr "Refer to the data element description in FrntSideRdrLeDetn1 with the same data element name.";
CM_ SG_ 324 FrntSideRdrLeDetn62RdrDetnConf "Refer to the data element description in FrntSideRdrLeDetn1 with the same data element name.";
CM_ SG_ 324 FrntSideRdrLeDetn62RdrDetnElevn "Refer to the data element description in FrntSideRdrLeDetn1 with the same data element name.";
CM_ SG_ 324 FrntSideRdrLeDetn62RdrDetnPwr "Refer to the data element description in FrntSideRdrLeDetn1 with the same data element name.";
CM_ SG_ 324 FrntSideRdrLeDetn62RdrDetnRng "Refer to the data element description in FrntSideRdrLeDetn1 with the same data element name.";
CM_ SG_ 324 FrntSideRdrLeDetn62RdrDetnRngV "Range Velocity";
CM_ SG_ 324 FrntSideRdrLeDetn62RdrDetnSts "Refer to the data element description in FrntSideRdrLeDetn1 with the same data element name.";
CM_ SG_ 324 FrntSideRdrLeDetn63RdrDetnAzi "Refer to the data element description in FrntSideRdrLeDetn1 with the same data element name.";
CM_ SG_ 324 FrntSideRdrLeDetn63RdrDetnChks "Refer to the data element description in FrntSideRdrLeDetn1 with the same data element name.";
CM_ SG_ 324 FrntSideRdrLeDetn63RdrDetnCntr "Refer to the data element description in FrntSideRdrLeDetn1 with the same data element name.";
CM_ SG_ 324 FrntSideRdrLeDetn63RdrDetnConf "Refer to the data element description in FrntSideRdrLeDetn1 with the same data element name.";
CM_ SG_ 324 FrntSideRdrLeDetn63RdrDetnElevn "Refer to the data element description in FrntSideRdrLeDetn1 with the same data element name.";
CM_ SG_ 324 FrntSideRdrLeDetn63RdrDetnPwr "Refer to the data element description in FrntSideRdrLeDetn1 with the same data element name.";
CM_ SG_ 324 FrntSideRdrLeDetn63RdrDetnRng "Refer to the data element description in FrntSideRdrLeDetn1 with the same data element name.";
CM_ SG_ 324 FrntSideRdrLeDetn63RdrDetnRngV "Range Velocity";
CM_ SG_ 324 FrntSideRdrLeDetn63RdrDetnSts "Refer to the data element description in FrntSideRdrLeDetn1 with the same data element name.";
CM_ SG_ 324 FrntSideRdrLeDetn64RdrDetnAzi "Refer to the data element description in FrntSideRdrLeDetn1 with the same data element name.";
CM_ SG_ 324 FrntSideRdrLeDetn64RdrDetnChks "Refer to the data element description in FrntSideRdrLeDetn1 with the same data element name.";
CM_ SG_ 324 FrntSideRdrLeDetn64RdrDetnCntr "Refer to the data element description in FrntSideRdrLeDetn1 with the same data element name.";
CM_ SG_ 324 FrntSideRdrLeDetn64RdrDetnConf "Refer to the data element description in FrntSideRdrLeDetn1 with the same data element name.";
CM_ SG_ 324 FrntSideRdrLeDetn64RdrDetnElevn "Refer to the data element description in FrntSideRdrLeDetn1 with the same data element name.";
CM_ SG_ 324 FrntSideRdrLeDetn64RdrDetnPwr "Refer to the data element description in FrntSideRdrLeDetn1 with the same data element name.";
CM_ SG_ 324 FrntSideRdrLeDetn64RdrDetnRng "Refer to the data element description in FrntSideRdrLeDetn1 with the same data element name.";
CM_ SG_ 324 FrntSideRdrLeDetn64RdrDetnRngV "Range Velocity";
CM_ SG_ 324 FrntSideRdrLeDetn64RdrDetnSts "Refer to the data element description in FrntSideRdrLeDetn1 with the same data element name.";
CM_ SG_ 324 FrntSideRdrLeDetn65RdrDetnAzi "Refer to the data element description in FrntSideRdrLeDetn1 with the same data element name.";
CM_ SG_ 324 FrntSideRdrLeDetn65RdrDetnChks "Refer to the data element description in FrntSideRdrLeDetn1 with the same data element name.";
CM_ SG_ 324 FrntSideRdrLeDetn65RdrDetnCntr "Refer to the data element description in FrntSideRdrLeDetn1 with the same data element name.";
CM_ SG_ 324 FrntSideRdrLeDetn65RdrDetnConf "Refer to the data element description in FrntSideRdrLeDetn1 with the same data element name.";
CM_ SG_ 324 FrntSideRdrLeDetn65RdrDetnElevn "Refer to the data element description in FrntSideRdrLeDetn1 with the same data element name.";
CM_ SG_ 324 FrntSideRdrLeDetn65RdrDetnPwr "Refer to the data element description in FrntSideRdrLeDetn1 with the same data element name.";
CM_ SG_ 324 FrntSideRdrLeDetn65RdrDetnRng "Refer to the data element description in FrntSideRdrLeDetn1 with the same data element name.";
CM_ SG_ 324 FrntSideRdrLeDetn65RdrDetnRngV "Range Velocity";
CM_ SG_ 324 FrntSideRdrLeDetn65RdrDetnSts "Refer to the data element description in FrntSideRdrLeDetn1 with the same data element name.";
CM_ SG_ 324 FrntSideRdrLeDetn66RdrDetnAzi "Refer to the data element description in FrntSideRdrLeDetn1 with the same data element name.";
CM_ SG_ 324 FrntSideRdrLeDetn66RdrDetnChks "Refer to the data element description in FrntSideRdrLeDetn1 with the same data element name.";
CM_ SG_ 324 FrntSideRdrLeDetn66RdrDetnCntr "Refer to the data element description in FrntSideRdrLeDetn1 with the same data element name.";
CM_ SG_ 324 FrntSideRdrLeDetn66RdrDetnConf "Refer to the data element description in FrntSideRdrLeDetn1 with the same data element name.";
CM_ SG_ 324 FrntSideRdrLeDetn66RdrDetnElevn "Refer to the data element description in FrntSideRdrLeDetn1 with the same data element name.";
CM_ SG_ 324 FrntSideRdrLeDetn66RdrDetnPwr "Refer to the data element description in FrntSideRdrLeDetn1 with the same data element name.";
CM_ SG_ 324 FrntSideRdrLeDetn66RdrDetnRng "Refer to the data element description in FrntSideRdrLeDetn1 with the same data element name.";
CM_ SG_ 324 FrntSideRdrLeDetn66RdrDetnRngV "Range Velocity";
CM_ SG_ 324 FrntSideRdrLeDetn66RdrDetnSts "Refer to the data element description in FrntSideRdrLeDetn1 with the same data element name.";
CM_ SG_ 326 FrntSideRdrLeDetn67RdrDetnAzi "Refer to the data element description in FrntSideRdrLeDetn1 with the same data element name.";
CM_ SG_ 326 FrntSideRdrLeDetn67RdrDetnChks "Refer to the data element description in FrntSideRdrLeDetn1 with the same data element name.";
CM_ SG_ 326 FrntSideRdrLeDetn67RdrDetnCntr "Refer to the data element description in FrntSideRdrLeDetn1 with the same data element name.";
CM_ SG_ 326 FrntSideRdrLeDetn67RdrDetnConf "Refer to the data element description in FrntSideRdrLeDetn1 with the same data element name.";
CM_ SG_ 326 FrntSideRdrLeDetn67RdrDetnElevn "Refer to the data element description in FrntSideRdrLeDetn1 with the same data element name.";
CM_ SG_ 326 FrntSideRdrLeDetn67RdrDetnPwr "Refer to the data element description in FrntSideRdrLeDetn1 with the same data element name.";
CM_ SG_ 326 FrntSideRdrLeDetn67RdrDetnRng "Refer to the data element description in FrntSideRdrLeDetn1 with the same data element name.";
CM_ SG_ 326 FrntSideRdrLeDetn67RdrDetnRngV "Range Velocity
";
CM_ SG_ 326 FrntSideRdrLeDetn67RdrDetnSts "Refer to the data element description in FrntSideRdrLeDetn1 with the same data element name.";
CM_ SG_ 326 FrntSideRdrLeDetn68RdrDetnAzi "Refer to the data element description in FrntSideRdrLeDetn1 with the same data element name.";
CM_ SG_ 326 FrntSideRdrLeDetn68RdrDetnChks "Refer to the data element description in FrntSideRdrLeDetn1 with the same data element name.";
CM_ SG_ 326 FrntSideRdrLeDetn68RdrDetnCntr "Refer to the data element description in FrntSideRdrLeDetn1 with the same data element name.";
CM_ SG_ 326 FrntSideRdrLeDetn68RdrDetnConf "Refer to the data element description in FrntSideRdrLeDetn1 with the same data element name.";
CM_ SG_ 326 FrntSideRdrLeDetn68RdrDetnElevn "Refer to the data element description in FrntSideRdrLeDetn1 with the same data element name.";
CM_ SG_ 326 FrntSideRdrLeDetn68RdrDetnPwr "Refer to the data element description in FrntSideRdrLeDetn1 with the same data element name.";
CM_ SG_ 326 FrntSideRdrLeDetn68RdrDetnRng "Refer to the data element description in FrntSideRdrLeDetn1 with the same data element name.";
CM_ SG_ 326 FrntSideRdrLeDetn68RdrDetnRngV "Range Velocity";
CM_ SG_ 326 FrntSideRdrLeDetn68RdrDetnSts "Refer to the data element description in FrntSideRdrLeDetn1 with the same data element name.";
CM_ SG_ 326 FrntSideRdrLeDetn69RdrDetnAzi "Refer to the data element description in FrntSideRdrLeDetn1 with the same data element name.";
CM_ SG_ 326 FrntSideRdrLeDetn69RdrDetnChks "Refer to the data element description in FrntSideRdrLeDetn1 with the same data element name.";
CM_ SG_ 326 FrntSideRdrLeDetn69RdrDetnCntr "Refer to the data element description in FrntSideRdrLeDetn1 with the same data element name.";
CM_ SG_ 326 FrntSideRdrLeDetn69RdrDetnConf "Refer to the data element description in FrntSideRdrLeDetn1 with the same data element name.";
CM_ SG_ 326 FrntSideRdrLeDetn69RdrDetnElevn "Refer to the data element description in FrntSideRdrLeDetn1 with the same data element name.";
CM_ SG_ 326 FrntSideRdrLeDetn69RdrDetnPwr "Refer to the data element description in FrntSideRdrLeDetn1 with the same data element name.";
CM_ SG_ 326 FrntSideRdrLeDetn69RdrDetnRng "Refer to the data element description in FrntSideRdrLeDetn1 with the same data element name.";
CM_ SG_ 326 FrntSideRdrLeDetn69RdrDetnRngV "Range Velocity";
CM_ SG_ 326 FrntSideRdrLeDetn69RdrDetnSts "Refer to the data element description in FrntSideRdrLeDetn1 with the same data element name.";
CM_ SG_ 326 FrntSideRdrLeDetn70RdrDetnAzi "Refer to the data element description in FrntSideRdrLeDetn1 with the same data element name.";
CM_ SG_ 326 FrntSideRdrLeDetn70RdrDetnChks "Refer to the data element description in FrntSideRdrLeDetn1 with the same data element name.";
CM_ SG_ 326 FrntSideRdrLeDetn70RdrDetnCntr "Refer to the data element description in FrntSideRdrLeDetn1 with the same data element name.";
CM_ SG_ 326 FrntSideRdrLeDetn70RdrDetnConf "Refer to the data element description in FrntSideRdrLeDetn1 with the same data element name.";
CM_ SG_ 326 FrntSideRdrLeDetn70RdrDetnElevn "Refer to the data element description in FrntSideRdrLeDetn1 with the same data element name.";
CM_ SG_ 326 FrntSideRdrLeDetn70RdrDetnPwr "Refer to the data element description in FrntSideRdrLeDetn1 with the same data element name.";
CM_ SG_ 326 FrntSideRdrLeDetn70RdrDetnRng "Refer to the data element description in FrntSideRdrLeDetn1 with the same data element name.";
CM_ SG_ 326 FrntSideRdrLeDetn70RdrDetnRngV "Range Velocity";
CM_ SG_ 326 FrntSideRdrLeDetn70RdrDetnSts "Refer to the data element description in FrntSideRdrLeDetn1 with the same data element name.";
CM_ SG_ 326 FrntSideRdrLeDetn71RdrDetnAzi "Refer to the data element description in FrntSideRdrLeDetn1 with the same data element name.";
CM_ SG_ 326 FrntSideRdrLeDetn71RdrDetnChks "Refer to the data element description in FrntSideRdrLeDetn1 with the same data element name.";
CM_ SG_ 326 FrntSideRdrLeDetn71RdrDetnCntr "Refer to the data element description in FrntSideRdrLeDetn1 with the same data element name.";
CM_ SG_ 326 FrntSideRdrLeDetn71RdrDetnConf "Refer to the data element description in FrntSideRdrLeDetn1 with the same data element name.";
CM_ SG_ 326 FrntSideRdrLeDetn71RdrDetnElevn "Refer to the data element description in FrntSideRdrLeDetn1 with the same data element name.";
CM_ SG_ 326 FrntSideRdrLeDetn71RdrDetnPwr "Refer to the data element description in FrntSideRdrLeDetn1 with the same data element name.";
CM_ SG_ 326 FrntSideRdrLeDetn71RdrDetnRng "Refer to the data element description in FrntSideRdrLeDetn1 with the same data element name.";
CM_ SG_ 326 FrntSideRdrLeDetn71RdrDetnRngV "Range Velocity";
CM_ SG_ 326 FrntSideRdrLeDetn71RdrDetnSts "Refer to the data element description in FrntSideRdrLeDetn1 with the same data element name.";
CM_ SG_ 326 FrntSideRdrLeDetn72RdrDetnAzi "Refer to the data element description in FrntSideRdrLeDetn1 with the same data element name.";
CM_ SG_ 326 FrntSideRdrLeDetn72RdrDetnChks "Refer to the data element description in FrntSideRdrLeDetn1 with the same data element name.";
CM_ SG_ 326 FrntSideRdrLeDetn72RdrDetnCntr "Refer to the data element description in FrntSideRdrLeDetn1 with the same data element name.";
CM_ SG_ 326 FrntSideRdrLeDetn72RdrDetnConf "Refer to the data element description in FrntSideRdrLeDetn1 with the same data element name.";
CM_ SG_ 326 FrntSideRdrLeDetn72RdrDetnElevn "Refer to the data element description in FrntSideRdrLeDetn1 with the same data element name.";
CM_ SG_ 326 FrntSideRdrLeDetn72RdrDetnPwr "Refer to the data element description in FrntSideRdrLeDetn1 with the same data element name.";
CM_ SG_ 326 FrntSideRdrLeDetn72RdrDetnRng "Refer to the data element description in FrntSideRdrLeDetn1 with the same data element name.";
CM_ SG_ 326 FrntSideRdrLeDetn72RdrDetnRngV "Range Velocity";
CM_ SG_ 326 FrntSideRdrLeDetn72RdrDetnSts "Refer to the data element description in FrntSideRdrLeDetn1 with the same data element name.";
CM_ SG_ 328 FrntSideRdrLeDetn73RdrDetnAzi "Refer to the data element description in FrntSideRdrLeDetn1 with the same data element name.";
CM_ SG_ 328 FrntSideRdrLeDetn73RdrDetnChks "Refer to the data element description in FrntSideRdrLeDetn1 with the same data element name.";
CM_ SG_ 328 FrntSideRdrLeDetn73RdrDetnCntr "Refer to the data element description in FrntSideRdrLeDetn1 with the same data element name.";
CM_ SG_ 328 FrntSideRdrLeDetn73RdrDetnConf "Refer to the data element description in FrntSideRdrLeDetn1 with the same data element name.";
CM_ SG_ 328 FrntSideRdrLeDetn73RdrDetnElevn "Refer to the data element description in FrntSideRdrLeDetn1 with the same data element name.";
CM_ SG_ 328 FrntSideRdrLeDetn73RdrDetnPwr "Refer to the data element description in FrntSideRdrLeDetn1 with the same data element name.";
CM_ SG_ 328 FrntSideRdrLeDetn73RdrDetnRng "Refer to the data element description in FrntSideRdrLeDetn1 with the same data element name.";
CM_ SG_ 328 FrntSideRdrLeDetn73RdrDetnRngV "Range Velocity";
CM_ SG_ 328 FrntSideRdrLeDetn73RdrDetnSts "Refer to the data element description in FrntSideRdrLeDetn1 with the same data element name.";
CM_ SG_ 328 FrntSideRdrLeDetn74RdrDetnAzi "Refer to the data element description in FrntSideRdrLeDetn1 with the same data element name.";
CM_ SG_ 328 FrntSideRdrLeDetn74RdrDetnChks "Refer to the data element description in FrntSideRdrLeDetn1 with the same data element name.";
CM_ SG_ 328 FrntSideRdrLeDetn74RdrDetnCntr "Refer to the data element description in FrntSideRdrLeDetn1 with the same data element name.";
CM_ SG_ 328 FrntSideRdrLeDetn74RdrDetnConf "Refer to the data element description in FrntSideRdrLeDetn1 with the same data element name.";
CM_ SG_ 328 FrntSideRdrLeDetn74RdrDetnElevn "Refer to the data element description in FrntSideRdrLeDetn1 with the same data element name.";
CM_ SG_ 328 FrntSideRdrLeDetn74RdrDetnPwr "Refer to the data element description in FrntSideRdrLeDetn1 with the same data element name.";
CM_ SG_ 328 FrntSideRdrLeDetn74RdrDetnRng "Refer to the data element description in FrntSideRdrLeDetn1 with the same data element name.";
CM_ SG_ 328 FrntSideRdrLeDetn74RdrDetnRngV "Range Velocity";
CM_ SG_ 328 FrntSideRdrLeDetn74RdrDetnSts "Refer to the data element description in FrntSideRdrLeDetn1 with the same data element name.";
CM_ SG_ 328 FrntSideRdrLeDetn75RdrDetnAzi "Refer to the data element description in FrntSideRdrLeDetn1 with the same data element name.";
CM_ SG_ 328 FrntSideRdrLeDetn75RdrDetnChks "Refer to the data element description in FrntSideRdrLeDetn1 with the same data element name.";
CM_ SG_ 328 FrntSideRdrLeDetn75RdrDetnCntr "Refer to the data element description in FrntSideRdrLeDetn1 with the same data element name.";
CM_ SG_ 328 FrntSideRdrLeDetn75RdrDetnConf "Refer to the data element description in FrntSideRdrLeDetn1 with the same data element name.";
CM_ SG_ 328 FrntSideRdrLeDetn75RdrDetnElevn "Refer to the data element description in FrntSideRdrLeDetn1 with the same data element name.";
CM_ SG_ 328 FrntSideRdrLeDetn75RdrDetnPwr "Refer to the data element description in FrntSideRdrLeDetn1 with the same data element name.";
CM_ SG_ 328 FrntSideRdrLeDetn75RdrDetnRng "Refer to the data element description in FrntSideRdrLeDetn1 with the same data element name.";
CM_ SG_ 328 FrntSideRdrLeDetn75RdrDetnRngV "Range Velocity";
CM_ SG_ 328 FrntSideRdrLeDetn75RdrDetnSts "Refer to the data element description in FrntSideRdrLeDetn1 with the same data element name.";
CM_ SG_ 328 FrntSideRdrLeDetn76RdrDetnAzi "Refer to the data element description in FrntSideRdrLeDetn1 with the same data element name.";
CM_ SG_ 328 FrntSideRdrLeDetn76RdrDetnChks "Refer to the data element description in FrntSideRdrLeDetn1 with the same data element name.";
CM_ SG_ 328 FrntSideRdrLeDetn76RdrDetnCntr "Refer to the data element description in FrntSideRdrLeDetn1 with the same data element name.";
CM_ SG_ 328 FrntSideRdrLeDetn76RdrDetnConf "Refer to the data element description in FrntSideRdrLeDetn1 with the same data element name.";
CM_ SG_ 328 FrntSideRdrLeDetn76RdrDetnElevn "Refer to the data element description in FrntSideRdrLeDetn1 with the same data element name.";
CM_ SG_ 328 FrntSideRdrLeDetn76RdrDetnPwr "Refer to the data element description in FrntSideRdrLeDetn1 with the same data element name.";
CM_ SG_ 328 FrntSideRdrLeDetn76RdrDetnRng "Refer to the data element description in FrntSideRdrLeDetn1 with the same data element name.";
CM_ SG_ 328 FrntSideRdrLeDetn76RdrDetnRngV "Range Velocity";
CM_ SG_ 328 FrntSideRdrLeDetn76RdrDetnSts "Refer to the data element description in FrntSideRdrLeDetn1 with the same data element name.";
CM_ SG_ 328 FrntSideRdrLeDetn77RdrDetnAzi "Refer to the data element description in FrntSideRdrLeDetn1 with the same data element name.";
CM_ SG_ 328 FrntSideRdrLeDetn77RdrDetnChks "Refer to the data element description in FrntSideRdrLeDetn1 with the same data element name.";
CM_ SG_ 328 FrntSideRdrLeDetn77RdrDetnCntr "Refer to the data element description in FrntSideRdrLeDetn1 with the same data element name.";
CM_ SG_ 328 FrntSideRdrLeDetn77RdrDetnConf "Refer to the data element description in FrntSideRdrLeDetn1 with the same data element name.";
CM_ SG_ 328 FrntSideRdrLeDetn77RdrDetnElevn "Refer to the data element description in FrntSideRdrLeDetn1 with the same data element name.";
CM_ SG_ 328 FrntSideRdrLeDetn77RdrDetnPwr "Refer to the data element description in FrntSideRdrLeDetn1 with the same data element name.";
CM_ SG_ 328 FrntSideRdrLeDetn77RdrDetnRng "Refer to the data element description in FrntSideRdrLeDetn1 with the same data element name.";
CM_ SG_ 328 FrntSideRdrLeDetn77RdrDetnRngV "Range Velocity";
CM_ SG_ 328 FrntSideRdrLeDetn77RdrDetnSts "Refer to the data element description in FrntSideRdrLeDetn1 with the same data element name.";
CM_ SG_ 328 FrntSideRdrLeDetn78RdrDetnAzi "Refer to the data element description in FrntSideRdrLeDetn1 with the same data element name.";
CM_ SG_ 328 FrntSideRdrLeDetn78RdrDetnChks "Refer to the data element description in FrntSideRdrLeDetn1 with the same data element name.";
CM_ SG_ 328 FrntSideRdrLeDetn78RdrDetnCntr "Refer to the data element description in FrntSideRdrLeDetn1 with the same data element name.";
CM_ SG_ 328 FrntSideRdrLeDetn78RdrDetnConf "Refer to the data element description in FrntSideRdrLeDetn1 with the same data element name.";
CM_ SG_ 328 FrntSideRdrLeDetn78RdrDetnElevn "Refer to the data element description in FrntSideRdrLeDetn1 with the same data element name.";
CM_ SG_ 328 FrntSideRdrLeDetn78RdrDetnPwr "Refer to the data element description in FrntSideRdrLeDetn1 with the same data element name.";
CM_ SG_ 328 FrntSideRdrLeDetn78RdrDetnRng "Refer to the data element description in FrntSideRdrLeDetn1 with the same data element name.";
CM_ SG_ 328 FrntSideRdrLeDetn78RdrDetnRngV "Range Velocity";
CM_ SG_ 328 FrntSideRdrLeDetn78RdrDetnSts "Refer to the data element description in FrntSideRdrLeDetn1 with the same data element name.";
CM_ SG_ 330 FrntSideRdrLeDetn79RdrDetnAzi "Refer to the data element description in FrntSideRdrLeDetn1 with the same data element name.";
CM_ SG_ 330 FrntSideRdrLeDetn79RdrDetnChks "Refer to the data element description in FrntSideRdrLeDetn1 with the same data element name.";
CM_ SG_ 330 FrntSideRdrLeDetn79RdrDetnCntr "Refer to the data element description in FrntSideRdrLeDetn1 with the same data element name.";
CM_ SG_ 330 FrntSideRdrLeDetn79RdrDetnConf "Refer to the data element description in FrntSideRdrLeDetn1 with the same data element name.";
CM_ SG_ 330 FrntSideRdrLeDetn79RdrDetnElevn "Refer to the data element description in FrntSideRdrLeDetn1 with the same data element name.";
CM_ SG_ 330 FrntSideRdrLeDetn79RdrDetnPwr "Refer to the data element description in FrntSideRdrLeDetn1 with the same data element name.";
CM_ SG_ 330 FrntSideRdrLeDetn79RdrDetnRng "Refer to the data element description in FrntSideRdrLeDetn1 with the same data element name.";
CM_ SG_ 330 FrntSideRdrLeDetn79RdrDetnRngV "Range Velocity";
CM_ SG_ 330 FrntSideRdrLeDetn79RdrDetnSts "Refer to the data element description in FrntSideRdrLeDetn1 with the same data element name.";
CM_ SG_ 330 FrntSideRdrLeDetn80RdrDetnAzi "Refer to the data element description in FrntSideRdrLeDetn1 with the same data element name.";
CM_ SG_ 330 FrntSideRdrLeDetn80RdrDetnChks "Refer to the data element description in FrntSideRdrLeDetn1 with the same data element name.";
CM_ SG_ 330 FrntSideRdrLeDetn80RdrDetnCntr "Refer to the data element description in FrntSideRdrLeDetn1 with the same data element name.";
CM_ SG_ 330 FrntSideRdrLeDetn80RdrDetnConf "Refer to the data element description in FrntSideRdrLeDetn1 with the same data element name.";
CM_ SG_ 330 FrntSideRdrLeDetn80RdrDetnElevn "Refer to the data element description in FrntSideRdrLeDetn1 with the same data element name.";
CM_ SG_ 330 FrntSideRdrLeDetn80RdrDetnPwr "Refer to the data element description in FrntSideRdrLeDetn1 with the same data element name.";
CM_ SG_ 330 FrntSideRdrLeDetn80RdrDetnRng "Refer to the data element description in FrntSideRdrLeDetn1 with the same data element name.";
CM_ SG_ 330 FrntSideRdrLeDetn80RdrDetnRngV "Range Velocity";
CM_ SG_ 330 FrntSideRdrLeDetn80RdrDetnSts "Refer to the data element description in FrntSideRdrLeDetn1 with the same data element name.";
CM_ SG_ 330 FrntSideRdrLeDetn81RdrDetnAzi "Refer to the data element description in FrntSideRdrLeDetn1 with the same data element name.";
CM_ SG_ 330 FrntSideRdrLeDetn81RdrDetnChks "Refer to the data element description in FrntSideRdrLeDetn1 with the same data element name.";
CM_ SG_ 330 FrntSideRdrLeDetn81RdrDetnCntr "Refer to the data element description in FrntSideRdrLeDetn1 with the same data element name.";
CM_ SG_ 330 FrntSideRdrLeDetn81RdrDetnConf "Refer to the data element description in FrntSideRdrLeDetn1 with the same data element name.";
CM_ SG_ 330 FrntSideRdrLeDetn81RdrDetnElevn "Refer to the data element description in FrntSideRdrLeDetn1 with the same data element name.";
CM_ SG_ 330 FrntSideRdrLeDetn81RdrDetnPwr "Refer to the data element description in FrntSideRdrLeDetn1 with the same data element name.";
CM_ SG_ 330 FrntSideRdrLeDetn81RdrDetnRng "Refer to the data element description in FrntSideRdrLeDetn1 with the same data element name.";
CM_ SG_ 330 FrntSideRdrLeDetn81RdrDetnRngV "Range Velocity";
CM_ SG_ 330 FrntSideRdrLeDetn81RdrDetnSts "Refer to the data element description in FrntSideRdrLeDetn1 with the same data element name.";
CM_ SG_ 330 FrntSideRdrLeDetn82RdrDetnAzi "Refer to the data element description in FrntSideRdrLeDetn1 with the same data element name.";
CM_ SG_ 330 FrntSideRdrLeDetn82RdrDetnChks "Refer to the data element description in FrntSideRdrLeDetn1 with the same data element name.";
CM_ SG_ 330 FrntSideRdrLeDetn82RdrDetnCntr "Refer to the data element description in FrntSideRdrLeDetn1 with the same data element name.";
CM_ SG_ 330 FrntSideRdrLeDetn82RdrDetnConf "Refer to the data element description in FrntSideRdrLeDetn1 with the same data element name.";
CM_ SG_ 330 FrntSideRdrLeDetn82RdrDetnElevn "Refer to the data element description in FrntSideRdrLeDetn1 with the same data element name.";
CM_ SG_ 330 FrntSideRdrLeDetn82RdrDetnPwr "Refer to the data element description in FrntSideRdrLeDetn1 with the same data element name.";
CM_ SG_ 330 FrntSideRdrLeDetn82RdrDetnRng "Refer to the data element description in FrntSideRdrLeDetn1 with the same data element name.";
CM_ SG_ 330 FrntSideRdrLeDetn82RdrDetnRngV "Range Velocity";
CM_ SG_ 330 FrntSideRdrLeDetn82RdrDetnSts "Refer to the data element description in FrntSideRdrLeDetn1 with the same data element name.";
CM_ SG_ 330 FrntSideRdrLeDetn83RdrDetnAzi "Refer to the data element description in FrntSideRdrLeDetn1 with the same data element name.";
CM_ SG_ 330 FrntSideRdrLeDetn83RdrDetnChks "Refer to the data element description in FrntSideRdrLeDetn1 with the same data element name.";
CM_ SG_ 330 FrntSideRdrLeDetn83RdrDetnCntr "Refer to the data element description in FrntSideRdrLeDetn1 with the same data element name.";
CM_ SG_ 330 FrntSideRdrLeDetn83RdrDetnConf "Refer to the data element description in FrntSideRdrLeDetn1 with the same data element name.";
CM_ SG_ 330 FrntSideRdrLeDetn83RdrDetnElevn "Refer to the data element description in FrntSideRdrLeDetn1 with the same data element name.";
CM_ SG_ 330 FrntSideRdrLeDetn83RdrDetnPwr "Refer to the data element description in FrntSideRdrLeDetn1 with the same data element name.";
CM_ SG_ 330 FrntSideRdrLeDetn83RdrDetnRng "Refer to the data element description in FrntSideRdrLeDetn1 with the same data element name.";
CM_ SG_ 330 FrntSideRdrLeDetn83RdrDetnRngV "Range Velocity";
CM_ SG_ 330 FrntSideRdrLeDetn83RdrDetnSts "Refer to the data element description in FrntSideRdrLeDetn1 with the same data element name.";
CM_ SG_ 330 FrntSideRdrLeDetn84RdrDetnAzi "Refer to the data element description in FrntSideRdrLeDetn1 with the same data element name.";
CM_ SG_ 330 FrntSideRdrLeDetn84RdrDetnChks "Refer to the data element description in FrntSideRdrLeDetn1 with the same data element name.";
CM_ SG_ 330 FrntSideRdrLeDetn84RdrDetnCntr "Refer to the data element description in FrntSideRdrLeDetn1 with the same data element name.";
CM_ SG_ 330 FrntSideRdrLeDetn84RdrDetnConf "Refer to the data element description in FrntSideRdrLeDetn1 with the same data element name.";
CM_ SG_ 330 FrntSideRdrLeDetn84RdrDetnElevn "Refer to the data element description in FrntSideRdrLeDetn1 with the same data element name.";
CM_ SG_ 330 FrntSideRdrLeDetn84RdrDetnPwr "Refer to the data element description in FrntSideRdrLeDetn1 with the same data element name.";
CM_ SG_ 330 FrntSideRdrLeDetn84RdrDetnRng "Refer to the data element description in FrntSideRdrLeDetn1 with the same data element name.";
CM_ SG_ 330 FrntSideRdrLeDetn84RdrDetnRngV "Range Velocity";
CM_ SG_ 330 FrntSideRdrLeDetn84RdrDetnSts "Refer to the data element description in FrntSideRdrLeDetn1 with the same data element name.";
BA_DEF_ BO_ "VFrameFormat" ENUM "StandardCAN","ExtendedCAN","reserved","J1939PG","reserved","reserved","reserved","reserved","reserved","reserved","reserved","reserved","reserved","reserved","StandardCAN_FD","ExtendedCAN_FD";
BA_DEF_ BO_ "CANFD_BRS" ENUM "0","1";
BA_DEF_ BO_ "GenMsgSendType" ENUM "cyclic", "spontaneous", "not-used", "not-used", "not-used", "cyclicAndSpontaneous", "not-used", "cyclicIfActive", "NoMsgSendType"; // [us]
BA_DEF_ BO_ "GenMsgCycleTime" INT 0 65536; // [ms]
BA_DEF_ BO_ "GenMsgStartDelayTime" INT 0 65536; // [ms]
BA_DEF_ BO_ "GenMsgDelayTime" INT 0 65536; // [ms]
BA_DEF_ SG_ "GenSigSendType" ENUM "Cyclic","OnWrite","OnWriteWithRepetition","OnChange","OnChangeWithRepetition","IfActive","IfActiveWithRepetition","NoSigSendType";
BA_DEF_ SG_ "GenSigStartValue" HEX 0 80000000;
BA_DEF_ BO_ "GenMsgILSupport" ENUM "No","Yes";
BA_DEF_ BO_ "NmAsrMessage" ENUM "No","Yes";
BA_DEF_ SG_ "GenSigFuncType" ENUM "NoFunction","n/a","n/a","n/a","n/a","n/a","n/a","n/a","n/a","n/a","n/a","n/a","n/a","n/a","n/a","CHK","CNTR","n/a","n/a","n/a","CNTR_AR_01","CRC_AR_01_BOTH","CRC_AR_01_ALT","CRC_AR_01_LOW","CRC_AR_01_NIBBLE","CNTR_AR_04","CRC_AR_04A","CNTR_AR_05","CRC_AR_05";
BA_DEF_ SG_ "GenSigDataID" STRING;

BA_DEF_DEF_ "VFrameFormat" "J1939PG";
BA_DEF_DEF_ "CANFD_BRS" "1";
BA_DEF_DEF_ "GenSigStartValue" 0;
BA_DEF_DEF_ "GenSigSendType" "NoSigSendType";
BA_DEF_DEF_ "GenMsgCycleTime" 0;
BA_DEF_DEF_ "GenMsgDelayTime" 0;
BA_DEF_DEF_ "GenMsgStartDelayTime" 0;
BA_DEF_DEF_ "GenMsgSendType" "NoMsgSendType";
BA_DEF_DEF_ "GenMsgILSupport" "Yes";
BA_DEF_DEF_ "NmAsrMessage" "No";
BA_DEF_DEF_ "GenSigFuncType" "NoFunction";
BA_DEF_DEF_ "GenSigDataID" "";
// Frame: FSRLSafetyCANFD1Frame07
BA_ "VFrameFormat" BO_ 316 14;
BA_ "GenMsgSendType" BO_ 316 0;
BA_ "GenMsgCycleTime" BO_ 316 50.000;
BA_ "GenSigStartValue" SG_ 316 FrntSideRdrLeDetn37RdrDetnAzi 900;
BA_ "GenSigSendType" SG_ 316 FrntSideRdrLeDetn37RdrDetnAzi 0;
BA_ "GenSigSendType" SG_ 316 FrntSideRdrLeDetn37RdrDetnChks 0;
BA_ "GenSigFuncType" SG_ 316 FrntSideRdrLeDetn37RdrDetnChks 15;
BA_ "GenSigDataID" SG_ 316 FrntSideRdrLeDetn37RdrDetnChks "0x858";
BA_ "GenSigSendType" SG_ 316 FrntSideRdrLeDetn37RdrDetnCntr 0;
BA_ "GenSigFuncType" SG_ 316 FrntSideRdrLeDetn37RdrDetnCntr 16;
BA_ "GenSigSendType" SG_ 316 FrntSideRdrLeDetn37RdrDetnConf 0;
BA_ "GenSigStartValue" SG_ 316 FrntSideRdrLeDetn37RdrDetnElevn 15;
BA_ "GenSigSendType" SG_ 316 FrntSideRdrLeDetn37RdrDetnElevn 0;
BA_ "GenSigSendType" SG_ 316 FrntSideRdrLeDetn37RdrDetnPwr 0;
BA_ "GenSigStartValue" SG_ 316 FrntSideRdrLeDetn37RdrDetnRng 10050;
BA_ "GenSigSendType" SG_ 316 FrntSideRdrLeDetn37RdrDetnRng 0;
BA_ "GenSigStartValue" SG_ 316 FrntSideRdrLeDetn37RdrDetnRngV 4000;
BA_ "GenSigSendType" SG_ 316 FrntSideRdrLeDetn37RdrDetnRngV 0;
BA_ "GenSigStartValue" SG_ 316 FrntSideRdrLeDetn37RdrDetnSts 3;
BA_ "GenSigSendType" SG_ 316 FrntSideRdrLeDetn37RdrDetnSts 0;
BA_ "GenSigStartValue" SG_ 316 FrntSideRdrLeDetn38RdrDetnAzi 900;
BA_ "GenSigSendType" SG_ 316 FrntSideRdrLeDetn38RdrDetnAzi 0;
BA_ "GenSigSendType" SG_ 316 FrntSideRdrLeDetn38RdrDetnChks 0;
BA_ "GenSigFuncType" SG_ 316 FrntSideRdrLeDetn38RdrDetnChks 15;
BA_ "GenSigDataID" SG_ 316 FrntSideRdrLeDetn38RdrDetnChks "0x859";
BA_ "GenSigSendType" SG_ 316 FrntSideRdrLeDetn38RdrDetnCntr 0;
BA_ "GenSigFuncType" SG_ 316 FrntSideRdrLeDetn38RdrDetnCntr 16;
BA_ "GenSigSendType" SG_ 316 FrntSideRdrLeDetn38RdrDetnConf 0;
BA_ "GenSigStartValue" SG_ 316 FrntSideRdrLeDetn38RdrDetnElevn 15;
BA_ "GenSigSendType" SG_ 316 FrntSideRdrLeDetn38RdrDetnElevn 0;
BA_ "GenSigSendType" SG_ 316 FrntSideRdrLeDetn38RdrDetnPwr 0;
BA_ "GenSigStartValue" SG_ 316 FrntSideRdrLeDetn38RdrDetnRng 10050;
BA_ "GenSigSendType" SG_ 316 FrntSideRdrLeDetn38RdrDetnRng 0;
BA_ "GenSigStartValue" SG_ 316 FrntSideRdrLeDetn38RdrDetnRngV 4000;
BA_ "GenSigSendType" SG_ 316 FrntSideRdrLeDetn38RdrDetnRngV 0;
BA_ "GenSigStartValue" SG_ 316 FrntSideRdrLeDetn38RdrDetnSts 3;
BA_ "GenSigSendType" SG_ 316 FrntSideRdrLeDetn38RdrDetnSts 0;
BA_ "GenSigStartValue" SG_ 316 FrntSideRdrLeDetn39RdrDetnAzi 900;
BA_ "GenSigSendType" SG_ 316 FrntSideRdrLeDetn39RdrDetnAzi 0;
BA_ "GenSigSendType" SG_ 316 FrntSideRdrLeDetn39RdrDetnChks 0;
BA_ "GenSigFuncType" SG_ 316 FrntSideRdrLeDetn39RdrDetnChks 15;
BA_ "GenSigDataID" SG_ 316 FrntSideRdrLeDetn39RdrDetnChks "0x85A";
BA_ "GenSigSendType" SG_ 316 FrntSideRdrLeDetn39RdrDetnCntr 0;
BA_ "GenSigFuncType" SG_ 316 FrntSideRdrLeDetn39RdrDetnCntr 16;
BA_ "GenSigSendType" SG_ 316 FrntSideRdrLeDetn39RdrDetnConf 0;
BA_ "GenSigStartValue" SG_ 316 FrntSideRdrLeDetn39RdrDetnElevn 15;
BA_ "GenSigSendType" SG_ 316 FrntSideRdrLeDetn39RdrDetnElevn 0;
BA_ "GenSigSendType" SG_ 316 FrntSideRdrLeDetn39RdrDetnPwr 0;
BA_ "GenSigStartValue" SG_ 316 FrntSideRdrLeDetn39RdrDetnRng 10050;
BA_ "GenSigSendType" SG_ 316 FrntSideRdrLeDetn39RdrDetnRng 0;
BA_ "GenSigStartValue" SG_ 316 FrntSideRdrLeDetn39RdrDetnRngV 4000;
BA_ "GenSigSendType" SG_ 316 FrntSideRdrLeDetn39RdrDetnRngV 0;
BA_ "GenSigStartValue" SG_ 316 FrntSideRdrLeDetn39RdrDetnSts 3;
BA_ "GenSigSendType" SG_ 316 FrntSideRdrLeDetn39RdrDetnSts 0;
BA_ "GenSigStartValue" SG_ 316 FrntSideRdrLeDetn40RdrDetnAzi 900;
BA_ "GenSigSendType" SG_ 316 FrntSideRdrLeDetn40RdrDetnAzi 0;
BA_ "GenSigSendType" SG_ 316 FrntSideRdrLeDetn40RdrDetnChks 0;
BA_ "GenSigFuncType" SG_ 316 FrntSideRdrLeDetn40RdrDetnChks 15;
BA_ "GenSigDataID" SG_ 316 FrntSideRdrLeDetn40RdrDetnChks "0x85B";
BA_ "GenSigSendType" SG_ 316 FrntSideRdrLeDetn40RdrDetnCntr 0;
BA_ "GenSigFuncType" SG_ 316 FrntSideRdrLeDetn40RdrDetnCntr 16;
BA_ "GenSigSendType" SG_ 316 FrntSideRdrLeDetn40RdrDetnConf 0;
BA_ "GenSigStartValue" SG_ 316 FrntSideRdrLeDetn40RdrDetnElevn 15;
BA_ "GenSigSendType" SG_ 316 FrntSideRdrLeDetn40RdrDetnElevn 0;
BA_ "GenSigSendType" SG_ 316 FrntSideRdrLeDetn40RdrDetnPwr 0;
BA_ "GenSigStartValue" SG_ 316 FrntSideRdrLeDetn40RdrDetnRng 10050;
BA_ "GenSigSendType" SG_ 316 FrntSideRdrLeDetn40RdrDetnRng 0;
BA_ "GenSigStartValue" SG_ 316 FrntSideRdrLeDetn40RdrDetnRngV 4000;
BA_ "GenSigSendType" SG_ 316 FrntSideRdrLeDetn40RdrDetnRngV 0;
BA_ "GenSigStartValue" SG_ 316 FrntSideRdrLeDetn40RdrDetnSts 3;
BA_ "GenSigSendType" SG_ 316 FrntSideRdrLeDetn40RdrDetnSts 0;
BA_ "GenSigStartValue" SG_ 316 FrntSideRdrLeDetn41RdrDetnAzi 900;
BA_ "GenSigSendType" SG_ 316 FrntSideRdrLeDetn41RdrDetnAzi 0;
BA_ "GenSigSendType" SG_ 316 FrntSideRdrLeDetn41RdrDetnChks 0;
BA_ "GenSigFuncType" SG_ 316 FrntSideRdrLeDetn41RdrDetnChks 15;
BA_ "GenSigDataID" SG_ 316 FrntSideRdrLeDetn41RdrDetnChks "0x85C";
BA_ "GenSigSendType" SG_ 316 FrntSideRdrLeDetn41RdrDetnCntr 0;
BA_ "GenSigFuncType" SG_ 316 FrntSideRdrLeDetn41RdrDetnCntr 16;
BA_ "GenSigSendType" SG_ 316 FrntSideRdrLeDetn41RdrDetnConf 0;
BA_ "GenSigStartValue" SG_ 316 FrntSideRdrLeDetn41RdrDetnElevn 15;
BA_ "GenSigSendType" SG_ 316 FrntSideRdrLeDetn41RdrDetnElevn 0;
BA_ "GenSigSendType" SG_ 316 FrntSideRdrLeDetn41RdrDetnPwr 0;
BA_ "GenSigStartValue" SG_ 316 FrntSideRdrLeDetn41RdrDetnRng 10050;
BA_ "GenSigSendType" SG_ 316 FrntSideRdrLeDetn41RdrDetnRng 0;
BA_ "GenSigStartValue" SG_ 316 FrntSideRdrLeDetn41RdrDetnRngV 4000;
BA_ "GenSigSendType" SG_ 316 FrntSideRdrLeDetn41RdrDetnRngV 0;
BA_ "GenSigStartValue" SG_ 316 FrntSideRdrLeDetn41RdrDetnSts 3;
BA_ "GenSigSendType" SG_ 316 FrntSideRdrLeDetn41RdrDetnSts 0;
BA_ "GenSigStartValue" SG_ 316 FrntSideRdrLeDetn42RdrDetnAzi 900;
BA_ "GenSigSendType" SG_ 316 FrntSideRdrLeDetn42RdrDetnAzi 0;
BA_ "GenSigSendType" SG_ 316 FrntSideRdrLeDetn42RdrDetnChks 0;
BA_ "GenSigFuncType" SG_ 316 FrntSideRdrLeDetn42RdrDetnChks 15;
BA_ "GenSigDataID" SG_ 316 FrntSideRdrLeDetn42RdrDetnChks "0x85D";
BA_ "GenSigSendType" SG_ 316 FrntSideRdrLeDetn42RdrDetnCntr 0;
BA_ "GenSigFuncType" SG_ 316 FrntSideRdrLeDetn42RdrDetnCntr 16;
BA_ "GenSigSendType" SG_ 316 FrntSideRdrLeDetn42RdrDetnConf 0;
BA_ "GenSigStartValue" SG_ 316 FrntSideRdrLeDetn42RdrDetnElevn 15;
BA_ "GenSigSendType" SG_ 316 FrntSideRdrLeDetn42RdrDetnElevn 0;
BA_ "GenSigSendType" SG_ 316 FrntSideRdrLeDetn42RdrDetnPwr 0;
BA_ "GenSigStartValue" SG_ 316 FrntSideRdrLeDetn42RdrDetnRng 10050;
BA_ "GenSigSendType" SG_ 316 FrntSideRdrLeDetn42RdrDetnRng 0;
BA_ "GenSigStartValue" SG_ 316 FrntSideRdrLeDetn42RdrDetnRngV 4000;
BA_ "GenSigSendType" SG_ 316 FrntSideRdrLeDetn42RdrDetnRngV 0;
BA_ "GenSigStartValue" SG_ 316 FrntSideRdrLeDetn42RdrDetnSts 3;
BA_ "GenSigSendType" SG_ 316 FrntSideRdrLeDetn42RdrDetnSts 0;
// Frame: FSRLSafetyCANFD1Frame08
BA_ "VFrameFormat" BO_ 318 14;
BA_ "GenMsgSendType" BO_ 318 0;
BA_ "GenMsgCycleTime" BO_ 318 50.000;
BA_ "GenSigStartValue" SG_ 318 FrntSideRdrLeDetn43RdrDetnAzi 900;
BA_ "GenSigSendType" SG_ 318 FrntSideRdrLeDetn43RdrDetnAzi 0;
BA_ "GenSigSendType" SG_ 318 FrntSideRdrLeDetn43RdrDetnChks 0;
BA_ "GenSigFuncType" SG_ 318 FrntSideRdrLeDetn43RdrDetnChks 15;
BA_ "GenSigDataID" SG_ 318 FrntSideRdrLeDetn43RdrDetnChks "0x85E";
BA_ "GenSigSendType" SG_ 318 FrntSideRdrLeDetn43RdrDetnCntr 0;
BA_ "GenSigFuncType" SG_ 318 FrntSideRdrLeDetn43RdrDetnCntr 16;
BA_ "GenSigSendType" SG_ 318 FrntSideRdrLeDetn43RdrDetnConf 0;
BA_ "GenSigStartValue" SG_ 318 FrntSideRdrLeDetn43RdrDetnElevn 15;
BA_ "GenSigSendType" SG_ 318 FrntSideRdrLeDetn43RdrDetnElevn 0;
BA_ "GenSigSendType" SG_ 318 FrntSideRdrLeDetn43RdrDetnPwr 0;
BA_ "GenSigStartValue" SG_ 318 FrntSideRdrLeDetn43RdrDetnRng 10050;
BA_ "GenSigSendType" SG_ 318 FrntSideRdrLeDetn43RdrDetnRng 0;
BA_ "GenSigStartValue" SG_ 318 FrntSideRdrLeDetn43RdrDetnRngV 4000;
BA_ "GenSigSendType" SG_ 318 FrntSideRdrLeDetn43RdrDetnRngV 0;
BA_ "GenSigStartValue" SG_ 318 FrntSideRdrLeDetn43RdrDetnSts 3;
BA_ "GenSigSendType" SG_ 318 FrntSideRdrLeDetn43RdrDetnSts 0;
BA_ "GenSigStartValue" SG_ 318 FrntSideRdrLeDetn44RdrDetnAzi 900;
BA_ "GenSigSendType" SG_ 318 FrntSideRdrLeDetn44RdrDetnAzi 0;
BA_ "GenSigSendType" SG_ 318 FrntSideRdrLeDetn44RdrDetnChks 0;
BA_ "GenSigFuncType" SG_ 318 FrntSideRdrLeDetn44RdrDetnChks 15;
BA_ "GenSigDataID" SG_ 318 FrntSideRdrLeDetn44RdrDetnChks "0x85F";
BA_ "GenSigSendType" SG_ 318 FrntSideRdrLeDetn44RdrDetnCntr 0;
BA_ "GenSigFuncType" SG_ 318 FrntSideRdrLeDetn44RdrDetnCntr 16;
BA_ "GenSigSendType" SG_ 318 FrntSideRdrLeDetn44RdrDetnConf 0;
BA_ "GenSigStartValue" SG_ 318 FrntSideRdrLeDetn44RdrDetnElevn 15;
BA_ "GenSigSendType" SG_ 318 FrntSideRdrLeDetn44RdrDetnElevn 0;
BA_ "GenSigSendType" SG_ 318 FrntSideRdrLeDetn44RdrDetnPwr 0;
BA_ "GenSigStartValue" SG_ 318 FrntSideRdrLeDetn44RdrDetnRng 10050;
BA_ "GenSigSendType" SG_ 318 FrntSideRdrLeDetn44RdrDetnRng 0;
BA_ "GenSigStartValue" SG_ 318 FrntSideRdrLeDetn44RdrDetnRngV 4000;
BA_ "GenSigSendType" SG_ 318 FrntSideRdrLeDetn44RdrDetnRngV 0;
BA_ "GenSigStartValue" SG_ 318 FrntSideRdrLeDetn44RdrDetnSts 3;
BA_ "GenSigSendType" SG_ 318 FrntSideRdrLeDetn44RdrDetnSts 0;
BA_ "GenSigStartValue" SG_ 318 FrntSideRdrLeDetn45RdrDetnAzi 900;
BA_ "GenSigSendType" SG_ 318 FrntSideRdrLeDetn45RdrDetnAzi 0;
BA_ "GenSigSendType" SG_ 318 FrntSideRdrLeDetn45RdrDetnChks 0;
BA_ "GenSigFuncType" SG_ 318 FrntSideRdrLeDetn45RdrDetnChks 15;
BA_ "GenSigDataID" SG_ 318 FrntSideRdrLeDetn45RdrDetnChks "0x860";
BA_ "GenSigSendType" SG_ 318 FrntSideRdrLeDetn45RdrDetnCntr 0;
BA_ "GenSigFuncType" SG_ 318 FrntSideRdrLeDetn45RdrDetnCntr 16;
BA_ "GenSigSendType" SG_ 318 FrntSideRdrLeDetn45RdrDetnConf 0;
BA_ "GenSigStartValue" SG_ 318 FrntSideRdrLeDetn45RdrDetnElevn 15;
BA_ "GenSigSendType" SG_ 318 FrntSideRdrLeDetn45RdrDetnElevn 0;
BA_ "GenSigSendType" SG_ 318 FrntSideRdrLeDetn45RdrDetnPwr 0;
BA_ "GenSigStartValue" SG_ 318 FrntSideRdrLeDetn45RdrDetnRng 10050;
BA_ "GenSigSendType" SG_ 318 FrntSideRdrLeDetn45RdrDetnRng 0;
BA_ "GenSigStartValue" SG_ 318 FrntSideRdrLeDetn45RdrDetnRngV 4000;
BA_ "GenSigSendType" SG_ 318 FrntSideRdrLeDetn45RdrDetnRngV 0;
BA_ "GenSigStartValue" SG_ 318 FrntSideRdrLeDetn45RdrDetnSts 3;
BA_ "GenSigSendType" SG_ 318 FrntSideRdrLeDetn45RdrDetnSts 0;
BA_ "GenSigStartValue" SG_ 318 FrntSideRdrLeDetn46RdrDetnAzi 900;
BA_ "GenSigSendType" SG_ 318 FrntSideRdrLeDetn46RdrDetnAzi 0;
BA_ "GenSigSendType" SG_ 318 FrntSideRdrLeDetn46RdrDetnChks 0;
BA_ "GenSigFuncType" SG_ 318 FrntSideRdrLeDetn46RdrDetnChks 15;
BA_ "GenSigDataID" SG_ 318 FrntSideRdrLeDetn46RdrDetnChks "0x861";
BA_ "GenSigSendType" SG_ 318 FrntSideRdrLeDetn46RdrDetnCntr 0;
BA_ "GenSigFuncType" SG_ 318 FrntSideRdrLeDetn46RdrDetnCntr 16;
BA_ "GenSigSendType" SG_ 318 FrntSideRdrLeDetn46RdrDetnConf 0;
BA_ "GenSigStartValue" SG_ 318 FrntSideRdrLeDetn46RdrDetnElevn 15;
BA_ "GenSigSendType" SG_ 318 FrntSideRdrLeDetn46RdrDetnElevn 0;
BA_ "GenSigSendType" SG_ 318 FrntSideRdrLeDetn46RdrDetnPwr 0;
BA_ "GenSigStartValue" SG_ 318 FrntSideRdrLeDetn46RdrDetnRng 10050;
BA_ "GenSigSendType" SG_ 318 FrntSideRdrLeDetn46RdrDetnRng 0;
BA_ "GenSigStartValue" SG_ 318 FrntSideRdrLeDetn46RdrDetnRngV 4000;
BA_ "GenSigSendType" SG_ 318 FrntSideRdrLeDetn46RdrDetnRngV 0;
BA_ "GenSigStartValue" SG_ 318 FrntSideRdrLeDetn46RdrDetnSts 3;
BA_ "GenSigSendType" SG_ 318 FrntSideRdrLeDetn46RdrDetnSts 0;
BA_ "GenSigStartValue" SG_ 318 FrntSideRdrLeDetn47RdrDetnAzi 900;
BA_ "GenSigSendType" SG_ 318 FrntSideRdrLeDetn47RdrDetnAzi 0;
BA_ "GenSigSendType" SG_ 318 FrntSideRdrLeDetn47RdrDetnChks 0;
BA_ "GenSigFuncType" SG_ 318 FrntSideRdrLeDetn47RdrDetnChks 15;
BA_ "GenSigDataID" SG_ 318 FrntSideRdrLeDetn47RdrDetnChks "0x862";
BA_ "GenSigSendType" SG_ 318 FrntSideRdrLeDetn47RdrDetnCntr 0;
BA_ "GenSigFuncType" SG_ 318 FrntSideRdrLeDetn47RdrDetnCntr 16;
BA_ "GenSigSendType" SG_ 318 FrntSideRdrLeDetn47RdrDetnConf 0;
BA_ "GenSigStartValue" SG_ 318 FrntSideRdrLeDetn47RdrDetnElevn 15;
BA_ "GenSigSendType" SG_ 318 FrntSideRdrLeDetn47RdrDetnElevn 0;
BA_ "GenSigSendType" SG_ 318 FrntSideRdrLeDetn47RdrDetnPwr 0;
BA_ "GenSigStartValue" SG_ 318 FrntSideRdrLeDetn47RdrDetnRng 10050;
BA_ "GenSigSendType" SG_ 318 FrntSideRdrLeDetn47RdrDetnRng 0;
BA_ "GenSigStartValue" SG_ 318 FrntSideRdrLeDetn47RdrDetnRngV 4000;
BA_ "GenSigSendType" SG_ 318 FrntSideRdrLeDetn47RdrDetnRngV 0;
BA_ "GenSigStartValue" SG_ 318 FrntSideRdrLeDetn47RdrDetnSts 3;
BA_ "GenSigSendType" SG_ 318 FrntSideRdrLeDetn47RdrDetnSts 0;
BA_ "GenSigStartValue" SG_ 318 FrntSideRdrLeDetn48RdrDetnAzi 900;
BA_ "GenSigSendType" SG_ 318 FrntSideRdrLeDetn48RdrDetnAzi 0;
BA_ "GenSigSendType" SG_ 318 FrntSideRdrLeDetn48RdrDetnChks 0;
BA_ "GenSigFuncType" SG_ 318 FrntSideRdrLeDetn48RdrDetnChks 15;
BA_ "GenSigDataID" SG_ 318 FrntSideRdrLeDetn48RdrDetnChks "0x863";
BA_ "GenSigSendType" SG_ 318 FrntSideRdrLeDetn48RdrDetnCntr 0;
BA_ "GenSigFuncType" SG_ 318 FrntSideRdrLeDetn48RdrDetnCntr 16;
BA_ "GenSigSendType" SG_ 318 FrntSideRdrLeDetn48RdrDetnConf 0;
BA_ "GenSigStartValue" SG_ 318 FrntSideRdrLeDetn48RdrDetnElevn 15;
BA_ "GenSigSendType" SG_ 318 FrntSideRdrLeDetn48RdrDetnElevn 0;
BA_ "GenSigSendType" SG_ 318 FrntSideRdrLeDetn48RdrDetnPwr 0;
BA_ "GenSigStartValue" SG_ 318 FrntSideRdrLeDetn48RdrDetnRng 10050;
BA_ "GenSigSendType" SG_ 318 FrntSideRdrLeDetn48RdrDetnRng 0;
BA_ "GenSigStartValue" SG_ 318 FrntSideRdrLeDetn48RdrDetnRngV 4000;
BA_ "GenSigSendType" SG_ 318 FrntSideRdrLeDetn48RdrDetnRngV 0;
BA_ "GenSigStartValue" SG_ 318 FrntSideRdrLeDetn48RdrDetnSts 3;
BA_ "GenSigSendType" SG_ 318 FrntSideRdrLeDetn48RdrDetnSts 0;
// Frame: FSRLSafetyCANFD1Frame09
BA_ "VFrameFormat" BO_ 320 14;
BA_ "GenMsgSendType" BO_ 320 0;
BA_ "GenMsgCycleTime" BO_ 320 50.000;
BA_ "GenSigStartValue" SG_ 320 FrntSideRdrLeDetn49RdrDetnAzi 900;
BA_ "GenSigSendType" SG_ 320 FrntSideRdrLeDetn49RdrDetnAzi 0;
BA_ "GenSigSendType" SG_ 320 FrntSideRdrLeDetn49RdrDetnChks 0;
BA_ "GenSigFuncType" SG_ 320 FrntSideRdrLeDetn49RdrDetnChks 15;
BA_ "GenSigDataID" SG_ 320 FrntSideRdrLeDetn49RdrDetnChks "0x864";
BA_ "GenSigSendType" SG_ 320 FrntSideRdrLeDetn49RdrDetnCntr 0;
BA_ "GenSigFuncType" SG_ 320 FrntSideRdrLeDetn49RdrDetnCntr 16;
BA_ "GenSigSendType" SG_ 320 FrntSideRdrLeDetn49RdrDetnConf 0;
BA_ "GenSigStartValue" SG_ 320 FrntSideRdrLeDetn49RdrDetnElevn 15;
BA_ "GenSigSendType" SG_ 320 FrntSideRdrLeDetn49RdrDetnElevn 0;
BA_ "GenSigSendType" SG_ 320 FrntSideRdrLeDetn49RdrDetnPwr 0;
BA_ "GenSigStartValue" SG_ 320 FrntSideRdrLeDetn49RdrDetnRng 10050;
BA_ "GenSigSendType" SG_ 320 FrntSideRdrLeDetn49RdrDetnRng 0;
BA_ "GenSigStartValue" SG_ 320 FrntSideRdrLeDetn49RdrDetnRngV 4000;
BA_ "GenSigSendType" SG_ 320 FrntSideRdrLeDetn49RdrDetnRngV 0;
BA_ "GenSigStartValue" SG_ 320 FrntSideRdrLeDetn49RdrDetnSts 3;
BA_ "GenSigSendType" SG_ 320 FrntSideRdrLeDetn49RdrDetnSts 0;
BA_ "GenSigStartValue" SG_ 320 FrntSideRdrLeDetn50RdrDetnAzi 900;
BA_ "GenSigSendType" SG_ 320 FrntSideRdrLeDetn50RdrDetnAzi 0;
BA_ "GenSigSendType" SG_ 320 FrntSideRdrLeDetn50RdrDetnChks 0;
BA_ "GenSigFuncType" SG_ 320 FrntSideRdrLeDetn50RdrDetnChks 15;
BA_ "GenSigDataID" SG_ 320 FrntSideRdrLeDetn50RdrDetnChks "0x865";
BA_ "GenSigSendType" SG_ 320 FrntSideRdrLeDetn50RdrDetnCntr 0;
BA_ "GenSigFuncType" SG_ 320 FrntSideRdrLeDetn50RdrDetnCntr 16;
BA_ "GenSigSendType" SG_ 320 FrntSideRdrLeDetn50RdrDetnConf 0;
BA_ "GenSigStartValue" SG_ 320 FrntSideRdrLeDetn50RdrDetnElevn 15;
BA_ "GenSigSendType" SG_ 320 FrntSideRdrLeDetn50RdrDetnElevn 0;
BA_ "GenSigSendType" SG_ 320 FrntSideRdrLeDetn50RdrDetnPwr 0;
BA_ "GenSigStartValue" SG_ 320 FrntSideRdrLeDetn50RdrDetnRng 10050;
BA_ "GenSigSendType" SG_ 320 FrntSideRdrLeDetn50RdrDetnRng 0;
BA_ "GenSigStartValue" SG_ 320 FrntSideRdrLeDetn50RdrDetnRngV 4000;
BA_ "GenSigSendType" SG_ 320 FrntSideRdrLeDetn50RdrDetnRngV 0;
BA_ "GenSigStartValue" SG_ 320 FrntSideRdrLeDetn50RdrDetnSts 3;
BA_ "GenSigSendType" SG_ 320 FrntSideRdrLeDetn50RdrDetnSts 0;
BA_ "GenSigStartValue" SG_ 320 FrntSideRdrLeDetn51RdrDetnAzi 900;
BA_ "GenSigSendType" SG_ 320 FrntSideRdrLeDetn51RdrDetnAzi 0;
BA_ "GenSigSendType" SG_ 320 FrntSideRdrLeDetn51RdrDetnChks 0;
BA_ "GenSigFuncType" SG_ 320 FrntSideRdrLeDetn51RdrDetnChks 15;
BA_ "GenSigDataID" SG_ 320 FrntSideRdrLeDetn51RdrDetnChks "0x866";
BA_ "GenSigSendType" SG_ 320 FrntSideRdrLeDetn51RdrDetnCntr 0;
BA_ "GenSigFuncType" SG_ 320 FrntSideRdrLeDetn51RdrDetnCntr 16;
BA_ "GenSigSendType" SG_ 320 FrntSideRdrLeDetn51RdrDetnConf 0;
BA_ "GenSigStartValue" SG_ 320 FrntSideRdrLeDetn51RdrDetnElevn 15;
BA_ "GenSigSendType" SG_ 320 FrntSideRdrLeDetn51RdrDetnElevn 0;
BA_ "GenSigSendType" SG_ 320 FrntSideRdrLeDetn51RdrDetnPwr 0;
BA_ "GenSigStartValue" SG_ 320 FrntSideRdrLeDetn51RdrDetnRng 10050;
BA_ "GenSigSendType" SG_ 320 FrntSideRdrLeDetn51RdrDetnRng 0;
BA_ "GenSigStartValue" SG_ 320 FrntSideRdrLeDetn51RdrDetnRngV 4000;
BA_ "GenSigSendType" SG_ 320 FrntSideRdrLeDetn51RdrDetnRngV 0;
BA_ "GenSigStartValue" SG_ 320 FrntSideRdrLeDetn51RdrDetnSts 3;
BA_ "GenSigSendType" SG_ 320 FrntSideRdrLeDetn51RdrDetnSts 0;
BA_ "GenSigStartValue" SG_ 320 FrntSideRdrLeDetn52RdrDetnAzi 900;
BA_ "GenSigSendType" SG_ 320 FrntSideRdrLeDetn52RdrDetnAzi 0;
BA_ "GenSigSendType" SG_ 320 FrntSideRdrLeDetn52RdrDetnChks 0;
BA_ "GenSigFuncType" SG_ 320 FrntSideRdrLeDetn52RdrDetnChks 15;
BA_ "GenSigDataID" SG_ 320 FrntSideRdrLeDetn52RdrDetnChks "0x867";
BA_ "GenSigSendType" SG_ 320 FrntSideRdrLeDetn52RdrDetnCntr 0;
BA_ "GenSigFuncType" SG_ 320 FrntSideRdrLeDetn52RdrDetnCntr 16;
BA_ "GenSigSendType" SG_ 320 FrntSideRdrLeDetn52RdrDetnConf 0;
BA_ "GenSigStartValue" SG_ 320 FrntSideRdrLeDetn52RdrDetnElevn 15;
BA_ "GenSigSendType" SG_ 320 FrntSideRdrLeDetn52RdrDetnElevn 0;
BA_ "GenSigSendType" SG_ 320 FrntSideRdrLeDetn52RdrDetnPwr 0;
BA_ "GenSigStartValue" SG_ 320 FrntSideRdrLeDetn52RdrDetnRng 10050;
BA_ "GenSigSendType" SG_ 320 FrntSideRdrLeDetn52RdrDetnRng 0;
BA_ "GenSigStartValue" SG_ 320 FrntSideRdrLeDetn52RdrDetnRngV 4000;
BA_ "GenSigSendType" SG_ 320 FrntSideRdrLeDetn52RdrDetnRngV 0;
BA_ "GenSigStartValue" SG_ 320 FrntSideRdrLeDetn52RdrDetnSts 3;
BA_ "GenSigSendType" SG_ 320 FrntSideRdrLeDetn52RdrDetnSts 0;
BA_ "GenSigStartValue" SG_ 320 FrntSideRdrLeDetn53RdrDetnAzi 900;
BA_ "GenSigSendType" SG_ 320 FrntSideRdrLeDetn53RdrDetnAzi 0;
BA_ "GenSigSendType" SG_ 320 FrntSideRdrLeDetn53RdrDetnChks 0;
BA_ "GenSigFuncType" SG_ 320 FrntSideRdrLeDetn53RdrDetnChks 15;
BA_ "GenSigDataID" SG_ 320 FrntSideRdrLeDetn53RdrDetnChks "0x868";
BA_ "GenSigSendType" SG_ 320 FrntSideRdrLeDetn53RdrDetnCntr 0;
BA_ "GenSigFuncType" SG_ 320 FrntSideRdrLeDetn53RdrDetnCntr 16;
BA_ "GenSigSendType" SG_ 320 FrntSideRdrLeDetn53RdrDetnConf 0;
BA_ "GenSigStartValue" SG_ 320 FrntSideRdrLeDetn53RdrDetnElevn 15;
BA_ "GenSigSendType" SG_ 320 FrntSideRdrLeDetn53RdrDetnElevn 0;
BA_ "GenSigSendType" SG_ 320 FrntSideRdrLeDetn53RdrDetnPwr 0;
BA_ "GenSigStartValue" SG_ 320 FrntSideRdrLeDetn53RdrDetnRng 10050;
BA_ "GenSigSendType" SG_ 320 FrntSideRdrLeDetn53RdrDetnRng 0;
BA_ "GenSigStartValue" SG_ 320 FrntSideRdrLeDetn53RdrDetnRngV 4000;
BA_ "GenSigSendType" SG_ 320 FrntSideRdrLeDetn53RdrDetnRngV 0;
BA_ "GenSigStartValue" SG_ 320 FrntSideRdrLeDetn53RdrDetnSts 3;
BA_ "GenSigSendType" SG_ 320 FrntSideRdrLeDetn53RdrDetnSts 0;
BA_ "GenSigStartValue" SG_ 320 FrntSideRdrLeDetn54RdrDetnAzi 900;
BA_ "GenSigSendType" SG_ 320 FrntSideRdrLeDetn54RdrDetnAzi 0;
BA_ "GenSigSendType" SG_ 320 FrntSideRdrLeDetn54RdrDetnChks 0;
BA_ "GenSigFuncType" SG_ 320 FrntSideRdrLeDetn54RdrDetnChks 15;
BA_ "GenSigDataID" SG_ 320 FrntSideRdrLeDetn54RdrDetnChks "0x869";
BA_ "GenSigSendType" SG_ 320 FrntSideRdrLeDetn54RdrDetnCntr 0;
BA_ "GenSigFuncType" SG_ 320 FrntSideRdrLeDetn54RdrDetnCntr 16;
BA_ "GenSigSendType" SG_ 320 FrntSideRdrLeDetn54RdrDetnConf 0;
BA_ "GenSigStartValue" SG_ 320 FrntSideRdrLeDetn54RdrDetnElevn 15;
BA_ "GenSigSendType" SG_ 320 FrntSideRdrLeDetn54RdrDetnElevn 0;
BA_ "GenSigSendType" SG_ 320 FrntSideRdrLeDetn54RdrDetnPwr 0;
BA_ "GenSigStartValue" SG_ 320 FrntSideRdrLeDetn54RdrDetnRng 10050;
BA_ "GenSigSendType" SG_ 320 FrntSideRdrLeDetn54RdrDetnRng 0;
BA_ "GenSigStartValue" SG_ 320 FrntSideRdrLeDetn54RdrDetnRngV 4000;
BA_ "GenSigSendType" SG_ 320 FrntSideRdrLeDetn54RdrDetnRngV 0;
BA_ "GenSigStartValue" SG_ 320 FrntSideRdrLeDetn54RdrDetnSts 3;
BA_ "GenSigSendType" SG_ 320 FrntSideRdrLeDetn54RdrDetnSts 0;
// Frame: FSRLSafetyCANFD1Frame10
BA_ "VFrameFormat" BO_ 322 14;
BA_ "GenMsgSendType" BO_ 322 0;
BA_ "GenMsgCycleTime" BO_ 322 50.000;
BA_ "GenSigStartValue" SG_ 322 FrntSideRdrLeDetn55RdrDetnAzi 900;
BA_ "GenSigSendType" SG_ 322 FrntSideRdrLeDetn55RdrDetnAzi 0;
BA_ "GenSigSendType" SG_ 322 FrntSideRdrLeDetn55RdrDetnChks 0;
BA_ "GenSigFuncType" SG_ 322 FrntSideRdrLeDetn55RdrDetnChks 15;
BA_ "GenSigDataID" SG_ 322 FrntSideRdrLeDetn55RdrDetnChks "0x86A";
BA_ "GenSigSendType" SG_ 322 FrntSideRdrLeDetn55RdrDetnCntr 0;
BA_ "GenSigFuncType" SG_ 322 FrntSideRdrLeDetn55RdrDetnCntr 16;
BA_ "GenSigSendType" SG_ 322 FrntSideRdrLeDetn55RdrDetnConf 0;
BA_ "GenSigStartValue" SG_ 322 FrntSideRdrLeDetn55RdrDetnElevn 15;
BA_ "GenSigSendType" SG_ 322 FrntSideRdrLeDetn55RdrDetnElevn 0;
BA_ "GenSigSendType" SG_ 322 FrntSideRdrLeDetn55RdrDetnPwr 0;
BA_ "GenSigStartValue" SG_ 322 FrntSideRdrLeDetn55RdrDetnRng 10050;
BA_ "GenSigSendType" SG_ 322 FrntSideRdrLeDetn55RdrDetnRng 0;
BA_ "GenSigStartValue" SG_ 322 FrntSideRdrLeDetn55RdrDetnRngV 4000;
BA_ "GenSigSendType" SG_ 322 FrntSideRdrLeDetn55RdrDetnRngV 0;
BA_ "GenSigStartValue" SG_ 322 FrntSideRdrLeDetn55RdrDetnSts 3;
BA_ "GenSigSendType" SG_ 322 FrntSideRdrLeDetn55RdrDetnSts 0;
BA_ "GenSigStartValue" SG_ 322 FrntSideRdrLeDetn56RdrDetnAzi 900;
BA_ "GenSigSendType" SG_ 322 FrntSideRdrLeDetn56RdrDetnAzi 0;
BA_ "GenSigSendType" SG_ 322 FrntSideRdrLeDetn56RdrDetnChks 0;
BA_ "GenSigFuncType" SG_ 322 FrntSideRdrLeDetn56RdrDetnChks 15;
BA_ "GenSigDataID" SG_ 322 FrntSideRdrLeDetn56RdrDetnChks "0x86B";
BA_ "GenSigSendType" SG_ 322 FrntSideRdrLeDetn56RdrDetnCntr 0;
BA_ "GenSigFuncType" SG_ 322 FrntSideRdrLeDetn56RdrDetnCntr 16;
BA_ "GenSigSendType" SG_ 322 FrntSideRdrLeDetn56RdrDetnConf 0;
BA_ "GenSigStartValue" SG_ 322 FrntSideRdrLeDetn56RdrDetnElevn 15;
BA_ "GenSigSendType" SG_ 322 FrntSideRdrLeDetn56RdrDetnElevn 0;
BA_ "GenSigSendType" SG_ 322 FrntSideRdrLeDetn56RdrDetnPwr 0;
BA_ "GenSigStartValue" SG_ 322 FrntSideRdrLeDetn56RdrDetnRng 10050;
BA_ "GenSigSendType" SG_ 322 FrntSideRdrLeDetn56RdrDetnRng 0;
BA_ "GenSigStartValue" SG_ 322 FrntSideRdrLeDetn56RdrDetnRngV 4000;
BA_ "GenSigSendType" SG_ 322 FrntSideRdrLeDetn56RdrDetnRngV 0;
BA_ "GenSigStartValue" SG_ 322 FrntSideRdrLeDetn56RdrDetnSts 3;
BA_ "GenSigSendType" SG_ 322 FrntSideRdrLeDetn56RdrDetnSts 0;
BA_ "GenSigStartValue" SG_ 322 FrntSideRdrLeDetn57RdrDetnAzi 900;
BA_ "GenSigSendType" SG_ 322 FrntSideRdrLeDetn57RdrDetnAzi 0;
BA_ "GenSigSendType" SG_ 322 FrntSideRdrLeDetn57RdrDetnChks 0;
BA_ "GenSigFuncType" SG_ 322 FrntSideRdrLeDetn57RdrDetnChks 15;
BA_ "GenSigDataID" SG_ 322 FrntSideRdrLeDetn57RdrDetnChks "0x86C";
BA_ "GenSigSendType" SG_ 322 FrntSideRdrLeDetn57RdrDetnCntr 0;
BA_ "GenSigFuncType" SG_ 322 FrntSideRdrLeDetn57RdrDetnCntr 16;
BA_ "GenSigSendType" SG_ 322 FrntSideRdrLeDetn57RdrDetnConf 0;
BA_ "GenSigStartValue" SG_ 322 FrntSideRdrLeDetn57RdrDetnElevn 15;
BA_ "GenSigSendType" SG_ 322 FrntSideRdrLeDetn57RdrDetnElevn 0;
BA_ "GenSigSendType" SG_ 322 FrntSideRdrLeDetn57RdrDetnPwr 0;
BA_ "GenSigStartValue" SG_ 322 FrntSideRdrLeDetn57RdrDetnRng 10050;
BA_ "GenSigSendType" SG_ 322 FrntSideRdrLeDetn57RdrDetnRng 0;
BA_ "GenSigStartValue" SG_ 322 FrntSideRdrLeDetn57RdrDetnRngV 4000;
BA_ "GenSigSendType" SG_ 322 FrntSideRdrLeDetn57RdrDetnRngV 0;
BA_ "GenSigStartValue" SG_ 322 FrntSideRdrLeDetn57RdrDetnSts 3;
BA_ "GenSigSendType" SG_ 322 FrntSideRdrLeDetn57RdrDetnSts 0;
BA_ "GenSigStartValue" SG_ 322 FrntSideRdrLeDetn58RdrDetnAzi 900;
BA_ "GenSigSendType" SG_ 322 FrntSideRdrLeDetn58RdrDetnAzi 0;
BA_ "GenSigSendType" SG_ 322 FrntSideRdrLeDetn58RdrDetnChks 0;
BA_ "GenSigFuncType" SG_ 322 FrntSideRdrLeDetn58RdrDetnChks 15;
BA_ "GenSigDataID" SG_ 322 FrntSideRdrLeDetn58RdrDetnChks "0x86D";
BA_ "GenSigSendType" SG_ 322 FrntSideRdrLeDetn58RdrDetnCntr 0;
BA_ "GenSigFuncType" SG_ 322 FrntSideRdrLeDetn58RdrDetnCntr 16;
BA_ "GenSigSendType" SG_ 322 FrntSideRdrLeDetn58RdrDetnConf 0;
BA_ "GenSigStartValue" SG_ 322 FrntSideRdrLeDetn58RdrDetnElevn 15;
BA_ "GenSigSendType" SG_ 322 FrntSideRdrLeDetn58RdrDetnElevn 0;
BA_ "GenSigSendType" SG_ 322 FrntSideRdrLeDetn58RdrDetnPwr 0;
BA_ "GenSigStartValue" SG_ 322 FrntSideRdrLeDetn58RdrDetnRng 10050;
BA_ "GenSigSendType" SG_ 322 FrntSideRdrLeDetn58RdrDetnRng 0;
BA_ "GenSigStartValue" SG_ 322 FrntSideRdrLeDetn58RdrDetnRngV 4000;
BA_ "GenSigSendType" SG_ 322 FrntSideRdrLeDetn58RdrDetnRngV 0;
BA_ "GenSigStartValue" SG_ 322 FrntSideRdrLeDetn58RdrDetnSts 3;
BA_ "GenSigSendType" SG_ 322 FrntSideRdrLeDetn58RdrDetnSts 0;
BA_ "GenSigStartValue" SG_ 322 FrntSideRdrLeDetn59RdrDetnAzi 900;
BA_ "GenSigSendType" SG_ 322 FrntSideRdrLeDetn59RdrDetnAzi 0;
BA_ "GenSigSendType" SG_ 322 FrntSideRdrLeDetn59RdrDetnChks 0;
BA_ "GenSigFuncType" SG_ 322 FrntSideRdrLeDetn59RdrDetnChks 15;
BA_ "GenSigDataID" SG_ 322 FrntSideRdrLeDetn59RdrDetnChks "0x86E";
BA_ "GenSigSendType" SG_ 322 FrntSideRdrLeDetn59RdrDetnCntr 0;
BA_ "GenSigFuncType" SG_ 322 FrntSideRdrLeDetn59RdrDetnCntr 16;
BA_ "GenSigSendType" SG_ 322 FrntSideRdrLeDetn59RdrDetnConf 0;
BA_ "GenSigStartValue" SG_ 322 FrntSideRdrLeDetn59RdrDetnElevn 15;
BA_ "GenSigSendType" SG_ 322 FrntSideRdrLeDetn59RdrDetnElevn 0;
BA_ "GenSigSendType" SG_ 322 FrntSideRdrLeDetn59RdrDetnPwr 0;
BA_ "GenSigStartValue" SG_ 322 FrntSideRdrLeDetn59RdrDetnRng 10050;
BA_ "GenSigSendType" SG_ 322 FrntSideRdrLeDetn59RdrDetnRng 0;
BA_ "GenSigStartValue" SG_ 322 FrntSideRdrLeDetn59RdrDetnRngV 4000;
BA_ "GenSigSendType" SG_ 322 FrntSideRdrLeDetn59RdrDetnRngV 0;
BA_ "GenSigStartValue" SG_ 322 FrntSideRdrLeDetn59RdrDetnSts 3;
BA_ "GenSigSendType" SG_ 322 FrntSideRdrLeDetn59RdrDetnSts 0;
BA_ "GenSigStartValue" SG_ 322 FrntSideRdrLeDetn60RdrDetnAzi 900;
BA_ "GenSigSendType" SG_ 322 FrntSideRdrLeDetn60RdrDetnAzi 0;
BA_ "GenSigSendType" SG_ 322 FrntSideRdrLeDetn60RdrDetnChks 0;
BA_ "GenSigFuncType" SG_ 322 FrntSideRdrLeDetn60RdrDetnChks 15;
BA_ "GenSigDataID" SG_ 322 FrntSideRdrLeDetn60RdrDetnChks "0x86F";
BA_ "GenSigSendType" SG_ 322 FrntSideRdrLeDetn60RdrDetnCntr 0;
BA_ "GenSigFuncType" SG_ 322 FrntSideRdrLeDetn60RdrDetnCntr 16;
BA_ "GenSigSendType" SG_ 322 FrntSideRdrLeDetn60RdrDetnConf 0;
BA_ "GenSigStartValue" SG_ 322 FrntSideRdrLeDetn60RdrDetnElevn 15;
BA_ "GenSigSendType" SG_ 322 FrntSideRdrLeDetn60RdrDetnElevn 0;
BA_ "GenSigSendType" SG_ 322 FrntSideRdrLeDetn60RdrDetnPwr 0;
BA_ "GenSigStartValue" SG_ 322 FrntSideRdrLeDetn60RdrDetnRng 10050;
BA_ "GenSigSendType" SG_ 322 FrntSideRdrLeDetn60RdrDetnRng 0;
BA_ "GenSigStartValue" SG_ 322 FrntSideRdrLeDetn60RdrDetnRngV 4000;
BA_ "GenSigSendType" SG_ 322 FrntSideRdrLeDetn60RdrDetnRngV 0;
BA_ "GenSigStartValue" SG_ 322 FrntSideRdrLeDetn60RdrDetnSts 3;
BA_ "GenSigSendType" SG_ 322 FrntSideRdrLeDetn60RdrDetnSts 0;
// Frame: FSRLSafetyCANFD1Frame11
BA_ "VFrameFormat" BO_ 324 14;
BA_ "GenMsgSendType" BO_ 324 0;
BA_ "GenMsgCycleTime" BO_ 324 50.000;
BA_ "GenSigStartValue" SG_ 324 FrntSideRdrLeDetn61RdrDetnAzi 900;
BA_ "GenSigSendType" SG_ 324 FrntSideRdrLeDetn61RdrDetnAzi 0;
BA_ "GenSigSendType" SG_ 324 FrntSideRdrLeDetn61RdrDetnChks 0;
BA_ "GenSigFuncType" SG_ 324 FrntSideRdrLeDetn61RdrDetnChks 15;
BA_ "GenSigDataID" SG_ 324 FrntSideRdrLeDetn61RdrDetnChks "0x870";
BA_ "GenSigSendType" SG_ 324 FrntSideRdrLeDetn61RdrDetnCntr 0;
BA_ "GenSigFuncType" SG_ 324 FrntSideRdrLeDetn61RdrDetnCntr 16;
BA_ "GenSigSendType" SG_ 324 FrntSideRdrLeDetn61RdrDetnConf 0;
BA_ "GenSigStartValue" SG_ 324 FrntSideRdrLeDetn61RdrDetnElevn 15;
BA_ "GenSigSendType" SG_ 324 FrntSideRdrLeDetn61RdrDetnElevn 0;
BA_ "GenSigSendType" SG_ 324 FrntSideRdrLeDetn61RdrDetnPwr 0;
BA_ "GenSigStartValue" SG_ 324 FrntSideRdrLeDetn61RdrDetnRng 10050;
BA_ "GenSigSendType" SG_ 324 FrntSideRdrLeDetn61RdrDetnRng 0;
BA_ "GenSigStartValue" SG_ 324 FrntSideRdrLeDetn61RdrDetnRngV 4000;
BA_ "GenSigSendType" SG_ 324 FrntSideRdrLeDetn61RdrDetnRngV 0;
BA_ "GenSigStartValue" SG_ 324 FrntSideRdrLeDetn61RdrDetnSts 3;
BA_ "GenSigSendType" SG_ 324 FrntSideRdrLeDetn61RdrDetnSts 0;
BA_ "GenSigStartValue" SG_ 324 FrntSideRdrLeDetn62RdrDetnAzi 900;
BA_ "GenSigSendType" SG_ 324 FrntSideRdrLeDetn62RdrDetnAzi 0;
BA_ "GenSigSendType" SG_ 324 FrntSideRdrLeDetn62RdrDetnChks 0;
BA_ "GenSigFuncType" SG_ 324 FrntSideRdrLeDetn62RdrDetnChks 15;
BA_ "GenSigDataID" SG_ 324 FrntSideRdrLeDetn62RdrDetnChks "0x871";
BA_ "GenSigSendType" SG_ 324 FrntSideRdrLeDetn62RdrDetnCntr 0;
BA_ "GenSigFuncType" SG_ 324 FrntSideRdrLeDetn62RdrDetnCntr 16;
BA_ "GenSigSendType" SG_ 324 FrntSideRdrLeDetn62RdrDetnConf 0;
BA_ "GenSigStartValue" SG_ 324 FrntSideRdrLeDetn62RdrDetnElevn 15;
BA_ "GenSigSendType" SG_ 324 FrntSideRdrLeDetn62RdrDetnElevn 0;
BA_ "GenSigSendType" SG_ 324 FrntSideRdrLeDetn62RdrDetnPwr 0;
BA_ "GenSigStartValue" SG_ 324 FrntSideRdrLeDetn62RdrDetnRng 10050;
BA_ "GenSigSendType" SG_ 324 FrntSideRdrLeDetn62RdrDetnRng 0;
BA_ "GenSigStartValue" SG_ 324 FrntSideRdrLeDetn62RdrDetnRngV 4000;
BA_ "GenSigSendType" SG_ 324 FrntSideRdrLeDetn62RdrDetnRngV 0;
BA_ "GenSigStartValue" SG_ 324 FrntSideRdrLeDetn62RdrDetnSts 3;
BA_ "GenSigSendType" SG_ 324 FrntSideRdrLeDetn62RdrDetnSts 0;
BA_ "GenSigStartValue" SG_ 324 FrntSideRdrLeDetn63RdrDetnAzi 900;
BA_ "GenSigSendType" SG_ 324 FrntSideRdrLeDetn63RdrDetnAzi 0;
BA_ "GenSigSendType" SG_ 324 FrntSideRdrLeDetn63RdrDetnChks 0;
BA_ "GenSigFuncType" SG_ 324 FrntSideRdrLeDetn63RdrDetnChks 15;
BA_ "GenSigDataID" SG_ 324 FrntSideRdrLeDetn63RdrDetnChks "0x872";
BA_ "GenSigSendType" SG_ 324 FrntSideRdrLeDetn63RdrDetnCntr 0;
BA_ "GenSigFuncType" SG_ 324 FrntSideRdrLeDetn63RdrDetnCntr 16;
BA_ "GenSigSendType" SG_ 324 FrntSideRdrLeDetn63RdrDetnConf 0;
BA_ "GenSigStartValue" SG_ 324 FrntSideRdrLeDetn63RdrDetnElevn 15;
BA_ "GenSigSendType" SG_ 324 FrntSideRdrLeDetn63RdrDetnElevn 0;
BA_ "GenSigSendType" SG_ 324 FrntSideRdrLeDetn63RdrDetnPwr 0;
BA_ "GenSigStartValue" SG_ 324 FrntSideRdrLeDetn63RdrDetnRng 10050;
BA_ "GenSigSendType" SG_ 324 FrntSideRdrLeDetn63RdrDetnRng 0;
BA_ "GenSigStartValue" SG_ 324 FrntSideRdrLeDetn63RdrDetnRngV 4000;
BA_ "GenSigSendType" SG_ 324 FrntSideRdrLeDetn63RdrDetnRngV 0;
BA_ "GenSigStartValue" SG_ 324 FrntSideRdrLeDetn63RdrDetnSts 3;
BA_ "GenSigSendType" SG_ 324 FrntSideRdrLeDetn63RdrDetnSts 0;
BA_ "GenSigStartValue" SG_ 324 FrntSideRdrLeDetn64RdrDetnAzi 900;
BA_ "GenSigSendType" SG_ 324 FrntSideRdrLeDetn64RdrDetnAzi 0;
BA_ "GenSigSendType" SG_ 324 FrntSideRdrLeDetn64RdrDetnChks 0;
BA_ "GenSigFuncType" SG_ 324 FrntSideRdrLeDetn64RdrDetnChks 15;
BA_ "GenSigDataID" SG_ 324 FrntSideRdrLeDetn64RdrDetnChks "0x873";
BA_ "GenSigSendType" SG_ 324 FrntSideRdrLeDetn64RdrDetnCntr 0;
BA_ "GenSigFuncType" SG_ 324 FrntSideRdrLeDetn64RdrDetnCntr 16;
BA_ "GenSigSendType" SG_ 324 FrntSideRdrLeDetn64RdrDetnConf 0;
BA_ "GenSigStartValue" SG_ 324 FrntSideRdrLeDetn64RdrDetnElevn 15;
BA_ "GenSigSendType" SG_ 324 FrntSideRdrLeDetn64RdrDetnElevn 0;
BA_ "GenSigSendType" SG_ 324 FrntSideRdrLeDetn64RdrDetnPwr 0;
BA_ "GenSigStartValue" SG_ 324 FrntSideRdrLeDetn64RdrDetnRng 10050;
BA_ "GenSigSendType" SG_ 324 FrntSideRdrLeDetn64RdrDetnRng 0;
BA_ "GenSigStartValue" SG_ 324 FrntSideRdrLeDetn64RdrDetnRngV 4000;
BA_ "GenSigSendType" SG_ 324 FrntSideRdrLeDetn64RdrDetnRngV 0;
BA_ "GenSigStartValue" SG_ 324 FrntSideRdrLeDetn64RdrDetnSts 3;
BA_ "GenSigSendType" SG_ 324 FrntSideRdrLeDetn64RdrDetnSts 0;
BA_ "GenSigStartValue" SG_ 324 FrntSideRdrLeDetn65RdrDetnAzi 900;
BA_ "GenSigSendType" SG_ 324 FrntSideRdrLeDetn65RdrDetnAzi 0;
BA_ "GenSigSendType" SG_ 324 FrntSideRdrLeDetn65RdrDetnChks 0;
BA_ "GenSigFuncType" SG_ 324 FrntSideRdrLeDetn65RdrDetnChks 15;
BA_ "GenSigDataID" SG_ 324 FrntSideRdrLeDetn65RdrDetnChks "0x874";
BA_ "GenSigSendType" SG_ 324 FrntSideRdrLeDetn65RdrDetnCntr 0;
BA_ "GenSigFuncType" SG_ 324 FrntSideRdrLeDetn65RdrDetnCntr 16;
BA_ "GenSigSendType" SG_ 324 FrntSideRdrLeDetn65RdrDetnConf 0;
BA_ "GenSigStartValue" SG_ 324 FrntSideRdrLeDetn65RdrDetnElevn 15;
BA_ "GenSigSendType" SG_ 324 FrntSideRdrLeDetn65RdrDetnElevn 0;
BA_ "GenSigSendType" SG_ 324 FrntSideRdrLeDetn65RdrDetnPwr 0;
BA_ "GenSigStartValue" SG_ 324 FrntSideRdrLeDetn65RdrDetnRng 10050;
BA_ "GenSigSendType" SG_ 324 FrntSideRdrLeDetn65RdrDetnRng 0;
BA_ "GenSigStartValue" SG_ 324 FrntSideRdrLeDetn65RdrDetnRngV 4000;
BA_ "GenSigSendType" SG_ 324 FrntSideRdrLeDetn65RdrDetnRngV 0;
BA_ "GenSigStartValue" SG_ 324 FrntSideRdrLeDetn65RdrDetnSts 3;
BA_ "GenSigSendType" SG_ 324 FrntSideRdrLeDetn65RdrDetnSts 0;
BA_ "GenSigStartValue" SG_ 324 FrntSideRdrLeDetn66RdrDetnAzi 900;
BA_ "GenSigSendType" SG_ 324 FrntSideRdrLeDetn66RdrDetnAzi 0;
BA_ "GenSigSendType" SG_ 324 FrntSideRdrLeDetn66RdrDetnChks 0;
BA_ "GenSigFuncType" SG_ 324 FrntSideRdrLeDetn66RdrDetnChks 15;
BA_ "GenSigDataID" SG_ 324 FrntSideRdrLeDetn66RdrDetnChks "0x875";
BA_ "GenSigSendType" SG_ 324 FrntSideRdrLeDetn66RdrDetnCntr 0;
BA_ "GenSigFuncType" SG_ 324 FrntSideRdrLeDetn66RdrDetnCntr 16;
BA_ "GenSigSendType" SG_ 324 FrntSideRdrLeDetn66RdrDetnConf 0;
BA_ "GenSigStartValue" SG_ 324 FrntSideRdrLeDetn66RdrDetnElevn 15;
BA_ "GenSigSendType" SG_ 324 FrntSideRdrLeDetn66RdrDetnElevn 0;
BA_ "GenSigSendType" SG_ 324 FrntSideRdrLeDetn66RdrDetnPwr 0;
BA_ "GenSigStartValue" SG_ 324 FrntSideRdrLeDetn66RdrDetnRng 10050;
BA_ "GenSigSendType" SG_ 324 FrntSideRdrLeDetn66RdrDetnRng 0;
BA_ "GenSigStartValue" SG_ 324 FrntSideRdrLeDetn66RdrDetnRngV 4000;
BA_ "GenSigSendType" SG_ 324 FrntSideRdrLeDetn66RdrDetnRngV 0;
BA_ "GenSigStartValue" SG_ 324 FrntSideRdrLeDetn66RdrDetnSts 3;
BA_ "GenSigSendType" SG_ 324 FrntSideRdrLeDetn66RdrDetnSts 0;
// Frame: FSRLSafetyCANFD1Frame12
BA_ "VFrameFormat" BO_ 326 14;
BA_ "GenMsgSendType" BO_ 326 0;
BA_ "GenMsgCycleTime" BO_ 326 50.000;
BA_ "GenSigStartValue" SG_ 326 FrntSideRdrLeDetn67RdrDetnAzi 900;
BA_ "GenSigSendType" SG_ 326 FrntSideRdrLeDetn67RdrDetnAzi 0;
BA_ "GenSigSendType" SG_ 326 FrntSideRdrLeDetn67RdrDetnChks 0;
BA_ "GenSigFuncType" SG_ 326 FrntSideRdrLeDetn67RdrDetnChks 15;
BA_ "GenSigDataID" SG_ 326 FrntSideRdrLeDetn67RdrDetnChks "0x876";
BA_ "GenSigSendType" SG_ 326 FrntSideRdrLeDetn67RdrDetnCntr 0;
BA_ "GenSigFuncType" SG_ 326 FrntSideRdrLeDetn67RdrDetnCntr 16;
BA_ "GenSigSendType" SG_ 326 FrntSideRdrLeDetn67RdrDetnConf 0;
BA_ "GenSigStartValue" SG_ 326 FrntSideRdrLeDetn67RdrDetnElevn 15;
BA_ "GenSigSendType" SG_ 326 FrntSideRdrLeDetn67RdrDetnElevn 0;
BA_ "GenSigSendType" SG_ 326 FrntSideRdrLeDetn67RdrDetnPwr 0;
BA_ "GenSigStartValue" SG_ 326 FrntSideRdrLeDetn67RdrDetnRng 10050;
BA_ "GenSigSendType" SG_ 326 FrntSideRdrLeDetn67RdrDetnRng 0;
BA_ "GenSigStartValue" SG_ 326 FrntSideRdrLeDetn67RdrDetnRngV 4000;
BA_ "GenSigSendType" SG_ 326 FrntSideRdrLeDetn67RdrDetnRngV 0;
BA_ "GenSigStartValue" SG_ 326 FrntSideRdrLeDetn67RdrDetnSts 3;
BA_ "GenSigSendType" SG_ 326 FrntSideRdrLeDetn67RdrDetnSts 0;
BA_ "GenSigStartValue" SG_ 326 FrntSideRdrLeDetn68RdrDetnAzi 900;
BA_ "GenSigSendType" SG_ 326 FrntSideRdrLeDetn68RdrDetnAzi 0;
BA_ "GenSigSendType" SG_ 326 FrntSideRdrLeDetn68RdrDetnChks 0;
BA_ "GenSigFuncType" SG_ 326 FrntSideRdrLeDetn68RdrDetnChks 15;
BA_ "GenSigDataID" SG_ 326 FrntSideRdrLeDetn68RdrDetnChks "0x877";
BA_ "GenSigSendType" SG_ 326 FrntSideRdrLeDetn68RdrDetnCntr 0;
BA_ "GenSigFuncType" SG_ 326 FrntSideRdrLeDetn68RdrDetnCntr 16;
BA_ "GenSigSendType" SG_ 326 FrntSideRdrLeDetn68RdrDetnConf 0;
BA_ "GenSigStartValue" SG_ 326 FrntSideRdrLeDetn68RdrDetnElevn 15;
BA_ "GenSigSendType" SG_ 326 FrntSideRdrLeDetn68RdrDetnElevn 0;
BA_ "GenSigSendType" SG_ 326 FrntSideRdrLeDetn68RdrDetnPwr 0;
BA_ "GenSigStartValue" SG_ 326 FrntSideRdrLeDetn68RdrDetnRng 10050;
BA_ "GenSigSendType" SG_ 326 FrntSideRdrLeDetn68RdrDetnRng 0;
BA_ "GenSigStartValue" SG_ 326 FrntSideRdrLeDetn68RdrDetnRngV 4000;
BA_ "GenSigSendType" SG_ 326 FrntSideRdrLeDetn68RdrDetnRngV 0;
BA_ "GenSigStartValue" SG_ 326 FrntSideRdrLeDetn68RdrDetnSts 3;
BA_ "GenSigSendType" SG_ 326 FrntSideRdrLeDetn68RdrDetnSts 0;
BA_ "GenSigStartValue" SG_ 326 FrntSideRdrLeDetn69RdrDetnAzi 900;
BA_ "GenSigSendType" SG_ 326 FrntSideRdrLeDetn69RdrDetnAzi 0;
BA_ "GenSigSendType" SG_ 326 FrntSideRdrLeDetn69RdrDetnChks 0;
BA_ "GenSigFuncType" SG_ 326 FrntSideRdrLeDetn69RdrDetnChks 15;
BA_ "GenSigDataID" SG_ 326 FrntSideRdrLeDetn69RdrDetnChks "0x878";
BA_ "GenSigSendType" SG_ 326 FrntSideRdrLeDetn69RdrDetnCntr 0;
BA_ "GenSigFuncType" SG_ 326 FrntSideRdrLeDetn69RdrDetnCntr 16;
BA_ "GenSigSendType" SG_ 326 FrntSideRdrLeDetn69RdrDetnConf 0;
BA_ "GenSigStartValue" SG_ 326 FrntSideRdrLeDetn69RdrDetnElevn 15;
BA_ "GenSigSendType" SG_ 326 FrntSideRdrLeDetn69RdrDetnElevn 0;
BA_ "GenSigSendType" SG_ 326 FrntSideRdrLeDetn69RdrDetnPwr 0;
BA_ "GenSigStartValue" SG_ 326 FrntSideRdrLeDetn69RdrDetnRng 10050;
BA_ "GenSigSendType" SG_ 326 FrntSideRdrLeDetn69RdrDetnRng 0;
BA_ "GenSigStartValue" SG_ 326 FrntSideRdrLeDetn69RdrDetnRngV 4000;
BA_ "GenSigSendType" SG_ 326 FrntSideRdrLeDetn69RdrDetnRngV 0;
BA_ "GenSigStartValue" SG_ 326 FrntSideRdrLeDetn69RdrDetnSts 3;
BA_ "GenSigSendType" SG_ 326 FrntSideRdrLeDetn69RdrDetnSts 0;
BA_ "GenSigStartValue" SG_ 326 FrntSideRdrLeDetn70RdrDetnAzi 900;
BA_ "GenSigSendType" SG_ 326 FrntSideRdrLeDetn70RdrDetnAzi 0;
BA_ "GenSigSendType" SG_ 326 FrntSideRdrLeDetn70RdrDetnChks 0;
BA_ "GenSigFuncType" SG_ 326 FrntSideRdrLeDetn70RdrDetnChks 15;
BA_ "GenSigDataID" SG_ 326 FrntSideRdrLeDetn70RdrDetnChks "0x879";
BA_ "GenSigSendType" SG_ 326 FrntSideRdrLeDetn70RdrDetnCntr 0;
BA_ "GenSigFuncType" SG_ 326 FrntSideRdrLeDetn70RdrDetnCntr 16;
BA_ "GenSigSendType" SG_ 326 FrntSideRdrLeDetn70RdrDetnConf 0;
BA_ "GenSigStartValue" SG_ 326 FrntSideRdrLeDetn70RdrDetnElevn 15;
BA_ "GenSigSendType" SG_ 326 FrntSideRdrLeDetn70RdrDetnElevn 0;
BA_ "GenSigSendType" SG_ 326 FrntSideRdrLeDetn70RdrDetnPwr 0;
BA_ "GenSigStartValue" SG_ 326 FrntSideRdrLeDetn70RdrDetnRng 10050;
BA_ "GenSigSendType" SG_ 326 FrntSideRdrLeDetn70RdrDetnRng 0;
BA_ "GenSigStartValue" SG_ 326 FrntSideRdrLeDetn70RdrDetnRngV 4000;
BA_ "GenSigSendType" SG_ 326 FrntSideRdrLeDetn70RdrDetnRngV 0;
BA_ "GenSigStartValue" SG_ 326 FrntSideRdrLeDetn70RdrDetnSts 3;
BA_ "GenSigSendType" SG_ 326 FrntSideRdrLeDetn70RdrDetnSts 0;
BA_ "GenSigStartValue" SG_ 326 FrntSideRdrLeDetn71RdrDetnAzi 900;
BA_ "GenSigSendType" SG_ 326 FrntSideRdrLeDetn71RdrDetnAzi 0;
BA_ "GenSigSendType" SG_ 326 FrntSideRdrLeDetn71RdrDetnChks 0;
BA_ "GenSigFuncType" SG_ 326 FrntSideRdrLeDetn71RdrDetnChks 15;
BA_ "GenSigDataID" SG_ 326 FrntSideRdrLeDetn71RdrDetnChks "0x87A";
BA_ "GenSigSendType" SG_ 326 FrntSideRdrLeDetn71RdrDetnCntr 0;
BA_ "GenSigFuncType" SG_ 326 FrntSideRdrLeDetn71RdrDetnCntr 16;
BA_ "GenSigSendType" SG_ 326 FrntSideRdrLeDetn71RdrDetnConf 0;
BA_ "GenSigStartValue" SG_ 326 FrntSideRdrLeDetn71RdrDetnElevn 15;
BA_ "GenSigSendType" SG_ 326 FrntSideRdrLeDetn71RdrDetnElevn 0;
BA_ "GenSigSendType" SG_ 326 FrntSideRdrLeDetn71RdrDetnPwr 0;
BA_ "GenSigStartValue" SG_ 326 FrntSideRdrLeDetn71RdrDetnRng 10050;
BA_ "GenSigSendType" SG_ 326 FrntSideRdrLeDetn71RdrDetnRng 0;
BA_ "GenSigStartValue" SG_ 326 FrntSideRdrLeDetn71RdrDetnRngV 4000;
BA_ "GenSigSendType" SG_ 326 FrntSideRdrLeDetn71RdrDetnRngV 0;
BA_ "GenSigStartValue" SG_ 326 FrntSideRdrLeDetn71RdrDetnSts 3;
BA_ "GenSigSendType" SG_ 326 FrntSideRdrLeDetn71RdrDetnSts 0;
BA_ "GenSigStartValue" SG_ 326 FrntSideRdrLeDetn72RdrDetnAzi 900;
BA_ "GenSigSendType" SG_ 326 FrntSideRdrLeDetn72RdrDetnAzi 0;
BA_ "GenSigSendType" SG_ 326 FrntSideRdrLeDetn72RdrDetnChks 0;
BA_ "GenSigFuncType" SG_ 326 FrntSideRdrLeDetn72RdrDetnChks 15;
BA_ "GenSigDataID" SG_ 326 FrntSideRdrLeDetn72RdrDetnChks "0x87B";
BA_ "GenSigSendType" SG_ 326 FrntSideRdrLeDetn72RdrDetnCntr 0;
BA_ "GenSigFuncType" SG_ 326 FrntSideRdrLeDetn72RdrDetnCntr 16;
BA_ "GenSigSendType" SG_ 326 FrntSideRdrLeDetn72RdrDetnConf 0;
BA_ "GenSigStartValue" SG_ 326 FrntSideRdrLeDetn72RdrDetnElevn 15;
BA_ "GenSigSendType" SG_ 326 FrntSideRdrLeDetn72RdrDetnElevn 0;
BA_ "GenSigSendType" SG_ 326 FrntSideRdrLeDetn72RdrDetnPwr 0;
BA_ "GenSigStartValue" SG_ 326 FrntSideRdrLeDetn72RdrDetnRng 10050;
BA_ "GenSigSendType" SG_ 326 FrntSideRdrLeDetn72RdrDetnRng 0;
BA_ "GenSigStartValue" SG_ 326 FrntSideRdrLeDetn72RdrDetnRngV 4000;
BA_ "GenSigSendType" SG_ 326 FrntSideRdrLeDetn72RdrDetnRngV 0;
BA_ "GenSigStartValue" SG_ 326 FrntSideRdrLeDetn72RdrDetnSts 3;
BA_ "GenSigSendType" SG_ 326 FrntSideRdrLeDetn72RdrDetnSts 0;
// Frame: FSRLSafetyCANFD1Frame13
BA_ "VFrameFormat" BO_ 328 14;
BA_ "GenMsgSendType" BO_ 328 0;
BA_ "GenMsgCycleTime" BO_ 328 50.000;
BA_ "GenSigStartValue" SG_ 328 FrntSideRdrLeDetn73RdrDetnAzi 900;
BA_ "GenSigSendType" SG_ 328 FrntSideRdrLeDetn73RdrDetnAzi 0;
BA_ "GenSigSendType" SG_ 328 FrntSideRdrLeDetn73RdrDetnChks 0;
BA_ "GenSigFuncType" SG_ 328 FrntSideRdrLeDetn73RdrDetnChks 15;
BA_ "GenSigDataID" SG_ 328 FrntSideRdrLeDetn73RdrDetnChks "0x87C";
BA_ "GenSigSendType" SG_ 328 FrntSideRdrLeDetn73RdrDetnCntr 0;
BA_ "GenSigFuncType" SG_ 328 FrntSideRdrLeDetn73RdrDetnCntr 16;
BA_ "GenSigSendType" SG_ 328 FrntSideRdrLeDetn73RdrDetnConf 0;
BA_ "GenSigStartValue" SG_ 328 FrntSideRdrLeDetn73RdrDetnElevn 15;
BA_ "GenSigSendType" SG_ 328 FrntSideRdrLeDetn73RdrDetnElevn 0;
BA_ "GenSigSendType" SG_ 328 FrntSideRdrLeDetn73RdrDetnPwr 0;
BA_ "GenSigStartValue" SG_ 328 FrntSideRdrLeDetn73RdrDetnRng 10050;
BA_ "GenSigSendType" SG_ 328 FrntSideRdrLeDetn73RdrDetnRng 0;
BA_ "GenSigStartValue" SG_ 328 FrntSideRdrLeDetn73RdrDetnRngV 4000;
BA_ "GenSigSendType" SG_ 328 FrntSideRdrLeDetn73RdrDetnRngV 0;
BA_ "GenSigStartValue" SG_ 328 FrntSideRdrLeDetn73RdrDetnSts 3;
BA_ "GenSigSendType" SG_ 328 FrntSideRdrLeDetn73RdrDetnSts 0;
BA_ "GenSigStartValue" SG_ 328 FrntSideRdrLeDetn74RdrDetnAzi 900;
BA_ "GenSigSendType" SG_ 328 FrntSideRdrLeDetn74RdrDetnAzi 0;
BA_ "GenSigSendType" SG_ 328 FrntSideRdrLeDetn74RdrDetnChks 0;
BA_ "GenSigFuncType" SG_ 328 FrntSideRdrLeDetn74RdrDetnChks 15;
BA_ "GenSigDataID" SG_ 328 FrntSideRdrLeDetn74RdrDetnChks "0x87D";
BA_ "GenSigSendType" SG_ 328 FrntSideRdrLeDetn74RdrDetnCntr 0;
BA_ "GenSigFuncType" SG_ 328 FrntSideRdrLeDetn74RdrDetnCntr 16;
BA_ "GenSigSendType" SG_ 328 FrntSideRdrLeDetn74RdrDetnConf 0;
BA_ "GenSigStartValue" SG_ 328 FrntSideRdrLeDetn74RdrDetnElevn 15;
BA_ "GenSigSendType" SG_ 328 FrntSideRdrLeDetn74RdrDetnElevn 0;
BA_ "GenSigSendType" SG_ 328 FrntSideRdrLeDetn74RdrDetnPwr 0;
BA_ "GenSigStartValue" SG_ 328 FrntSideRdrLeDetn74RdrDetnRng 10050;
BA_ "GenSigSendType" SG_ 328 FrntSideRdrLeDetn74RdrDetnRng 0;
BA_ "GenSigStartValue" SG_ 328 FrntSideRdrLeDetn74RdrDetnRngV 4000;
BA_ "GenSigSendType" SG_ 328 FrntSideRdrLeDetn74RdrDetnRngV 0;
BA_ "GenSigStartValue" SG_ 328 FrntSideRdrLeDetn74RdrDetnSts 3;
BA_ "GenSigSendType" SG_ 328 FrntSideRdrLeDetn74RdrDetnSts 0;
BA_ "GenSigStartValue" SG_ 328 FrntSideRdrLeDetn75RdrDetnAzi 900;
BA_ "GenSigSendType" SG_ 328 FrntSideRdrLeDetn75RdrDetnAzi 0;
BA_ "GenSigSendType" SG_ 328 FrntSideRdrLeDetn75RdrDetnChks 0;
BA_ "GenSigFuncType" SG_ 328 FrntSideRdrLeDetn75RdrDetnChks 15;
BA_ "GenSigDataID" SG_ 328 FrntSideRdrLeDetn75RdrDetnChks "0x87E";
BA_ "GenSigSendType" SG_ 328 FrntSideRdrLeDetn75RdrDetnCntr 0;
BA_ "GenSigFuncType" SG_ 328 FrntSideRdrLeDetn75RdrDetnCntr 16;
BA_ "GenSigSendType" SG_ 328 FrntSideRdrLeDetn75RdrDetnConf 0;
BA_ "GenSigStartValue" SG_ 328 FrntSideRdrLeDetn75RdrDetnElevn 15;
BA_ "GenSigSendType" SG_ 328 FrntSideRdrLeDetn75RdrDetnElevn 0;
BA_ "GenSigSendType" SG_ 328 FrntSideRdrLeDetn75RdrDetnPwr 0;
BA_ "GenSigStartValue" SG_ 328 FrntSideRdrLeDetn75RdrDetnRng 10050;
BA_ "GenSigSendType" SG_ 328 FrntSideRdrLeDetn75RdrDetnRng 0;
BA_ "GenSigStartValue" SG_ 328 FrntSideRdrLeDetn75RdrDetnRngV 4000;
BA_ "GenSigSendType" SG_ 328 FrntSideRdrLeDetn75RdrDetnRngV 0;
BA_ "GenSigStartValue" SG_ 328 FrntSideRdrLeDetn75RdrDetnSts 3;
BA_ "GenSigSendType" SG_ 328 FrntSideRdrLeDetn75RdrDetnSts 0;
BA_ "GenSigStartValue" SG_ 328 FrntSideRdrLeDetn76RdrDetnAzi 900;
BA_ "GenSigSendType" SG_ 328 FrntSideRdrLeDetn76RdrDetnAzi 0;
BA_ "GenSigSendType" SG_ 328 FrntSideRdrLeDetn76RdrDetnChks 0;
BA_ "GenSigFuncType" SG_ 328 FrntSideRdrLeDetn76RdrDetnChks 15;
BA_ "GenSigDataID" SG_ 328 FrntSideRdrLeDetn76RdrDetnChks "0x87F";
BA_ "GenSigSendType" SG_ 328 FrntSideRdrLeDetn76RdrDetnCntr 0;
BA_ "GenSigFuncType" SG_ 328 FrntSideRdrLeDetn76RdrDetnCntr 16;
BA_ "GenSigSendType" SG_ 328 FrntSideRdrLeDetn76RdrDetnConf 0;
BA_ "GenSigStartValue" SG_ 328 FrntSideRdrLeDetn76RdrDetnElevn 15;
BA_ "GenSigSendType" SG_ 328 FrntSideRdrLeDetn76RdrDetnElevn 0;
BA_ "GenSigSendType" SG_ 328 FrntSideRdrLeDetn76RdrDetnPwr 0;
BA_ "GenSigStartValue" SG_ 328 FrntSideRdrLeDetn76RdrDetnRng 10050;
BA_ "GenSigSendType" SG_ 328 FrntSideRdrLeDetn76RdrDetnRng 0;
BA_ "GenSigStartValue" SG_ 328 FrntSideRdrLeDetn76RdrDetnRngV 4000;
BA_ "GenSigSendType" SG_ 328 FrntSideRdrLeDetn76RdrDetnRngV 0;
BA_ "GenSigStartValue" SG_ 328 FrntSideRdrLeDetn76RdrDetnSts 3;
BA_ "GenSigSendType" SG_ 328 FrntSideRdrLeDetn76RdrDetnSts 0;
BA_ "GenSigStartValue" SG_ 328 FrntSideRdrLeDetn77RdrDetnAzi 900;
BA_ "GenSigSendType" SG_ 328 FrntSideRdrLeDetn77RdrDetnAzi 0;
BA_ "GenSigSendType" SG_ 328 FrntSideRdrLeDetn77RdrDetnChks 0;
BA_ "GenSigFuncType" SG_ 328 FrntSideRdrLeDetn77RdrDetnChks 15;
BA_ "GenSigDataID" SG_ 328 FrntSideRdrLeDetn77RdrDetnChks "0x880";
BA_ "GenSigSendType" SG_ 328 FrntSideRdrLeDetn77RdrDetnCntr 0;
BA_ "GenSigFuncType" SG_ 328 FrntSideRdrLeDetn77RdrDetnCntr 16;
BA_ "GenSigSendType" SG_ 328 FrntSideRdrLeDetn77RdrDetnConf 0;
BA_ "GenSigStartValue" SG_ 328 FrntSideRdrLeDetn77RdrDetnElevn 15;
BA_ "GenSigSendType" SG_ 328 FrntSideRdrLeDetn77RdrDetnElevn 0;
BA_ "GenSigSendType" SG_ 328 FrntSideRdrLeDetn77RdrDetnPwr 0;
BA_ "GenSigStartValue" SG_ 328 FrntSideRdrLeDetn77RdrDetnRng 10050;
BA_ "GenSigSendType" SG_ 328 FrntSideRdrLeDetn77RdrDetnRng 0;
BA_ "GenSigStartValue" SG_ 328 FrntSideRdrLeDetn77RdrDetnRngV 4000;
BA_ "GenSigSendType" SG_ 328 FrntSideRdrLeDetn77RdrDetnRngV 0;
BA_ "GenSigStartValue" SG_ 328 FrntSideRdrLeDetn77RdrDetnSts 3;
BA_ "GenSigSendType" SG_ 328 FrntSideRdrLeDetn77RdrDetnSts 0;
BA_ "GenSigStartValue" SG_ 328 FrntSideRdrLeDetn78RdrDetnAzi 900;
BA_ "GenSigSendType" SG_ 328 FrntSideRdrLeDetn78RdrDetnAzi 0;
BA_ "GenSigSendType" SG_ 328 FrntSideRdrLeDetn78RdrDetnChks 0;
BA_ "GenSigFuncType" SG_ 328 FrntSideRdrLeDetn78RdrDetnChks 15;
BA_ "GenSigDataID" SG_ 328 FrntSideRdrLeDetn78RdrDetnChks "0x881";
BA_ "GenSigSendType" SG_ 328 FrntSideRdrLeDetn78RdrDetnCntr 0;
BA_ "GenSigFuncType" SG_ 328 FrntSideRdrLeDetn78RdrDetnCntr 16;
BA_ "GenSigSendType" SG_ 328 FrntSideRdrLeDetn78RdrDetnConf 0;
BA_ "GenSigStartValue" SG_ 328 FrntSideRdrLeDetn78RdrDetnElevn 15;
BA_ "GenSigSendType" SG_ 328 FrntSideRdrLeDetn78RdrDetnElevn 0;
BA_ "GenSigSendType" SG_ 328 FrntSideRdrLeDetn78RdrDetnPwr 0;
BA_ "GenSigStartValue" SG_ 328 FrntSideRdrLeDetn78RdrDetnRng 10050;
BA_ "GenSigSendType" SG_ 328 FrntSideRdrLeDetn78RdrDetnRng 0;
BA_ "GenSigStartValue" SG_ 328 FrntSideRdrLeDetn78RdrDetnRngV 4000;
BA_ "GenSigSendType" SG_ 328 FrntSideRdrLeDetn78RdrDetnRngV 0;
BA_ "GenSigStartValue" SG_ 328 FrntSideRdrLeDetn78RdrDetnSts 3;
BA_ "GenSigSendType" SG_ 328 FrntSideRdrLeDetn78RdrDetnSts 0;
// Frame: FSRLSafetyCANFD1Frame14
BA_ "VFrameFormat" BO_ 330 14;
BA_ "GenMsgSendType" BO_ 330 0;
BA_ "GenMsgCycleTime" BO_ 330 50.000;
BA_ "GenSigStartValue" SG_ 330 FrntSideRdrLeDetn79RdrDetnAzi 900;
BA_ "GenSigSendType" SG_ 330 FrntSideRdrLeDetn79RdrDetnAzi 0;
BA_ "GenSigSendType" SG_ 330 FrntSideRdrLeDetn79RdrDetnChks 0;
BA_ "GenSigFuncType" SG_ 330 FrntSideRdrLeDetn79RdrDetnChks 15;
BA_ "GenSigDataID" SG_ 330 FrntSideRdrLeDetn79RdrDetnChks "0x882";
BA_ "GenSigSendType" SG_ 330 FrntSideRdrLeDetn79RdrDetnCntr 0;
BA_ "GenSigFuncType" SG_ 330 FrntSideRdrLeDetn79RdrDetnCntr 16;
BA_ "GenSigSendType" SG_ 330 FrntSideRdrLeDetn79RdrDetnConf 0;
BA_ "GenSigStartValue" SG_ 330 FrntSideRdrLeDetn79RdrDetnElevn 15;
BA_ "GenSigSendType" SG_ 330 FrntSideRdrLeDetn79RdrDetnElevn 0;
BA_ "GenSigSendType" SG_ 330 FrntSideRdrLeDetn79RdrDetnPwr 0;
BA_ "GenSigStartValue" SG_ 330 FrntSideRdrLeDetn79RdrDetnRng 10050;
BA_ "GenSigSendType" SG_ 330 FrntSideRdrLeDetn79RdrDetnRng 0;
BA_ "GenSigStartValue" SG_ 330 FrntSideRdrLeDetn79RdrDetnRngV 4000;
BA_ "GenSigSendType" SG_ 330 FrntSideRdrLeDetn79RdrDetnRngV 0;
BA_ "GenSigStartValue" SG_ 330 FrntSideRdrLeDetn79RdrDetnSts 3;
BA_ "GenSigSendType" SG_ 330 FrntSideRdrLeDetn79RdrDetnSts 0;
BA_ "GenSigStartValue" SG_ 330 FrntSideRdrLeDetn80RdrDetnAzi 900;
BA_ "GenSigSendType" SG_ 330 FrntSideRdrLeDetn80RdrDetnAzi 0;
BA_ "GenSigSendType" SG_ 330 FrntSideRdrLeDetn80RdrDetnChks 0;
BA_ "GenSigFuncType" SG_ 330 FrntSideRdrLeDetn80RdrDetnChks 15;
BA_ "GenSigDataID" SG_ 330 FrntSideRdrLeDetn80RdrDetnChks "0x883";
BA_ "GenSigSendType" SG_ 330 FrntSideRdrLeDetn80RdrDetnCntr 0;
BA_ "GenSigFuncType" SG_ 330 FrntSideRdrLeDetn80RdrDetnCntr 16;
BA_ "GenSigSendType" SG_ 330 FrntSideRdrLeDetn80RdrDetnConf 0;
BA_ "GenSigStartValue" SG_ 330 FrntSideRdrLeDetn80RdrDetnElevn 15;
BA_ "GenSigSendType" SG_ 330 FrntSideRdrLeDetn80RdrDetnElevn 0;
BA_ "GenSigSendType" SG_ 330 FrntSideRdrLeDetn80RdrDetnPwr 0;
BA_ "GenSigStartValue" SG_ 330 FrntSideRdrLeDetn80RdrDetnRng 10050;
BA_ "GenSigSendType" SG_ 330 FrntSideRdrLeDetn80RdrDetnRng 0;
BA_ "GenSigStartValue" SG_ 330 FrntSideRdrLeDetn80RdrDetnRngV 4000;
BA_ "GenSigSendType" SG_ 330 FrntSideRdrLeDetn80RdrDetnRngV 0;
BA_ "GenSigStartValue" SG_ 330 FrntSideRdrLeDetn80RdrDetnSts 3;
BA_ "GenSigSendType" SG_ 330 FrntSideRdrLeDetn80RdrDetnSts 0;
BA_ "GenSigStartValue" SG_ 330 FrntSideRdrLeDetn81RdrDetnAzi 900;
BA_ "GenSigSendType" SG_ 330 FrntSideRdrLeDetn81RdrDetnAzi 0;
BA_ "GenSigSendType" SG_ 330 FrntSideRdrLeDetn81RdrDetnChks 0;
BA_ "GenSigFuncType" SG_ 330 FrntSideRdrLeDetn81RdrDetnChks 15;
BA_ "GenSigDataID" SG_ 330 FrntSideRdrLeDetn81RdrDetnChks "0x884";
BA_ "GenSigSendType" SG_ 330 FrntSideRdrLeDetn81RdrDetnCntr 0;
BA_ "GenSigFuncType" SG_ 330 FrntSideRdrLeDetn81RdrDetnCntr 16;
BA_ "GenSigSendType" SG_ 330 FrntSideRdrLeDetn81RdrDetnConf 0;
BA_ "GenSigStartValue" SG_ 330 FrntSideRdrLeDetn81RdrDetnElevn 15;
BA_ "GenSigSendType" SG_ 330 FrntSideRdrLeDetn81RdrDetnElevn 0;
BA_ "GenSigSendType" SG_ 330 FrntSideRdrLeDetn81RdrDetnPwr 0;
BA_ "GenSigStartValue" SG_ 330 FrntSideRdrLeDetn81RdrDetnRng 10050;
BA_ "GenSigSendType" SG_ 330 FrntSideRdrLeDetn81RdrDetnRng 0;
BA_ "GenSigStartValue" SG_ 330 FrntSideRdrLeDetn81RdrDetnRngV 4000;
BA_ "GenSigSendType" SG_ 330 FrntSideRdrLeDetn81RdrDetnRngV 0;
BA_ "GenSigStartValue" SG_ 330 FrntSideRdrLeDetn81RdrDetnSts 3;
BA_ "GenSigSendType" SG_ 330 FrntSideRdrLeDetn81RdrDetnSts 0;
BA_ "GenSigStartValue" SG_ 330 FrntSideRdrLeDetn82RdrDetnAzi 900;
BA_ "GenSigSendType" SG_ 330 FrntSideRdrLeDetn82RdrDetnAzi 0;
BA_ "GenSigSendType" SG_ 330 FrntSideRdrLeDetn82RdrDetnChks 0;
BA_ "GenSigFuncType" SG_ 330 FrntSideRdrLeDetn82RdrDetnChks 15;
BA_ "GenSigDataID" SG_ 330 FrntSideRdrLeDetn82RdrDetnChks "0x885";
BA_ "GenSigSendType" SG_ 330 FrntSideRdrLeDetn82RdrDetnCntr 0;
BA_ "GenSigFuncType" SG_ 330 FrntSideRdrLeDetn82RdrDetnCntr 16;
BA_ "GenSigSendType" SG_ 330 FrntSideRdrLeDetn82RdrDetnConf 0;
BA_ "GenSigStartValue" SG_ 330 FrntSideRdrLeDetn82RdrDetnElevn 15;
BA_ "GenSigSendType" SG_ 330 FrntSideRdrLeDetn82RdrDetnElevn 0;
BA_ "GenSigSendType" SG_ 330 FrntSideRdrLeDetn82RdrDetnPwr 0;
BA_ "GenSigStartValue" SG_ 330 FrntSideRdrLeDetn82RdrDetnRng 10050;
BA_ "GenSigSendType" SG_ 330 FrntSideRdrLeDetn82RdrDetnRng 0;
BA_ "GenSigStartValue" SG_ 330 FrntSideRdrLeDetn82RdrDetnRngV 4000;
BA_ "GenSigSendType" SG_ 330 FrntSideRdrLeDetn82RdrDetnRngV 0;
BA_ "GenSigStartValue" SG_ 330 FrntSideRdrLeDetn82RdrDetnSts 3;
BA_ "GenSigSendType" SG_ 330 FrntSideRdrLeDetn82RdrDetnSts 0;
BA_ "GenSigStartValue" SG_ 330 FrntSideRdrLeDetn83RdrDetnAzi 900;
BA_ "GenSigSendType" SG_ 330 FrntSideRdrLeDetn83RdrDetnAzi 0;
BA_ "GenSigSendType" SG_ 330 FrntSideRdrLeDetn83RdrDetnChks 0;
BA_ "GenSigFuncType" SG_ 330 FrntSideRdrLeDetn83RdrDetnChks 15;
BA_ "GenSigDataID" SG_ 330 FrntSideRdrLeDetn83RdrDetnChks "0x886";
BA_ "GenSigSendType" SG_ 330 FrntSideRdrLeDetn83RdrDetnCntr 0;
BA_ "GenSigFuncType" SG_ 330 FrntSideRdrLeDetn83RdrDetnCntr 16;
BA_ "GenSigSendType" SG_ 330 FrntSideRdrLeDetn83RdrDetnConf 0;
BA_ "GenSigStartValue" SG_ 330 FrntSideRdrLeDetn83RdrDetnElevn 15;
BA_ "GenSigSendType" SG_ 330 FrntSideRdrLeDetn83RdrDetnElevn 0;
BA_ "GenSigSendType" SG_ 330 FrntSideRdrLeDetn83RdrDetnPwr 0;
BA_ "GenSigStartValue" SG_ 330 FrntSideRdrLeDetn83RdrDetnRng 10050;
BA_ "GenSigSendType" SG_ 330 FrntSideRdrLeDetn83RdrDetnRng 0;
BA_ "GenSigStartValue" SG_ 330 FrntSideRdrLeDetn83RdrDetnRngV 4000;
BA_ "GenSigSendType" SG_ 330 FrntSideRdrLeDetn83RdrDetnRngV 0;
BA_ "GenSigStartValue" SG_ 330 FrntSideRdrLeDetn83RdrDetnSts 3;
BA_ "GenSigSendType" SG_ 330 FrntSideRdrLeDetn83RdrDetnSts 0;
BA_ "GenSigStartValue" SG_ 330 FrntSideRdrLeDetn84RdrDetnAzi 900;
BA_ "GenSigSendType" SG_ 330 FrntSideRdrLeDetn84RdrDetnAzi 0;
BA_ "GenSigSendType" SG_ 330 FrntSideRdrLeDetn84RdrDetnChks 0;
BA_ "GenSigFuncType" SG_ 330 FrntSideRdrLeDetn84RdrDetnChks 15;
BA_ "GenSigDataID" SG_ 330 FrntSideRdrLeDetn84RdrDetnChks "0x887";
BA_ "GenSigSendType" SG_ 330 FrntSideRdrLeDetn84RdrDetnCntr 0;
BA_ "GenSigFuncType" SG_ 330 FrntSideRdrLeDetn84RdrDetnCntr 16;
BA_ "GenSigSendType" SG_ 330 FrntSideRdrLeDetn84RdrDetnConf 0;
BA_ "GenSigStartValue" SG_ 330 FrntSideRdrLeDetn84RdrDetnElevn 15;
BA_ "GenSigSendType" SG_ 330 FrntSideRdrLeDetn84RdrDetnElevn 0;
BA_ "GenSigSendType" SG_ 330 FrntSideRdrLeDetn84RdrDetnPwr 0;
BA_ "GenSigStartValue" SG_ 330 FrntSideRdrLeDetn84RdrDetnRng 10050;
BA_ "GenSigSendType" SG_ 330 FrntSideRdrLeDetn84RdrDetnRng 0;
BA_ "GenSigStartValue" SG_ 330 FrntSideRdrLeDetn84RdrDetnRngV 4000;
BA_ "GenSigSendType" SG_ 330 FrntSideRdrLeDetn84RdrDetnRngV 0;
BA_ "GenSigStartValue" SG_ 330 FrntSideRdrLeDetn84RdrDetnSts 3;
BA_ "GenSigSendType" SG_ 330 FrntSideRdrLeDetn84RdrDetnSts 0;
VAL_ 316 FrntSideRdrLeDetn37RdrDetnSts 0 "RdrDetnSts_Ukwn" 1 "RdrDetnSts_Movg" 2 "RdrDetnSts_Staty" 3 "RdrDetnSts_Invalid";
VAL_ 316 FrntSideRdrLeDetn38RdrDetnSts 0 "RdrDetnSts_Ukwn" 1 "RdrDetnSts_Movg" 2 "RdrDetnSts_Staty" 3 "RdrDetnSts_Invalid";
VAL_ 316 FrntSideRdrLeDetn39RdrDetnSts 0 "RdrDetnSts_Ukwn" 1 "RdrDetnSts_Movg" 2 "RdrDetnSts_Staty" 3 "RdrDetnSts_Invalid";
VAL_ 316 FrntSideRdrLeDetn40RdrDetnSts 0 "RdrDetnSts_Ukwn" 1 "RdrDetnSts_Movg" 2 "RdrDetnSts_Staty" 3 "RdrDetnSts_Invalid";
VAL_ 316 FrntSideRdrLeDetn41RdrDetnSts 0 "RdrDetnSts_Ukwn" 1 "RdrDetnSts_Movg" 2 "RdrDetnSts_Staty" 3 "RdrDetnSts_Invalid";
VAL_ 316 FrntSideRdrLeDetn42RdrDetnSts 0 "RdrDetnSts_Ukwn" 1 "RdrDetnSts_Movg" 2 "RdrDetnSts_Staty" 3 "RdrDetnSts_Invalid";
VAL_ 318 FrntSideRdrLeDetn43RdrDetnSts 0 "RdrDetnSts_Ukwn" 1 "RdrDetnSts_Movg" 2 "RdrDetnSts_Staty" 3 "RdrDetnSts_Invalid";
VAL_ 318 FrntSideRdrLeDetn44RdrDetnSts 0 "RdrDetnSts_Ukwn" 1 "RdrDetnSts_Movg" 2 "RdrDetnSts_Staty" 3 "RdrDetnSts_Invalid";
VAL_ 318 FrntSideRdrLeDetn45RdrDetnSts 0 "RdrDetnSts_Ukwn" 1 "RdrDetnSts_Movg" 2 "RdrDetnSts_Staty" 3 "RdrDetnSts_Invalid";
VAL_ 318 FrntSideRdrLeDetn46RdrDetnSts 0 "RdrDetnSts_Ukwn" 1 "RdrDetnSts_Movg" 2 "RdrDetnSts_Staty" 3 "RdrDetnSts_Invalid";
VAL_ 318 FrntSideRdrLeDetn47RdrDetnSts 0 "RdrDetnSts_Ukwn" 1 "RdrDetnSts_Movg" 2 "RdrDetnSts_Staty" 3 "RdrDetnSts_Invalid";
VAL_ 318 FrntSideRdrLeDetn48RdrDetnSts 0 "RdrDetnSts_Ukwn" 1 "RdrDetnSts_Movg" 2 "RdrDetnSts_Staty" 3 "RdrDetnSts_Invalid";
VAL_ 320 FrntSideRdrLeDetn49RdrDetnSts 0 "RdrDetnSts_Ukwn" 1 "RdrDetnSts_Movg" 2 "RdrDetnSts_Staty" 3 "RdrDetnSts_Invalid";
VAL_ 320 FrntSideRdrLeDetn50RdrDetnSts 0 "RdrDetnSts_Ukwn" 1 "RdrDetnSts_Movg" 2 "RdrDetnSts_Staty" 3 "RdrDetnSts_Invalid";
VAL_ 320 FrntSideRdrLeDetn51RdrDetnSts 0 "RdrDetnSts_Ukwn" 1 "RdrDetnSts_Movg" 2 "RdrDetnSts_Staty" 3 "RdrDetnSts_Invalid";
VAL_ 320 FrntSideRdrLeDetn52RdrDetnSts 0 "RdrDetnSts_Ukwn" 1 "RdrDetnSts_Movg" 2 "RdrDetnSts_Staty" 3 "RdrDetnSts_Invalid";
VAL_ 320 FrntSideRdrLeDetn53RdrDetnSts 0 "RdrDetnSts_Ukwn" 1 "RdrDetnSts_Movg" 2 "RdrDetnSts_Staty" 3 "RdrDetnSts_Invalid";
VAL_ 320 FrntSideRdrLeDetn54RdrDetnSts 0 "RdrDetnSts_Ukwn" 1 "RdrDetnSts_Movg" 2 "RdrDetnSts_Staty" 3 "RdrDetnSts_Invalid";
VAL_ 322 FrntSideRdrLeDetn55RdrDetnSts 0 "RdrDetnSts_Ukwn" 1 "RdrDetnSts_Movg" 2 "RdrDetnSts_Staty" 3 "RdrDetnSts_Invalid";
VAL_ 322 FrntSideRdrLeDetn56RdrDetnSts 0 "RdrDetnSts_Ukwn" 1 "RdrDetnSts_Movg" 2 "RdrDetnSts_Staty" 3 "RdrDetnSts_Invalid";
VAL_ 322 FrntSideRdrLeDetn57RdrDetnSts 0 "RdrDetnSts_Ukwn" 1 "RdrDetnSts_Movg" 2 "RdrDetnSts_Staty" 3 "RdrDetnSts_Invalid";
VAL_ 322 FrntSideRdrLeDetn58RdrDetnSts 0 "RdrDetnSts_Ukwn" 1 "RdrDetnSts_Movg" 2 "RdrDetnSts_Staty" 3 "RdrDetnSts_Invalid";
VAL_ 322 FrntSideRdrLeDetn59RdrDetnSts 0 "RdrDetnSts_Ukwn" 1 "RdrDetnSts_Movg" 2 "RdrDetnSts_Staty" 3 "RdrDetnSts_Invalid";
VAL_ 322 FrntSideRdrLeDetn60RdrDetnSts 0 "RdrDetnSts_Ukwn" 1 "RdrDetnSts_Movg" 2 "RdrDetnSts_Staty" 3 "RdrDetnSts_Invalid";
VAL_ 324 FrntSideRdrLeDetn61RdrDetnSts 0 "RdrDetnSts_Ukwn" 1 "RdrDetnSts_Movg" 2 "RdrDetnSts_Staty" 3 "RdrDetnSts_Invalid";
VAL_ 324 FrntSideRdrLeDetn62RdrDetnSts 0 "RdrDetnSts_Ukwn" 1 "RdrDetnSts_Movg" 2 "RdrDetnSts_Staty" 3 "RdrDetnSts_Invalid";
VAL_ 324 FrntSideRdrLeDetn63RdrDetnSts 0 "RdrDetnSts_Ukwn" 1 "RdrDetnSts_Movg" 2 "RdrDetnSts_Staty" 3 "RdrDetnSts_Invalid";
VAL_ 324 FrntSideRdrLeDetn64RdrDetnSts 0 "RdrDetnSts_Ukwn" 1 "RdrDetnSts_Movg" 2 "RdrDetnSts_Staty" 3 "RdrDetnSts_Invalid";
VAL_ 324 FrntSideRdrLeDetn65RdrDetnSts 0 "RdrDetnSts_Ukwn" 1 "RdrDetnSts_Movg" 2 "RdrDetnSts_Staty" 3 "RdrDetnSts_Invalid";
VAL_ 324 FrntSideRdrLeDetn66RdrDetnSts 0 "RdrDetnSts_Ukwn" 1 "RdrDetnSts_Movg" 2 "RdrDetnSts_Staty" 3 "RdrDetnSts_Invalid";
VAL_ 326 FrntSideRdrLeDetn67RdrDetnSts 0 "RdrDetnSts_Ukwn" 1 "RdrDetnSts_Movg" 2 "RdrDetnSts_Staty" 3 "RdrDetnSts_Invalid";
VAL_ 326 FrntSideRdrLeDetn68RdrDetnSts 0 "RdrDetnSts_Ukwn" 1 "RdrDetnSts_Movg" 2 "RdrDetnSts_Staty" 3 "RdrDetnSts_Invalid";
VAL_ 326 FrntSideRdrLeDetn69RdrDetnSts 0 "RdrDetnSts_Ukwn" 1 "RdrDetnSts_Movg" 2 "RdrDetnSts_Staty" 3 "RdrDetnSts_Invalid";
VAL_ 326 FrntSideRdrLeDetn70RdrDetnSts 0 "RdrDetnSts_Ukwn" 1 "RdrDetnSts_Movg" 2 "RdrDetnSts_Staty" 3 "RdrDetnSts_Invalid";
VAL_ 326 FrntSideRdrLeDetn71RdrDetnSts 0 "RdrDetnSts_Ukwn" 1 "RdrDetnSts_Movg" 2 "RdrDetnSts_Staty" 3 "RdrDetnSts_Invalid";
VAL_ 326 FrntSideRdrLeDetn72RdrDetnSts 0 "RdrDetnSts_Ukwn" 1 "RdrDetnSts_Movg" 2 "RdrDetnSts_Staty" 3 "RdrDetnSts_Invalid";
VAL_ 328 FrntSideRdrLeDetn73RdrDetnSts 0 "RdrDetnSts_Ukwn" 1 "RdrDetnSts_Movg" 2 "RdrDetnSts_Staty" 3 "RdrDetnSts_Invalid";
VAL_ 328 FrntSideRdrLeDetn74RdrDetnSts 0 "RdrDetnSts_Ukwn" 1 "RdrDetnSts_Movg" 2 "RdrDetnSts_Staty" 3 "RdrDetnSts_Invalid";
VAL_ 328 FrntSideRdrLeDetn75RdrDetnSts 0 "RdrDetnSts_Ukwn" 1 "RdrDetnSts_Movg" 2 "RdrDetnSts_Staty" 3 "RdrDetnSts_Invalid";
VAL_ 328 FrntSideRdrLeDetn76RdrDetnSts 0 "RdrDetnSts_Ukwn" 1 "RdrDetnSts_Movg" 2 "RdrDetnSts_Staty" 3 "RdrDetnSts_Invalid";
VAL_ 328 FrntSideRdrLeDetn77RdrDetnSts 0 "RdrDetnSts_Ukwn" 1 "RdrDetnSts_Movg" 2 "RdrDetnSts_Staty" 3 "RdrDetnSts_Invalid";
VAL_ 328 FrntSideRdrLeDetn78RdrDetnSts 0 "RdrDetnSts_Ukwn" 1 "RdrDetnSts_Movg" 2 "RdrDetnSts_Staty" 3 "RdrDetnSts_Invalid";
VAL_ 330 FrntSideRdrLeDetn79RdrDetnSts 0 "RdrDetnSts_Ukwn" 1 "RdrDetnSts_Movg" 2 "RdrDetnSts_Staty" 3 "RdrDetnSts_Invalid";
VAL_ 330 FrntSideRdrLeDetn80RdrDetnSts 0 "RdrDetnSts_Ukwn" 1 "RdrDetnSts_Movg" 2 "RdrDetnSts_Staty" 3 "RdrDetnSts_Invalid";
VAL_ 330 FrntSideRdrLeDetn81RdrDetnSts 0 "RdrDetnSts_Ukwn" 1 "RdrDetnSts_Movg" 2 "RdrDetnSts_Staty" 3 "RdrDetnSts_Invalid";
VAL_ 330 FrntSideRdrLeDetn82RdrDetnSts 0 "RdrDetnSts_Ukwn" 1 "RdrDetnSts_Movg" 2 "RdrDetnSts_Staty" 3 "RdrDetnSts_Invalid";
VAL_ 330 FrntSideRdrLeDetn83RdrDetnSts 0 "RdrDetnSts_Ukwn" 1 "RdrDetnSts_Movg" 2 "RdrDetnSts_Staty" 3 "RdrDetnSts_Invalid";
VAL_ 330 FrntSideRdrLeDetn84RdrDetnSts 0 "RdrDetnSts_Ukwn" 1 "RdrDetnSts_Movg" 2 "RdrDetnSts_Staty" 3 "RdrDetnSts_Invalid";
SIG_GROUP_ 316 FrntSideRdrLeDetn37 1 : FrntSideRdrLeDetn37RdrDetnAzi FrntSideRdrLeDetn37RdrDetnChks FrntSideRdrLeDetn37RdrDetnCntr FrntSideRdrLeDetn37RdrDetnConf FrntSideRdrLeDetn37RdrDetnElevn FrntSideRdrLeDetn37RdrDetnPwr FrntSideRdrLeDetn37RdrDetnRng FrntSideRdrLeDetn37RdrDetnRngV FrntSideRdrLeDetn37RdrDetnSts;
SIG_GROUP_ 316 FrntSideRdrLeDetn38 1 : FrntSideRdrLeDetn38RdrDetnAzi FrntSideRdrLeDetn38RdrDetnChks FrntSideRdrLeDetn38RdrDetnCntr FrntSideRdrLeDetn38RdrDetnConf FrntSideRdrLeDetn38RdrDetnElevn FrntSideRdrLeDetn38RdrDetnPwr FrntSideRdrLeDetn38RdrDetnRng FrntSideRdrLeDetn38RdrDetnRngV FrntSideRdrLeDetn38RdrDetnSts;
SIG_GROUP_ 316 FrntSideRdrLeDetn39 1 : FrntSideRdrLeDetn39RdrDetnAzi FrntSideRdrLeDetn39RdrDetnChks FrntSideRdrLeDetn39RdrDetnCntr FrntSideRdrLeDetn39RdrDetnConf FrntSideRdrLeDetn39RdrDetnElevn FrntSideRdrLeDetn39RdrDetnPwr FrntSideRdrLeDetn39RdrDetnRng FrntSideRdrLeDetn39RdrDetnRngV FrntSideRdrLeDetn39RdrDetnSts;
SIG_GROUP_ 316 FrntSideRdrLeDetn40 1 : FrntSideRdrLeDetn40RdrDetnAzi FrntSideRdrLeDetn40RdrDetnChks FrntSideRdrLeDetn40RdrDetnCntr FrntSideRdrLeDetn40RdrDetnConf FrntSideRdrLeDetn40RdrDetnElevn FrntSideRdrLeDetn40RdrDetnPwr FrntSideRdrLeDetn40RdrDetnRng FrntSideRdrLeDetn40RdrDetnRngV FrntSideRdrLeDetn40RdrDetnSts;
SIG_GROUP_ 316 FrntSideRdrLeDetn41 1 : FrntSideRdrLeDetn41RdrDetnAzi FrntSideRdrLeDetn41RdrDetnChks FrntSideRdrLeDetn41RdrDetnCntr FrntSideRdrLeDetn41RdrDetnConf FrntSideRdrLeDetn41RdrDetnElevn FrntSideRdrLeDetn41RdrDetnPwr FrntSideRdrLeDetn41RdrDetnRng FrntSideRdrLeDetn41RdrDetnRngV FrntSideRdrLeDetn41RdrDetnSts;
SIG_GROUP_ 316 FrntSideRdrLeDetn42 1 : FrntSideRdrLeDetn42RdrDetnAzi FrntSideRdrLeDetn42RdrDetnChks FrntSideRdrLeDetn42RdrDetnCntr FrntSideRdrLeDetn42RdrDetnConf FrntSideRdrLeDetn42RdrDetnElevn FrntSideRdrLeDetn42RdrDetnPwr FrntSideRdrLeDetn42RdrDetnRng FrntSideRdrLeDetn42RdrDetnRngV FrntSideRdrLeDetn42RdrDetnSts;
SIG_GROUP_ 318 FrntSideRdrLeDetn43 1 : FrntSideRdrLeDetn43RdrDetnAzi FrntSideRdrLeDetn43RdrDetnChks FrntSideRdrLeDetn43RdrDetnCntr FrntSideRdrLeDetn43RdrDetnConf FrntSideRdrLeDetn43RdrDetnElevn FrntSideRdrLeDetn43RdrDetnPwr FrntSideRdrLeDetn43RdrDetnRng FrntSideRdrLeDetn43RdrDetnRngV FrntSideRdrLeDetn43RdrDetnSts;
SIG_GROUP_ 318 FrntSideRdrLeDetn44 1 : FrntSideRdrLeDetn44RdrDetnAzi FrntSideRdrLeDetn44RdrDetnChks FrntSideRdrLeDetn44RdrDetnCntr FrntSideRdrLeDetn44RdrDetnConf FrntSideRdrLeDetn44RdrDetnElevn FrntSideRdrLeDetn44RdrDetnPwr FrntSideRdrLeDetn44RdrDetnRng FrntSideRdrLeDetn44RdrDetnRngV FrntSideRdrLeDetn44RdrDetnSts;
SIG_GROUP_ 318 FrntSideRdrLeDetn45 1 : FrntSideRdrLeDetn45RdrDetnAzi FrntSideRdrLeDetn45RdrDetnChks FrntSideRdrLeDetn45RdrDetnCntr FrntSideRdrLeDetn45RdrDetnConf FrntSideRdrLeDetn45RdrDetnElevn FrntSideRdrLeDetn45RdrDetnPwr FrntSideRdrLeDetn45RdrDetnRng FrntSideRdrLeDetn45RdrDetnRngV FrntSideRdrLeDetn45RdrDetnSts;
SIG_GROUP_ 318 FrntSideRdrLeDetn46 1 : FrntSideRdrLeDetn46RdrDetnAzi FrntSideRdrLeDetn46RdrDetnChks FrntSideRdrLeDetn46RdrDetnCntr FrntSideRdrLeDetn46RdrDetnConf FrntSideRdrLeDetn46RdrDetnElevn FrntSideRdrLeDetn46RdrDetnPwr FrntSideRdrLeDetn46RdrDetnRng FrntSideRdrLeDetn46RdrDetnRngV FrntSideRdrLeDetn46RdrDetnSts;
SIG_GROUP_ 318 FrntSideRdrLeDetn47 1 : FrntSideRdrLeDetn47RdrDetnAzi FrntSideRdrLeDetn47RdrDetnChks FrntSideRdrLeDetn47RdrDetnCntr FrntSideRdrLeDetn47RdrDetnConf FrntSideRdrLeDetn47RdrDetnElevn FrntSideRdrLeDetn47RdrDetnPwr FrntSideRdrLeDetn47RdrDetnRng FrntSideRdrLeDetn47RdrDetnRngV FrntSideRdrLeDetn47RdrDetnSts;
SIG_GROUP_ 318 FrntSideRdrLeDetn48 1 : FrntSideRdrLeDetn48RdrDetnAzi FrntSideRdrLeDetn48RdrDetnChks FrntSideRdrLeDetn48RdrDetnCntr FrntSideRdrLeDetn48RdrDetnConf FrntSideRdrLeDetn48RdrDetnElevn FrntSideRdrLeDetn48RdrDetnPwr FrntSideRdrLeDetn48RdrDetnRng FrntSideRdrLeDetn48RdrDetnRngV FrntSideRdrLeDetn48RdrDetnSts;
SIG_GROUP_ 320 FrntSideRdrLeDetn49 1 : FrntSideRdrLeDetn49RdrDetnAzi FrntSideRdrLeDetn49RdrDetnChks FrntSideRdrLeDetn49RdrDetnCntr FrntSideRdrLeDetn49RdrDetnConf FrntSideRdrLeDetn49RdrDetnElevn FrntSideRdrLeDetn49RdrDetnPwr FrntSideRdrLeDetn49RdrDetnRng FrntSideRdrLeDetn49RdrDetnRngV FrntSideRdrLeDetn49RdrDetnSts;
SIG_GROUP_ 320 FrntSideRdrLeDetn50 1 : FrntSideRdrLeDetn50RdrDetnAzi FrntSideRdrLeDetn50RdrDetnChks FrntSideRdrLeDetn50RdrDetnCntr FrntSideRdrLeDetn50RdrDetnConf FrntSideRdrLeDetn50RdrDetnElevn FrntSideRdrLeDetn50RdrDetnPwr FrntSideRdrLeDetn50RdrDetnRng FrntSideRdrLeDetn50RdrDetnRngV FrntSideRdrLeDetn50RdrDetnSts;
SIG_GROUP_ 320 FrntSideRdrLeDetn51 1 : FrntSideRdrLeDetn51RdrDetnAzi FrntSideRdrLeDetn51RdrDetnChks FrntSideRdrLeDetn51RdrDetnCntr FrntSideRdrLeDetn51RdrDetnConf FrntSideRdrLeDetn51RdrDetnElevn FrntSideRdrLeDetn51RdrDetnPwr FrntSideRdrLeDetn51RdrDetnRng FrntSideRdrLeDetn51RdrDetnRngV FrntSideRdrLeDetn51RdrDetnSts;
SIG_GROUP_ 320 FrntSideRdrLeDetn52 1 : FrntSideRdrLeDetn52RdrDetnAzi FrntSideRdrLeDetn52RdrDetnChks FrntSideRdrLeDetn52RdrDetnCntr FrntSideRdrLeDetn52RdrDetnConf FrntSideRdrLeDetn52RdrDetnElevn FrntSideRdrLeDetn52RdrDetnPwr FrntSideRdrLeDetn52RdrDetnRng FrntSideRdrLeDetn52RdrDetnRngV FrntSideRdrLeDetn52RdrDetnSts;
SIG_GROUP_ 320 FrntSideRdrLeDetn53 1 : FrntSideRdrLeDetn53RdrDetnAzi FrntSideRdrLeDetn53RdrDetnChks FrntSideRdrLeDetn53RdrDetnCntr FrntSideRdrLeDetn53RdrDetnConf FrntSideRdrLeDetn53RdrDetnElevn FrntSideRdrLeDetn53RdrDetnPwr FrntSideRdrLeDetn53RdrDetnRng FrntSideRdrLeDetn53RdrDetnRngV FrntSideRdrLeDetn53RdrDetnSts;
SIG_GROUP_ 320 FrntSideRdrLeDetn54 1 : FrntSideRdrLeDetn54RdrDetnAzi FrntSideRdrLeDetn54RdrDetnChks FrntSideRdrLeDetn54RdrDetnCntr FrntSideRdrLeDetn54RdrDetnConf FrntSideRdrLeDetn54RdrDetnElevn FrntSideRdrLeDetn54RdrDetnPwr FrntSideRdrLeDetn54RdrDetnRng FrntSideRdrLeDetn54RdrDetnRngV FrntSideRdrLeDetn54RdrDetnSts;
SIG_GROUP_ 322 FrntSideRdrLeDetn55 1 : FrntSideRdrLeDetn55RdrDetnAzi FrntSideRdrLeDetn55RdrDetnChks FrntSideRdrLeDetn55RdrDetnCntr FrntSideRdrLeDetn55RdrDetnConf FrntSideRdrLeDetn55RdrDetnElevn FrntSideRdrLeDetn55RdrDetnPwr FrntSideRdrLeDetn55RdrDetnRng FrntSideRdrLeDetn55RdrDetnRngV FrntSideRdrLeDetn55RdrDetnSts;
SIG_GROUP_ 322 FrntSideRdrLeDetn56 1 : FrntSideRdrLeDetn56RdrDetnAzi FrntSideRdrLeDetn56RdrDetnChks FrntSideRdrLeDetn56RdrDetnCntr FrntSideRdrLeDetn56RdrDetnConf FrntSideRdrLeDetn56RdrDetnElevn FrntSideRdrLeDetn56RdrDetnPwr FrntSideRdrLeDetn56RdrDetnRng FrntSideRdrLeDetn56RdrDetnRngV FrntSideRdrLeDetn56RdrDetnSts;
SIG_GROUP_ 322 FrntSideRdrLeDetn57 1 : FrntSideRdrLeDetn57RdrDetnAzi FrntSideRdrLeDetn57RdrDetnChks FrntSideRdrLeDetn57RdrDetnCntr FrntSideRdrLeDetn57RdrDetnConf FrntSideRdrLeDetn57RdrDetnElevn FrntSideRdrLeDetn57RdrDetnPwr FrntSideRdrLeDetn57RdrDetnRng FrntSideRdrLeDetn57RdrDetnRngV FrntSideRdrLeDetn57RdrDetnSts;
SIG_GROUP_ 322 FrntSideRdrLeDetn58 1 : FrntSideRdrLeDetn58RdrDetnAzi FrntSideRdrLeDetn58RdrDetnChks FrntSideRdrLeDetn58RdrDetnCntr FrntSideRdrLeDetn58RdrDetnConf FrntSideRdrLeDetn58RdrDetnElevn FrntSideRdrLeDetn58RdrDetnPwr FrntSideRdrLeDetn58RdrDetnRng FrntSideRdrLeDetn58RdrDetnRngV FrntSideRdrLeDetn58RdrDetnSts;
SIG_GROUP_ 322 FrntSideRdrLeDetn59 1 : FrntSideRdrLeDetn59RdrDetnAzi FrntSideRdrLeDetn59RdrDetnChks FrntSideRdrLeDetn59RdrDetnCntr FrntSideRdrLeDetn59RdrDetnConf FrntSideRdrLeDetn59RdrDetnElevn FrntSideRdrLeDetn59RdrDetnPwr FrntSideRdrLeDetn59RdrDetnRng FrntSideRdrLeDetn59RdrDetnRngV FrntSideRdrLeDetn59RdrDetnSts;
SIG_GROUP_ 322 FrntSideRdrLeDetn60 1 : FrntSideRdrLeDetn60RdrDetnAzi FrntSideRdrLeDetn60RdrDetnChks FrntSideRdrLeDetn60RdrDetnCntr FrntSideRdrLeDetn60RdrDetnConf FrntSideRdrLeDetn60RdrDetnElevn FrntSideRdrLeDetn60RdrDetnPwr FrntSideRdrLeDetn60RdrDetnRng FrntSideRdrLeDetn60RdrDetnRngV FrntSideRdrLeDetn60RdrDetnSts;
SIG_GROUP_ 324 FrntSideRdrLeDetn61 1 : FrntSideRdrLeDetn61RdrDetnAzi FrntSideRdrLeDetn61RdrDetnChks FrntSideRdrLeDetn61RdrDetnCntr FrntSideRdrLeDetn61RdrDetnConf FrntSideRdrLeDetn61RdrDetnElevn FrntSideRdrLeDetn61RdrDetnPwr FrntSideRdrLeDetn61RdrDetnRng FrntSideRdrLeDetn61RdrDetnRngV FrntSideRdrLeDetn61RdrDetnSts;
SIG_GROUP_ 324 FrntSideRdrLeDetn62 1 : FrntSideRdrLeDetn62RdrDetnAzi FrntSideRdrLeDetn62RdrDetnChks FrntSideRdrLeDetn62RdrDetnCntr FrntSideRdrLeDetn62RdrDetnConf FrntSideRdrLeDetn62RdrDetnElevn FrntSideRdrLeDetn62RdrDetnPwr FrntSideRdrLeDetn62RdrDetnRng FrntSideRdrLeDetn62RdrDetnRngV FrntSideRdrLeDetn62RdrDetnSts;
SIG_GROUP_ 324 FrntSideRdrLeDetn63 1 : FrntSideRdrLeDetn63RdrDetnAzi FrntSideRdrLeDetn63RdrDetnChks FrntSideRdrLeDetn63RdrDetnCntr FrntSideRdrLeDetn63RdrDetnConf FrntSideRdrLeDetn63RdrDetnElevn FrntSideRdrLeDetn63RdrDetnPwr FrntSideRdrLeDetn63RdrDetnRng FrntSideRdrLeDetn63RdrDetnRngV FrntSideRdrLeDetn63RdrDetnSts;
SIG_GROUP_ 324 FrntSideRdrLeDetn64 1 : FrntSideRdrLeDetn64RdrDetnAzi FrntSideRdrLeDetn64RdrDetnChks FrntSideRdrLeDetn64RdrDetnCntr FrntSideRdrLeDetn64RdrDetnConf FrntSideRdrLeDetn64RdrDetnElevn FrntSideRdrLeDetn64RdrDetnPwr FrntSideRdrLeDetn64RdrDetnRng FrntSideRdrLeDetn64RdrDetnRngV FrntSideRdrLeDetn64RdrDetnSts;
SIG_GROUP_ 324 FrntSideRdrLeDetn65 1 : FrntSideRdrLeDetn65RdrDetnAzi FrntSideRdrLeDetn65RdrDetnChks FrntSideRdrLeDetn65RdrDetnCntr FrntSideRdrLeDetn65RdrDetnConf FrntSideRdrLeDetn65RdrDetnElevn FrntSideRdrLeDetn65RdrDetnPwr FrntSideRdrLeDetn65RdrDetnRng FrntSideRdrLeDetn65RdrDetnRngV FrntSideRdrLeDetn65RdrDetnSts;
SIG_GROUP_ 324 FrntSideRdrLeDetn66 1 : FrntSideRdrLeDetn66RdrDetnAzi FrntSideRdrLeDetn66RdrDetnChks FrntSideRdrLeDetn66RdrDetnCntr FrntSideRdrLeDetn66RdrDetnConf FrntSideRdrLeDetn66RdrDetnElevn FrntSideRdrLeDetn66RdrDetnPwr FrntSideRdrLeDetn66RdrDetnRng FrntSideRdrLeDetn66RdrDetnRngV FrntSideRdrLeDetn66RdrDetnSts;
SIG_GROUP_ 326 FrntSideRdrLeDetn67 1 : FrntSideRdrLeDetn67RdrDetnAzi FrntSideRdrLeDetn67RdrDetnChks FrntSideRdrLeDetn67RdrDetnCntr FrntSideRdrLeDetn67RdrDetnConf FrntSideRdrLeDetn67RdrDetnElevn FrntSideRdrLeDetn67RdrDetnPwr FrntSideRdrLeDetn67RdrDetnRng FrntSideRdrLeDetn67RdrDetnRngV FrntSideRdrLeDetn67RdrDetnSts;
SIG_GROUP_ 326 FrntSideRdrLeDetn68 1 : FrntSideRdrLeDetn68RdrDetnAzi FrntSideRdrLeDetn68RdrDetnChks FrntSideRdrLeDetn68RdrDetnCntr FrntSideRdrLeDetn68RdrDetnConf FrntSideRdrLeDetn68RdrDetnElevn FrntSideRdrLeDetn68RdrDetnPwr FrntSideRdrLeDetn68RdrDetnRng FrntSideRdrLeDetn68RdrDetnRngV FrntSideRdrLeDetn68RdrDetnSts;
SIG_GROUP_ 326 FrntSideRdrLeDetn69 1 : FrntSideRdrLeDetn69RdrDetnAzi FrntSideRdrLeDetn69RdrDetnChks FrntSideRdrLeDetn69RdrDetnCntr FrntSideRdrLeDetn69RdrDetnConf FrntSideRdrLeDetn69RdrDetnElevn FrntSideRdrLeDetn69RdrDetnPwr FrntSideRdrLeDetn69RdrDetnRng FrntSideRdrLeDetn69RdrDetnRngV FrntSideRdrLeDetn69RdrDetnSts;
SIG_GROUP_ 326 FrntSideRdrLeDetn70 1 : FrntSideRdrLeDetn70RdrDetnAzi FrntSideRdrLeDetn70RdrDetnChks FrntSideRdrLeDetn70RdrDetnCntr FrntSideRdrLeDetn70RdrDetnConf FrntSideRdrLeDetn70RdrDetnElevn FrntSideRdrLeDetn70RdrDetnPwr FrntSideRdrLeDetn70RdrDetnRng FrntSideRdrLeDetn70RdrDetnRngV FrntSideRdrLeDetn70RdrDetnSts;
SIG_GROUP_ 326 FrntSideRdrLeDetn71 1 : FrntSideRdrLeDetn71RdrDetnAzi FrntSideRdrLeDetn71RdrDetnChks FrntSideRdrLeDetn71RdrDetnCntr FrntSideRdrLeDetn71RdrDetnConf FrntSideRdrLeDetn71RdrDetnElevn FrntSideRdrLeDetn71RdrDetnPwr FrntSideRdrLeDetn71RdrDetnRng FrntSideRdrLeDetn71RdrDetnRngV FrntSideRdrLeDetn71RdrDetnSts;
SIG_GROUP_ 326 FrntSideRdrLeDetn72 1 : FrntSideRdrLeDetn72RdrDetnAzi FrntSideRdrLeDetn72RdrDetnChks FrntSideRdrLeDetn72RdrDetnCntr FrntSideRdrLeDetn72RdrDetnConf FrntSideRdrLeDetn72RdrDetnElevn FrntSideRdrLeDetn72RdrDetnPwr FrntSideRdrLeDetn72RdrDetnRng FrntSideRdrLeDetn72RdrDetnRngV FrntSideRdrLeDetn72RdrDetnSts;
SIG_GROUP_ 328 FrntSideRdrLeDetn73 1 : FrntSideRdrLeDetn73RdrDetnAzi FrntSideRdrLeDetn73RdrDetnChks FrntSideRdrLeDetn73RdrDetnCntr FrntSideRdrLeDetn73RdrDetnConf FrntSideRdrLeDetn73RdrDetnElevn FrntSideRdrLeDetn73RdrDetnPwr FrntSideRdrLeDetn73RdrDetnRng FrntSideRdrLeDetn73RdrDetnRngV FrntSideRdrLeDetn73RdrDetnSts;
SIG_GROUP_ 328 FrntSideRdrLeDetn74 1 : FrntSideRdrLeDetn74RdrDetnAzi FrntSideRdrLeDetn74RdrDetnChks FrntSideRdrLeDetn74RdrDetnCntr FrntSideRdrLeDetn74RdrDetnConf FrntSideRdrLeDetn74RdrDetnElevn FrntSideRdrLeDetn74RdrDetnPwr FrntSideRdrLeDetn74RdrDetnRng FrntSideRdrLeDetn74RdrDetnRngV FrntSideRdrLeDetn74RdrDetnSts;
SIG_GROUP_ 328 FrntSideRdrLeDetn75 1 : FrntSideRdrLeDetn75RdrDetnAzi FrntSideRdrLeDetn75RdrDetnChks FrntSideRdrLeDetn75RdrDetnCntr FrntSideRdrLeDetn75RdrDetnConf FrntSideRdrLeDetn75RdrDetnElevn FrntSideRdrLeDetn75RdrDetnPwr FrntSideRdrLeDetn75RdrDetnRng FrntSideRdrLeDetn75RdrDetnRngV FrntSideRdrLeDetn75RdrDetnSts;
SIG_GROUP_ 328 FrntSideRdrLeDetn76 1 : FrntSideRdrLeDetn76RdrDetnAzi FrntSideRdrLeDetn76RdrDetnChks FrntSideRdrLeDetn76RdrDetnCntr FrntSideRdrLeDetn76RdrDetnConf FrntSideRdrLeDetn76RdrDetnElevn FrntSideRdrLeDetn76RdrDetnPwr FrntSideRdrLeDetn76RdrDetnRng FrntSideRdrLeDetn76RdrDetnRngV FrntSideRdrLeDetn76RdrDetnSts;
SIG_GROUP_ 328 FrntSideRdrLeDetn77 1 : FrntSideRdrLeDetn77RdrDetnAzi FrntSideRdrLeDetn77RdrDetnChks FrntSideRdrLeDetn77RdrDetnCntr FrntSideRdrLeDetn77RdrDetnConf FrntSideRdrLeDetn77RdrDetnElevn FrntSideRdrLeDetn77RdrDetnPwr FrntSideRdrLeDetn77RdrDetnRng FrntSideRdrLeDetn77RdrDetnRngV FrntSideRdrLeDetn77RdrDetnSts;
SIG_GROUP_ 328 FrntSideRdrLeDetn78 1 : FrntSideRdrLeDetn78RdrDetnAzi FrntSideRdrLeDetn78RdrDetnChks FrntSideRdrLeDetn78RdrDetnCntr FrntSideRdrLeDetn78RdrDetnConf FrntSideRdrLeDetn78RdrDetnElevn FrntSideRdrLeDetn78RdrDetnPwr FrntSideRdrLeDetn78RdrDetnRng FrntSideRdrLeDetn78RdrDetnRngV FrntSideRdrLeDetn78RdrDetnSts;
SIG_GROUP_ 330 FrntSideRdrLeDetn79 1 : FrntSideRdrLeDetn79RdrDetnAzi FrntSideRdrLeDetn79RdrDetnChks FrntSideRdrLeDetn79RdrDetnCntr FrntSideRdrLeDetn79RdrDetnConf FrntSideRdrLeDetn79RdrDetnElevn FrntSideRdrLeDetn79RdrDetnPwr FrntSideRdrLeDetn79RdrDetnRng FrntSideRdrLeDetn79RdrDetnRngV FrntSideRdrLeDetn79RdrDetnSts;
SIG_GROUP_ 330 FrntSideRdrLeDetn80 1 : FrntSideRdrLeDetn80RdrDetnAzi FrntSideRdrLeDetn80RdrDetnChks FrntSideRdrLeDetn80RdrDetnCntr FrntSideRdrLeDetn80RdrDetnConf FrntSideRdrLeDetn80RdrDetnElevn FrntSideRdrLeDetn80RdrDetnPwr FrntSideRdrLeDetn80RdrDetnRng FrntSideRdrLeDetn80RdrDetnRngV FrntSideRdrLeDetn80RdrDetnSts;
SIG_GROUP_ 330 FrntSideRdrLeDetn81 1 : FrntSideRdrLeDetn81RdrDetnAzi FrntSideRdrLeDetn81RdrDetnChks FrntSideRdrLeDetn81RdrDetnCntr FrntSideRdrLeDetn81RdrDetnConf FrntSideRdrLeDetn81RdrDetnElevn FrntSideRdrLeDetn81RdrDetnPwr FrntSideRdrLeDetn81RdrDetnRng FrntSideRdrLeDetn81RdrDetnRngV FrntSideRdrLeDetn81RdrDetnSts;
SIG_GROUP_ 330 FrntSideRdrLeDetn82 1 : FrntSideRdrLeDetn82RdrDetnAzi FrntSideRdrLeDetn82RdrDetnChks FrntSideRdrLeDetn82RdrDetnCntr FrntSideRdrLeDetn82RdrDetnConf FrntSideRdrLeDetn82RdrDetnElevn FrntSideRdrLeDetn82RdrDetnPwr FrntSideRdrLeDetn82RdrDetnRng FrntSideRdrLeDetn82RdrDetnRngV FrntSideRdrLeDetn82RdrDetnSts;
SIG_GROUP_ 330 FrntSideRdrLeDetn83 1 : FrntSideRdrLeDetn83RdrDetnAzi FrntSideRdrLeDetn83RdrDetnChks FrntSideRdrLeDetn83RdrDetnCntr FrntSideRdrLeDetn83RdrDetnConf FrntSideRdrLeDetn83RdrDetnElevn FrntSideRdrLeDetn83RdrDetnPwr FrntSideRdrLeDetn83RdrDetnRng FrntSideRdrLeDetn83RdrDetnRngV FrntSideRdrLeDetn83RdrDetnSts;
SIG_GROUP_ 330 FrntSideRdrLeDetn84 1 : FrntSideRdrLeDetn84RdrDetnAzi FrntSideRdrLeDetn84RdrDetnChks FrntSideRdrLeDetn84RdrDetnCntr FrntSideRdrLeDetn84RdrDetnConf FrntSideRdrLeDetn84RdrDetnElevn FrntSideRdrLeDetn84RdrDetnPwr FrntSideRdrLeDetn84RdrDetnRng FrntSideRdrLeDetn84RdrDetnRngV FrntSideRdrLeDetn84RdrDetnSts;
