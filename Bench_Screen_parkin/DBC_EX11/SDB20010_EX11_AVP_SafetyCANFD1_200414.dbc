// *************************************************************************** *
// *                                                                           *
// *                      Mentor Graphics Corporation                          *
// *                          All rights reserved                              *
// *                                                                           *
// *************************************************************************** *
// *                                                                           *
// * Description:         CANDB File                                           *
// * Generated at:        2020-04-14 13:12:04                                  *
// * System:              SDB20010                                             *
// * Variant:             EX11_AVP                                             *
// * Network:             SafetyCANFD1                                         *
// *                                                                           *
// *************************************************************************** *
// *                                                                           *
// *             THIS CONFIGURATION MIGHT CONTAIN SOME ERRORS                  *
// *              IF THE INPUT MODEL WAS NOT PROPERLY FORMED!                  *
// *                    Do Not Use this File directly!                         *
// *                                                                           *
// *************************************************************************** *
VERSION "SafetyCANFD1"

NS_ :

BS_:

BU_:  ASDM ETC FSRL FSRR PAS

BO_ 319 FSRRSafetyCANFD1Frame08: 64 FSRR
 SG_ FrntSideRdrRiDetn43_UB : 74|1@0+ (1,0) [0|1] "" ASDM,PAS
 SG_ FrntSideRdrRiDetn43RdrDetnAzi : 31|11@0+ (0.1,-90.0) [-90.0|90.0] "Deg" ASDM,PAS
 SG_ FrntSideRdrRiDetn43RdrDetnChks : 7|8@0+ (1.0,0.0) [0.0|255.0] "Unitless" ASDM,PAS
 SG_ FrntSideRdrRiDetn43RdrDetnCntr : 15|4@0+ (1.0,0.0) [0.0|15.0] "Unitless" ASDM,PAS
 SG_ FrntSideRdrRiDetn43RdrDetnConf : 71|7@0+ (1.0,0.0) [0.0|100.0] "%" ASDM,PAS
 SG_ FrntSideRdrRiDetn43RdrDetnElevn : 79|5@0+ (1.0,-15.0) [-15.0|15.0] "Deg" ASDM,PAS
 SG_ FrntSideRdrRiDetn43RdrDetnPwr : 8|9@0+ (0.1,0.0) [0.0|51.1] "dB" ASDM,PAS
 SG_ FrntSideRdrRiDetn43RdrDetnRng : 55|14@0+ (0.02,-1.0) [-1.0|200.0] "m" ASDM,PAS
 SG_ FrntSideRdrRiDetn43RdrDetnRngV : 36|13@0+ (0.02,-80.0) [-80.0|80.0] "m/s" ASDM,PAS
 SG_ FrntSideRdrRiDetn43RdrDetnSts : 11|2@0+ (1,0) [0|3] "" ASDM,PAS
 SG_ FrntSideRdrRiDetn44_UB : 154|1@0+ (1,0) [0|1] "" ASDM,PAS
 SG_ FrntSideRdrRiDetn44RdrDetnAzi : 119|11@0+ (0.1,-90.0) [-90.0|90.0] "Deg" ASDM,PAS
 SG_ FrntSideRdrRiDetn44RdrDetnChks : 87|8@0+ (1.0,0.0) [0.0|255.0] "Unitless" ASDM,PAS
 SG_ FrntSideRdrRiDetn44RdrDetnCntr : 95|4@0+ (1.0,0.0) [0.0|15.0] "Unitless" ASDM,PAS
 SG_ FrntSideRdrRiDetn44RdrDetnConf : 111|7@0+ (1.0,0.0) [0.0|100.0] "%" ASDM,PAS
 SG_ FrntSideRdrRiDetn44RdrDetnElevn : 159|5@0+ (1.0,-15.0) [-15.0|15.0] "Deg" ASDM,PAS
 SG_ FrntSideRdrRiDetn44RdrDetnPwr : 89|9@0+ (0.1,0.0) [0.0|51.1] "dB" ASDM,PAS
 SG_ FrntSideRdrRiDetn44RdrDetnRng : 143|14@0+ (0.02,-1.0) [-1.0|200.0] "m" ASDM,PAS
 SG_ FrntSideRdrRiDetn44RdrDetnRngV : 124|13@0+ (0.02,-80.0) [-80.0|80.0] "m/s" ASDM,PAS
 SG_ FrntSideRdrRiDetn44RdrDetnSts : 91|2@0+ (1,0) [0|3] "" ASDM,PAS
 SG_ FrntSideRdrRiDetn45_UB : 234|1@0+ (1,0) [0|1] "" ASDM,PAS
 SG_ FrntSideRdrRiDetn45RdrDetnAzi : 199|11@0+ (0.1,-90.0) [-90.0|90.0] "Deg" ASDM,PAS
 SG_ FrntSideRdrRiDetn45RdrDetnChks : 167|8@0+ (1.0,0.0) [0.0|255.0] "Unitless" ASDM,PAS
 SG_ FrntSideRdrRiDetn45RdrDetnCntr : 175|4@0+ (1.0,0.0) [0.0|15.0] "Unitless" ASDM,PAS
 SG_ FrntSideRdrRiDetn45RdrDetnConf : 191|7@0+ (1.0,0.0) [0.0|100.0] "%" ASDM,PAS
 SG_ FrntSideRdrRiDetn45RdrDetnElevn : 239|5@0+ (1.0,-15.0) [-15.0|15.0] "Deg" ASDM,PAS
 SG_ FrntSideRdrRiDetn45RdrDetnPwr : 169|9@0+ (0.1,0.0) [0.0|51.1] "dB" ASDM,PAS
 SG_ FrntSideRdrRiDetn45RdrDetnRng : 223|14@0+ (0.02,-1.0) [-1.0|200.0] "m" ASDM,PAS
 SG_ FrntSideRdrRiDetn45RdrDetnRngV : 204|13@0+ (0.02,-80.0) [-80.0|80.0] "m/s" ASDM,PAS
 SG_ FrntSideRdrRiDetn45RdrDetnSts : 171|2@0+ (1,0) [0|3] "" ASDM,PAS
 SG_ FrntSideRdrRiDetn46_UB : 314|1@0+ (1,0) [0|1] "" ASDM,PAS
 SG_ FrntSideRdrRiDetn46RdrDetnAzi : 287|11@0+ (0.1,-90.0) [-90.0|90.0] "Deg" ASDM,PAS
 SG_ FrntSideRdrRiDetn46RdrDetnChks : 247|8@0+ (1.0,0.0) [0.0|255.0] "Unitless" ASDM,PAS
 SG_ FrntSideRdrRiDetn46RdrDetnCntr : 255|4@0+ (1.0,0.0) [0.0|15.0] "Unitless" ASDM,PAS
 SG_ FrntSideRdrRiDetn46RdrDetnConf : 311|7@0+ (1.0,0.0) [0.0|100.0] "%" ASDM,PAS
 SG_ FrntSideRdrRiDetn46RdrDetnElevn : 319|5@0+ (1.0,-15.0) [-15.0|15.0] "Deg" ASDM,PAS
 SG_ FrntSideRdrRiDetn46RdrDetnPwr : 249|9@0+ (0.1,0.0) [0.0|51.1] "dB" ASDM,PAS
 SG_ FrntSideRdrRiDetn46RdrDetnRng : 271|14@0+ (0.02,-1.0) [-1.0|200.0] "m" ASDM,PAS
 SG_ FrntSideRdrRiDetn46RdrDetnRngV : 292|13@0+ (0.02,-80.0) [-80.0|80.0] "m/s" ASDM,PAS
 SG_ FrntSideRdrRiDetn46RdrDetnSts : 251|2@0+ (1,0) [0|3] "" ASDM,PAS
 SG_ FrntSideRdrRiDetn47_UB : 394|1@0+ (1,0) [0|1] "" ASDM,PAS
 SG_ FrntSideRdrRiDetn47RdrDetnAzi : 367|11@0+ (0.1,-90.0) [-90.0|90.0] "Deg" ASDM,PAS
 SG_ FrntSideRdrRiDetn47RdrDetnChks : 327|8@0+ (1.0,0.0) [0.0|255.0] "Unitless" ASDM,PAS
 SG_ FrntSideRdrRiDetn47RdrDetnCntr : 335|4@0+ (1.0,0.0) [0.0|15.0] "Unitless" ASDM,PAS
 SG_ FrntSideRdrRiDetn47RdrDetnConf : 391|7@0+ (1.0,0.0) [0.0|100.0] "%" ASDM,PAS
 SG_ FrntSideRdrRiDetn47RdrDetnElevn : 399|5@0+ (1.0,-15.0) [-15.0|15.0] "Deg" ASDM,PAS
 SG_ FrntSideRdrRiDetn47RdrDetnPwr : 329|9@0+ (0.1,0.0) [0.0|51.1] "dB" ASDM,PAS
 SG_ FrntSideRdrRiDetn47RdrDetnRng : 351|14@0+ (0.02,-1.0) [-1.0|200.0] "m" ASDM,PAS
 SG_ FrntSideRdrRiDetn47RdrDetnRngV : 372|13@0+ (0.02,-80.0) [-80.0|80.0] "m/s" ASDM,PAS
 SG_ FrntSideRdrRiDetn47RdrDetnSts : 331|2@0+ (1,0) [0|3] "" ASDM,PAS
 SG_ FrntSideRdrRiDetn48_UB : 474|1@0+ (1,0) [0|1] "" ASDM,PAS
 SG_ FrntSideRdrRiDetn48RdrDetnAzi : 447|11@0+ (0.1,-90.0) [-90.0|90.0] "Deg" ASDM,PAS
 SG_ FrntSideRdrRiDetn48RdrDetnChks : 407|8@0+ (1.0,0.0) [0.0|255.0] "Unitless" ASDM,PAS
 SG_ FrntSideRdrRiDetn48RdrDetnCntr : 415|4@0+ (1.0,0.0) [0.0|15.0] "Unitless" ASDM,PAS
 SG_ FrntSideRdrRiDetn48RdrDetnConf : 471|7@0+ (1.0,0.0) [0.0|100.0] "%" ASDM,PAS
 SG_ FrntSideRdrRiDetn48RdrDetnElevn : 479|5@0+ (1.0,-15.0) [-15.0|15.0] "Deg" ASDM,PAS
 SG_ FrntSideRdrRiDetn48RdrDetnPwr : 409|9@0+ (0.1,0.0) [0.0|51.1] "dB" ASDM,PAS
 SG_ FrntSideRdrRiDetn48RdrDetnRng : 431|14@0+ (0.02,-1.0) [-1.0|200.0] "m" ASDM,PAS
 SG_ FrntSideRdrRiDetn48RdrDetnRngV : 452|13@0+ (0.02,-80.0) [-80.0|80.0] "m/s" ASDM,PAS
 SG_ FrntSideRdrRiDetn48RdrDetnSts : 411|2@0+ (1,0) [0|3] "" ASDM,PAS

BO_ 321 FSRRSafetyCANFD1Frame09: 64 FSRR
 SG_ FrntSideRdrRiDetn49_UB : 74|1@0+ (1,0) [0|1] "" ASDM,PAS
 SG_ FrntSideRdrRiDetn49RdrDetnAzi : 31|11@0+ (0.1,-90.0) [-90.0|90.0] "Deg" ASDM,PAS
 SG_ FrntSideRdrRiDetn49RdrDetnChks : 7|8@0+ (1.0,0.0) [0.0|255.0] "Unitless" ASDM,PAS
 SG_ FrntSideRdrRiDetn49RdrDetnCntr : 15|4@0+ (1.0,0.0) [0.0|15.0] "Unitless" ASDM,PAS
 SG_ FrntSideRdrRiDetn49RdrDetnConf : 71|7@0+ (1.0,0.0) [0.0|100.0] "%" ASDM,PAS
 SG_ FrntSideRdrRiDetn49RdrDetnElevn : 79|5@0+ (1.0,-15.0) [-15.0|15.0] "Deg" ASDM,PAS
 SG_ FrntSideRdrRiDetn49RdrDetnPwr : 8|9@0+ (0.1,0.0) [0.0|51.1] "dB" ASDM,PAS
 SG_ FrntSideRdrRiDetn49RdrDetnRng : 55|14@0+ (0.02,-1.0) [-1.0|200.0] "m" ASDM,PAS
 SG_ FrntSideRdrRiDetn49RdrDetnRngV : 36|13@0+ (0.02,-80.0) [-80.0|80.0] "m/s" ASDM,PAS
 SG_ FrntSideRdrRiDetn49RdrDetnSts : 11|2@0+ (1,0) [0|3] "" ASDM,PAS
 SG_ FrntSideRdrRiDetn50_UB : 154|1@0+ (1,0) [0|1] "" ASDM,PAS
 SG_ FrntSideRdrRiDetn50RdrDetnAzi : 119|11@0+ (0.1,-90.0) [-90.0|90.0] "Deg" ASDM,PAS
 SG_ FrntSideRdrRiDetn50RdrDetnChks : 87|8@0+ (1.0,0.0) [0.0|255.0] "Unitless" ASDM,PAS
 SG_ FrntSideRdrRiDetn50RdrDetnCntr : 95|4@0+ (1.0,0.0) [0.0|15.0] "Unitless" ASDM,PAS
 SG_ FrntSideRdrRiDetn50RdrDetnConf : 111|7@0+ (1.0,0.0) [0.0|100.0] "%" ASDM,PAS
 SG_ FrntSideRdrRiDetn50RdrDetnElevn : 159|5@0+ (1.0,-15.0) [-15.0|15.0] "Deg" ASDM,PAS
 SG_ FrntSideRdrRiDetn50RdrDetnPwr : 89|9@0+ (0.1,0.0) [0.0|51.1] "dB" ASDM,PAS
 SG_ FrntSideRdrRiDetn50RdrDetnRng : 143|14@0+ (0.02,-1.0) [-1.0|200.0] "m" ASDM,PAS
 SG_ FrntSideRdrRiDetn50RdrDetnRngV : 124|13@0+ (0.02,-80.0) [-80.0|80.0] "m/s" ASDM,PAS
 SG_ FrntSideRdrRiDetn50RdrDetnSts : 91|2@0+ (1,0) [0|3] "" ASDM,PAS
 SG_ FrntSideRdrRiDetn51_UB : 234|1@0+ (1,0) [0|1] "" ASDM,PAS
 SG_ FrntSideRdrRiDetn51RdrDetnAzi : 199|11@0+ (0.1,-90.0) [-90.0|90.0] "Deg" ASDM,PAS
 SG_ FrntSideRdrRiDetn51RdrDetnChks : 167|8@0+ (1.0,0.0) [0.0|255.0] "Unitless" ASDM,PAS
 SG_ FrntSideRdrRiDetn51RdrDetnCntr : 175|4@0+ (1.0,0.0) [0.0|15.0] "Unitless" ASDM,PAS
 SG_ FrntSideRdrRiDetn51RdrDetnConf : 191|7@0+ (1.0,0.0) [0.0|100.0] "%" ASDM,PAS
 SG_ FrntSideRdrRiDetn51RdrDetnElevn : 239|5@0+ (1.0,-15.0) [-15.0|15.0] "Deg" ASDM,PAS
 SG_ FrntSideRdrRiDetn51RdrDetnPwr : 169|9@0+ (0.1,0.0) [0.0|51.1] "dB" ASDM,PAS
 SG_ FrntSideRdrRiDetn51RdrDetnRng : 223|14@0+ (0.02,-1.0) [-1.0|200.0] "m" ASDM,PAS
 SG_ FrntSideRdrRiDetn51RdrDetnRngV : 204|13@0+ (0.02,-80.0) [-80.0|80.0] "m/s" ASDM,PAS
 SG_ FrntSideRdrRiDetn51RdrDetnSts : 171|2@0+ (1,0) [0|3] "" ASDM,PAS
 SG_ FrntSideRdrRiDetn52_UB : 314|1@0+ (1,0) [0|1] "" ASDM,PAS
 SG_ FrntSideRdrRiDetn52RdrDetnAzi : 287|11@0+ (0.1,-90.0) [-90.0|90.0] "Deg" ASDM,PAS
 SG_ FrntSideRdrRiDetn52RdrDetnChks : 247|8@0+ (1.0,0.0) [0.0|255.0] "Unitless" ASDM,PAS
 SG_ FrntSideRdrRiDetn52RdrDetnCntr : 255|4@0+ (1.0,0.0) [0.0|15.0] "Unitless" ASDM,PAS
 SG_ FrntSideRdrRiDetn52RdrDetnConf : 311|7@0+ (1.0,0.0) [0.0|100.0] "%" ASDM,PAS
 SG_ FrntSideRdrRiDetn52RdrDetnElevn : 319|5@0+ (1.0,-15.0) [-15.0|15.0] "Deg" ASDM,PAS
 SG_ FrntSideRdrRiDetn52RdrDetnPwr : 249|9@0+ (0.1,0.0) [0.0|51.1] "dB" ASDM,PAS
 SG_ FrntSideRdrRiDetn52RdrDetnRng : 271|14@0+ (0.02,-1.0) [-1.0|200.0] "m" ASDM,PAS
 SG_ FrntSideRdrRiDetn52RdrDetnRngV : 292|13@0+ (0.02,-80.0) [-80.0|80.0] "m/s" ASDM,PAS
 SG_ FrntSideRdrRiDetn52RdrDetnSts : 251|2@0+ (1,0) [0|3] "" ASDM,PAS
 SG_ FrntSideRdrRiDetn53_UB : 394|1@0+ (1,0) [0|1] "" ASDM,PAS
 SG_ FrntSideRdrRiDetn53RdrDetnAzi : 367|11@0+ (0.1,-90.0) [-90.0|90.0] "Deg" ASDM,PAS
 SG_ FrntSideRdrRiDetn53RdrDetnChks : 327|8@0+ (1.0,0.0) [0.0|255.0] "Unitless" ASDM,PAS
 SG_ FrntSideRdrRiDetn53RdrDetnCntr : 335|4@0+ (1.0,0.0) [0.0|15.0] "Unitless" ASDM,PAS
 SG_ FrntSideRdrRiDetn53RdrDetnConf : 391|7@0+ (1.0,0.0) [0.0|100.0] "%" ASDM,PAS
 SG_ FrntSideRdrRiDetn53RdrDetnElevn : 399|5@0+ (1.0,-15.0) [-15.0|15.0] "Deg" ASDM,PAS
 SG_ FrntSideRdrRiDetn53RdrDetnPwr : 329|9@0+ (0.1,0.0) [0.0|51.1] "dB" ASDM,PAS
 SG_ FrntSideRdrRiDetn53RdrDetnRng : 351|14@0+ (0.02,-1.0) [-1.0|200.0] "m" ASDM,PAS
 SG_ FrntSideRdrRiDetn53RdrDetnRngV : 372|13@0+ (0.02,-80.0) [-80.0|80.0] "m/s" ASDM,PAS
 SG_ FrntSideRdrRiDetn53RdrDetnSts : 331|2@0+ (1,0) [0|3] "" ASDM,PAS
 SG_ FrntSideRdrRiDetn54_UB : 474|1@0+ (1,0) [0|1] "" ASDM,PAS
 SG_ FrntSideRdrRiDetn54RdrDetnAzi : 447|11@0+ (0.1,-90.0) [-90.0|90.0] "Deg" ASDM,PAS
 SG_ FrntSideRdrRiDetn54RdrDetnChks : 407|8@0+ (1.0,0.0) [0.0|255.0] "Unitless" ASDM,PAS
 SG_ FrntSideRdrRiDetn54RdrDetnCntr : 415|4@0+ (1.0,0.0) [0.0|15.0] "Unitless" ASDM,PAS
 SG_ FrntSideRdrRiDetn54RdrDetnConf : 471|7@0+ (1.0,0.0) [0.0|100.0] "%" ASDM,PAS
 SG_ FrntSideRdrRiDetn54RdrDetnElevn : 479|5@0+ (1.0,-15.0) [-15.0|15.0] "Deg" ASDM,PAS
 SG_ FrntSideRdrRiDetn54RdrDetnPwr : 409|9@0+ (0.1,0.0) [0.0|51.1] "dB" ASDM,PAS
 SG_ FrntSideRdrRiDetn54RdrDetnRng : 431|14@0+ (0.02,-1.0) [-1.0|200.0] "m" ASDM,PAS
 SG_ FrntSideRdrRiDetn54RdrDetnRngV : 452|13@0+ (0.02,-80.0) [-80.0|80.0] "m/s" ASDM,PAS
 SG_ FrntSideRdrRiDetn54RdrDetnSts : 411|2@0+ (1,0) [0|3] "" ASDM,PAS

BO_ 323 FSRRSafetyCANFD1Frame10: 64 FSRR
 SG_ FrntSideRdrRiDetn55_UB : 74|1@0+ (1,0) [0|1] "" ASDM,PAS
 SG_ FrntSideRdrRiDetn55RdrDetnAzi : 31|11@0+ (0.1,-90.0) [-90.0|90.0] "Deg" ASDM,PAS
 SG_ FrntSideRdrRiDetn55RdrDetnChks : 7|8@0+ (1.0,0.0) [0.0|255.0] "Unitless" ASDM,PAS
 SG_ FrntSideRdrRiDetn55RdrDetnCntr : 15|4@0+ (1.0,0.0) [0.0|15.0] "Unitless" ASDM,PAS
 SG_ FrntSideRdrRiDetn55RdrDetnConf : 71|7@0+ (1.0,0.0) [0.0|100.0] "%" ASDM,PAS
 SG_ FrntSideRdrRiDetn55RdrDetnElevn : 79|5@0+ (1.0,-15.0) [-15.0|15.0] "Deg" ASDM,PAS
 SG_ FrntSideRdrRiDetn55RdrDetnPwr : 8|9@0+ (0.1,0.0) [0.0|51.1] "dB" ASDM,PAS
 SG_ FrntSideRdrRiDetn55RdrDetnRng : 55|14@0+ (0.02,-1.0) [-1.0|200.0] "m" ASDM,PAS
 SG_ FrntSideRdrRiDetn55RdrDetnRngV : 36|13@0+ (0.02,-80.0) [-80.0|80.0] "m/s" ASDM,PAS
 SG_ FrntSideRdrRiDetn55RdrDetnSts : 11|2@0+ (1,0) [0|3] "" ASDM,PAS
 SG_ FrntSideRdrRiDetn56_UB : 154|1@0+ (1,0) [0|1] "" ASDM,PAS
 SG_ FrntSideRdrRiDetn56RdrDetnAzi : 119|11@0+ (0.1,-90.0) [-90.0|90.0] "Deg" ASDM,PAS
 SG_ FrntSideRdrRiDetn56RdrDetnChks : 87|8@0+ (1.0,0.0) [0.0|255.0] "Unitless" ASDM,PAS
 SG_ FrntSideRdrRiDetn56RdrDetnCntr : 95|4@0+ (1.0,0.0) [0.0|15.0] "Unitless" ASDM,PAS
 SG_ FrntSideRdrRiDetn56RdrDetnConf : 111|7@0+ (1.0,0.0) [0.0|100.0] "%" ASDM,PAS
 SG_ FrntSideRdrRiDetn56RdrDetnElevn : 159|5@0+ (1.0,-15.0) [-15.0|15.0] "Deg" ASDM,PAS
 SG_ FrntSideRdrRiDetn56RdrDetnPwr : 89|9@0+ (0.1,0.0) [0.0|51.1] "dB" ASDM,PAS
 SG_ FrntSideRdrRiDetn56RdrDetnRng : 143|14@0+ (0.02,-1.0) [-1.0|200.0] "m" ASDM,PAS
 SG_ FrntSideRdrRiDetn56RdrDetnRngV : 124|13@0+ (0.02,-80.0) [-80.0|80.0] "m/s" ASDM,PAS
 SG_ FrntSideRdrRiDetn56RdrDetnSts : 91|2@0+ (1,0) [0|3] "" ASDM,PAS
 SG_ FrntSideRdrRiDetn57_UB : 234|1@0+ (1,0) [0|1] "" ASDM,PAS
 SG_ FrntSideRdrRiDetn57RdrDetnAzi : 199|11@0+ (0.1,-90.0) [-90.0|90.0] "Deg" ASDM,PAS
 SG_ FrntSideRdrRiDetn57RdrDetnChks : 167|8@0+ (1.0,0.0) [0.0|255.0] "Unitless" ASDM,PAS
 SG_ FrntSideRdrRiDetn57RdrDetnCntr : 175|4@0+ (1.0,0.0) [0.0|15.0] "Unitless" ASDM,PAS
 SG_ FrntSideRdrRiDetn57RdrDetnConf : 191|7@0+ (1.0,0.0) [0.0|100.0] "%" ASDM,PAS
 SG_ FrntSideRdrRiDetn57RdrDetnElevn : 239|5@0+ (1.0,-15.0) [-15.0|15.0] "Deg" ASDM,PAS
 SG_ FrntSideRdrRiDetn57RdrDetnPwr : 169|9@0+ (0.1,0.0) [0.0|51.1] "dB" ASDM,PAS
 SG_ FrntSideRdrRiDetn57RdrDetnRng : 223|14@0+ (0.02,-1.0) [-1.0|200.0] "m" ASDM,PAS
 SG_ FrntSideRdrRiDetn57RdrDetnRngV : 204|13@0+ (0.02,-80.0) [-80.0|80.0] "m/s" ASDM,PAS
 SG_ FrntSideRdrRiDetn57RdrDetnSts : 171|2@0+ (1,0) [0|3] "" ASDM,PAS
 SG_ FrntSideRdrRiDetn58_UB : 314|1@0+ (1,0) [0|1] "" ASDM,PAS
 SG_ FrntSideRdrRiDetn58RdrDetnAzi : 287|11@0+ (0.1,-90.0) [-90.0|90.0] "Deg" ASDM,PAS
 SG_ FrntSideRdrRiDetn58RdrDetnChks : 247|8@0+ (1.0,0.0) [0.0|255.0] "Unitless" ASDM,PAS
 SG_ FrntSideRdrRiDetn58RdrDetnCntr : 255|4@0+ (1.0,0.0) [0.0|15.0] "Unitless" ASDM,PAS
 SG_ FrntSideRdrRiDetn58RdrDetnConf : 311|7@0+ (1.0,0.0) [0.0|100.0] "%" ASDM,PAS
 SG_ FrntSideRdrRiDetn58RdrDetnElevn : 319|5@0+ (1.0,-15.0) [-15.0|15.0] "Deg" ASDM,PAS
 SG_ FrntSideRdrRiDetn58RdrDetnPwr : 249|9@0+ (0.1,0.0) [0.0|51.1] "dB" ASDM,PAS
 SG_ FrntSideRdrRiDetn58RdrDetnRng : 271|14@0+ (0.02,-1.0) [-1.0|200.0] "m" ASDM,PAS
 SG_ FrntSideRdrRiDetn58RdrDetnRngV : 292|13@0+ (0.02,-80.0) [-80.0|80.0] "m/s" ASDM,PAS
 SG_ FrntSideRdrRiDetn58RdrDetnSts : 251|2@0+ (1,0) [0|3] "" ASDM,PAS
 SG_ FrntSideRdrRiDetn59_UB : 394|1@0+ (1,0) [0|1] "" ASDM,PAS
 SG_ FrntSideRdrRiDetn59RdrDetnAzi : 367|11@0+ (0.1,-90.0) [-90.0|90.0] "Deg" ASDM,PAS
 SG_ FrntSideRdrRiDetn59RdrDetnChks : 327|8@0+ (1.0,0.0) [0.0|255.0] "Unitless" ASDM,PAS
 SG_ FrntSideRdrRiDetn59RdrDetnCntr : 335|4@0+ (1.0,0.0) [0.0|15.0] "Unitless" ASDM,PAS
 SG_ FrntSideRdrRiDetn59RdrDetnConf : 391|7@0+ (1.0,0.0) [0.0|100.0] "%" ASDM,PAS
 SG_ FrntSideRdrRiDetn59RdrDetnElevn : 399|5@0+ (1.0,-15.0) [-15.0|15.0] "Deg" ASDM,PAS
 SG_ FrntSideRdrRiDetn59RdrDetnPwr : 329|9@0+ (0.1,0.0) [0.0|51.1] "dB" ASDM,PAS
 SG_ FrntSideRdrRiDetn59RdrDetnRng : 351|14@0+ (0.02,-1.0) [-1.0|200.0] "m" ASDM,PAS
 SG_ FrntSideRdrRiDetn59RdrDetnRngV : 372|13@0+ (0.02,-80.0) [-80.0|80.0] "m/s" ASDM,PAS
 SG_ FrntSideRdrRiDetn59RdrDetnSts : 331|2@0+ (1,0) [0|3] "" ASDM,PAS
 SG_ FrntSideRdrRiDetn60_UB : 474|1@0+ (1,0) [0|1] "" ASDM,PAS
 SG_ FrntSideRdrRiDetn60RdrDetnAzi : 447|11@0+ (0.1,-90.0) [-90.0|90.0] "Deg" ASDM,PAS
 SG_ FrntSideRdrRiDetn60RdrDetnChks : 407|8@0+ (1.0,0.0) [0.0|255.0] "Unitless" ASDM,PAS
 SG_ FrntSideRdrRiDetn60RdrDetnCntr : 415|4@0+ (1.0,0.0) [0.0|15.0] "Unitless" ASDM,PAS
 SG_ FrntSideRdrRiDetn60RdrDetnConf : 471|7@0+ (1.0,0.0) [0.0|100.0] "%" ASDM,PAS
 SG_ FrntSideRdrRiDetn60RdrDetnElevn : 479|5@0+ (1.0,-15.0) [-15.0|15.0] "Deg" ASDM,PAS
 SG_ FrntSideRdrRiDetn60RdrDetnPwr : 409|9@0+ (0.1,0.0) [0.0|51.1] "dB" ASDM,PAS
 SG_ FrntSideRdrRiDetn60RdrDetnRng : 431|14@0+ (0.02,-1.0) [-1.0|200.0] "m" ASDM,PAS
 SG_ FrntSideRdrRiDetn60RdrDetnRngV : 452|13@0+ (0.02,-80.0) [-80.0|80.0] "m/s" ASDM,PAS
 SG_ FrntSideRdrRiDetn60RdrDetnSts : 411|2@0+ (1,0) [0|3] "" ASDM,PAS

BO_ 325 FSRRSafetyCANFD1Frame11: 64 FSRR
 SG_ FrntSideRdrRiDetn61_UB : 74|1@0+ (1,0) [0|1] "" ASDM,PAS
 SG_ FrntSideRdrRiDetn61RdrDetnAzi : 31|11@0+ (0.1,-90.0) [-90.0|90.0] "Deg" ASDM,PAS
 SG_ FrntSideRdrRiDetn61RdrDetnChks : 7|8@0+ (1.0,0.0) [0.0|255.0] "Unitless" ASDM,PAS
 SG_ FrntSideRdrRiDetn61RdrDetnCntr : 15|4@0+ (1.0,0.0) [0.0|15.0] "Unitless" ASDM,PAS
 SG_ FrntSideRdrRiDetn61RdrDetnConf : 71|7@0+ (1.0,0.0) [0.0|100.0] "%" ASDM,PAS
 SG_ FrntSideRdrRiDetn61RdrDetnElevn : 79|5@0+ (1.0,-15.0) [-15.0|15.0] "Deg" ASDM,PAS
 SG_ FrntSideRdrRiDetn61RdrDetnPwr : 8|9@0+ (0.1,0.0) [0.0|51.1] "dB" ASDM,PAS
 SG_ FrntSideRdrRiDetn61RdrDetnRng : 55|14@0+ (0.02,-1.0) [-1.0|200.0] "m" ASDM,PAS
 SG_ FrntSideRdrRiDetn61RdrDetnRngV : 36|13@0+ (0.02,-80.0) [-80.0|80.0] "m/s" ASDM,PAS
 SG_ FrntSideRdrRiDetn61RdrDetnSts : 11|2@0+ (1,0) [0|3] "" ASDM,PAS
 SG_ FrntSideRdrRiDetn62_UB : 154|1@0+ (1,0) [0|1] "" ASDM,PAS
 SG_ FrntSideRdrRiDetn62RdrDetnAzi : 119|11@0+ (0.1,-90.0) [-90.0|90.0] "Deg" ASDM,PAS
 SG_ FrntSideRdrRiDetn62RdrDetnChks : 87|8@0+ (1.0,0.0) [0.0|255.0] "Unitless" ASDM,PAS
 SG_ FrntSideRdrRiDetn62RdrDetnCntr : 95|4@0+ (1.0,0.0) [0.0|15.0] "Unitless" ASDM,PAS
 SG_ FrntSideRdrRiDetn62RdrDetnConf : 111|7@0+ (1.0,0.0) [0.0|100.0] "%" ASDM,PAS
 SG_ FrntSideRdrRiDetn62RdrDetnElevn : 159|5@0+ (1.0,-15.0) [-15.0|15.0] "Deg" ASDM,PAS
 SG_ FrntSideRdrRiDetn62RdrDetnPwr : 89|9@0+ (0.1,0.0) [0.0|51.1] "dB" ASDM,PAS
 SG_ FrntSideRdrRiDetn62RdrDetnRng : 143|14@0+ (0.02,-1.0) [-1.0|200.0] "m" ASDM,PAS
 SG_ FrntSideRdrRiDetn62RdrDetnRngV : 124|13@0+ (0.02,-80.0) [-80.0|80.0] "m/s" ASDM,PAS
 SG_ FrntSideRdrRiDetn62RdrDetnSts : 91|2@0+ (1,0) [0|3] "" ASDM,PAS
 SG_ FrntSideRdrRiDetn63_UB : 234|1@0+ (1,0) [0|1] "" ASDM,PAS
 SG_ FrntSideRdrRiDetn63RdrDetnAzi : 199|11@0+ (0.1,-90.0) [-90.0|90.0] "Deg" ASDM,PAS
 SG_ FrntSideRdrRiDetn63RdrDetnChks : 167|8@0+ (1.0,0.0) [0.0|255.0] "Unitless" ASDM,PAS
 SG_ FrntSideRdrRiDetn63RdrDetnCntr : 175|4@0+ (1.0,0.0) [0.0|15.0] "Unitless" ASDM,PAS
 SG_ FrntSideRdrRiDetn63RdrDetnConf : 191|7@0+ (1.0,0.0) [0.0|100.0] "%" ASDM,PAS
 SG_ FrntSideRdrRiDetn63RdrDetnElevn : 239|5@0+ (1.0,-15.0) [-15.0|15.0] "Deg" ASDM,PAS
 SG_ FrntSideRdrRiDetn63RdrDetnPwr : 169|9@0+ (0.1,0.0) [0.0|51.1] "dB" ASDM,PAS
 SG_ FrntSideRdrRiDetn63RdrDetnRng : 223|14@0+ (0.02,-1.0) [-1.0|200.0] "m" ASDM,PAS
 SG_ FrntSideRdrRiDetn63RdrDetnRngV : 204|13@0+ (0.02,-80.0) [-80.0|80.0] "m/s" ASDM,PAS
 SG_ FrntSideRdrRiDetn63RdrDetnSts : 171|2@0+ (1,0) [0|3] "" ASDM,PAS
 SG_ FrntSideRdrRiDetn64_UB : 314|1@0+ (1,0) [0|1] "" ASDM,PAS
 SG_ FrntSideRdrRiDetn64RdrDetnAzi : 287|11@0+ (0.1,-90.0) [-90.0|90.0] "Deg" ASDM,PAS
 SG_ FrntSideRdrRiDetn64RdrDetnChks : 247|8@0+ (1.0,0.0) [0.0|255.0] "Unitless" ASDM,PAS
 SG_ FrntSideRdrRiDetn64RdrDetnCntr : 255|4@0+ (1.0,0.0) [0.0|15.0] "Unitless" ASDM,PAS
 SG_ FrntSideRdrRiDetn64RdrDetnConf : 311|7@0+ (1.0,0.0) [0.0|100.0] "%" ASDM,PAS
 SG_ FrntSideRdrRiDetn64RdrDetnElevn : 319|5@0+ (1.0,-15.0) [-15.0|15.0] "Deg" ASDM,PAS
 SG_ FrntSideRdrRiDetn64RdrDetnPwr : 249|9@0+ (0.1,0.0) [0.0|51.1] "dB" ASDM,PAS
 SG_ FrntSideRdrRiDetn64RdrDetnRng : 271|14@0+ (0.02,-1.0) [-1.0|200.0] "m" ASDM,PAS
 SG_ FrntSideRdrRiDetn64RdrDetnRngV : 292|13@0+ (0.02,-80.0) [-80.0|80.0] "m/s" ASDM,PAS
 SG_ FrntSideRdrRiDetn64RdrDetnSts : 251|2@0+ (1,0) [0|3] "" ASDM,PAS
 SG_ FrntSideRdrRiDetn65_UB : 394|1@0+ (1,0) [0|1] "" ASDM,PAS
 SG_ FrntSideRdrRiDetn65RdrDetnAzi : 367|11@0+ (0.1,-90.0) [-90.0|90.0] "Deg" ASDM,PAS
 SG_ FrntSideRdrRiDetn65RdrDetnChks : 327|8@0+ (1.0,0.0) [0.0|255.0] "Unitless" ASDM,PAS
 SG_ FrntSideRdrRiDetn65RdrDetnCntr : 335|4@0+ (1.0,0.0) [0.0|15.0] "Unitless" ASDM,PAS
 SG_ FrntSideRdrRiDetn65RdrDetnConf : 391|7@0+ (1.0,0.0) [0.0|100.0] "%" ASDM,PAS
 SG_ FrntSideRdrRiDetn65RdrDetnElevn : 399|5@0+ (1.0,-15.0) [-15.0|15.0] "Deg" ASDM,PAS
 SG_ FrntSideRdrRiDetn65RdrDetnPwr : 329|9@0+ (0.1,0.0) [0.0|51.1] "dB" ASDM,PAS
 SG_ FrntSideRdrRiDetn65RdrDetnRng : 351|14@0+ (0.02,-1.0) [-1.0|200.0] "m" ASDM,PAS
 SG_ FrntSideRdrRiDetn65RdrDetnRngV : 372|13@0+ (0.02,-80.0) [-80.0|80.0] "m/s" ASDM,PAS
 SG_ FrntSideRdrRiDetn65RdrDetnSts : 331|2@0+ (1,0) [0|3] "" ASDM,PAS
 SG_ FrntSideRdrRiDetn66_UB : 474|1@0+ (1,0) [0|1] "" ASDM,PAS
 SG_ FrntSideRdrRiDetn66RdrDetnAzi : 447|11@0+ (0.1,-90.0) [-90.0|90.0] "Deg" ASDM,PAS
 SG_ FrntSideRdrRiDetn66RdrDetnChks : 407|8@0+ (1.0,0.0) [0.0|255.0] "Unitless" ASDM,PAS
 SG_ FrntSideRdrRiDetn66RdrDetnCntr : 415|4@0+ (1.0,0.0) [0.0|15.0] "Unitless" ASDM,PAS
 SG_ FrntSideRdrRiDetn66RdrDetnConf : 471|7@0+ (1.0,0.0) [0.0|100.0] "%" ASDM,PAS
 SG_ FrntSideRdrRiDetn66RdrDetnElevn : 479|5@0+ (1.0,-15.0) [-15.0|15.0] "Deg" ASDM,PAS
 SG_ FrntSideRdrRiDetn66RdrDetnPwr : 409|9@0+ (0.1,0.0) [0.0|51.1] "dB" ASDM,PAS
 SG_ FrntSideRdrRiDetn66RdrDetnRng : 431|14@0+ (0.02,-1.0) [-1.0|200.0] "m" ASDM,PAS
 SG_ FrntSideRdrRiDetn66RdrDetnRngV : 452|13@0+ (0.02,-80.0) [-80.0|80.0] "m/s" ASDM,PAS
 SG_ FrntSideRdrRiDetn66RdrDetnSts : 411|2@0+ (1,0) [0|3] "" ASDM,PAS

BO_ 327 FSRRSafetyCANFD1Frame12: 64 FSRR
 SG_ FrntSideRdrRiDetn67_UB : 74|1@0+ (1,0) [0|1] "" ASDM,PAS
 SG_ FrntSideRdrRiDetn67RdrDetnAzi : 31|11@0+ (0.1,-90.0) [-90.0|90.0] "Deg" ASDM,PAS
 SG_ FrntSideRdrRiDetn67RdrDetnChks : 7|8@0+ (1.0,0.0) [0.0|255.0] "Unitless" ASDM,PAS
 SG_ FrntSideRdrRiDetn67RdrDetnCntr : 15|4@0+ (1.0,0.0) [0.0|15.0] "Unitless" ASDM,PAS
 SG_ FrntSideRdrRiDetn67RdrDetnConf : 71|7@0+ (1.0,0.0) [0.0|100.0] "%" ASDM,PAS
 SG_ FrntSideRdrRiDetn67RdrDetnElevn : 79|5@0+ (1.0,-15.0) [-15.0|15.0] "Deg" ASDM,PAS
 SG_ FrntSideRdrRiDetn67RdrDetnPwr : 8|9@0+ (0.1,0.0) [0.0|51.1] "dB" ASDM,PAS
 SG_ FrntSideRdrRiDetn67RdrDetnRng : 55|14@0+ (0.02,-1.0) [-1.0|200.0] "m" ASDM,PAS
 SG_ FrntSideRdrRiDetn67RdrDetnRngV : 36|13@0+ (0.02,-80.0) [-80.0|80.0] "m/s" ASDM,PAS
 SG_ FrntSideRdrRiDetn67RdrDetnSts : 11|2@0+ (1,0) [0|3] "" ASDM,PAS
 SG_ FrntSideRdrRiDetn68_UB : 154|1@0+ (1,0) [0|1] "" ASDM,PAS
 SG_ FrntSideRdrRiDetn68RdrDetnAzi : 119|11@0+ (0.1,-90.0) [-90.0|90.0] "Deg" ASDM,PAS
 SG_ FrntSideRdrRiDetn68RdrDetnChks : 87|8@0+ (1.0,0.0) [0.0|255.0] "Unitless" ASDM,PAS
 SG_ FrntSideRdrRiDetn68RdrDetnCntr : 95|4@0+ (1.0,0.0) [0.0|15.0] "Unitless" ASDM,PAS
 SG_ FrntSideRdrRiDetn68RdrDetnConf : 111|7@0+ (1.0,0.0) [0.0|100.0] "%" ASDM,PAS
 SG_ FrntSideRdrRiDetn68RdrDetnElevn : 159|5@0+ (1.0,-15.0) [-15.0|15.0] "Deg" ASDM,PAS
 SG_ FrntSideRdrRiDetn68RdrDetnPwr : 89|9@0+ (0.1,0.0) [0.0|51.1] "dB" ASDM,PAS
 SG_ FrntSideRdrRiDetn68RdrDetnRng : 143|14@0+ (0.02,-1.0) [-1.0|200.0] "m" ASDM,PAS
 SG_ FrntSideRdrRiDetn68RdrDetnRngV : 124|13@0+ (0.02,-80.0) [-80.0|80.0] "m/s" ASDM,PAS
 SG_ FrntSideRdrRiDetn68RdrDetnSts : 91|2@0+ (1,0) [0|3] "" ASDM,PAS
 SG_ FrntSideRdrRiDetn69_UB : 234|1@0+ (1,0) [0|1] "" ASDM,PAS
 SG_ FrntSideRdrRiDetn69RdrDetnAzi : 199|11@0+ (0.1,-90.0) [-90.0|90.0] "Deg" ASDM,PAS
 SG_ FrntSideRdrRiDetn69RdrDetnChks : 167|8@0+ (1.0,0.0) [0.0|255.0] "Unitless" ASDM,PAS
 SG_ FrntSideRdrRiDetn69RdrDetnCntr : 175|4@0+ (1.0,0.0) [0.0|15.0] "Unitless" ASDM,PAS
 SG_ FrntSideRdrRiDetn69RdrDetnConf : 191|7@0+ (1.0,0.0) [0.0|100.0] "%" ASDM,PAS
 SG_ FrntSideRdrRiDetn69RdrDetnElevn : 239|5@0+ (1.0,-15.0) [-15.0|15.0] "Deg" ASDM,PAS
 SG_ FrntSideRdrRiDetn69RdrDetnPwr : 169|9@0+ (0.1,0.0) [0.0|51.1] "dB" ASDM,PAS
 SG_ FrntSideRdrRiDetn69RdrDetnRng : 223|14@0+ (0.02,-1.0) [-1.0|200.0] "m" ASDM,PAS
 SG_ FrntSideRdrRiDetn69RdrDetnRngV : 204|13@0+ (0.02,-80.0) [-80.0|80.0] "m/s" ASDM,PAS
 SG_ FrntSideRdrRiDetn69RdrDetnSts : 171|2@0+ (1,0) [0|3] "" ASDM,PAS
 SG_ FrntSideRdrRiDetn70_UB : 314|1@0+ (1,0) [0|1] "" ASDM,PAS
 SG_ FrntSideRdrRiDetn70RdrDetnAzi : 287|11@0+ (0.1,-90.0) [-90.0|90.0] "Deg" ASDM,PAS
 SG_ FrntSideRdrRiDetn70RdrDetnChks : 247|8@0+ (1.0,0.0) [0.0|255.0] "Unitless" ASDM,PAS
 SG_ FrntSideRdrRiDetn70RdrDetnCntr : 255|4@0+ (1.0,0.0) [0.0|15.0] "Unitless" ASDM,PAS
 SG_ FrntSideRdrRiDetn70RdrDetnConf : 311|7@0+ (1.0,0.0) [0.0|100.0] "%" ASDM,PAS
 SG_ FrntSideRdrRiDetn70RdrDetnElevn : 319|5@0+ (1.0,-15.0) [-15.0|15.0] "Deg" ASDM,PAS
 SG_ FrntSideRdrRiDetn70RdrDetnPwr : 249|9@0+ (0.1,0.0) [0.0|51.1] "dB" ASDM,PAS
 SG_ FrntSideRdrRiDetn70RdrDetnRng : 271|14@0+ (0.02,-1.0) [-1.0|200.0] "m" ASDM,PAS
 SG_ FrntSideRdrRiDetn70RdrDetnRngV : 292|13@0+ (0.02,-80.0) [-80.0|80.0] "m/s" ASDM,PAS
 SG_ FrntSideRdrRiDetn70RdrDetnSts : 251|2@0+ (1,0) [0|3] "" ASDM,PAS
 SG_ FrntSideRdrRiDetn71_UB : 394|1@0+ (1,0) [0|1] "" ASDM,PAS
 SG_ FrntSideRdrRiDetn71RdrDetnAzi : 367|11@0+ (0.1,-90.0) [-90.0|90.0] "Deg" ASDM,PAS
 SG_ FrntSideRdrRiDetn71RdrDetnChks : 327|8@0+ (1.0,0.0) [0.0|255.0] "Unitless" ASDM,PAS
 SG_ FrntSideRdrRiDetn71RdrDetnCntr : 335|4@0+ (1.0,0.0) [0.0|15.0] "Unitless" ASDM,PAS
 SG_ FrntSideRdrRiDetn71RdrDetnConf : 391|7@0+ (1.0,0.0) [0.0|100.0] "%" ASDM,PAS
 SG_ FrntSideRdrRiDetn71RdrDetnElevn : 399|5@0+ (1.0,-15.0) [-15.0|15.0] "Deg" ASDM,PAS
 SG_ FrntSideRdrRiDetn71RdrDetnPwr : 329|9@0+ (0.1,0.0) [0.0|51.1] "dB" ASDM,PAS
 SG_ FrntSideRdrRiDetn71RdrDetnRng : 351|14@0+ (0.02,-1.0) [-1.0|200.0] "m" ASDM,PAS
 SG_ FrntSideRdrRiDetn71RdrDetnRngV : 372|13@0+ (0.02,-80.0) [-80.0|80.0] "m/s" ASDM,PAS
 SG_ FrntSideRdrRiDetn71RdrDetnSts : 331|2@0+ (1,0) [0|3] "" ASDM,PAS
 SG_ FrntSideRdrRiDetn72_UB : 474|1@0+ (1,0) [0|1] "" ASDM,PAS
 SG_ FrntSideRdrRiDetn72RdrDetnAzi : 447|11@0+ (0.1,-90.0) [-90.0|90.0] "Deg" ASDM,PAS
 SG_ FrntSideRdrRiDetn72RdrDetnChks : 407|8@0+ (1.0,0.0) [0.0|255.0] "Unitless" ASDM,PAS
 SG_ FrntSideRdrRiDetn72RdrDetnCntr : 415|4@0+ (1.0,0.0) [0.0|15.0] "Unitless" ASDM,PAS
 SG_ FrntSideRdrRiDetn72RdrDetnConf : 471|7@0+ (1.0,0.0) [0.0|100.0] "%" ASDM,PAS
 SG_ FrntSideRdrRiDetn72RdrDetnElevn : 479|5@0+ (1.0,-15.0) [-15.0|15.0] "Deg" ASDM,PAS
 SG_ FrntSideRdrRiDetn72RdrDetnPwr : 409|9@0+ (0.1,0.0) [0.0|51.1] "dB" ASDM,PAS
 SG_ FrntSideRdrRiDetn72RdrDetnRng : 431|14@0+ (0.02,-1.0) [-1.0|200.0] "m" ASDM,PAS
 SG_ FrntSideRdrRiDetn72RdrDetnRngV : 452|13@0+ (0.02,-80.0) [-80.0|80.0] "m/s" ASDM,PAS
 SG_ FrntSideRdrRiDetn72RdrDetnSts : 411|2@0+ (1,0) [0|3] "" ASDM,PAS

BO_ 329 FSRRSafetyCANFD1Frame13: 64 FSRR
 SG_ FrntSideRdrRiDetn73_UB : 74|1@0+ (1,0) [0|1] "" ASDM,PAS
 SG_ FrntSideRdrRiDetn73RdrDetnAzi : 31|11@0+ (0.1,-90.0) [-90.0|90.0] "Deg" ASDM,PAS
 SG_ FrntSideRdrRiDetn73RdrDetnChks : 7|8@0+ (1.0,0.0) [0.0|255.0] "Unitless" ASDM,PAS
 SG_ FrntSideRdrRiDetn73RdrDetnCntr : 15|4@0+ (1.0,0.0) [0.0|15.0] "Unitless" ASDM,PAS
 SG_ FrntSideRdrRiDetn73RdrDetnConf : 71|7@0+ (1.0,0.0) [0.0|100.0] "%" ASDM,PAS
 SG_ FrntSideRdrRiDetn73RdrDetnElevn : 79|5@0+ (1.0,-15.0) [-15.0|15.0] "Deg" ASDM,PAS
 SG_ FrntSideRdrRiDetn73RdrDetnPwr : 8|9@0+ (0.1,0.0) [0.0|51.1] "dB" ASDM,PAS
 SG_ FrntSideRdrRiDetn73RdrDetnRng : 55|14@0+ (0.02,-1.0) [-1.0|200.0] "m" ASDM,PAS
 SG_ FrntSideRdrRiDetn73RdrDetnRngV : 36|13@0+ (0.02,-80.0) [-80.0|80.0] "m/s" ASDM,PAS
 SG_ FrntSideRdrRiDetn73RdrDetnSts : 11|2@0+ (1,0) [0|3] "" ASDM,PAS
 SG_ FrntSideRdrRiDetn74_UB : 154|1@0+ (1,0) [0|1] "" ASDM,PAS
 SG_ FrntSideRdrRiDetn74RdrDetnAzi : 119|11@0+ (0.1,-90.0) [-90.0|90.0] "Deg" ASDM,PAS
 SG_ FrntSideRdrRiDetn74RdrDetnChks : 87|8@0+ (1.0,0.0) [0.0|255.0] "Unitless" ASDM,PAS
 SG_ FrntSideRdrRiDetn74RdrDetnCntr : 95|4@0+ (1.0,0.0) [0.0|15.0] "Unitless" ASDM,PAS
 SG_ FrntSideRdrRiDetn74RdrDetnConf : 111|7@0+ (1.0,0.0) [0.0|100.0] "%" ASDM,PAS
 SG_ FrntSideRdrRiDetn74RdrDetnElevn : 159|5@0+ (1.0,-15.0) [-15.0|15.0] "Deg" ASDM,PAS
 SG_ FrntSideRdrRiDetn74RdrDetnPwr : 89|9@0+ (0.1,0.0) [0.0|51.1] "dB" ASDM,PAS
 SG_ FrntSideRdrRiDetn74RdrDetnRng : 143|14@0+ (0.02,-1.0) [-1.0|200.0] "m" ASDM,PAS
 SG_ FrntSideRdrRiDetn74RdrDetnRngV : 124|13@0+ (0.02,-80.0) [-80.0|80.0] "m/s" ASDM,PAS
 SG_ FrntSideRdrRiDetn74RdrDetnSts : 91|2@0+ (1,0) [0|3] "" ASDM,PAS
 SG_ FrntSideRdrRiDetn75_UB : 234|1@0+ (1,0) [0|1] "" ASDM,PAS
 SG_ FrntSideRdrRiDetn75RdrDetnAzi : 199|11@0+ (0.1,-90.0) [-90.0|90.0] "Deg" ASDM,PAS
 SG_ FrntSideRdrRiDetn75RdrDetnChks : 167|8@0+ (1.0,0.0) [0.0|255.0] "Unitless" ASDM,PAS
 SG_ FrntSideRdrRiDetn75RdrDetnCntr : 175|4@0+ (1.0,0.0) [0.0|15.0] "Unitless" ASDM,PAS
 SG_ FrntSideRdrRiDetn75RdrDetnConf : 191|7@0+ (1.0,0.0) [0.0|100.0] "%" ASDM,PAS
 SG_ FrntSideRdrRiDetn75RdrDetnElevn : 239|5@0+ (1.0,-15.0) [-15.0|15.0] "Deg" ASDM,PAS
 SG_ FrntSideRdrRiDetn75RdrDetnPwr : 169|9@0+ (0.1,0.0) [0.0|51.1] "dB" ASDM,PAS
 SG_ FrntSideRdrRiDetn75RdrDetnRng : 223|14@0+ (0.02,-1.0) [-1.0|200.0] "m" ASDM,PAS
 SG_ FrntSideRdrRiDetn75RdrDetnRngV : 204|13@0+ (0.02,-80.0) [-80.0|80.0] "m/s" ASDM,PAS
 SG_ FrntSideRdrRiDetn75RdrDetnSts : 171|2@0+ (1,0) [0|3] "" ASDM,PAS
 SG_ FrntSideRdrRiDetn76_UB : 314|1@0+ (1,0) [0|1] "" ASDM,PAS
 SG_ FrntSideRdrRiDetn76RdrDetnAzi : 287|11@0+ (0.1,-90.0) [-90.0|90.0] "Deg" ASDM,PAS
 SG_ FrntSideRdrRiDetn76RdrDetnChks : 247|8@0+ (1.0,0.0) [0.0|255.0] "Unitless" ASDM,PAS
 SG_ FrntSideRdrRiDetn76RdrDetnCntr : 255|4@0+ (1.0,0.0) [0.0|15.0] "Unitless" ASDM,PAS
 SG_ FrntSideRdrRiDetn76RdrDetnConf : 311|7@0+ (1.0,0.0) [0.0|100.0] "%" ASDM,PAS
 SG_ FrntSideRdrRiDetn76RdrDetnElevn : 319|5@0+ (1.0,-15.0) [-15.0|15.0] "Deg" ASDM,PAS
 SG_ FrntSideRdrRiDetn76RdrDetnPwr : 249|9@0+ (0.1,0.0) [0.0|51.1] "dB" ASDM,PAS
 SG_ FrntSideRdrRiDetn76RdrDetnRng : 271|14@0+ (0.02,-1.0) [-1.0|200.0] "m" ASDM,PAS
 SG_ FrntSideRdrRiDetn76RdrDetnRngV : 292|13@0+ (0.02,-80.0) [-80.0|80.0] "m/s" ASDM,PAS
 SG_ FrntSideRdrRiDetn76RdrDetnSts : 251|2@0+ (1,0) [0|3] "" ASDM,PAS
 SG_ FrntSideRdrRiDetn77_UB : 394|1@0+ (1,0) [0|1] "" ASDM,PAS
 SG_ FrntSideRdrRiDetn77RdrDetnAzi : 367|11@0+ (0.1,-90.0) [-90.0|90.0] "Deg" ASDM,PAS
 SG_ FrntSideRdrRiDetn77RdrDetnChks : 327|8@0+ (1.0,0.0) [0.0|255.0] "Unitless" ASDM,PAS
 SG_ FrntSideRdrRiDetn77RdrDetnCntr : 335|4@0+ (1.0,0.0) [0.0|15.0] "Unitless" ASDM,PAS
 SG_ FrntSideRdrRiDetn77RdrDetnConf : 391|7@0+ (1.0,0.0) [0.0|100.0] "%" ASDM,PAS
 SG_ FrntSideRdrRiDetn77RdrDetnElevn : 399|5@0+ (1.0,-15.0) [-15.0|15.0] "Deg" ASDM,PAS
 SG_ FrntSideRdrRiDetn77RdrDetnPwr : 329|9@0+ (0.1,0.0) [0.0|51.1] "dB" ASDM,PAS
 SG_ FrntSideRdrRiDetn77RdrDetnRng : 351|14@0+ (0.02,-1.0) [-1.0|200.0] "m" ASDM,PAS
 SG_ FrntSideRdrRiDetn77RdrDetnRngV : 372|13@0+ (0.02,-80.0) [-80.0|80.0] "m/s" ASDM,PAS
 SG_ FrntSideRdrRiDetn77RdrDetnSts : 331|2@0+ (1,0) [0|3] "" ASDM,PAS
 SG_ FrntSideRdrRiDetn78_UB : 474|1@0+ (1,0) [0|1] "" ASDM,PAS
 SG_ FrntSideRdrRiDetn78RdrDetnAzi : 447|11@0+ (0.1,-90.0) [-90.0|90.0] "Deg" ASDM,PAS
 SG_ FrntSideRdrRiDetn78RdrDetnChks : 407|8@0+ (1.0,0.0) [0.0|255.0] "Unitless" ASDM,PAS
 SG_ FrntSideRdrRiDetn78RdrDetnCntr : 415|4@0+ (1.0,0.0) [0.0|15.0] "Unitless" ASDM,PAS
 SG_ FrntSideRdrRiDetn78RdrDetnConf : 471|7@0+ (1.0,0.0) [0.0|100.0] "%" ASDM,PAS
 SG_ FrntSideRdrRiDetn78RdrDetnElevn : 479|5@0+ (1.0,-15.0) [-15.0|15.0] "Deg" ASDM,PAS
 SG_ FrntSideRdrRiDetn78RdrDetnPwr : 409|9@0+ (0.1,0.0) [0.0|51.1] "dB" ASDM,PAS
 SG_ FrntSideRdrRiDetn78RdrDetnRng : 431|14@0+ (0.02,-1.0) [-1.0|200.0] "m" ASDM,PAS
 SG_ FrntSideRdrRiDetn78RdrDetnRngV : 452|13@0+ (0.02,-80.0) [-80.0|80.0] "m/s" ASDM,PAS
 SG_ FrntSideRdrRiDetn78RdrDetnSts : 411|2@0+ (1,0) [0|3] "" ASDM,PAS

BO_ 331 FSRRSafetyCANFD1Frame14: 64 FSRR
 SG_ FrntSideRdrRiDetn79_UB : 74|1@0+ (1,0) [0|1] "" ASDM,PAS
 SG_ FrntSideRdrRiDetn79RdrDetnAzi : 31|11@0+ (0.1,-90.0) [-90.0|90.0] "Deg" ASDM,PAS
 SG_ FrntSideRdrRiDetn79RdrDetnChks : 7|8@0+ (1.0,0.0) [0.0|255.0] "Unitless" ASDM,PAS
 SG_ FrntSideRdrRiDetn79RdrDetnCntr : 15|4@0+ (1.0,0.0) [0.0|15.0] "Unitless" ASDM,PAS
 SG_ FrntSideRdrRiDetn79RdrDetnConf : 71|7@0+ (1.0,0.0) [0.0|100.0] "%" ASDM,PAS
 SG_ FrntSideRdrRiDetn79RdrDetnElevn : 79|5@0+ (1.0,-15.0) [-15.0|15.0] "Deg" ASDM,PAS
 SG_ FrntSideRdrRiDetn79RdrDetnPwr : 8|9@0+ (0.1,0.0) [0.0|51.1] "dB" ASDM,PAS
 SG_ FrntSideRdrRiDetn79RdrDetnRng : 55|14@0+ (0.02,-1.0) [-1.0|200.0] "m" ASDM,PAS
 SG_ FrntSideRdrRiDetn79RdrDetnRngV : 36|13@0+ (0.02,-80.0) [-80.0|80.0] "m/s" ASDM,PAS
 SG_ FrntSideRdrRiDetn79RdrDetnSts : 11|2@0+ (1,0) [0|3] "" ASDM,PAS
 SG_ FrntSideRdrRiDetn80_UB : 154|1@0+ (1,0) [0|1] "" ASDM,PAS
 SG_ FrntSideRdrRiDetn80RdrDetnAzi : 119|11@0+ (0.1,-90.0) [-90.0|90.0] "Deg" ASDM,PAS
 SG_ FrntSideRdrRiDetn80RdrDetnChks : 87|8@0+ (1.0,0.0) [0.0|255.0] "Unitless" ASDM,PAS
 SG_ FrntSideRdrRiDetn80RdrDetnCntr : 95|4@0+ (1.0,0.0) [0.0|15.0] "Unitless" ASDM,PAS
 SG_ FrntSideRdrRiDetn80RdrDetnConf : 111|7@0+ (1.0,0.0) [0.0|100.0] "%" ASDM,PAS
 SG_ FrntSideRdrRiDetn80RdrDetnElevn : 159|5@0+ (1.0,-15.0) [-15.0|15.0] "Deg" ASDM,PAS
 SG_ FrntSideRdrRiDetn80RdrDetnPwr : 89|9@0+ (0.1,0.0) [0.0|51.1] "dB" ASDM,PAS
 SG_ FrntSideRdrRiDetn80RdrDetnRng : 143|14@0+ (0.02,-1.0) [-1.0|200.0] "m" ASDM,PAS
 SG_ FrntSideRdrRiDetn80RdrDetnRngV : 124|13@0+ (0.02,-80.0) [-80.0|80.0] "m/s" ASDM,PAS
 SG_ FrntSideRdrRiDetn80RdrDetnSts : 91|2@0+ (1,0) [0|3] "" ASDM,PAS
 SG_ FrntSideRdrRiDetn81_UB : 234|1@0+ (1,0) [0|1] "" ASDM,PAS
 SG_ FrntSideRdrRiDetn81RdrDetnAzi : 199|11@0+ (0.1,-90.0) [-90.0|90.0] "Deg" ASDM,PAS
 SG_ FrntSideRdrRiDetn81RdrDetnChks : 167|8@0+ (1.0,0.0) [0.0|255.0] "Unitless" ASDM,PAS
 SG_ FrntSideRdrRiDetn81RdrDetnCntr : 175|4@0+ (1.0,0.0) [0.0|15.0] "Unitless" ASDM,PAS
 SG_ FrntSideRdrRiDetn81RdrDetnConf : 191|7@0+ (1.0,0.0) [0.0|100.0] "%" ASDM,PAS
 SG_ FrntSideRdrRiDetn81RdrDetnElevn : 239|5@0+ (1.0,-15.0) [-15.0|15.0] "Deg" ASDM,PAS
 SG_ FrntSideRdrRiDetn81RdrDetnPwr : 169|9@0+ (0.1,0.0) [0.0|51.1] "dB" ASDM,PAS
 SG_ FrntSideRdrRiDetn81RdrDetnRng : 223|14@0+ (0.02,-1.0) [-1.0|200.0] "m" ASDM,PAS
 SG_ FrntSideRdrRiDetn81RdrDetnRngV : 204|13@0+ (0.02,-80.0) [-80.0|80.0] "m/s" ASDM,PAS
 SG_ FrntSideRdrRiDetn81RdrDetnSts : 171|2@0+ (1,0) [0|3] "" ASDM,PAS
 SG_ FrntSideRdrRiDetn82_UB : 314|1@0+ (1,0) [0|1] "" ASDM,PAS
 SG_ FrntSideRdrRiDetn82RdrDetnAzi : 287|11@0+ (0.1,-90.0) [-90.0|90.0] "Deg" ASDM,PAS
 SG_ FrntSideRdrRiDetn82RdrDetnChks : 247|8@0+ (1.0,0.0) [0.0|255.0] "Unitless" ASDM,PAS
 SG_ FrntSideRdrRiDetn82RdrDetnCntr : 255|4@0+ (1.0,0.0) [0.0|15.0] "Unitless" ASDM,PAS
 SG_ FrntSideRdrRiDetn82RdrDetnConf : 311|7@0+ (1.0,0.0) [0.0|100.0] "%" ASDM,PAS
 SG_ FrntSideRdrRiDetn82RdrDetnElevn : 319|5@0+ (1.0,-15.0) [-15.0|15.0] "Deg" ASDM,PAS
 SG_ FrntSideRdrRiDetn82RdrDetnPwr : 249|9@0+ (0.1,0.0) [0.0|51.1] "dB" ASDM,PAS
 SG_ FrntSideRdrRiDetn82RdrDetnRng : 271|14@0+ (0.02,-1.0) [-1.0|200.0] "m" ASDM,PAS
 SG_ FrntSideRdrRiDetn82RdrDetnRngV : 292|13@0+ (0.02,-80.0) [-80.0|80.0] "m/s" ASDM,PAS
 SG_ FrntSideRdrRiDetn82RdrDetnSts : 251|2@0+ (1,0) [0|3] "" ASDM,PAS
 SG_ FrntSideRdrRiDetn83_UB : 394|1@0+ (1,0) [0|1] "" ASDM,PAS
 SG_ FrntSideRdrRiDetn83RdrDetnAzi : 367|11@0+ (0.1,-90.0) [-90.0|90.0] "Deg" ASDM,PAS
 SG_ FrntSideRdrRiDetn83RdrDetnChks : 327|8@0+ (1.0,0.0) [0.0|255.0] "Unitless" ASDM,PAS
 SG_ FrntSideRdrRiDetn83RdrDetnCntr : 335|4@0+ (1.0,0.0) [0.0|15.0] "Unitless" ASDM,PAS
 SG_ FrntSideRdrRiDetn83RdrDetnConf : 391|7@0+ (1.0,0.0) [0.0|100.0] "%" ASDM,PAS
 SG_ FrntSideRdrRiDetn83RdrDetnElevn : 399|5@0+ (1.0,-15.0) [-15.0|15.0] "Deg" ASDM,PAS
 SG_ FrntSideRdrRiDetn83RdrDetnPwr : 329|9@0+ (0.1,0.0) [0.0|51.1] "dB" ASDM,PAS
 SG_ FrntSideRdrRiDetn83RdrDetnRng : 351|14@0+ (0.02,-1.0) [-1.0|200.0] "m" ASDM,PAS
 SG_ FrntSideRdrRiDetn83RdrDetnRngV : 372|13@0+ (0.02,-80.0) [-80.0|80.0] "m/s" ASDM,PAS
 SG_ FrntSideRdrRiDetn83RdrDetnSts : 331|2@0+ (1,0) [0|3] "" ASDM,PAS
 SG_ FrntSideRdrRiDetn84_UB : 474|1@0+ (1,0) [0|1] "" ASDM,PAS
 SG_ FrntSideRdrRiDetn84RdrDetnAzi : 447|11@0+ (0.1,-90.0) [-90.0|90.0] "Deg" ASDM,PAS
 SG_ FrntSideRdrRiDetn84RdrDetnChks : 407|8@0+ (1.0,0.0) [0.0|255.0] "Unitless" ASDM,PAS
 SG_ FrntSideRdrRiDetn84RdrDetnCntr : 415|4@0+ (1.0,0.0) [0.0|15.0] "Unitless" ASDM,PAS
 SG_ FrntSideRdrRiDetn84RdrDetnConf : 471|7@0+ (1.0,0.0) [0.0|100.0] "%" ASDM,PAS
 SG_ FrntSideRdrRiDetn84RdrDetnElevn : 479|5@0+ (1.0,-15.0) [-15.0|15.0] "Deg" ASDM,PAS
 SG_ FrntSideRdrRiDetn84RdrDetnPwr : 409|9@0+ (0.1,0.0) [0.0|51.1] "dB" ASDM,PAS
 SG_ FrntSideRdrRiDetn84RdrDetnRng : 431|14@0+ (0.02,-1.0) [-1.0|200.0] "m" ASDM,PAS
 SG_ FrntSideRdrRiDetn84RdrDetnRngV : 452|13@0+ (0.02,-80.0) [-80.0|80.0] "m/s" ASDM,PAS
 SG_ FrntSideRdrRiDetn84RdrDetnSts : 411|2@0+ (1,0) [0|3] "" ASDM,PAS

BO_ 333 FSRRSafetyCANFD1Frame15: 64 FSRR
 SG_ FrntSideRdrRiDetn85_UB : 74|1@0+ (1,0) [0|1] "" ASDM,PAS
 SG_ FrntSideRdrRiDetn85RdrDetnAzi : 31|11@0+ (0.1,-90.0) [-90.0|90.0] "Deg" ASDM,PAS
 SG_ FrntSideRdrRiDetn85RdrDetnChks : 7|8@0+ (1.0,0.0) [0.0|255.0] "Unitless" ASDM,PAS
 SG_ FrntSideRdrRiDetn85RdrDetnCntr : 15|4@0+ (1.0,0.0) [0.0|15.0] "Unitless" ASDM,PAS
 SG_ FrntSideRdrRiDetn85RdrDetnConf : 71|7@0+ (1.0,0.0) [0.0|100.0] "%" ASDM,PAS
 SG_ FrntSideRdrRiDetn85RdrDetnElevn : 79|5@0+ (1.0,-15.0) [-15.0|15.0] "Deg" ASDM,PAS
 SG_ FrntSideRdrRiDetn85RdrDetnPwr : 8|9@0+ (0.1,0.0) [0.0|51.1] "dB" ASDM,PAS
 SG_ FrntSideRdrRiDetn85RdrDetnRng : 55|14@0+ (0.02,-1.0) [-1.0|200.0] "m" ASDM,PAS
 SG_ FrntSideRdrRiDetn85RdrDetnRngV : 36|13@0+ (0.02,-80.0) [-80.0|80.0] "m/s" ASDM,PAS
 SG_ FrntSideRdrRiDetn85RdrDetnSts : 11|2@0+ (1,0) [0|3] "" ASDM,PAS
 SG_ FrntSideRdrRiDetn86_UB : 154|1@0+ (1,0) [0|1] "" ASDM,PAS
 SG_ FrntSideRdrRiDetn86RdrDetnAzi : 119|11@0+ (0.1,-90.0) [-90.0|90.0] "Deg" ASDM,PAS
 SG_ FrntSideRdrRiDetn86RdrDetnChks : 87|8@0+ (1.0,0.0) [0.0|255.0] "Unitless" ASDM,PAS
 SG_ FrntSideRdrRiDetn86RdrDetnCntr : 95|4@0+ (1.0,0.0) [0.0|15.0] "Unitless" ASDM,PAS
 SG_ FrntSideRdrRiDetn86RdrDetnConf : 111|7@0+ (1.0,0.0) [0.0|100.0] "%" ASDM,PAS
 SG_ FrntSideRdrRiDetn86RdrDetnElevn : 159|5@0+ (1.0,-15.0) [-15.0|15.0] "Deg" ASDM,PAS
 SG_ FrntSideRdrRiDetn86RdrDetnPwr : 89|9@0+ (0.1,0.0) [0.0|51.1] "dB" ASDM,PAS
 SG_ FrntSideRdrRiDetn86RdrDetnRng : 143|14@0+ (0.02,-1.0) [-1.0|200.0] "m" ASDM,PAS
 SG_ FrntSideRdrRiDetn86RdrDetnRngV : 124|13@0+ (0.02,-80.0) [-80.0|80.0] "m/s" ASDM,PAS
 SG_ FrntSideRdrRiDetn86RdrDetnSts : 91|2@0+ (1,0) [0|3] "" ASDM,PAS
 SG_ FrntSideRdrRiDetn87_UB : 234|1@0+ (1,0) [0|1] "" ASDM,PAS
 SG_ FrntSideRdrRiDetn87RdrDetnAzi : 199|11@0+ (0.1,-90.0) [-90.0|90.0] "Deg" ASDM,PAS
 SG_ FrntSideRdrRiDetn87RdrDetnChks : 167|8@0+ (1.0,0.0) [0.0|255.0] "Unitless" ASDM,PAS
 SG_ FrntSideRdrRiDetn87RdrDetnCntr : 175|4@0+ (1.0,0.0) [0.0|15.0] "Unitless" ASDM,PAS
 SG_ FrntSideRdrRiDetn87RdrDetnConf : 191|7@0+ (1.0,0.0) [0.0|100.0] "%" ASDM,PAS
 SG_ FrntSideRdrRiDetn87RdrDetnElevn : 239|5@0+ (1.0,-15.0) [-15.0|15.0] "Deg" ASDM,PAS
 SG_ FrntSideRdrRiDetn87RdrDetnPwr : 169|9@0+ (0.1,0.0) [0.0|51.1] "dB" ASDM,PAS
 SG_ FrntSideRdrRiDetn87RdrDetnRng : 223|14@0+ (0.02,-1.0) [-1.0|200.0] "m" ASDM,PAS
 SG_ FrntSideRdrRiDetn87RdrDetnRngV : 204|13@0+ (0.02,-80.0) [-80.0|80.0] "m/s" ASDM,PAS
 SG_ FrntSideRdrRiDetn87RdrDetnSts : 171|2@0+ (1,0) [0|3] "" ASDM,PAS
 SG_ FrntSideRdrRiDetn88_UB : 314|1@0+ (1,0) [0|1] "" ASDM,PAS
 SG_ FrntSideRdrRiDetn88RdrDetnAzi : 287|11@0+ (0.1,-90.0) [-90.0|90.0] "Deg" ASDM,PAS
 SG_ FrntSideRdrRiDetn88RdrDetnChks : 247|8@0+ (1.0,0.0) [0.0|255.0] "Unitless" ASDM,PAS
 SG_ FrntSideRdrRiDetn88RdrDetnCntr : 255|4@0+ (1.0,0.0) [0.0|15.0] "Unitless" ASDM,PAS
 SG_ FrntSideRdrRiDetn88RdrDetnConf : 311|7@0+ (1.0,0.0) [0.0|100.0] "%" ASDM,PAS
 SG_ FrntSideRdrRiDetn88RdrDetnElevn : 319|5@0+ (1.0,-15.0) [-15.0|15.0] "Deg" ASDM,PAS
 SG_ FrntSideRdrRiDetn88RdrDetnPwr : 249|9@0+ (0.1,0.0) [0.0|51.1] "dB" ASDM,PAS
 SG_ FrntSideRdrRiDetn88RdrDetnRng : 271|14@0+ (0.02,-1.0) [-1.0|200.0] "m" ASDM,PAS
 SG_ FrntSideRdrRiDetn88RdrDetnRngV : 292|13@0+ (0.02,-80.0) [-80.0|80.0] "m/s" ASDM,PAS
 SG_ FrntSideRdrRiDetn88RdrDetnSts : 251|2@0+ (1,0) [0|3] "" ASDM,PAS
 SG_ FrntSideRdrRiDetn89_UB : 394|1@0+ (1,0) [0|1] "" ASDM,PAS
 SG_ FrntSideRdrRiDetn89RdrDetnAzi : 367|11@0+ (0.1,-90.0) [-90.0|90.0] "Deg" ASDM,PAS
 SG_ FrntSideRdrRiDetn89RdrDetnChks : 327|8@0+ (1.0,0.0) [0.0|255.0] "Unitless" ASDM,PAS
 SG_ FrntSideRdrRiDetn89RdrDetnCntr : 335|4@0+ (1.0,0.0) [0.0|15.0] "Unitless" ASDM,PAS
 SG_ FrntSideRdrRiDetn89RdrDetnConf : 391|7@0+ (1.0,0.0) [0.0|100.0] "%" ASDM,PAS
 SG_ FrntSideRdrRiDetn89RdrDetnElevn : 399|5@0+ (1.0,-15.0) [-15.0|15.0] "Deg" ASDM,PAS
 SG_ FrntSideRdrRiDetn89RdrDetnPwr : 329|9@0+ (0.1,0.0) [0.0|51.1] "dB" ASDM,PAS
 SG_ FrntSideRdrRiDetn89RdrDetnRng : 351|14@0+ (0.02,-1.0) [-1.0|200.0] "m" ASDM,PAS
 SG_ FrntSideRdrRiDetn89RdrDetnRngV : 372|13@0+ (0.02,-80.0) [-80.0|80.0] "m/s" ASDM,PAS
 SG_ FrntSideRdrRiDetn89RdrDetnSts : 331|2@0+ (1,0) [0|3] "" ASDM,PAS
 SG_ FrntSideRdrRiDetn90_UB : 474|1@0+ (1,0) [0|1] "" ASDM,PAS
 SG_ FrntSideRdrRiDetn90RdrDetnAzi : 447|11@0+ (0.1,-90.0) [-90.0|90.0] "Deg" ASDM,PAS
 SG_ FrntSideRdrRiDetn90RdrDetnChks : 407|8@0+ (1.0,0.0) [0.0|255.0] "Unitless" ASDM,PAS
 SG_ FrntSideRdrRiDetn90RdrDetnCntr : 415|4@0+ (1.0,0.0) [0.0|15.0] "Unitless" ASDM,PAS
 SG_ FrntSideRdrRiDetn90RdrDetnConf : 471|7@0+ (1.0,0.0) [0.0|100.0] "%" ASDM,PAS
 SG_ FrntSideRdrRiDetn90RdrDetnElevn : 479|5@0+ (1.0,-15.0) [-15.0|15.0] "Deg" ASDM,PAS
 SG_ FrntSideRdrRiDetn90RdrDetnPwr : 409|9@0+ (0.1,0.0) [0.0|51.1] "dB" ASDM,PAS
 SG_ FrntSideRdrRiDetn90RdrDetnRng : 431|14@0+ (0.02,-1.0) [-1.0|200.0] "m" ASDM,PAS
 SG_ FrntSideRdrRiDetn90RdrDetnRngV : 452|13@0+ (0.02,-80.0) [-80.0|80.0] "m/s" ASDM,PAS
 SG_ FrntSideRdrRiDetn90RdrDetnSts : 411|2@0+ (1,0) [0|3] "" ASDM,PAS

CM_ SG_ 319 FrntSideRdrRiDetn43RdrDetnAzi "Refer to the data element description in FrntSideRdrLeDetn1 with the same data element name.";
CM_ SG_ 319 FrntSideRdrRiDetn43RdrDetnChks "Refer to the data element description in FrntSideRdrLeDetn1 with the same data element name.";
CM_ SG_ 319 FrntSideRdrRiDetn43RdrDetnCntr "Refer to the data element description in FrntSideRdrLeDetn1 with the same data element name.";
CM_ SG_ 319 FrntSideRdrRiDetn43RdrDetnConf "Refer to the data element description in FrntSideRdrLeDetn1 with the same data element name.";
CM_ SG_ 319 FrntSideRdrRiDetn43RdrDetnElevn "Refer to the data element description in FrntSideRdrLeDetn1 with the same data element name.";
CM_ SG_ 319 FrntSideRdrRiDetn43RdrDetnPwr "Refer to the data element description in FrntSideRdrLeDetn1 with the same data element name.";
CM_ SG_ 319 FrntSideRdrRiDetn43RdrDetnRng "Refer to the data element description in FrntSideRdrLeDetn1 with the same data element name.";
CM_ SG_ 319 FrntSideRdrRiDetn43RdrDetnRngV "Range Velocity";
CM_ SG_ 319 FrntSideRdrRiDetn43RdrDetnSts "Refer to the data element description in FrntSideRdrLeDetn1 with the same data element name.";
CM_ SG_ 319 FrntSideRdrRiDetn44RdrDetnAzi "Refer to the data element description in FrntSideRdrLeDetn1 with the same data element name.";
CM_ SG_ 319 FrntSideRdrRiDetn44RdrDetnChks "Refer to the data element description in FrntSideRdrLeDetn1 with the same data element name.";
CM_ SG_ 319 FrntSideRdrRiDetn44RdrDetnCntr "Refer to the data element description in FrntSideRdrLeDetn1 with the same data element name.";
CM_ SG_ 319 FrntSideRdrRiDetn44RdrDetnConf "Refer to the data element description in FrntSideRdrLeDetn1 with the same data element name.";
CM_ SG_ 319 FrntSideRdrRiDetn44RdrDetnElevn "Refer to the data element description in FrntSideRdrLeDetn1 with the same data element name.";
CM_ SG_ 319 FrntSideRdrRiDetn44RdrDetnPwr "Refer to the data element description in FrntSideRdrLeDetn1 with the same data element name.";
CM_ SG_ 319 FrntSideRdrRiDetn44RdrDetnRng "Refer to the data element description in FrntSideRdrLeDetn1 with the same data element name.";
CM_ SG_ 319 FrntSideRdrRiDetn44RdrDetnRngV "Range Velocity";
CM_ SG_ 319 FrntSideRdrRiDetn44RdrDetnSts "Refer to the data element description in FrntSideRdrLeDetn1 with the same data element name.";
CM_ SG_ 319 FrntSideRdrRiDetn45RdrDetnAzi "Refer to the data element description in FrntSideRdrLeDetn1 with the same data element name.";
CM_ SG_ 319 FrntSideRdrRiDetn45RdrDetnChks "Refer to the data element description in FrntSideRdrLeDetn1 with the same data element name.";
CM_ SG_ 319 FrntSideRdrRiDetn45RdrDetnCntr "Refer to the data element description in FrntSideRdrLeDetn1 with the same data element name.";
CM_ SG_ 319 FrntSideRdrRiDetn45RdrDetnConf "Refer to the data element description in FrntSideRdrLeDetn1 with the same data element name.";
CM_ SG_ 319 FrntSideRdrRiDetn45RdrDetnElevn "Refer to the data element description in FrntSideRdrLeDetn1 with the same data element name.";
CM_ SG_ 319 FrntSideRdrRiDetn45RdrDetnPwr "Refer to the data element description in FrntSideRdrLeDetn1 with the same data element name.";
CM_ SG_ 319 FrntSideRdrRiDetn45RdrDetnRng "Refer to the data element description in FrntSideRdrLeDetn1 with the same data element name.";
CM_ SG_ 319 FrntSideRdrRiDetn45RdrDetnRngV "Range Velocity";
CM_ SG_ 319 FrntSideRdrRiDetn45RdrDetnSts "Refer to the data element description in FrntSideRdrLeDetn1 with the same data element name.";
CM_ SG_ 319 FrntSideRdrRiDetn46RdrDetnAzi "Refer to the data element description in FrntSideRdrLeDetn1 with the same data element name.";
CM_ SG_ 319 FrntSideRdrRiDetn46RdrDetnChks "Refer to the data element description in FrntSideRdrLeDetn1 with the same data element name.";
CM_ SG_ 319 FrntSideRdrRiDetn46RdrDetnCntr "Refer to the data element description in FrntSideRdrLeDetn1 with the same data element name.";
CM_ SG_ 319 FrntSideRdrRiDetn46RdrDetnConf "Refer to the data element description in FrntSideRdrLeDetn1 with the same data element name.";
CM_ SG_ 319 FrntSideRdrRiDetn46RdrDetnElevn "Refer to the data element description in FrntSideRdrLeDetn1 with the same data element name.";
CM_ SG_ 319 FrntSideRdrRiDetn46RdrDetnPwr "Refer to the data element description in FrntSideRdrLeDetn1 with the same data element name.";
CM_ SG_ 319 FrntSideRdrRiDetn46RdrDetnRng "Refer to the data element description in FrntSideRdrLeDetn1 with the same data element name.";
CM_ SG_ 319 FrntSideRdrRiDetn46RdrDetnRngV "Range Velocity";
CM_ SG_ 319 FrntSideRdrRiDetn46RdrDetnSts "Refer to the data element description in FrntSideRdrLeDetn1 with the same data element name.";
CM_ SG_ 319 FrntSideRdrRiDetn47RdrDetnAzi "Refer to the data element description in FrntSideRdrLeDetn1 with the same data element name.";
CM_ SG_ 319 FrntSideRdrRiDetn47RdrDetnChks "Refer to the data element description in FrntSideRdrLeDetn1 with the same data element name.";
CM_ SG_ 319 FrntSideRdrRiDetn47RdrDetnCntr "Refer to the data element description in FrntSideRdrLeDetn1 with the same data element name.";
CM_ SG_ 319 FrntSideRdrRiDetn47RdrDetnConf "Refer to the data element description in FrntSideRdrLeDetn1 with the same data element name.";
CM_ SG_ 319 FrntSideRdrRiDetn47RdrDetnElevn "Refer to the data element description in FrntSideRdrLeDetn1 with the same data element name.";
CM_ SG_ 319 FrntSideRdrRiDetn47RdrDetnPwr "Refer to the data element description in FrntSideRdrLeDetn1 with the same data element name.";
CM_ SG_ 319 FrntSideRdrRiDetn47RdrDetnRng "Refer to the data element description in FrntSideRdrLeDetn1 with the same data element name.";
CM_ SG_ 319 FrntSideRdrRiDetn47RdrDetnRngV "Range Velocity";
CM_ SG_ 319 FrntSideRdrRiDetn47RdrDetnSts "Refer to the data element description in FrntSideRdrLeDetn1 with the same data element name.";
CM_ SG_ 319 FrntSideRdrRiDetn48RdrDetnAzi "Refer to the data element description in FrntSideRdrLeDetn1 with the same data element name.";
CM_ SG_ 319 FrntSideRdrRiDetn48RdrDetnChks "Refer to the data element description in FrntSideRdrLeDetn1 with the same data element name.";
CM_ SG_ 319 FrntSideRdrRiDetn48RdrDetnCntr "Refer to the data element description in FrntSideRdrLeDetn1 with the same data element name.";
CM_ SG_ 319 FrntSideRdrRiDetn48RdrDetnConf "Refer to the data element description in FrntSideRdrLeDetn1 with the same data element name.";
CM_ SG_ 319 FrntSideRdrRiDetn48RdrDetnElevn "Refer to the data element description in FrntSideRdrLeDetn1 with the same data element name.";
CM_ SG_ 319 FrntSideRdrRiDetn48RdrDetnPwr "Refer to the data element description in FrntSideRdrLeDetn1 with the same data element name.";
CM_ SG_ 319 FrntSideRdrRiDetn48RdrDetnRng "Refer to the data element description in FrntSideRdrLeDetn1 with the same data element name.";
CM_ SG_ 319 FrntSideRdrRiDetn48RdrDetnRngV "Range Velocity";
CM_ SG_ 319 FrntSideRdrRiDetn48RdrDetnSts "Refer to the data element description in FrntSideRdrLeDetn1 with the same data element name.";
CM_ SG_ 321 FrntSideRdrRiDetn49RdrDetnAzi "Refer to the data element description in FrntSideRdrLeDetn1 with the same data element name.";
CM_ SG_ 321 FrntSideRdrRiDetn49RdrDetnChks "Refer to the data element description in FrntSideRdrLeDetn1 with the same data element name.";
CM_ SG_ 321 FrntSideRdrRiDetn49RdrDetnCntr "Refer to the data element description in FrntSideRdrLeDetn1 with the same data element name.";
CM_ SG_ 321 FrntSideRdrRiDetn49RdrDetnConf "Refer to the data element description in FrntSideRdrLeDetn1 with the same data element name.";
CM_ SG_ 321 FrntSideRdrRiDetn49RdrDetnElevn "Refer to the data element description in FrntSideRdrLeDetn1 with the same data element name.";
CM_ SG_ 321 FrntSideRdrRiDetn49RdrDetnPwr "Refer to the data element description in FrntSideRdrLeDetn1 with the same data element name.";
CM_ SG_ 321 FrntSideRdrRiDetn49RdrDetnRng "Refer to the data element description in FrntSideRdrLeDetn1 with the same data element name.";
CM_ SG_ 321 FrntSideRdrRiDetn49RdrDetnRngV "Range Velocity";
CM_ SG_ 321 FrntSideRdrRiDetn49RdrDetnSts "Refer to the data element description in FrntSideRdrLeDetn1 with the same data element name.";
CM_ SG_ 321 FrntSideRdrRiDetn50RdrDetnAzi "Refer to the data element description in FrntSideRdrLeDetn1 with the same data element name.";
CM_ SG_ 321 FrntSideRdrRiDetn50RdrDetnChks "Refer to the data element description in FrntSideRdrLeDetn1 with the same data element name.";
CM_ SG_ 321 FrntSideRdrRiDetn50RdrDetnCntr "Refer to the data element description in FrntSideRdrLeDetn1 with the same data element name.";
CM_ SG_ 321 FrntSideRdrRiDetn50RdrDetnConf "Refer to the data element description in FrntSideRdrLeDetn1 with the same data element name.";
CM_ SG_ 321 FrntSideRdrRiDetn50RdrDetnElevn "Refer to the data element description in FrntSideRdrLeDetn1 with the same data element name.";
CM_ SG_ 321 FrntSideRdrRiDetn50RdrDetnPwr "Refer to the data element description in FrntSideRdrLeDetn1 with the same data element name.";
CM_ SG_ 321 FrntSideRdrRiDetn50RdrDetnRng "Refer to the data element description in FrntSideRdrLeDetn1 with the same data element name.";
CM_ SG_ 321 FrntSideRdrRiDetn50RdrDetnRngV "Range Velocity";
CM_ SG_ 321 FrntSideRdrRiDetn50RdrDetnSts "Refer to the data element description in FrntSideRdrLeDetn1 with the same data element name.";
CM_ SG_ 321 FrntSideRdrRiDetn51RdrDetnAzi "Refer to the data element description in FrntSideRdrLeDetn1 with the same data element name.";
CM_ SG_ 321 FrntSideRdrRiDetn51RdrDetnChks "Refer to the data element description in FrntSideRdrLeDetn1 with the same data element name.";
CM_ SG_ 321 FrntSideRdrRiDetn51RdrDetnCntr "Refer to the data element description in FrntSideRdrLeDetn1 with the same data element name.";
CM_ SG_ 321 FrntSideRdrRiDetn51RdrDetnConf "Refer to the data element description in FrntSideRdrLeDetn1 with the same data element name.";
CM_ SG_ 321 FrntSideRdrRiDetn51RdrDetnElevn "Refer to the data element description in FrntSideRdrLeDetn1 with the same data element name.";
CM_ SG_ 321 FrntSideRdrRiDetn51RdrDetnPwr "Refer to the data element description in FrntSideRdrLeDetn1 with the same data element name.";
CM_ SG_ 321 FrntSideRdrRiDetn51RdrDetnRng "Refer to the data element description in FrntSideRdrLeDetn1 with the same data element name.";
CM_ SG_ 321 FrntSideRdrRiDetn51RdrDetnRngV "Range Velocity";
CM_ SG_ 321 FrntSideRdrRiDetn51RdrDetnSts "Refer to the data element description in FrntSideRdrLeDetn1 with the same data element name.";
CM_ SG_ 321 FrntSideRdrRiDetn52RdrDetnAzi "Refer to the data element description in FrntSideRdrLeDetn1 with the same data element name.";
CM_ SG_ 321 FrntSideRdrRiDetn52RdrDetnChks "Refer to the data element description in FrntSideRdrLeDetn1 with the same data element name.";
CM_ SG_ 321 FrntSideRdrRiDetn52RdrDetnCntr "Refer to the data element description in FrntSideRdrLeDetn1 with the same data element name.";
CM_ SG_ 321 FrntSideRdrRiDetn52RdrDetnConf "Refer to the data element description in FrntSideRdrLeDetn1 with the same data element name.";
CM_ SG_ 321 FrntSideRdrRiDetn52RdrDetnElevn "Refer to the data element description in FrntSideRdrLeDetn1 with the same data element name.";
CM_ SG_ 321 FrntSideRdrRiDetn52RdrDetnPwr "Refer to the data element description in FrntSideRdrLeDetn1 with the same data element name.";
CM_ SG_ 321 FrntSideRdrRiDetn52RdrDetnRng "Refer to the data element description in FrntSideRdrLeDetn1 with the same data element name.";
CM_ SG_ 321 FrntSideRdrRiDetn52RdrDetnRngV "Range Velocity";
CM_ SG_ 321 FrntSideRdrRiDetn52RdrDetnSts "Refer to the data element description in FrntSideRdrLeDetn1 with the same data element name.";
CM_ SG_ 321 FrntSideRdrRiDetn53RdrDetnAzi "Refer to the data element description in FrntSideRdrLeDetn1 with the same data element name.";
CM_ SG_ 321 FrntSideRdrRiDetn53RdrDetnChks "Refer to the data element description in FrntSideRdrLeDetn1 with the same data element name.";
CM_ SG_ 321 FrntSideRdrRiDetn53RdrDetnCntr "Refer to the data element description in FrntSideRdrLeDetn1 with the same data element name.";
CM_ SG_ 321 FrntSideRdrRiDetn53RdrDetnConf "Refer to the data element description in FrntSideRdrLeDetn1 with the same data element name.";
CM_ SG_ 321 FrntSideRdrRiDetn53RdrDetnElevn "Refer to the data element description in FrntSideRdrLeDetn1 with the same data element name.";
CM_ SG_ 321 FrntSideRdrRiDetn53RdrDetnPwr "Refer to the data element description in FrntSideRdrLeDetn1 with the same data element name.";
CM_ SG_ 321 FrntSideRdrRiDetn53RdrDetnRng "Refer to the data element description in FrntSideRdrLeDetn1 with the same data element name.";
CM_ SG_ 321 FrntSideRdrRiDetn53RdrDetnRngV "Range Velocity";
CM_ SG_ 321 FrntSideRdrRiDetn53RdrDetnSts "Refer to the data element description in FrntSideRdrLeDetn1 with the same data element name.";
CM_ SG_ 321 FrntSideRdrRiDetn54RdrDetnAzi "Refer to the data element description in FrntSideRdrLeDetn1 with the same data element name.";
CM_ SG_ 321 FrntSideRdrRiDetn54RdrDetnChks "Refer to the data element description in FrntSideRdrLeDetn1 with the same data element name.";
CM_ SG_ 321 FrntSideRdrRiDetn54RdrDetnCntr "Refer to the data element description in FrntSideRdrLeDetn1 with the same data element name.";
CM_ SG_ 321 FrntSideRdrRiDetn54RdrDetnConf "Refer to the data element description in FrntSideRdrLeDetn1 with the same data element name.";
CM_ SG_ 321 FrntSideRdrRiDetn54RdrDetnElevn "Refer to the data element description in FrntSideRdrLeDetn1 with the same data element name.";
CM_ SG_ 321 FrntSideRdrRiDetn54RdrDetnPwr "Refer to the data element description in FrntSideRdrLeDetn1 with the same data element name.";
CM_ SG_ 321 FrntSideRdrRiDetn54RdrDetnRng "Refer to the data element description in FrntSideRdrLeDetn1 with the same data element name.";
CM_ SG_ 321 FrntSideRdrRiDetn54RdrDetnRngV "Range Velocity";
CM_ SG_ 321 FrntSideRdrRiDetn54RdrDetnSts "Refer to the data element description in FrntSideRdrLeDetn1 with the same data element name.";
CM_ SG_ 323 FrntSideRdrRiDetn55RdrDetnAzi "Refer to the data element description in FrntSideRdrLeDetn1 with the same data element name.";
CM_ SG_ 323 FrntSideRdrRiDetn55RdrDetnChks "Refer to the data element description in FrntSideRdrLeDetn1 with the same data element name.";
CM_ SG_ 323 FrntSideRdrRiDetn55RdrDetnCntr "Refer to the data element description in FrntSideRdrLeDetn1 with the same data element name.";
CM_ SG_ 323 FrntSideRdrRiDetn55RdrDetnConf "Refer to the data element description in FrntSideRdrLeDetn1 with the same data element name.";
CM_ SG_ 323 FrntSideRdrRiDetn55RdrDetnElevn "Refer to the data element description in FrntSideRdrLeDetn1 with the same data element name.";
CM_ SG_ 323 FrntSideRdrRiDetn55RdrDetnPwr "Refer to the data element description in FrntSideRdrLeDetn1 with the same data element name.";
CM_ SG_ 323 FrntSideRdrRiDetn55RdrDetnRng "Refer to the data element description in FrntSideRdrLeDetn1 with the same data element name.";
CM_ SG_ 323 FrntSideRdrRiDetn55RdrDetnRngV "Range Velocity";
CM_ SG_ 323 FrntSideRdrRiDetn55RdrDetnSts "Refer to the data element description in FrntSideRdrLeDetn1 with the same data element name.";
CM_ SG_ 323 FrntSideRdrRiDetn56RdrDetnAzi "Refer to the data element description in FrntSideRdrLeDetn1 with the same data element name.";
CM_ SG_ 323 FrntSideRdrRiDetn56RdrDetnChks "Refer to the data element description in FrntSideRdrLeDetn1 with the same data element name.";
CM_ SG_ 323 FrntSideRdrRiDetn56RdrDetnCntr "Refer to the data element description in FrntSideRdrLeDetn1 with the same data element name.";
CM_ SG_ 323 FrntSideRdrRiDetn56RdrDetnConf "Refer to the data element description in FrntSideRdrLeDetn1 with the same data element name.";
CM_ SG_ 323 FrntSideRdrRiDetn56RdrDetnElevn "Refer to the data element description in FrntSideRdrLeDetn1 with the same data element name.";
CM_ SG_ 323 FrntSideRdrRiDetn56RdrDetnPwr "Refer to the data element description in FrntSideRdrLeDetn1 with the same data element name.";
CM_ SG_ 323 FrntSideRdrRiDetn56RdrDetnRng "Refer to the data element description in FrntSideRdrLeDetn1 with the same data element name.";
CM_ SG_ 323 FrntSideRdrRiDetn56RdrDetnRngV "Range Velocity";
CM_ SG_ 323 FrntSideRdrRiDetn56RdrDetnSts "Refer to the data element description in FrntSideRdrLeDetn1 with the same data element name.";
CM_ SG_ 323 FrntSideRdrRiDetn57RdrDetnAzi "Refer to the data element description in FrntSideRdrLeDetn1 with the same data element name.";
CM_ SG_ 323 FrntSideRdrRiDetn57RdrDetnChks "Refer to the data element description in FrntSideRdrLeDetn1 with the same data element name.";
CM_ SG_ 323 FrntSideRdrRiDetn57RdrDetnCntr "Refer to the data element description in FrntSideRdrLeDetn1 with the same data element name.";
CM_ SG_ 323 FrntSideRdrRiDetn57RdrDetnConf "Refer to the data element description in FrntSideRdrLeDetn1 with the same data element name.";
CM_ SG_ 323 FrntSideRdrRiDetn57RdrDetnElevn "Refer to the data element description in FrntSideRdrLeDetn1 with the same data element name.";
CM_ SG_ 323 FrntSideRdrRiDetn57RdrDetnPwr "Refer to the data element description in FrntSideRdrLeDetn1 with the same data element name.";
CM_ SG_ 323 FrntSideRdrRiDetn57RdrDetnRng "Refer to the data element description in FrntSideRdrLeDetn1 with the same data element name.";
CM_ SG_ 323 FrntSideRdrRiDetn57RdrDetnRngV "Range Velocity";
CM_ SG_ 323 FrntSideRdrRiDetn57RdrDetnSts "Refer to the data element description in FrntSideRdrLeDetn1 with the same data element name.";
CM_ SG_ 323 FrntSideRdrRiDetn58RdrDetnAzi "Refer to the data element description in FrntSideRdrLeDetn1 with the same data element name.";
CM_ SG_ 323 FrntSideRdrRiDetn58RdrDetnChks "Refer to the data element description in FrntSideRdrLeDetn1 with the same data element name.";
CM_ SG_ 323 FrntSideRdrRiDetn58RdrDetnCntr "Refer to the data element description in FrntSideRdrLeDetn1 with the same data element name.";
CM_ SG_ 323 FrntSideRdrRiDetn58RdrDetnConf "Refer to the data element description in FrntSideRdrLeDetn1 with the same data element name.";
CM_ SG_ 323 FrntSideRdrRiDetn58RdrDetnElevn "Refer to the data element description in FrntSideRdrLeDetn1 with the same data element name.";
CM_ SG_ 323 FrntSideRdrRiDetn58RdrDetnPwr "Refer to the data element description in FrntSideRdrLeDetn1 with the same data element name.";
CM_ SG_ 323 FrntSideRdrRiDetn58RdrDetnRng "Refer to the data element description in FrntSideRdrLeDetn1 with the same data element name.";
CM_ SG_ 323 FrntSideRdrRiDetn58RdrDetnRngV "Range Velocity";
CM_ SG_ 323 FrntSideRdrRiDetn58RdrDetnSts "Refer to the data element description in FrntSideRdrLeDetn1 with the same data element name.";
CM_ SG_ 323 FrntSideRdrRiDetn59RdrDetnAzi "Refer to the data element description in FrntSideRdrLeDetn1 with the same data element name.";
CM_ SG_ 323 FrntSideRdrRiDetn59RdrDetnChks "Refer to the data element description in FrntSideRdrLeDetn1 with the same data element name.";
CM_ SG_ 323 FrntSideRdrRiDetn59RdrDetnCntr "Refer to the data element description in FrntSideRdrLeDetn1 with the same data element name.";
CM_ SG_ 323 FrntSideRdrRiDetn59RdrDetnConf "Refer to the data element description in FrntSideRdrLeDetn1 with the same data element name.";
CM_ SG_ 323 FrntSideRdrRiDetn59RdrDetnElevn "Refer to the data element description in FrntSideRdrLeDetn1 with the same data element name.";
CM_ SG_ 323 FrntSideRdrRiDetn59RdrDetnPwr "Refer to the data element description in FrntSideRdrLeDetn1 with the same data element name.";
CM_ SG_ 323 FrntSideRdrRiDetn59RdrDetnRng "Refer to the data element description in FrntSideRdrLeDetn1 with the same data element name.";
CM_ SG_ 323 FrntSideRdrRiDetn59RdrDetnRngV "Range Velocity";
CM_ SG_ 323 FrntSideRdrRiDetn59RdrDetnSts "Refer to the data element description in FrntSideRdrLeDetn1 with the same data element name.";
CM_ SG_ 323 FrntSideRdrRiDetn60RdrDetnAzi "Refer to the data element description in FrntSideRdrLeDetn1 with the same data element name.";
CM_ SG_ 323 FrntSideRdrRiDetn60RdrDetnChks "Refer to the data element description in FrntSideRdrLeDetn1 with the same data element name.";
CM_ SG_ 323 FrntSideRdrRiDetn60RdrDetnCntr "Refer to the data element description in FrntSideRdrLeDetn1 with the same data element name.";
CM_ SG_ 323 FrntSideRdrRiDetn60RdrDetnConf "Refer to the data element description in FrntSideRdrLeDetn1 with the same data element name.";
CM_ SG_ 323 FrntSideRdrRiDetn60RdrDetnElevn "Refer to the data element description in FrntSideRdrLeDetn1 with the same data element name.";
CM_ SG_ 323 FrntSideRdrRiDetn60RdrDetnPwr "Refer to the data element description in FrntSideRdrLeDetn1 with the same data element name.";
CM_ SG_ 323 FrntSideRdrRiDetn60RdrDetnRng "Refer to the data element description in FrntSideRdrLeDetn1 with the same data element name.";
CM_ SG_ 323 FrntSideRdrRiDetn60RdrDetnRngV "Range Velocity";
CM_ SG_ 323 FrntSideRdrRiDetn60RdrDetnSts "Refer to the data element description in FrntSideRdrLeDetn1 with the same data element name.";
CM_ SG_ 325 FrntSideRdrRiDetn61RdrDetnAzi "Refer to the data element description in FrntSideRdrLeDetn1 with the same data element name.";
CM_ SG_ 325 FrntSideRdrRiDetn61RdrDetnChks "Refer to the data element description in FrntSideRdrLeDetn1 with the same data element name.";
CM_ SG_ 325 FrntSideRdrRiDetn61RdrDetnCntr "Refer to the data element description in FrntSideRdrLeDetn1 with the same data element name.";
CM_ SG_ 325 FrntSideRdrRiDetn61RdrDetnConf "Refer to the data element description in FrntSideRdrLeDetn1 with the same data element name.";
CM_ SG_ 325 FrntSideRdrRiDetn61RdrDetnElevn "Refer to the data element description in FrntSideRdrLeDetn1 with the same data element name.";
CM_ SG_ 325 FrntSideRdrRiDetn61RdrDetnPwr "Refer to the data element description in FrntSideRdrLeDetn1 with the same data element name.";
CM_ SG_ 325 FrntSideRdrRiDetn61RdrDetnRng "Refer to the data element description in FrntSideRdrLeDetn1 with the same data element name.";
CM_ SG_ 325 FrntSideRdrRiDetn61RdrDetnRngV "Range Velocity";
CM_ SG_ 325 FrntSideRdrRiDetn61RdrDetnSts "Refer to the data element description in FrntSideRdrLeDetn1 with the same data element name.";
CM_ SG_ 325 FrntSideRdrRiDetn62RdrDetnAzi "Refer to the data element description in FrntSideRdrLeDetn1 with the same data element name.";
CM_ SG_ 325 FrntSideRdrRiDetn62RdrDetnChks "Refer to the data element description in FrntSideRdrLeDetn1 with the same data element name.";
CM_ SG_ 325 FrntSideRdrRiDetn62RdrDetnCntr "Refer to the data element description in FrntSideRdrLeDetn1 with the same data element name.";
CM_ SG_ 325 FrntSideRdrRiDetn62RdrDetnConf "Refer to the data element description in FrntSideRdrLeDetn1 with the same data element name.";
CM_ SG_ 325 FrntSideRdrRiDetn62RdrDetnElevn "Refer to the data element description in FrntSideRdrLeDetn1 with the same data element name.";
CM_ SG_ 325 FrntSideRdrRiDetn62RdrDetnPwr "Refer to the data element description in FrntSideRdrLeDetn1 with the same data element name.";
CM_ SG_ 325 FrntSideRdrRiDetn62RdrDetnRng "Refer to the data element description in FrntSideRdrLeDetn1 with the same data element name.";
CM_ SG_ 325 FrntSideRdrRiDetn62RdrDetnRngV "Range Velocity";
CM_ SG_ 325 FrntSideRdrRiDetn62RdrDetnSts "Refer to the data element description in FrntSideRdrLeDetn1 with the same data element name.";
CM_ SG_ 325 FrntSideRdrRiDetn63RdrDetnAzi "Refer to the data element description in FrntSideRdrLeDetn1 with the same data element name.";
CM_ SG_ 325 FrntSideRdrRiDetn63RdrDetnChks "Refer to the data element description in FrntSideRdrLeDetn1 with the same data element name.";
CM_ SG_ 325 FrntSideRdrRiDetn63RdrDetnCntr "Refer to the data element description in FrntSideRdrLeDetn1 with the same data element name.";
CM_ SG_ 325 FrntSideRdrRiDetn63RdrDetnConf "Refer to the data element description in FrntSideRdrLeDetn1 with the same data element name.";
CM_ SG_ 325 FrntSideRdrRiDetn63RdrDetnElevn "Refer to the data element description in FrntSideRdrLeDetn1 with the same data element name.";
CM_ SG_ 325 FrntSideRdrRiDetn63RdrDetnPwr "Refer to the data element description in FrntSideRdrLeDetn1 with the same data element name.";
CM_ SG_ 325 FrntSideRdrRiDetn63RdrDetnRng "Refer to the data element description in FrntSideRdrLeDetn1 with the same data element name.";
CM_ SG_ 325 FrntSideRdrRiDetn63RdrDetnRngV "Range Velocity";
CM_ SG_ 325 FrntSideRdrRiDetn63RdrDetnSts "Refer to the data element description in FrntSideRdrLeDetn1 with the same data element name.";
CM_ SG_ 325 FrntSideRdrRiDetn64RdrDetnAzi "Refer to the data element description in FrntSideRdrLeDetn1 with the same data element name.";
CM_ SG_ 325 FrntSideRdrRiDetn64RdrDetnChks "Refer to the data element description in FrntSideRdrLeDetn1 with the same data element name.";
CM_ SG_ 325 FrntSideRdrRiDetn64RdrDetnCntr "Refer to the data element description in FrntSideRdrLeDetn1 with the same data element name.";
CM_ SG_ 325 FrntSideRdrRiDetn64RdrDetnConf "Refer to the data element description in FrntSideRdrLeDetn1 with the same data element name.";
CM_ SG_ 325 FrntSideRdrRiDetn64RdrDetnElevn "Refer to the data element description in FrntSideRdrLeDetn1 with the same data element name.";
CM_ SG_ 325 FrntSideRdrRiDetn64RdrDetnPwr "Refer to the data element description in FrntSideRdrLeDetn1 with the same data element name.";
CM_ SG_ 325 FrntSideRdrRiDetn64RdrDetnRng "Refer to the data element description in FrntSideRdrLeDetn1 with the same data element name.";
CM_ SG_ 325 FrntSideRdrRiDetn64RdrDetnRngV "Range Velocity";
CM_ SG_ 325 FrntSideRdrRiDetn64RdrDetnSts "Refer to the data element description in FrntSideRdrLeDetn1 with the same data element name.";
CM_ SG_ 325 FrntSideRdrRiDetn65RdrDetnAzi "Refer to the data element description in FrntSideRdrLeDetn1 with the same data element name.";
CM_ SG_ 325 FrntSideRdrRiDetn65RdrDetnChks "Refer to the data element description in FrntSideRdrLeDetn1 with the same data element name.";
CM_ SG_ 325 FrntSideRdrRiDetn65RdrDetnCntr "Refer to the data element description in FrntSideRdrLeDetn1 with the same data element name.";
CM_ SG_ 325 FrntSideRdrRiDetn65RdrDetnConf "Refer to the data element description in FrntSideRdrLeDetn1 with the same data element name.";
CM_ SG_ 325 FrntSideRdrRiDetn65RdrDetnElevn "Refer to the data element description in FrntSideRdrLeDetn1 with the same data element name.";
CM_ SG_ 325 FrntSideRdrRiDetn65RdrDetnPwr "Refer to the data element description in FrntSideRdrLeDetn1 with the same data element name.";
CM_ SG_ 325 FrntSideRdrRiDetn65RdrDetnRng "Refer to the data element description in FrntSideRdrLeDetn1 with the same data element name.";
CM_ SG_ 325 FrntSideRdrRiDetn65RdrDetnRngV "Range Velocity";
CM_ SG_ 325 FrntSideRdrRiDetn65RdrDetnSts "Refer to the data element description in FrntSideRdrLeDetn1 with the same data element name.";
CM_ SG_ 325 FrntSideRdrRiDetn66RdrDetnAzi "Refer to the data element description in FrntSideRdrLeDetn1 with the same data element name.";
CM_ SG_ 325 FrntSideRdrRiDetn66RdrDetnChks "Refer to the data element description in FrntSideRdrLeDetn1 with the same data element name.";
CM_ SG_ 325 FrntSideRdrRiDetn66RdrDetnCntr "Refer to the data element description in FrntSideRdrLeDetn1 with the same data element name.";
CM_ SG_ 325 FrntSideRdrRiDetn66RdrDetnConf "Refer to the data element description in FrntSideRdrLeDetn1 with the same data element name.";
CM_ SG_ 325 FrntSideRdrRiDetn66RdrDetnElevn "Refer to the data element description in FrntSideRdrLeDetn1 with the same data element name.";
CM_ SG_ 325 FrntSideRdrRiDetn66RdrDetnPwr "Refer to the data element description in FrntSideRdrLeDetn1 with the same data element name.";
CM_ SG_ 325 FrntSideRdrRiDetn66RdrDetnRng "Refer to the data element description in FrntSideRdrLeDetn1 with the same data element name.";
CM_ SG_ 325 FrntSideRdrRiDetn66RdrDetnRngV "Range Velocity";
CM_ SG_ 325 FrntSideRdrRiDetn66RdrDetnSts "Refer to the data element description in FrntSideRdrLeDetn1 with the same data element name.";
CM_ SG_ 327 FrntSideRdrRiDetn67RdrDetnAzi "Refer to the data element description in FrntSideRdrLeDetn1 with the same data element name.";
CM_ SG_ 327 FrntSideRdrRiDetn67RdrDetnChks "Refer to the data element description in FrntSideRdrLeDetn1 with the same data element name.";
CM_ SG_ 327 FrntSideRdrRiDetn67RdrDetnCntr "Refer to the data element description in FrntSideRdrLeDetn1 with the same data element name.";
CM_ SG_ 327 FrntSideRdrRiDetn67RdrDetnConf "Refer to the data element description in FrntSideRdrLeDetn1 with the same data element name.";
CM_ SG_ 327 FrntSideRdrRiDetn67RdrDetnElevn "Refer to the data element description in FrntSideRdrLeDetn1 with the same data element name.";
CM_ SG_ 327 FrntSideRdrRiDetn67RdrDetnPwr "Refer to the data element description in FrntSideRdrLeDetn1 with the same data element name.";
CM_ SG_ 327 FrntSideRdrRiDetn67RdrDetnRng "Refer to the data element description in FrntSideRdrLeDetn1 with the same data element name.";
CM_ SG_ 327 FrntSideRdrRiDetn67RdrDetnRngV "Range Velocity";
CM_ SG_ 327 FrntSideRdrRiDetn67RdrDetnSts "Refer to the data element description in FrntSideRdrLeDetn1 with the same data element name.";
CM_ SG_ 327 FrntSideRdrRiDetn68RdrDetnAzi "Refer to the data element description in FrntSideRdrLeDetn1 with the same data element name.";
CM_ SG_ 327 FrntSideRdrRiDetn68RdrDetnChks "Refer to the data element description in FrntSideRdrLeDetn1 with the same data element name.";
CM_ SG_ 327 FrntSideRdrRiDetn68RdrDetnCntr "Refer to the data element description in FrntSideRdrLeDetn1 with the same data element name.";
CM_ SG_ 327 FrntSideRdrRiDetn68RdrDetnConf "Refer to the data element description in FrntSideRdrLeDetn1 with the same data element name.";
CM_ SG_ 327 FrntSideRdrRiDetn68RdrDetnElevn "Refer to the data element description in FrntSideRdrLeDetn1 with the same data element name.";
CM_ SG_ 327 FrntSideRdrRiDetn68RdrDetnPwr "Refer to the data element description in FrntSideRdrLeDetn1 with the same data element name.";
CM_ SG_ 327 FrntSideRdrRiDetn68RdrDetnRng "Refer to the data element description in FrntSideRdrLeDetn1 with the same data element name.";
CM_ SG_ 327 FrntSideRdrRiDetn68RdrDetnRngV "Range Velocity";
CM_ SG_ 327 FrntSideRdrRiDetn68RdrDetnSts "Refer to the data element description in FrntSideRdrLeDetn1 with the same data element name.";
CM_ SG_ 327 FrntSideRdrRiDetn69RdrDetnAzi "Refer to the data element description in FrntSideRdrLeDetn1 with the same data element name.";
CM_ SG_ 327 FrntSideRdrRiDetn69RdrDetnChks "Refer to the data element description in FrntSideRdrLeDetn1 with the same data element name.";
CM_ SG_ 327 FrntSideRdrRiDetn69RdrDetnCntr "Refer to the data element description in FrntSideRdrLeDetn1 with the same data element name.";
CM_ SG_ 327 FrntSideRdrRiDetn69RdrDetnConf "Refer to the data element description in FrntSideRdrLeDetn1 with the same data element name.";
CM_ SG_ 327 FrntSideRdrRiDetn69RdrDetnElevn "Refer to the data element description in FrntSideRdrLeDetn1 with the same data element name.";
CM_ SG_ 327 FrntSideRdrRiDetn69RdrDetnPwr "Refer to the data element description in FrntSideRdrLeDetn1 with the same data element name.";
CM_ SG_ 327 FrntSideRdrRiDetn69RdrDetnRng "Refer to the data element description in FrntSideRdrLeDetn1 with the same data element name.";
CM_ SG_ 327 FrntSideRdrRiDetn69RdrDetnRngV "Range Velocity";
CM_ SG_ 327 FrntSideRdrRiDetn69RdrDetnSts "Refer to the data element description in FrntSideRdrLeDetn1 with the same data element name.";
CM_ SG_ 327 FrntSideRdrRiDetn70RdrDetnAzi "Refer to the data element description in FrntSideRdrLeDetn1 with the same data element name.";
CM_ SG_ 327 FrntSideRdrRiDetn70RdrDetnChks "Refer to the data element description in FrntSideRdrLeDetn1 with the same data element name.";
CM_ SG_ 327 FrntSideRdrRiDetn70RdrDetnCntr "Refer to the data element description in FrntSideRdrLeDetn1 with the same data element name.";
CM_ SG_ 327 FrntSideRdrRiDetn70RdrDetnConf "Refer to the data element description in FrntSideRdrLeDetn1 with the same data element name.";
CM_ SG_ 327 FrntSideRdrRiDetn70RdrDetnElevn "Refer to the data element description in FrntSideRdrLeDetn1 with the same data element name.";
CM_ SG_ 327 FrntSideRdrRiDetn70RdrDetnPwr "Refer to the data element description in FrntSideRdrLeDetn1 with the same data element name.";
CM_ SG_ 327 FrntSideRdrRiDetn70RdrDetnRng "Refer to the data element description in FrntSideRdrLeDetn1 with the same data element name.";
CM_ SG_ 327 FrntSideRdrRiDetn70RdrDetnRngV "Range Velocity";
CM_ SG_ 327 FrntSideRdrRiDetn70RdrDetnSts "Refer to the data element description in FrntSideRdrLeDetn1 with the same data element name.";
CM_ SG_ 327 FrntSideRdrRiDetn71RdrDetnAzi "Refer to the data element description in FrntSideRdrLeDetn1 with the same data element name.";
CM_ SG_ 327 FrntSideRdrRiDetn71RdrDetnChks "Refer to the data element description in FrntSideRdrLeDetn1 with the same data element name.";
CM_ SG_ 327 FrntSideRdrRiDetn71RdrDetnCntr "Refer to the data element description in FrntSideRdrLeDetn1 with the same data element name.";
CM_ SG_ 327 FrntSideRdrRiDetn71RdrDetnConf "Refer to the data element description in FrntSideRdrLeDetn1 with the same data element name.";
CM_ SG_ 327 FrntSideRdrRiDetn71RdrDetnElevn "Refer to the data element description in FrntSideRdrLeDetn1 with the same data element name.";
CM_ SG_ 327 FrntSideRdrRiDetn71RdrDetnPwr "Refer to the data element description in FrntSideRdrLeDetn1 with the same data element name.";
CM_ SG_ 327 FrntSideRdrRiDetn71RdrDetnRng "Refer to the data element description in FrntSideRdrLeDetn1 with the same data element name.";
CM_ SG_ 327 FrntSideRdrRiDetn71RdrDetnRngV "Range Velocity";
CM_ SG_ 327 FrntSideRdrRiDetn71RdrDetnSts "Refer to the data element description in FrntSideRdrLeDetn1 with the same data element name.";
CM_ SG_ 327 FrntSideRdrRiDetn72RdrDetnAzi "Refer to the data element description in FrntSideRdrLeDetn1 with the same data element name.";
CM_ SG_ 327 FrntSideRdrRiDetn72RdrDetnChks "Refer to the data element description in FrntSideRdrLeDetn1 with the same data element name.";
CM_ SG_ 327 FrntSideRdrRiDetn72RdrDetnCntr "Refer to the data element description in FrntSideRdrLeDetn1 with the same data element name.";
CM_ SG_ 327 FrntSideRdrRiDetn72RdrDetnConf "Refer to the data element description in FrntSideRdrLeDetn1 with the same data element name.";
CM_ SG_ 327 FrntSideRdrRiDetn72RdrDetnElevn "Refer to the data element description in FrntSideRdrLeDetn1 with the same data element name.";
CM_ SG_ 327 FrntSideRdrRiDetn72RdrDetnPwr "Refer to the data element description in FrntSideRdrLeDetn1 with the same data element name.";
CM_ SG_ 327 FrntSideRdrRiDetn72RdrDetnRng "Refer to the data element description in FrntSideRdrLeDetn1 with the same data element name.";
CM_ SG_ 327 FrntSideRdrRiDetn72RdrDetnRngV "Range Velocity";
CM_ SG_ 327 FrntSideRdrRiDetn72RdrDetnSts "Refer to the data element description in FrntSideRdrLeDetn1 with the same data element name.";
CM_ SG_ 329 FrntSideRdrRiDetn73RdrDetnAzi "Refer to the data element description in FrntSideRdrLeDetn1 with the same data element name.";
CM_ SG_ 329 FrntSideRdrRiDetn73RdrDetnChks "Refer to the data element description in FrntSideRdrLeDetn1 with the same data element name.";
CM_ SG_ 329 FrntSideRdrRiDetn73RdrDetnCntr "Refer to the data element description in FrntSideRdrLeDetn1 with the same data element name.";
CM_ SG_ 329 FrntSideRdrRiDetn73RdrDetnConf "Refer to the data element description in FrntSideRdrLeDetn1 with the same data element name.";
CM_ SG_ 329 FrntSideRdrRiDetn73RdrDetnElevn "Refer to the data element description in FrntSideRdrLeDetn1 with the same data element name.";
CM_ SG_ 329 FrntSideRdrRiDetn73RdrDetnPwr "Refer to the data element description in FrntSideRdrLeDetn1 with the same data element name.";
CM_ SG_ 329 FrntSideRdrRiDetn73RdrDetnRng "Refer to the data element description in FrntSideRdrLeDetn1 with the same data element name.";
CM_ SG_ 329 FrntSideRdrRiDetn73RdrDetnRngV "Range Velocity";
CM_ SG_ 329 FrntSideRdrRiDetn73RdrDetnSts "Refer to the data element description in FrntSideRdrLeDetn1 with the same data element name.";
CM_ SG_ 329 FrntSideRdrRiDetn74RdrDetnAzi "Refer to the data element description in FrntSideRdrLeDetn1 with the same data element name.";
CM_ SG_ 329 FrntSideRdrRiDetn74RdrDetnChks "Refer to the data element description in FrntSideRdrLeDetn1 with the same data element name.";
CM_ SG_ 329 FrntSideRdrRiDetn74RdrDetnCntr "Refer to the data element description in FrntSideRdrLeDetn1 with the same data element name.";
CM_ SG_ 329 FrntSideRdrRiDetn74RdrDetnConf "Refer to the data element description in FrntSideRdrLeDetn1 with the same data element name.";
CM_ SG_ 329 FrntSideRdrRiDetn74RdrDetnElevn "Refer to the data element description in FrntSideRdrLeDetn1 with the same data element name.";
CM_ SG_ 329 FrntSideRdrRiDetn74RdrDetnPwr "Refer to the data element description in FrntSideRdrLeDetn1 with the same data element name.";
CM_ SG_ 329 FrntSideRdrRiDetn74RdrDetnRng "Refer to the data element description in FrntSideRdrLeDetn1 with the same data element name.";
CM_ SG_ 329 FrntSideRdrRiDetn74RdrDetnRngV "Range Velocity";
CM_ SG_ 329 FrntSideRdrRiDetn74RdrDetnSts "Refer to the data element description in FrntSideRdrLeDetn1 with the same data element name.";
CM_ SG_ 329 FrntSideRdrRiDetn75RdrDetnAzi "Refer to the data element description in FrntSideRdrLeDetn1 with the same data element name.";
CM_ SG_ 329 FrntSideRdrRiDetn75RdrDetnChks "Refer to the data element description in FrntSideRdrLeDetn1 with the same data element name.";
CM_ SG_ 329 FrntSideRdrRiDetn75RdrDetnCntr "Refer to the data element description in FrntSideRdrLeDetn1 with the same data element name.";
CM_ SG_ 329 FrntSideRdrRiDetn75RdrDetnConf "Refer to the data element description in FrntSideRdrLeDetn1 with the same data element name.";
CM_ SG_ 329 FrntSideRdrRiDetn75RdrDetnElevn "Refer to the data element description in FrntSideRdrLeDetn1 with the same data element name.";
CM_ SG_ 329 FrntSideRdrRiDetn75RdrDetnPwr "Refer to the data element description in FrntSideRdrLeDetn1 with the same data element name.";
CM_ SG_ 329 FrntSideRdrRiDetn75RdrDetnRng "Refer to the data element description in FrntSideRdrLeDetn1 with the same data element name.";
CM_ SG_ 329 FrntSideRdrRiDetn75RdrDetnRngV "Range Velocity";
CM_ SG_ 329 FrntSideRdrRiDetn75RdrDetnSts "Refer to the data element description in FrntSideRdrLeDetn1 with the same data element name.";
CM_ SG_ 329 FrntSideRdrRiDetn76RdrDetnAzi "Refer to the data element description in FrntSideRdrLeDetn1 with the same data element name.";
CM_ SG_ 329 FrntSideRdrRiDetn76RdrDetnChks "Refer to the data element description in FrntSideRdrLeDetn1 with the same data element name.";
CM_ SG_ 329 FrntSideRdrRiDetn76RdrDetnCntr "Refer to the data element description in FrntSideRdrLeDetn1 with the same data element name.";
CM_ SG_ 329 FrntSideRdrRiDetn76RdrDetnConf "Refer to the data element description in FrntSideRdrLeDetn1 with the same data element name.";
CM_ SG_ 329 FrntSideRdrRiDetn76RdrDetnElevn "Refer to the data element description in FrntSideRdrLeDetn1 with the same data element name.";
CM_ SG_ 329 FrntSideRdrRiDetn76RdrDetnPwr "Refer to the data element description in FrntSideRdrLeDetn1 with the same data element name.";
CM_ SG_ 329 FrntSideRdrRiDetn76RdrDetnRng "Refer to the data element description in FrntSideRdrLeDetn1 with the same data element name.";
CM_ SG_ 329 FrntSideRdrRiDetn76RdrDetnRngV "Range Velocity";
CM_ SG_ 329 FrntSideRdrRiDetn76RdrDetnSts "Refer to the data element description in FrntSideRdrLeDetn1 with the same data element name.";
CM_ SG_ 329 FrntSideRdrRiDetn77RdrDetnAzi "Refer to the data element description in FrntSideRdrLeDetn1 with the same data element name.";
CM_ SG_ 329 FrntSideRdrRiDetn77RdrDetnChks "Refer to the data element description in FrntSideRdrLeDetn1 with the same data element name.";
CM_ SG_ 329 FrntSideRdrRiDetn77RdrDetnCntr "Refer to the data element description in FrntSideRdrLeDetn1 with the same data element name.";
CM_ SG_ 329 FrntSideRdrRiDetn77RdrDetnConf "Refer to the data element description in FrntSideRdrLeDetn1 with the same data element name.";
CM_ SG_ 329 FrntSideRdrRiDetn77RdrDetnElevn "Refer to the data element description in FrntSideRdrLeDetn1 with the same data element name.";
CM_ SG_ 329 FrntSideRdrRiDetn77RdrDetnPwr "Refer to the data element description in FrntSideRdrLeDetn1 with the same data element name.";
CM_ SG_ 329 FrntSideRdrRiDetn77RdrDetnRng "Refer to the data element description in FrntSideRdrLeDetn1 with the same data element name.";
CM_ SG_ 329 FrntSideRdrRiDetn77RdrDetnRngV "Range Velocity";
CM_ SG_ 329 FrntSideRdrRiDetn77RdrDetnSts "Refer to the data element description in FrntSideRdrLeDetn1 with the same data element name.";
CM_ SG_ 329 FrntSideRdrRiDetn78RdrDetnAzi "Refer to the data element description in FrntSideRdrLeDetn1 with the same data element name.";
CM_ SG_ 329 FrntSideRdrRiDetn78RdrDetnChks "Refer to the data element description in FrntSideRdrLeDetn1 with the same data element name.";
CM_ SG_ 329 FrntSideRdrRiDetn78RdrDetnCntr "Refer to the data element description in FrntSideRdrLeDetn1 with the same data element name.";
CM_ SG_ 329 FrntSideRdrRiDetn78RdrDetnConf "Refer to the data element description in FrntSideRdrLeDetn1 with the same data element name.";
CM_ SG_ 329 FrntSideRdrRiDetn78RdrDetnElevn "Refer to the data element description in FrntSideRdrLeDetn1 with the same data element name.";
CM_ SG_ 329 FrntSideRdrRiDetn78RdrDetnPwr "Refer to the data element description in FrntSideRdrLeDetn1 with the same data element name.";
CM_ SG_ 329 FrntSideRdrRiDetn78RdrDetnRng "Refer to the data element description in FrntSideRdrLeDetn1 with the same data element name.";
CM_ SG_ 329 FrntSideRdrRiDetn78RdrDetnRngV "Range Velocity";
CM_ SG_ 329 FrntSideRdrRiDetn78RdrDetnSts "Refer to the data element description in FrntSideRdrLeDetn1 with the same data element name.";
CM_ SG_ 331 FrntSideRdrRiDetn79RdrDetnAzi "Refer to the data element description in FrntSideRdrLeDetn1 with the same data element name.";
CM_ SG_ 331 FrntSideRdrRiDetn79RdrDetnChks "Refer to the data element description in FrntSideRdrLeDetn1 with the same data element name.";
CM_ SG_ 331 FrntSideRdrRiDetn79RdrDetnCntr "Refer to the data element description in FrntSideRdrLeDetn1 with the same data element name.";
CM_ SG_ 331 FrntSideRdrRiDetn79RdrDetnConf "Refer to the data element description in FrntSideRdrLeDetn1 with the same data element name.";
CM_ SG_ 331 FrntSideRdrRiDetn79RdrDetnElevn "Refer to the data element description in FrntSideRdrLeDetn1 with the same data element name.";
CM_ SG_ 331 FrntSideRdrRiDetn79RdrDetnPwr "Refer to the data element description in FrntSideRdrLeDetn1 with the same data element name.";
CM_ SG_ 331 FrntSideRdrRiDetn79RdrDetnRng "Refer to the data element description in FrntSideRdrLeDetn1 with the same data element name.";
CM_ SG_ 331 FrntSideRdrRiDetn79RdrDetnRngV "Range Velocity";
CM_ SG_ 331 FrntSideRdrRiDetn79RdrDetnSts "Refer to the data element description in FrntSideRdrLeDetn1 with the same data element name.";
CM_ SG_ 331 FrntSideRdrRiDetn80RdrDetnAzi "Refer to the data element description in FrntSideRdrLeDetn1 with the same data element name.";
CM_ SG_ 331 FrntSideRdrRiDetn80RdrDetnChks "Refer to the data element description in FrntSideRdrLeDetn1 with the same data element name.";
CM_ SG_ 331 FrntSideRdrRiDetn80RdrDetnCntr "Refer to the data element description in FrntSideRdrLeDetn1 with the same data element name.";
CM_ SG_ 331 FrntSideRdrRiDetn80RdrDetnConf "Refer to the data element description in FrntSideRdrLeDetn1 with the same data element name.";
CM_ SG_ 331 FrntSideRdrRiDetn80RdrDetnElevn "Refer to the data element description in FrntSideRdrLeDetn1 with the same data element name.";
CM_ SG_ 331 FrntSideRdrRiDetn80RdrDetnPwr "Refer to the data element description in FrntSideRdrLeDetn1 with the same data element name.";
CM_ SG_ 331 FrntSideRdrRiDetn80RdrDetnRng "Refer to the data element description in FrntSideRdrLeDetn1 with the same data element name.";
CM_ SG_ 331 FrntSideRdrRiDetn80RdrDetnRngV "Range Velocity";
CM_ SG_ 331 FrntSideRdrRiDetn80RdrDetnSts "Refer to the data element description in FrntSideRdrLeDetn1 with the same data element name.";
CM_ SG_ 331 FrntSideRdrRiDetn81RdrDetnAzi "Refer to the data element description in FrntSideRdrLeDetn1 with the same data element name.";
CM_ SG_ 331 FrntSideRdrRiDetn81RdrDetnChks "Refer to the data element description in FrntSideRdrLeDetn1 with the same data element name.";
CM_ SG_ 331 FrntSideRdrRiDetn81RdrDetnCntr "Refer to the data element description in FrntSideRdrLeDetn1 with the same data element name.";
CM_ SG_ 331 FrntSideRdrRiDetn81RdrDetnConf "Refer to the data element description in FrntSideRdrLeDetn1 with the same data element name.";
CM_ SG_ 331 FrntSideRdrRiDetn81RdrDetnElevn "Refer to the data element description in FrntSideRdrLeDetn1 with the same data element name.";
CM_ SG_ 331 FrntSideRdrRiDetn81RdrDetnPwr "Refer to the data element description in FrntSideRdrLeDetn1 with the same data element name.";
CM_ SG_ 331 FrntSideRdrRiDetn81RdrDetnRng "Refer to the data element description in FrntSideRdrLeDetn1 with the same data element name.";
CM_ SG_ 331 FrntSideRdrRiDetn81RdrDetnRngV "Range Velocity";
CM_ SG_ 331 FrntSideRdrRiDetn81RdrDetnSts "Refer to the data element description in FrntSideRdrLeDetn1 with the same data element name.";
CM_ SG_ 331 FrntSideRdrRiDetn82RdrDetnAzi "Refer to the data element description in FrntSideRdrLeDetn1 with the same data element name.";
CM_ SG_ 331 FrntSideRdrRiDetn82RdrDetnChks "Refer to the data element description in FrntSideRdrLeDetn1 with the same data element name.";
CM_ SG_ 331 FrntSideRdrRiDetn82RdrDetnCntr "Refer to the data element description in FrntSideRdrLeDetn1 with the same data element name.";
CM_ SG_ 331 FrntSideRdrRiDetn82RdrDetnConf "Refer to the data element description in FrntSideRdrLeDetn1 with the same data element name.";
CM_ SG_ 331 FrntSideRdrRiDetn82RdrDetnElevn "Refer to the data element description in FrntSideRdrLeDetn1 with the same data element name.";
CM_ SG_ 331 FrntSideRdrRiDetn82RdrDetnPwr "Refer to the data element description in FrntSideRdrLeDetn1 with the same data element name.";
CM_ SG_ 331 FrntSideRdrRiDetn82RdrDetnRng "Refer to the data element description in FrntSideRdrLeDetn1 with the same data element name.";
CM_ SG_ 331 FrntSideRdrRiDetn82RdrDetnRngV "Range Velocity";
CM_ SG_ 331 FrntSideRdrRiDetn82RdrDetnSts "Refer to the data element description in FrntSideRdrLeDetn1 with the same data element name.";
CM_ SG_ 331 FrntSideRdrRiDetn83RdrDetnAzi "Refer to the data element description in FrntSideRdrLeDetn1 with the same data element name.";
CM_ SG_ 331 FrntSideRdrRiDetn83RdrDetnChks "Refer to the data element description in FrntSideRdrLeDetn1 with the same data element name.";
CM_ SG_ 331 FrntSideRdrRiDetn83RdrDetnCntr "Refer to the data element description in FrntSideRdrLeDetn1 with the same data element name.";
CM_ SG_ 331 FrntSideRdrRiDetn83RdrDetnConf "Refer to the data element description in FrntSideRdrLeDetn1 with the same data element name.";
CM_ SG_ 331 FrntSideRdrRiDetn83RdrDetnElevn "Refer to the data element description in FrntSideRdrLeDetn1 with the same data element name.";
CM_ SG_ 331 FrntSideRdrRiDetn83RdrDetnPwr "Refer to the data element description in FrntSideRdrLeDetn1 with the same data element name.";
CM_ SG_ 331 FrntSideRdrRiDetn83RdrDetnRng "Refer to the data element description in FrntSideRdrLeDetn1 with the same data element name.";
CM_ SG_ 331 FrntSideRdrRiDetn83RdrDetnRngV "Range Velocity";
CM_ SG_ 331 FrntSideRdrRiDetn83RdrDetnSts "Refer to the data element description in FrntSideRdrLeDetn1 with the same data element name.";
CM_ SG_ 331 FrntSideRdrRiDetn84RdrDetnAzi "Refer to the data element description in FrntSideRdrLeDetn1 with the same data element name.";
CM_ SG_ 331 FrntSideRdrRiDetn84RdrDetnChks "Refer to the data element description in FrntSideRdrLeDetn1 with the same data element name.";
CM_ SG_ 331 FrntSideRdrRiDetn84RdrDetnCntr "Refer to the data element description in FrntSideRdrLeDetn1 with the same data element name.";
CM_ SG_ 331 FrntSideRdrRiDetn84RdrDetnConf "Refer to the data element description in FrntSideRdrLeDetn1 with the same data element name.";
CM_ SG_ 331 FrntSideRdrRiDetn84RdrDetnElevn "Refer to the data element description in FrntSideRdrLeDetn1 with the same data element name.";
CM_ SG_ 331 FrntSideRdrRiDetn84RdrDetnPwr "Refer to the data element description in FrntSideRdrLeDetn1 with the same data element name.";
CM_ SG_ 331 FrntSideRdrRiDetn84RdrDetnRng "Refer to the data element description in FrntSideRdrLeDetn1 with the same data element name.";
CM_ SG_ 331 FrntSideRdrRiDetn84RdrDetnRngV "Range Velocity";
CM_ SG_ 331 FrntSideRdrRiDetn84RdrDetnSts "Refer to the data element description in FrntSideRdrLeDetn1 with the same data element name.";
CM_ SG_ 333 FrntSideRdrRiDetn85RdrDetnAzi "Refer to the data element description in FrntSideRdrLeDetn1 with the same data element name.";
CM_ SG_ 333 FrntSideRdrRiDetn85RdrDetnChks "Refer to the data element description in FrntSideRdrLeDetn1 with the same data element name.";
CM_ SG_ 333 FrntSideRdrRiDetn85RdrDetnCntr "Refer to the data element description in FrntSideRdrLeDetn1 with the same data element name.";
CM_ SG_ 333 FrntSideRdrRiDetn85RdrDetnConf "Refer to the data element description in FrntSideRdrLeDetn1 with the same data element name.";
CM_ SG_ 333 FrntSideRdrRiDetn85RdrDetnElevn "Refer to the data element description in FrntSideRdrLeDetn1 with the same data element name.";
CM_ SG_ 333 FrntSideRdrRiDetn85RdrDetnPwr "Refer to the data element description in FrntSideRdrLeDetn1 with the same data element name.";
CM_ SG_ 333 FrntSideRdrRiDetn85RdrDetnRng "Refer to the data element description in FrntSideRdrLeDetn1 with the same data element name.";
CM_ SG_ 333 FrntSideRdrRiDetn85RdrDetnRngV "Range Velocity";
CM_ SG_ 333 FrntSideRdrRiDetn85RdrDetnSts "Refer to the data element description in FrntSideRdrLeDetn1 with the same data element name.";
CM_ SG_ 333 FrntSideRdrRiDetn86RdrDetnAzi "Refer to the data element description in FrntSideRdrLeDetn1 with the same data element name.";
CM_ SG_ 333 FrntSideRdrRiDetn86RdrDetnChks "Refer to the data element description in FrntSideRdrLeDetn1 with the same data element name.";
CM_ SG_ 333 FrntSideRdrRiDetn86RdrDetnCntr "Refer to the data element description in FrntSideRdrLeDetn1 with the same data element name.";
CM_ SG_ 333 FrntSideRdrRiDetn86RdrDetnConf "Refer to the data element description in FrntSideRdrLeDetn1 with the same data element name.";
CM_ SG_ 333 FrntSideRdrRiDetn86RdrDetnElevn "Refer to the data element description in FrntSideRdrLeDetn1 with the same data element name.";
CM_ SG_ 333 FrntSideRdrRiDetn86RdrDetnPwr "Refer to the data element description in FrntSideRdrLeDetn1 with the same data element name.";
CM_ SG_ 333 FrntSideRdrRiDetn86RdrDetnRng "Refer to the data element description in FrntSideRdrLeDetn1 with the same data element name.";
CM_ SG_ 333 FrntSideRdrRiDetn86RdrDetnRngV "Range Velocity";
CM_ SG_ 333 FrntSideRdrRiDetn86RdrDetnSts "Refer to the data element description in FrntSideRdrLeDetn1 with the same data element name.";
CM_ SG_ 333 FrntSideRdrRiDetn87RdrDetnAzi "Refer to the data element description in FrntSideRdrLeDetn1 with the same data element name.";
CM_ SG_ 333 FrntSideRdrRiDetn87RdrDetnChks "Refer to the data element description in FrntSideRdrLeDetn1 with the same data element name.";
CM_ SG_ 333 FrntSideRdrRiDetn87RdrDetnCntr "Refer to the data element description in FrntSideRdrLeDetn1 with the same data element name.";
CM_ SG_ 333 FrntSideRdrRiDetn87RdrDetnConf "Refer to the data element description in FrntSideRdrLeDetn1 with the same data element name.";
CM_ SG_ 333 FrntSideRdrRiDetn87RdrDetnElevn "Refer to the data element description in FrntSideRdrLeDetn1 with the same data element name.";
CM_ SG_ 333 FrntSideRdrRiDetn87RdrDetnPwr "Refer to the data element description in FrntSideRdrLeDetn1 with the same data element name.";
CM_ SG_ 333 FrntSideRdrRiDetn87RdrDetnRng "Refer to the data element description in FrntSideRdrLeDetn1 with the same data element name.";
CM_ SG_ 333 FrntSideRdrRiDetn87RdrDetnRngV "Range Velocity";
CM_ SG_ 333 FrntSideRdrRiDetn87RdrDetnSts "Refer to the data element description in FrntSideRdrLeDetn1 with the same data element name.";
CM_ SG_ 333 FrntSideRdrRiDetn88RdrDetnAzi "Refer to the data element description in FrntSideRdrLeDetn1 with the same data element name.";
CM_ SG_ 333 FrntSideRdrRiDetn88RdrDetnChks "Refer to the data element description in FrntSideRdrLeDetn1 with the same data element name.";
CM_ SG_ 333 FrntSideRdrRiDetn88RdrDetnCntr "Refer to the data element description in FrntSideRdrLeDetn1 with the same data element name.";
CM_ SG_ 333 FrntSideRdrRiDetn88RdrDetnConf "Refer to the data element description in FrntSideRdrLeDetn1 with the same data element name.";
CM_ SG_ 333 FrntSideRdrRiDetn88RdrDetnElevn "Refer to the data element description in FrntSideRdrLeDetn1 with the same data element name.";
CM_ SG_ 333 FrntSideRdrRiDetn88RdrDetnPwr "Refer to the data element description in FrntSideRdrLeDetn1 with the same data element name.";
CM_ SG_ 333 FrntSideRdrRiDetn88RdrDetnRng "Refer to the data element description in FrntSideRdrLeDetn1 with the same data element name.";
CM_ SG_ 333 FrntSideRdrRiDetn88RdrDetnRngV "Range Velocity";
CM_ SG_ 333 FrntSideRdrRiDetn88RdrDetnSts "Refer to the data element description in FrntSideRdrLeDetn1 with the same data element name.";
CM_ SG_ 333 FrntSideRdrRiDetn89RdrDetnAzi "Refer to the data element description in FrntSideRdrLeDetn1 with the same data element name.";
CM_ SG_ 333 FrntSideRdrRiDetn89RdrDetnChks "Refer to the data element description in FrntSideRdrLeDetn1 with the same data element name.";
CM_ SG_ 333 FrntSideRdrRiDetn89RdrDetnCntr "Refer to the data element description in FrntSideRdrLeDetn1 with the same data element name.";
CM_ SG_ 333 FrntSideRdrRiDetn89RdrDetnConf "Refer to the data element description in FrntSideRdrLeDetn1 with the same data element name.";
CM_ SG_ 333 FrntSideRdrRiDetn89RdrDetnElevn "Refer to the data element description in FrntSideRdrLeDetn1 with the same data element name.";
CM_ SG_ 333 FrntSideRdrRiDetn89RdrDetnPwr "Refer to the data element description in FrntSideRdrLeDetn1 with the same data element name.";
CM_ SG_ 333 FrntSideRdrRiDetn89RdrDetnRng "Refer to the data element description in FrntSideRdrLeDetn1 with the same data element name.";
CM_ SG_ 333 FrntSideRdrRiDetn89RdrDetnRngV "Range Velocity";
CM_ SG_ 333 FrntSideRdrRiDetn89RdrDetnSts "Refer to the data element description in FrntSideRdrLeDetn1 with the same data element name.";
CM_ SG_ 333 FrntSideRdrRiDetn90RdrDetnAzi "Refer to the data element description in FrntSideRdrLeDetn1 with the same data element name.";
CM_ SG_ 333 FrntSideRdrRiDetn90RdrDetnChks "Refer to the data element description in FrntSideRdrLeDetn1 with the same data element name.";
CM_ SG_ 333 FrntSideRdrRiDetn90RdrDetnCntr "Refer to the data element description in FrntSideRdrLeDetn1 with the same data element name.";
CM_ SG_ 333 FrntSideRdrRiDetn90RdrDetnConf "Refer to the data element description in FrntSideRdrLeDetn1 with the same data element name.";
CM_ SG_ 333 FrntSideRdrRiDetn90RdrDetnElevn "Refer to the data element description in FrntSideRdrLeDetn1 with the same data element name.";
CM_ SG_ 333 FrntSideRdrRiDetn90RdrDetnPwr "Refer to the data element description in FrntSideRdrLeDetn1 with the same data element name.";
CM_ SG_ 333 FrntSideRdrRiDetn90RdrDetnRng "Refer to the data element description in FrntSideRdrLeDetn1 with the same data element name.";
CM_ SG_ 333 FrntSideRdrRiDetn90RdrDetnRngV "Range Velocity";
CM_ SG_ 333 FrntSideRdrRiDetn90RdrDetnSts "Refer to the data element description in FrntSideRdrLeDetn1 with the same data element name.";
BA_DEF_ BO_ "VFrameFormat" ENUM "StandardCAN","ExtendedCAN","reserved","J1939PG","reserved","reserved","reserved","reserved","reserved","reserved","reserved","reserved","reserved","reserved","StandardCAN_FD","ExtendedCAN_FD";
BA_DEF_ BO_ "CANFD_BRS" ENUM "0","1";
BA_DEF_ BO_ "GenMsgSendType" ENUM "cyclic", "spontaneous", "not-used", "not-used", "not-used", "cyclicAndSpontaneous", "not-used", "cyclicIfActive", "NoMsgSendType"; // [us]
BA_DEF_ BO_ "GenMsgCycleTime" INT 0 65536; // [ms]
BA_DEF_ BO_ "GenMsgStartDelayTime" INT 0 65536; // [ms]
BA_DEF_ BO_ "GenMsgDelayTime" INT 0 65536; // [ms]
BA_DEF_ SG_ "GenSigSendType" ENUM "Cyclic","OnWrite","OnWriteWithRepetition","OnChange","OnChangeWithRepetition","IfActive","IfActiveWithRepetition","NoSigSendType";
BA_DEF_ SG_ "GenSigStartValue" HEX 0 80000000;
BA_DEF_ BO_ "GenMsgILSupport" ENUM "No","Yes";
BA_DEF_ BO_ "NmAsrMessage" ENUM "No","Yes";
BA_DEF_ SG_ "GenSigFuncType" ENUM "NoFunction","n/a","n/a","n/a","n/a","n/a","n/a","n/a","n/a","n/a","n/a","n/a","n/a","n/a","n/a","CHK","CNTR","n/a","n/a","n/a","CNTR_AR_01","CRC_AR_01_BOTH","CRC_AR_01_ALT","CRC_AR_01_LOW","CRC_AR_01_NIBBLE","CNTR_AR_04","CRC_AR_04A","CNTR_AR_05","CRC_AR_05";
BA_DEF_ SG_ "GenSigDataID" STRING;

BA_DEF_DEF_ "VFrameFormat" "J1939PG";
BA_DEF_DEF_ "CANFD_BRS" "1";
BA_DEF_DEF_ "GenSigStartValue" 0;
BA_DEF_DEF_ "GenSigSendType" "NoSigSendType";
BA_DEF_DEF_ "GenMsgCycleTime" 0;
BA_DEF_DEF_ "GenMsgDelayTime" 0;
BA_DEF_DEF_ "GenMsgStartDelayTime" 0;
BA_DEF_DEF_ "GenMsgSendType" "NoMsgSendType";
BA_DEF_DEF_ "GenMsgILSupport" "Yes";
BA_DEF_DEF_ "NmAsrMessage" "No";
BA_DEF_DEF_ "GenSigFuncType" "NoFunction";
BA_DEF_DEF_ "GenSigDataID" "";
// Frame: FSRRSafetyCANFD1Frame08
BA_ "VFrameFormat" BO_ 319 14;
BA_ "GenMsgSendType" BO_ 319 0;
BA_ "GenMsgCycleTime" BO_ 319 50.000;
BA_ "GenSigStartValue" SG_ 319 FrntSideRdrRiDetn43RdrDetnAzi 900;
BA_ "GenSigSendType" SG_ 319 FrntSideRdrRiDetn43RdrDetnAzi 0;
BA_ "GenSigSendType" SG_ 319 FrntSideRdrRiDetn43RdrDetnChks 0;
BA_ "GenSigFuncType" SG_ 319 FrntSideRdrRiDetn43RdrDetnChks 15;
BA_ "GenSigDataID" SG_ 319 FrntSideRdrRiDetn43RdrDetnChks "0x90D";
BA_ "GenSigSendType" SG_ 319 FrntSideRdrRiDetn43RdrDetnCntr 0;
BA_ "GenSigFuncType" SG_ 319 FrntSideRdrRiDetn43RdrDetnCntr 16;
BA_ "GenSigSendType" SG_ 319 FrntSideRdrRiDetn43RdrDetnConf 0;
BA_ "GenSigStartValue" SG_ 319 FrntSideRdrRiDetn43RdrDetnElevn 15;
BA_ "GenSigSendType" SG_ 319 FrntSideRdrRiDetn43RdrDetnElevn 0;
BA_ "GenSigSendType" SG_ 319 FrntSideRdrRiDetn43RdrDetnPwr 0;
BA_ "GenSigStartValue" SG_ 319 FrntSideRdrRiDetn43RdrDetnRng 10050;
BA_ "GenSigSendType" SG_ 319 FrntSideRdrRiDetn43RdrDetnRng 0;
BA_ "GenSigStartValue" SG_ 319 FrntSideRdrRiDetn43RdrDetnRngV 4000;
BA_ "GenSigSendType" SG_ 319 FrntSideRdrRiDetn43RdrDetnRngV 0;
BA_ "GenSigStartValue" SG_ 319 FrntSideRdrRiDetn43RdrDetnSts 3;
BA_ "GenSigSendType" SG_ 319 FrntSideRdrRiDetn43RdrDetnSts 0;
BA_ "GenSigStartValue" SG_ 319 FrntSideRdrRiDetn44RdrDetnAzi 900;
BA_ "GenSigSendType" SG_ 319 FrntSideRdrRiDetn44RdrDetnAzi 0;
BA_ "GenSigSendType" SG_ 319 FrntSideRdrRiDetn44RdrDetnChks 0;
BA_ "GenSigFuncType" SG_ 319 FrntSideRdrRiDetn44RdrDetnChks 15;
BA_ "GenSigDataID" SG_ 319 FrntSideRdrRiDetn44RdrDetnChks "0x90E";
BA_ "GenSigSendType" SG_ 319 FrntSideRdrRiDetn44RdrDetnCntr 0;
BA_ "GenSigFuncType" SG_ 319 FrntSideRdrRiDetn44RdrDetnCntr 16;
BA_ "GenSigSendType" SG_ 319 FrntSideRdrRiDetn44RdrDetnConf 0;
BA_ "GenSigStartValue" SG_ 319 FrntSideRdrRiDetn44RdrDetnElevn 15;
BA_ "GenSigSendType" SG_ 319 FrntSideRdrRiDetn44RdrDetnElevn 0;
BA_ "GenSigSendType" SG_ 319 FrntSideRdrRiDetn44RdrDetnPwr 0;
BA_ "GenSigStartValue" SG_ 319 FrntSideRdrRiDetn44RdrDetnRng 10050;
BA_ "GenSigSendType" SG_ 319 FrntSideRdrRiDetn44RdrDetnRng 0;
BA_ "GenSigStartValue" SG_ 319 FrntSideRdrRiDetn44RdrDetnRngV 4000;
BA_ "GenSigSendType" SG_ 319 FrntSideRdrRiDetn44RdrDetnRngV 0;
BA_ "GenSigStartValue" SG_ 319 FrntSideRdrRiDetn44RdrDetnSts 3;
BA_ "GenSigSendType" SG_ 319 FrntSideRdrRiDetn44RdrDetnSts 0;
BA_ "GenSigStartValue" SG_ 319 FrntSideRdrRiDetn45RdrDetnAzi 900;
BA_ "GenSigSendType" SG_ 319 FrntSideRdrRiDetn45RdrDetnAzi 0;
BA_ "GenSigSendType" SG_ 319 FrntSideRdrRiDetn45RdrDetnChks 0;
BA_ "GenSigFuncType" SG_ 319 FrntSideRdrRiDetn45RdrDetnChks 15;
BA_ "GenSigDataID" SG_ 319 FrntSideRdrRiDetn45RdrDetnChks "0x90F";
BA_ "GenSigSendType" SG_ 319 FrntSideRdrRiDetn45RdrDetnCntr 0;
BA_ "GenSigFuncType" SG_ 319 FrntSideRdrRiDetn45RdrDetnCntr 16;
BA_ "GenSigSendType" SG_ 319 FrntSideRdrRiDetn45RdrDetnConf 0;
BA_ "GenSigStartValue" SG_ 319 FrntSideRdrRiDetn45RdrDetnElevn 15;
BA_ "GenSigSendType" SG_ 319 FrntSideRdrRiDetn45RdrDetnElevn 0;
BA_ "GenSigSendType" SG_ 319 FrntSideRdrRiDetn45RdrDetnPwr 0;
BA_ "GenSigStartValue" SG_ 319 FrntSideRdrRiDetn45RdrDetnRng 10050;
BA_ "GenSigSendType" SG_ 319 FrntSideRdrRiDetn45RdrDetnRng 0;
BA_ "GenSigStartValue" SG_ 319 FrntSideRdrRiDetn45RdrDetnRngV 4000;
BA_ "GenSigSendType" SG_ 319 FrntSideRdrRiDetn45RdrDetnRngV 0;
BA_ "GenSigStartValue" SG_ 319 FrntSideRdrRiDetn45RdrDetnSts 3;
BA_ "GenSigSendType" SG_ 319 FrntSideRdrRiDetn45RdrDetnSts 0;
BA_ "GenSigStartValue" SG_ 319 FrntSideRdrRiDetn46RdrDetnAzi 900;
BA_ "GenSigSendType" SG_ 319 FrntSideRdrRiDetn46RdrDetnAzi 0;
BA_ "GenSigSendType" SG_ 319 FrntSideRdrRiDetn46RdrDetnChks 0;
BA_ "GenSigFuncType" SG_ 319 FrntSideRdrRiDetn46RdrDetnChks 15;
BA_ "GenSigDataID" SG_ 319 FrntSideRdrRiDetn46RdrDetnChks "0x910";
BA_ "GenSigSendType" SG_ 319 FrntSideRdrRiDetn46RdrDetnCntr 0;
BA_ "GenSigFuncType" SG_ 319 FrntSideRdrRiDetn46RdrDetnCntr 16;
BA_ "GenSigSendType" SG_ 319 FrntSideRdrRiDetn46RdrDetnConf 0;
BA_ "GenSigStartValue" SG_ 319 FrntSideRdrRiDetn46RdrDetnElevn 15;
BA_ "GenSigSendType" SG_ 319 FrntSideRdrRiDetn46RdrDetnElevn 0;
BA_ "GenSigSendType" SG_ 319 FrntSideRdrRiDetn46RdrDetnPwr 0;
BA_ "GenSigStartValue" SG_ 319 FrntSideRdrRiDetn46RdrDetnRng 10050;
BA_ "GenSigSendType" SG_ 319 FrntSideRdrRiDetn46RdrDetnRng 0;
BA_ "GenSigStartValue" SG_ 319 FrntSideRdrRiDetn46RdrDetnRngV 4000;
BA_ "GenSigSendType" SG_ 319 FrntSideRdrRiDetn46RdrDetnRngV 0;
BA_ "GenSigStartValue" SG_ 319 FrntSideRdrRiDetn46RdrDetnSts 3;
BA_ "GenSigSendType" SG_ 319 FrntSideRdrRiDetn46RdrDetnSts 0;
BA_ "GenSigStartValue" SG_ 319 FrntSideRdrRiDetn47RdrDetnAzi 900;
BA_ "GenSigSendType" SG_ 319 FrntSideRdrRiDetn47RdrDetnAzi 0;
BA_ "GenSigSendType" SG_ 319 FrntSideRdrRiDetn47RdrDetnChks 0;
BA_ "GenSigFuncType" SG_ 319 FrntSideRdrRiDetn47RdrDetnChks 15;
BA_ "GenSigDataID" SG_ 319 FrntSideRdrRiDetn47RdrDetnChks "0x911";
BA_ "GenSigSendType" SG_ 319 FrntSideRdrRiDetn47RdrDetnCntr 0;
BA_ "GenSigFuncType" SG_ 319 FrntSideRdrRiDetn47RdrDetnCntr 16;
BA_ "GenSigSendType" SG_ 319 FrntSideRdrRiDetn47RdrDetnConf 0;
BA_ "GenSigStartValue" SG_ 319 FrntSideRdrRiDetn47RdrDetnElevn 15;
BA_ "GenSigSendType" SG_ 319 FrntSideRdrRiDetn47RdrDetnElevn 0;
BA_ "GenSigSendType" SG_ 319 FrntSideRdrRiDetn47RdrDetnPwr 0;
BA_ "GenSigStartValue" SG_ 319 FrntSideRdrRiDetn47RdrDetnRng 10050;
BA_ "GenSigSendType" SG_ 319 FrntSideRdrRiDetn47RdrDetnRng 0;
BA_ "GenSigStartValue" SG_ 319 FrntSideRdrRiDetn47RdrDetnRngV 4000;
BA_ "GenSigSendType" SG_ 319 FrntSideRdrRiDetn47RdrDetnRngV 0;
BA_ "GenSigStartValue" SG_ 319 FrntSideRdrRiDetn47RdrDetnSts 3;
BA_ "GenSigSendType" SG_ 319 FrntSideRdrRiDetn47RdrDetnSts 0;
BA_ "GenSigStartValue" SG_ 319 FrntSideRdrRiDetn48RdrDetnAzi 900;
BA_ "GenSigSendType" SG_ 319 FrntSideRdrRiDetn48RdrDetnAzi 0;
BA_ "GenSigSendType" SG_ 319 FrntSideRdrRiDetn48RdrDetnChks 0;
BA_ "GenSigFuncType" SG_ 319 FrntSideRdrRiDetn48RdrDetnChks 15;
BA_ "GenSigDataID" SG_ 319 FrntSideRdrRiDetn48RdrDetnChks "0x912";
BA_ "GenSigSendType" SG_ 319 FrntSideRdrRiDetn48RdrDetnCntr 0;
BA_ "GenSigFuncType" SG_ 319 FrntSideRdrRiDetn48RdrDetnCntr 16;
BA_ "GenSigSendType" SG_ 319 FrntSideRdrRiDetn48RdrDetnConf 0;
BA_ "GenSigStartValue" SG_ 319 FrntSideRdrRiDetn48RdrDetnElevn 15;
BA_ "GenSigSendType" SG_ 319 FrntSideRdrRiDetn48RdrDetnElevn 0;
BA_ "GenSigSendType" SG_ 319 FrntSideRdrRiDetn48RdrDetnPwr 0;
BA_ "GenSigStartValue" SG_ 319 FrntSideRdrRiDetn48RdrDetnRng 10050;
BA_ "GenSigSendType" SG_ 319 FrntSideRdrRiDetn48RdrDetnRng 0;
BA_ "GenSigStartValue" SG_ 319 FrntSideRdrRiDetn48RdrDetnRngV 4000;
BA_ "GenSigSendType" SG_ 319 FrntSideRdrRiDetn48RdrDetnRngV 0;
BA_ "GenSigStartValue" SG_ 319 FrntSideRdrRiDetn48RdrDetnSts 3;
BA_ "GenSigSendType" SG_ 319 FrntSideRdrRiDetn48RdrDetnSts 0;
// Frame: FSRRSafetyCANFD1Frame09
BA_ "VFrameFormat" BO_ 321 14;
BA_ "GenMsgSendType" BO_ 321 0;
BA_ "GenMsgCycleTime" BO_ 321 50.000;
BA_ "GenSigStartValue" SG_ 321 FrntSideRdrRiDetn49RdrDetnAzi 900;
BA_ "GenSigSendType" SG_ 321 FrntSideRdrRiDetn49RdrDetnAzi 0;
BA_ "GenSigSendType" SG_ 321 FrntSideRdrRiDetn49RdrDetnChks 0;
BA_ "GenSigFuncType" SG_ 321 FrntSideRdrRiDetn49RdrDetnChks 15;
BA_ "GenSigDataID" SG_ 321 FrntSideRdrRiDetn49RdrDetnChks "0x913";
BA_ "GenSigSendType" SG_ 321 FrntSideRdrRiDetn49RdrDetnCntr 0;
BA_ "GenSigFuncType" SG_ 321 FrntSideRdrRiDetn49RdrDetnCntr 16;
BA_ "GenSigSendType" SG_ 321 FrntSideRdrRiDetn49RdrDetnConf 0;
BA_ "GenSigStartValue" SG_ 321 FrntSideRdrRiDetn49RdrDetnElevn 15;
BA_ "GenSigSendType" SG_ 321 FrntSideRdrRiDetn49RdrDetnElevn 0;
BA_ "GenSigSendType" SG_ 321 FrntSideRdrRiDetn49RdrDetnPwr 0;
BA_ "GenSigStartValue" SG_ 321 FrntSideRdrRiDetn49RdrDetnRng 10050;
BA_ "GenSigSendType" SG_ 321 FrntSideRdrRiDetn49RdrDetnRng 0;
BA_ "GenSigStartValue" SG_ 321 FrntSideRdrRiDetn49RdrDetnRngV 4000;
BA_ "GenSigSendType" SG_ 321 FrntSideRdrRiDetn49RdrDetnRngV 0;
BA_ "GenSigStartValue" SG_ 321 FrntSideRdrRiDetn49RdrDetnSts 3;
BA_ "GenSigSendType" SG_ 321 FrntSideRdrRiDetn49RdrDetnSts 0;
BA_ "GenSigStartValue" SG_ 321 FrntSideRdrRiDetn50RdrDetnAzi 900;
BA_ "GenSigSendType" SG_ 321 FrntSideRdrRiDetn50RdrDetnAzi 0;
BA_ "GenSigSendType" SG_ 321 FrntSideRdrRiDetn50RdrDetnChks 0;
BA_ "GenSigFuncType" SG_ 321 FrntSideRdrRiDetn50RdrDetnChks 15;
BA_ "GenSigDataID" SG_ 321 FrntSideRdrRiDetn50RdrDetnChks "0x914";
BA_ "GenSigSendType" SG_ 321 FrntSideRdrRiDetn50RdrDetnCntr 0;
BA_ "GenSigFuncType" SG_ 321 FrntSideRdrRiDetn50RdrDetnCntr 16;
BA_ "GenSigSendType" SG_ 321 FrntSideRdrRiDetn50RdrDetnConf 0;
BA_ "GenSigStartValue" SG_ 321 FrntSideRdrRiDetn50RdrDetnElevn 15;
BA_ "GenSigSendType" SG_ 321 FrntSideRdrRiDetn50RdrDetnElevn 0;
BA_ "GenSigSendType" SG_ 321 FrntSideRdrRiDetn50RdrDetnPwr 0;
BA_ "GenSigStartValue" SG_ 321 FrntSideRdrRiDetn50RdrDetnRng 10050;
BA_ "GenSigSendType" SG_ 321 FrntSideRdrRiDetn50RdrDetnRng 0;
BA_ "GenSigStartValue" SG_ 321 FrntSideRdrRiDetn50RdrDetnRngV 4000;
BA_ "GenSigSendType" SG_ 321 FrntSideRdrRiDetn50RdrDetnRngV 0;
BA_ "GenSigStartValue" SG_ 321 FrntSideRdrRiDetn50RdrDetnSts 3;
BA_ "GenSigSendType" SG_ 321 FrntSideRdrRiDetn50RdrDetnSts 0;
BA_ "GenSigStartValue" SG_ 321 FrntSideRdrRiDetn51RdrDetnAzi 900;
BA_ "GenSigSendType" SG_ 321 FrntSideRdrRiDetn51RdrDetnAzi 0;
BA_ "GenSigSendType" SG_ 321 FrntSideRdrRiDetn51RdrDetnChks 0;
BA_ "GenSigFuncType" SG_ 321 FrntSideRdrRiDetn51RdrDetnChks 15;
BA_ "GenSigDataID" SG_ 321 FrntSideRdrRiDetn51RdrDetnChks "0x915";
BA_ "GenSigSendType" SG_ 321 FrntSideRdrRiDetn51RdrDetnCntr 0;
BA_ "GenSigFuncType" SG_ 321 FrntSideRdrRiDetn51RdrDetnCntr 16;
BA_ "GenSigSendType" SG_ 321 FrntSideRdrRiDetn51RdrDetnConf 0;
BA_ "GenSigStartValue" SG_ 321 FrntSideRdrRiDetn51RdrDetnElevn 15;
BA_ "GenSigSendType" SG_ 321 FrntSideRdrRiDetn51RdrDetnElevn 0;
BA_ "GenSigSendType" SG_ 321 FrntSideRdrRiDetn51RdrDetnPwr 0;
BA_ "GenSigStartValue" SG_ 321 FrntSideRdrRiDetn51RdrDetnRng 10050;
BA_ "GenSigSendType" SG_ 321 FrntSideRdrRiDetn51RdrDetnRng 0;
BA_ "GenSigStartValue" SG_ 321 FrntSideRdrRiDetn51RdrDetnRngV 4000;
BA_ "GenSigSendType" SG_ 321 FrntSideRdrRiDetn51RdrDetnRngV 0;
BA_ "GenSigStartValue" SG_ 321 FrntSideRdrRiDetn51RdrDetnSts 3;
BA_ "GenSigSendType" SG_ 321 FrntSideRdrRiDetn51RdrDetnSts 0;
BA_ "GenSigStartValue" SG_ 321 FrntSideRdrRiDetn52RdrDetnAzi 900;
BA_ "GenSigSendType" SG_ 321 FrntSideRdrRiDetn52RdrDetnAzi 0;
BA_ "GenSigSendType" SG_ 321 FrntSideRdrRiDetn52RdrDetnChks 0;
BA_ "GenSigFuncType" SG_ 321 FrntSideRdrRiDetn52RdrDetnChks 15;
BA_ "GenSigDataID" SG_ 321 FrntSideRdrRiDetn52RdrDetnChks "0x916";
BA_ "GenSigSendType" SG_ 321 FrntSideRdrRiDetn52RdrDetnCntr 0;
BA_ "GenSigFuncType" SG_ 321 FrntSideRdrRiDetn52RdrDetnCntr 16;
BA_ "GenSigSendType" SG_ 321 FrntSideRdrRiDetn52RdrDetnConf 0;
BA_ "GenSigStartValue" SG_ 321 FrntSideRdrRiDetn52RdrDetnElevn 15;
BA_ "GenSigSendType" SG_ 321 FrntSideRdrRiDetn52RdrDetnElevn 0;
BA_ "GenSigSendType" SG_ 321 FrntSideRdrRiDetn52RdrDetnPwr 0;
BA_ "GenSigStartValue" SG_ 321 FrntSideRdrRiDetn52RdrDetnRng 10050;
BA_ "GenSigSendType" SG_ 321 FrntSideRdrRiDetn52RdrDetnRng 0;
BA_ "GenSigStartValue" SG_ 321 FrntSideRdrRiDetn52RdrDetnRngV 4000;
BA_ "GenSigSendType" SG_ 321 FrntSideRdrRiDetn52RdrDetnRngV 0;
BA_ "GenSigStartValue" SG_ 321 FrntSideRdrRiDetn52RdrDetnSts 3;
BA_ "GenSigSendType" SG_ 321 FrntSideRdrRiDetn52RdrDetnSts 0;
BA_ "GenSigStartValue" SG_ 321 FrntSideRdrRiDetn53RdrDetnAzi 900;
BA_ "GenSigSendType" SG_ 321 FrntSideRdrRiDetn53RdrDetnAzi 0;
BA_ "GenSigSendType" SG_ 321 FrntSideRdrRiDetn53RdrDetnChks 0;
BA_ "GenSigFuncType" SG_ 321 FrntSideRdrRiDetn53RdrDetnChks 15;
BA_ "GenSigDataID" SG_ 321 FrntSideRdrRiDetn53RdrDetnChks "0x917";
BA_ "GenSigSendType" SG_ 321 FrntSideRdrRiDetn53RdrDetnCntr 0;
BA_ "GenSigFuncType" SG_ 321 FrntSideRdrRiDetn53RdrDetnCntr 16;
BA_ "GenSigSendType" SG_ 321 FrntSideRdrRiDetn53RdrDetnConf 0;
BA_ "GenSigStartValue" SG_ 321 FrntSideRdrRiDetn53RdrDetnElevn 15;
BA_ "GenSigSendType" SG_ 321 FrntSideRdrRiDetn53RdrDetnElevn 0;
BA_ "GenSigSendType" SG_ 321 FrntSideRdrRiDetn53RdrDetnPwr 0;
BA_ "GenSigStartValue" SG_ 321 FrntSideRdrRiDetn53RdrDetnRng 10050;
BA_ "GenSigSendType" SG_ 321 FrntSideRdrRiDetn53RdrDetnRng 0;
BA_ "GenSigStartValue" SG_ 321 FrntSideRdrRiDetn53RdrDetnRngV 4000;
BA_ "GenSigSendType" SG_ 321 FrntSideRdrRiDetn53RdrDetnRngV 0;
BA_ "GenSigStartValue" SG_ 321 FrntSideRdrRiDetn53RdrDetnSts 3;
BA_ "GenSigSendType" SG_ 321 FrntSideRdrRiDetn53RdrDetnSts 0;
BA_ "GenSigStartValue" SG_ 321 FrntSideRdrRiDetn54RdrDetnAzi 900;
BA_ "GenSigSendType" SG_ 321 FrntSideRdrRiDetn54RdrDetnAzi 0;
BA_ "GenSigSendType" SG_ 321 FrntSideRdrRiDetn54RdrDetnChks 0;
BA_ "GenSigFuncType" SG_ 321 FrntSideRdrRiDetn54RdrDetnChks 15;
BA_ "GenSigDataID" SG_ 321 FrntSideRdrRiDetn54RdrDetnChks "0x918";
BA_ "GenSigSendType" SG_ 321 FrntSideRdrRiDetn54RdrDetnCntr 0;
BA_ "GenSigFuncType" SG_ 321 FrntSideRdrRiDetn54RdrDetnCntr 16;
BA_ "GenSigSendType" SG_ 321 FrntSideRdrRiDetn54RdrDetnConf 0;
BA_ "GenSigStartValue" SG_ 321 FrntSideRdrRiDetn54RdrDetnElevn 15;
BA_ "GenSigSendType" SG_ 321 FrntSideRdrRiDetn54RdrDetnElevn 0;
BA_ "GenSigSendType" SG_ 321 FrntSideRdrRiDetn54RdrDetnPwr 0;
BA_ "GenSigStartValue" SG_ 321 FrntSideRdrRiDetn54RdrDetnRng 10050;
BA_ "GenSigSendType" SG_ 321 FrntSideRdrRiDetn54RdrDetnRng 0;
BA_ "GenSigStartValue" SG_ 321 FrntSideRdrRiDetn54RdrDetnRngV 4000;
BA_ "GenSigSendType" SG_ 321 FrntSideRdrRiDetn54RdrDetnRngV 0;
BA_ "GenSigStartValue" SG_ 321 FrntSideRdrRiDetn54RdrDetnSts 3;
BA_ "GenSigSendType" SG_ 321 FrntSideRdrRiDetn54RdrDetnSts 0;
// Frame: FSRRSafetyCANFD1Frame10
BA_ "VFrameFormat" BO_ 323 14;
BA_ "GenMsgSendType" BO_ 323 0;
BA_ "GenMsgCycleTime" BO_ 323 50.000;
BA_ "GenSigStartValue" SG_ 323 FrntSideRdrRiDetn55RdrDetnAzi 900;
BA_ "GenSigSendType" SG_ 323 FrntSideRdrRiDetn55RdrDetnAzi 0;
BA_ "GenSigSendType" SG_ 323 FrntSideRdrRiDetn55RdrDetnChks 0;
BA_ "GenSigFuncType" SG_ 323 FrntSideRdrRiDetn55RdrDetnChks 15;
BA_ "GenSigDataID" SG_ 323 FrntSideRdrRiDetn55RdrDetnChks "0x919";
BA_ "GenSigSendType" SG_ 323 FrntSideRdrRiDetn55RdrDetnCntr 0;
BA_ "GenSigFuncType" SG_ 323 FrntSideRdrRiDetn55RdrDetnCntr 16;
BA_ "GenSigSendType" SG_ 323 FrntSideRdrRiDetn55RdrDetnConf 0;
BA_ "GenSigStartValue" SG_ 323 FrntSideRdrRiDetn55RdrDetnElevn 15;
BA_ "GenSigSendType" SG_ 323 FrntSideRdrRiDetn55RdrDetnElevn 0;
BA_ "GenSigSendType" SG_ 323 FrntSideRdrRiDetn55RdrDetnPwr 0;
BA_ "GenSigStartValue" SG_ 323 FrntSideRdrRiDetn55RdrDetnRng 10050;
BA_ "GenSigSendType" SG_ 323 FrntSideRdrRiDetn55RdrDetnRng 0;
BA_ "GenSigStartValue" SG_ 323 FrntSideRdrRiDetn55RdrDetnRngV 4000;
BA_ "GenSigSendType" SG_ 323 FrntSideRdrRiDetn55RdrDetnRngV 0;
BA_ "GenSigStartValue" SG_ 323 FrntSideRdrRiDetn55RdrDetnSts 3;
BA_ "GenSigSendType" SG_ 323 FrntSideRdrRiDetn55RdrDetnSts 0;
BA_ "GenSigStartValue" SG_ 323 FrntSideRdrRiDetn56RdrDetnAzi 900;
BA_ "GenSigSendType" SG_ 323 FrntSideRdrRiDetn56RdrDetnAzi 0;
BA_ "GenSigSendType" SG_ 323 FrntSideRdrRiDetn56RdrDetnChks 0;
BA_ "GenSigFuncType" SG_ 323 FrntSideRdrRiDetn56RdrDetnChks 15;
BA_ "GenSigDataID" SG_ 323 FrntSideRdrRiDetn56RdrDetnChks "0x91A";
BA_ "GenSigSendType" SG_ 323 FrntSideRdrRiDetn56RdrDetnCntr 0;
BA_ "GenSigFuncType" SG_ 323 FrntSideRdrRiDetn56RdrDetnCntr 16;
BA_ "GenSigSendType" SG_ 323 FrntSideRdrRiDetn56RdrDetnConf 0;
BA_ "GenSigStartValue" SG_ 323 FrntSideRdrRiDetn56RdrDetnElevn 15;
BA_ "GenSigSendType" SG_ 323 FrntSideRdrRiDetn56RdrDetnElevn 0;
BA_ "GenSigSendType" SG_ 323 FrntSideRdrRiDetn56RdrDetnPwr 0;
BA_ "GenSigStartValue" SG_ 323 FrntSideRdrRiDetn56RdrDetnRng 10050;
BA_ "GenSigSendType" SG_ 323 FrntSideRdrRiDetn56RdrDetnRng 0;
BA_ "GenSigStartValue" SG_ 323 FrntSideRdrRiDetn56RdrDetnRngV 4000;
BA_ "GenSigSendType" SG_ 323 FrntSideRdrRiDetn56RdrDetnRngV 0;
BA_ "GenSigStartValue" SG_ 323 FrntSideRdrRiDetn56RdrDetnSts 3;
BA_ "GenSigSendType" SG_ 323 FrntSideRdrRiDetn56RdrDetnSts 0;
BA_ "GenSigStartValue" SG_ 323 FrntSideRdrRiDetn57RdrDetnAzi 900;
BA_ "GenSigSendType" SG_ 323 FrntSideRdrRiDetn57RdrDetnAzi 0;
BA_ "GenSigSendType" SG_ 323 FrntSideRdrRiDetn57RdrDetnChks 0;
BA_ "GenSigFuncType" SG_ 323 FrntSideRdrRiDetn57RdrDetnChks 15;
BA_ "GenSigDataID" SG_ 323 FrntSideRdrRiDetn57RdrDetnChks "0x91B";
BA_ "GenSigSendType" SG_ 323 FrntSideRdrRiDetn57RdrDetnCntr 0;
BA_ "GenSigFuncType" SG_ 323 FrntSideRdrRiDetn57RdrDetnCntr 16;
BA_ "GenSigSendType" SG_ 323 FrntSideRdrRiDetn57RdrDetnConf 0;
BA_ "GenSigStartValue" SG_ 323 FrntSideRdrRiDetn57RdrDetnElevn 15;
BA_ "GenSigSendType" SG_ 323 FrntSideRdrRiDetn57RdrDetnElevn 0;
BA_ "GenSigSendType" SG_ 323 FrntSideRdrRiDetn57RdrDetnPwr 0;
BA_ "GenSigStartValue" SG_ 323 FrntSideRdrRiDetn57RdrDetnRng 10050;
BA_ "GenSigSendType" SG_ 323 FrntSideRdrRiDetn57RdrDetnRng 0;
BA_ "GenSigStartValue" SG_ 323 FrntSideRdrRiDetn57RdrDetnRngV 4000;
BA_ "GenSigSendType" SG_ 323 FrntSideRdrRiDetn57RdrDetnRngV 0;
BA_ "GenSigStartValue" SG_ 323 FrntSideRdrRiDetn57RdrDetnSts 3;
BA_ "GenSigSendType" SG_ 323 FrntSideRdrRiDetn57RdrDetnSts 0;
BA_ "GenSigStartValue" SG_ 323 FrntSideRdrRiDetn58RdrDetnAzi 900;
BA_ "GenSigSendType" SG_ 323 FrntSideRdrRiDetn58RdrDetnAzi 0;
BA_ "GenSigSendType" SG_ 323 FrntSideRdrRiDetn58RdrDetnChks 0;
BA_ "GenSigFuncType" SG_ 323 FrntSideRdrRiDetn58RdrDetnChks 15;
BA_ "GenSigDataID" SG_ 323 FrntSideRdrRiDetn58RdrDetnChks "0x91C";
BA_ "GenSigSendType" SG_ 323 FrntSideRdrRiDetn58RdrDetnCntr 0;
BA_ "GenSigFuncType" SG_ 323 FrntSideRdrRiDetn58RdrDetnCntr 16;
BA_ "GenSigSendType" SG_ 323 FrntSideRdrRiDetn58RdrDetnConf 0;
BA_ "GenSigStartValue" SG_ 323 FrntSideRdrRiDetn58RdrDetnElevn 15;
BA_ "GenSigSendType" SG_ 323 FrntSideRdrRiDetn58RdrDetnElevn 0;
BA_ "GenSigSendType" SG_ 323 FrntSideRdrRiDetn58RdrDetnPwr 0;
BA_ "GenSigStartValue" SG_ 323 FrntSideRdrRiDetn58RdrDetnRng 10050;
BA_ "GenSigSendType" SG_ 323 FrntSideRdrRiDetn58RdrDetnRng 0;
BA_ "GenSigStartValue" SG_ 323 FrntSideRdrRiDetn58RdrDetnRngV 4000;
BA_ "GenSigSendType" SG_ 323 FrntSideRdrRiDetn58RdrDetnRngV 0;
BA_ "GenSigStartValue" SG_ 323 FrntSideRdrRiDetn58RdrDetnSts 3;
BA_ "GenSigSendType" SG_ 323 FrntSideRdrRiDetn58RdrDetnSts 0;
BA_ "GenSigStartValue" SG_ 323 FrntSideRdrRiDetn59RdrDetnAzi 900;
BA_ "GenSigSendType" SG_ 323 FrntSideRdrRiDetn59RdrDetnAzi 0;
BA_ "GenSigSendType" SG_ 323 FrntSideRdrRiDetn59RdrDetnChks 0;
BA_ "GenSigFuncType" SG_ 323 FrntSideRdrRiDetn59RdrDetnChks 15;
BA_ "GenSigDataID" SG_ 323 FrntSideRdrRiDetn59RdrDetnChks "0x91D";
BA_ "GenSigSendType" SG_ 323 FrntSideRdrRiDetn59RdrDetnCntr 0;
BA_ "GenSigFuncType" SG_ 323 FrntSideRdrRiDetn59RdrDetnCntr 16;
BA_ "GenSigSendType" SG_ 323 FrntSideRdrRiDetn59RdrDetnConf 0;
BA_ "GenSigStartValue" SG_ 323 FrntSideRdrRiDetn59RdrDetnElevn 15;
BA_ "GenSigSendType" SG_ 323 FrntSideRdrRiDetn59RdrDetnElevn 0;
BA_ "GenSigSendType" SG_ 323 FrntSideRdrRiDetn59RdrDetnPwr 0;
BA_ "GenSigStartValue" SG_ 323 FrntSideRdrRiDetn59RdrDetnRng 10050;
BA_ "GenSigSendType" SG_ 323 FrntSideRdrRiDetn59RdrDetnRng 0;
BA_ "GenSigStartValue" SG_ 323 FrntSideRdrRiDetn59RdrDetnRngV 4000;
BA_ "GenSigSendType" SG_ 323 FrntSideRdrRiDetn59RdrDetnRngV 0;
BA_ "GenSigStartValue" SG_ 323 FrntSideRdrRiDetn59RdrDetnSts 3;
BA_ "GenSigSendType" SG_ 323 FrntSideRdrRiDetn59RdrDetnSts 0;
BA_ "GenSigStartValue" SG_ 323 FrntSideRdrRiDetn60RdrDetnAzi 900;
BA_ "GenSigSendType" SG_ 323 FrntSideRdrRiDetn60RdrDetnAzi 0;
BA_ "GenSigSendType" SG_ 323 FrntSideRdrRiDetn60RdrDetnChks 0;
BA_ "GenSigFuncType" SG_ 323 FrntSideRdrRiDetn60RdrDetnChks 15;
BA_ "GenSigDataID" SG_ 323 FrntSideRdrRiDetn60RdrDetnChks "0x91E";
BA_ "GenSigSendType" SG_ 323 FrntSideRdrRiDetn60RdrDetnCntr 0;
BA_ "GenSigFuncType" SG_ 323 FrntSideRdrRiDetn60RdrDetnCntr 16;
BA_ "GenSigSendType" SG_ 323 FrntSideRdrRiDetn60RdrDetnConf 0;
BA_ "GenSigStartValue" SG_ 323 FrntSideRdrRiDetn60RdrDetnElevn 15;
BA_ "GenSigSendType" SG_ 323 FrntSideRdrRiDetn60RdrDetnElevn 0;
BA_ "GenSigSendType" SG_ 323 FrntSideRdrRiDetn60RdrDetnPwr 0;
BA_ "GenSigStartValue" SG_ 323 FrntSideRdrRiDetn60RdrDetnRng 10050;
BA_ "GenSigSendType" SG_ 323 FrntSideRdrRiDetn60RdrDetnRng 0;
BA_ "GenSigStartValue" SG_ 323 FrntSideRdrRiDetn60RdrDetnRngV 4000;
BA_ "GenSigSendType" SG_ 323 FrntSideRdrRiDetn60RdrDetnRngV 0;
BA_ "GenSigStartValue" SG_ 323 FrntSideRdrRiDetn60RdrDetnSts 3;
BA_ "GenSigSendType" SG_ 323 FrntSideRdrRiDetn60RdrDetnSts 0;
// Frame: FSRRSafetyCANFD1Frame11
BA_ "VFrameFormat" BO_ 325 14;
BA_ "GenMsgSendType" BO_ 325 0;
BA_ "GenMsgCycleTime" BO_ 325 50.000;
BA_ "GenSigStartValue" SG_ 325 FrntSideRdrRiDetn61RdrDetnAzi 900;
BA_ "GenSigSendType" SG_ 325 FrntSideRdrRiDetn61RdrDetnAzi 0;
BA_ "GenSigSendType" SG_ 325 FrntSideRdrRiDetn61RdrDetnChks 0;
BA_ "GenSigFuncType" SG_ 325 FrntSideRdrRiDetn61RdrDetnChks 15;
BA_ "GenSigDataID" SG_ 325 FrntSideRdrRiDetn61RdrDetnChks "0x91F";
BA_ "GenSigSendType" SG_ 325 FrntSideRdrRiDetn61RdrDetnCntr 0;
BA_ "GenSigFuncType" SG_ 325 FrntSideRdrRiDetn61RdrDetnCntr 16;
BA_ "GenSigSendType" SG_ 325 FrntSideRdrRiDetn61RdrDetnConf 0;
BA_ "GenSigStartValue" SG_ 325 FrntSideRdrRiDetn61RdrDetnElevn 15;
BA_ "GenSigSendType" SG_ 325 FrntSideRdrRiDetn61RdrDetnElevn 0;
BA_ "GenSigSendType" SG_ 325 FrntSideRdrRiDetn61RdrDetnPwr 0;
BA_ "GenSigStartValue" SG_ 325 FrntSideRdrRiDetn61RdrDetnRng 10050;
BA_ "GenSigSendType" SG_ 325 FrntSideRdrRiDetn61RdrDetnRng 0;
BA_ "GenSigStartValue" SG_ 325 FrntSideRdrRiDetn61RdrDetnRngV 4000;
BA_ "GenSigSendType" SG_ 325 FrntSideRdrRiDetn61RdrDetnRngV 0;
BA_ "GenSigStartValue" SG_ 325 FrntSideRdrRiDetn61RdrDetnSts 3;
BA_ "GenSigSendType" SG_ 325 FrntSideRdrRiDetn61RdrDetnSts 0;
BA_ "GenSigStartValue" SG_ 325 FrntSideRdrRiDetn62RdrDetnAzi 900;
BA_ "GenSigSendType" SG_ 325 FrntSideRdrRiDetn62RdrDetnAzi 0;
BA_ "GenSigSendType" SG_ 325 FrntSideRdrRiDetn62RdrDetnChks 0;
BA_ "GenSigFuncType" SG_ 325 FrntSideRdrRiDetn62RdrDetnChks 15;
BA_ "GenSigDataID" SG_ 325 FrntSideRdrRiDetn62RdrDetnChks "0x920";
BA_ "GenSigSendType" SG_ 325 FrntSideRdrRiDetn62RdrDetnCntr 0;
BA_ "GenSigFuncType" SG_ 325 FrntSideRdrRiDetn62RdrDetnCntr 16;
BA_ "GenSigSendType" SG_ 325 FrntSideRdrRiDetn62RdrDetnConf 0;
BA_ "GenSigStartValue" SG_ 325 FrntSideRdrRiDetn62RdrDetnElevn 15;
BA_ "GenSigSendType" SG_ 325 FrntSideRdrRiDetn62RdrDetnElevn 0;
BA_ "GenSigSendType" SG_ 325 FrntSideRdrRiDetn62RdrDetnPwr 0;
BA_ "GenSigStartValue" SG_ 325 FrntSideRdrRiDetn62RdrDetnRng 10050;
BA_ "GenSigSendType" SG_ 325 FrntSideRdrRiDetn62RdrDetnRng 0;
BA_ "GenSigStartValue" SG_ 325 FrntSideRdrRiDetn62RdrDetnRngV 4000;
BA_ "GenSigSendType" SG_ 325 FrntSideRdrRiDetn62RdrDetnRngV 0;
BA_ "GenSigStartValue" SG_ 325 FrntSideRdrRiDetn62RdrDetnSts 3;
BA_ "GenSigSendType" SG_ 325 FrntSideRdrRiDetn62RdrDetnSts 0;
BA_ "GenSigStartValue" SG_ 325 FrntSideRdrRiDetn63RdrDetnAzi 900;
BA_ "GenSigSendType" SG_ 325 FrntSideRdrRiDetn63RdrDetnAzi 0;
BA_ "GenSigSendType" SG_ 325 FrntSideRdrRiDetn63RdrDetnChks 0;
BA_ "GenSigFuncType" SG_ 325 FrntSideRdrRiDetn63RdrDetnChks 15;
BA_ "GenSigDataID" SG_ 325 FrntSideRdrRiDetn63RdrDetnChks "0x921";
BA_ "GenSigSendType" SG_ 325 FrntSideRdrRiDetn63RdrDetnCntr 0;
BA_ "GenSigFuncType" SG_ 325 FrntSideRdrRiDetn63RdrDetnCntr 16;
BA_ "GenSigSendType" SG_ 325 FrntSideRdrRiDetn63RdrDetnConf 0;
BA_ "GenSigStartValue" SG_ 325 FrntSideRdrRiDetn63RdrDetnElevn 15;
BA_ "GenSigSendType" SG_ 325 FrntSideRdrRiDetn63RdrDetnElevn 0;
BA_ "GenSigSendType" SG_ 325 FrntSideRdrRiDetn63RdrDetnPwr 0;
BA_ "GenSigStartValue" SG_ 325 FrntSideRdrRiDetn63RdrDetnRng 10050;
BA_ "GenSigSendType" SG_ 325 FrntSideRdrRiDetn63RdrDetnRng 0;
BA_ "GenSigStartValue" SG_ 325 FrntSideRdrRiDetn63RdrDetnRngV 4000;
BA_ "GenSigSendType" SG_ 325 FrntSideRdrRiDetn63RdrDetnRngV 0;
BA_ "GenSigStartValue" SG_ 325 FrntSideRdrRiDetn63RdrDetnSts 3;
BA_ "GenSigSendType" SG_ 325 FrntSideRdrRiDetn63RdrDetnSts 0;
BA_ "GenSigStartValue" SG_ 325 FrntSideRdrRiDetn64RdrDetnAzi 900;
BA_ "GenSigSendType" SG_ 325 FrntSideRdrRiDetn64RdrDetnAzi 0;
BA_ "GenSigSendType" SG_ 325 FrntSideRdrRiDetn64RdrDetnChks 0;
BA_ "GenSigFuncType" SG_ 325 FrntSideRdrRiDetn64RdrDetnChks 15;
BA_ "GenSigDataID" SG_ 325 FrntSideRdrRiDetn64RdrDetnChks "0x922";
BA_ "GenSigSendType" SG_ 325 FrntSideRdrRiDetn64RdrDetnCntr 0;
BA_ "GenSigFuncType" SG_ 325 FrntSideRdrRiDetn64RdrDetnCntr 16;
BA_ "GenSigSendType" SG_ 325 FrntSideRdrRiDetn64RdrDetnConf 0;
BA_ "GenSigStartValue" SG_ 325 FrntSideRdrRiDetn64RdrDetnElevn 15;
BA_ "GenSigSendType" SG_ 325 FrntSideRdrRiDetn64RdrDetnElevn 0;
BA_ "GenSigSendType" SG_ 325 FrntSideRdrRiDetn64RdrDetnPwr 0;
BA_ "GenSigStartValue" SG_ 325 FrntSideRdrRiDetn64RdrDetnRng 10050;
BA_ "GenSigSendType" SG_ 325 FrntSideRdrRiDetn64RdrDetnRng 0;
BA_ "GenSigStartValue" SG_ 325 FrntSideRdrRiDetn64RdrDetnRngV 4000;
BA_ "GenSigSendType" SG_ 325 FrntSideRdrRiDetn64RdrDetnRngV 0;
BA_ "GenSigStartValue" SG_ 325 FrntSideRdrRiDetn64RdrDetnSts 3;
BA_ "GenSigSendType" SG_ 325 FrntSideRdrRiDetn64RdrDetnSts 0;
BA_ "GenSigStartValue" SG_ 325 FrntSideRdrRiDetn65RdrDetnAzi 900;
BA_ "GenSigSendType" SG_ 325 FrntSideRdrRiDetn65RdrDetnAzi 0;
BA_ "GenSigSendType" SG_ 325 FrntSideRdrRiDetn65RdrDetnChks 0;
BA_ "GenSigFuncType" SG_ 325 FrntSideRdrRiDetn65RdrDetnChks 15;
BA_ "GenSigDataID" SG_ 325 FrntSideRdrRiDetn65RdrDetnChks "0x923";
BA_ "GenSigSendType" SG_ 325 FrntSideRdrRiDetn65RdrDetnCntr 0;
BA_ "GenSigFuncType" SG_ 325 FrntSideRdrRiDetn65RdrDetnCntr 16;
BA_ "GenSigSendType" SG_ 325 FrntSideRdrRiDetn65RdrDetnConf 0;
BA_ "GenSigStartValue" SG_ 325 FrntSideRdrRiDetn65RdrDetnElevn 15;
BA_ "GenSigSendType" SG_ 325 FrntSideRdrRiDetn65RdrDetnElevn 0;
BA_ "GenSigSendType" SG_ 325 FrntSideRdrRiDetn65RdrDetnPwr 0;
BA_ "GenSigStartValue" SG_ 325 FrntSideRdrRiDetn65RdrDetnRng 10050;
BA_ "GenSigSendType" SG_ 325 FrntSideRdrRiDetn65RdrDetnRng 0;
BA_ "GenSigStartValue" SG_ 325 FrntSideRdrRiDetn65RdrDetnRngV 4000;
BA_ "GenSigSendType" SG_ 325 FrntSideRdrRiDetn65RdrDetnRngV 0;
BA_ "GenSigStartValue" SG_ 325 FrntSideRdrRiDetn65RdrDetnSts 3;
BA_ "GenSigSendType" SG_ 325 FrntSideRdrRiDetn65RdrDetnSts 0;
BA_ "GenSigStartValue" SG_ 325 FrntSideRdrRiDetn66RdrDetnAzi 900;
BA_ "GenSigSendType" SG_ 325 FrntSideRdrRiDetn66RdrDetnAzi 0;
BA_ "GenSigSendType" SG_ 325 FrntSideRdrRiDetn66RdrDetnChks 0;
BA_ "GenSigFuncType" SG_ 325 FrntSideRdrRiDetn66RdrDetnChks 15;
BA_ "GenSigDataID" SG_ 325 FrntSideRdrRiDetn66RdrDetnChks "0x924";
BA_ "GenSigSendType" SG_ 325 FrntSideRdrRiDetn66RdrDetnCntr 0;
BA_ "GenSigFuncType" SG_ 325 FrntSideRdrRiDetn66RdrDetnCntr 16;
BA_ "GenSigSendType" SG_ 325 FrntSideRdrRiDetn66RdrDetnConf 0;
BA_ "GenSigStartValue" SG_ 325 FrntSideRdrRiDetn66RdrDetnElevn 15;
BA_ "GenSigSendType" SG_ 325 FrntSideRdrRiDetn66RdrDetnElevn 0;
BA_ "GenSigSendType" SG_ 325 FrntSideRdrRiDetn66RdrDetnPwr 0;
BA_ "GenSigStartValue" SG_ 325 FrntSideRdrRiDetn66RdrDetnRng 10050;
BA_ "GenSigSendType" SG_ 325 FrntSideRdrRiDetn66RdrDetnRng 0;
BA_ "GenSigStartValue" SG_ 325 FrntSideRdrRiDetn66RdrDetnRngV 4000;
BA_ "GenSigSendType" SG_ 325 FrntSideRdrRiDetn66RdrDetnRngV 0;
BA_ "GenSigStartValue" SG_ 325 FrntSideRdrRiDetn66RdrDetnSts 3;
BA_ "GenSigSendType" SG_ 325 FrntSideRdrRiDetn66RdrDetnSts 0;
// Frame: FSRRSafetyCANFD1Frame12
BA_ "VFrameFormat" BO_ 327 14;
BA_ "GenMsgSendType" BO_ 327 0;
BA_ "GenMsgCycleTime" BO_ 327 50.000;
BA_ "GenSigStartValue" SG_ 327 FrntSideRdrRiDetn67RdrDetnAzi 900;
BA_ "GenSigSendType" SG_ 327 FrntSideRdrRiDetn67RdrDetnAzi 0;
BA_ "GenSigSendType" SG_ 327 FrntSideRdrRiDetn67RdrDetnChks 0;
BA_ "GenSigFuncType" SG_ 327 FrntSideRdrRiDetn67RdrDetnChks 15;
BA_ "GenSigDataID" SG_ 327 FrntSideRdrRiDetn67RdrDetnChks "0x925";
BA_ "GenSigSendType" SG_ 327 FrntSideRdrRiDetn67RdrDetnCntr 0;
BA_ "GenSigFuncType" SG_ 327 FrntSideRdrRiDetn67RdrDetnCntr 16;
BA_ "GenSigSendType" SG_ 327 FrntSideRdrRiDetn67RdrDetnConf 0;
BA_ "GenSigStartValue" SG_ 327 FrntSideRdrRiDetn67RdrDetnElevn 15;
BA_ "GenSigSendType" SG_ 327 FrntSideRdrRiDetn67RdrDetnElevn 0;
BA_ "GenSigSendType" SG_ 327 FrntSideRdrRiDetn67RdrDetnPwr 0;
BA_ "GenSigStartValue" SG_ 327 FrntSideRdrRiDetn67RdrDetnRng 10050;
BA_ "GenSigSendType" SG_ 327 FrntSideRdrRiDetn67RdrDetnRng 0;
BA_ "GenSigStartValue" SG_ 327 FrntSideRdrRiDetn67RdrDetnRngV 4000;
BA_ "GenSigSendType" SG_ 327 FrntSideRdrRiDetn67RdrDetnRngV 0;
BA_ "GenSigStartValue" SG_ 327 FrntSideRdrRiDetn67RdrDetnSts 3;
BA_ "GenSigSendType" SG_ 327 FrntSideRdrRiDetn67RdrDetnSts 0;
BA_ "GenSigStartValue" SG_ 327 FrntSideRdrRiDetn68RdrDetnAzi 900;
BA_ "GenSigSendType" SG_ 327 FrntSideRdrRiDetn68RdrDetnAzi 0;
BA_ "GenSigSendType" SG_ 327 FrntSideRdrRiDetn68RdrDetnChks 0;
BA_ "GenSigFuncType" SG_ 327 FrntSideRdrRiDetn68RdrDetnChks 15;
BA_ "GenSigDataID" SG_ 327 FrntSideRdrRiDetn68RdrDetnChks "0x926";
BA_ "GenSigSendType" SG_ 327 FrntSideRdrRiDetn68RdrDetnCntr 0;
BA_ "GenSigFuncType" SG_ 327 FrntSideRdrRiDetn68RdrDetnCntr 16;
BA_ "GenSigSendType" SG_ 327 FrntSideRdrRiDetn68RdrDetnConf 0;
BA_ "GenSigStartValue" SG_ 327 FrntSideRdrRiDetn68RdrDetnElevn 15;
BA_ "GenSigSendType" SG_ 327 FrntSideRdrRiDetn68RdrDetnElevn 0;
BA_ "GenSigSendType" SG_ 327 FrntSideRdrRiDetn68RdrDetnPwr 0;
BA_ "GenSigStartValue" SG_ 327 FrntSideRdrRiDetn68RdrDetnRng 10050;
BA_ "GenSigSendType" SG_ 327 FrntSideRdrRiDetn68RdrDetnRng 0;
BA_ "GenSigStartValue" SG_ 327 FrntSideRdrRiDetn68RdrDetnRngV 4000;
BA_ "GenSigSendType" SG_ 327 FrntSideRdrRiDetn68RdrDetnRngV 0;
BA_ "GenSigStartValue" SG_ 327 FrntSideRdrRiDetn68RdrDetnSts 3;
BA_ "GenSigSendType" SG_ 327 FrntSideRdrRiDetn68RdrDetnSts 0;
BA_ "GenSigStartValue" SG_ 327 FrntSideRdrRiDetn69RdrDetnAzi 900;
BA_ "GenSigSendType" SG_ 327 FrntSideRdrRiDetn69RdrDetnAzi 0;
BA_ "GenSigSendType" SG_ 327 FrntSideRdrRiDetn69RdrDetnChks 0;
BA_ "GenSigFuncType" SG_ 327 FrntSideRdrRiDetn69RdrDetnChks 15;
BA_ "GenSigDataID" SG_ 327 FrntSideRdrRiDetn69RdrDetnChks "0x927";
BA_ "GenSigSendType" SG_ 327 FrntSideRdrRiDetn69RdrDetnCntr 0;
BA_ "GenSigFuncType" SG_ 327 FrntSideRdrRiDetn69RdrDetnCntr 16;
BA_ "GenSigSendType" SG_ 327 FrntSideRdrRiDetn69RdrDetnConf 0;
BA_ "GenSigStartValue" SG_ 327 FrntSideRdrRiDetn69RdrDetnElevn 15;
BA_ "GenSigSendType" SG_ 327 FrntSideRdrRiDetn69RdrDetnElevn 0;
BA_ "GenSigSendType" SG_ 327 FrntSideRdrRiDetn69RdrDetnPwr 0;
BA_ "GenSigStartValue" SG_ 327 FrntSideRdrRiDetn69RdrDetnRng 10050;
BA_ "GenSigSendType" SG_ 327 FrntSideRdrRiDetn69RdrDetnRng 0;
BA_ "GenSigStartValue" SG_ 327 FrntSideRdrRiDetn69RdrDetnRngV 4000;
BA_ "GenSigSendType" SG_ 327 FrntSideRdrRiDetn69RdrDetnRngV 0;
BA_ "GenSigStartValue" SG_ 327 FrntSideRdrRiDetn69RdrDetnSts 3;
BA_ "GenSigSendType" SG_ 327 FrntSideRdrRiDetn69RdrDetnSts 0;
BA_ "GenSigStartValue" SG_ 327 FrntSideRdrRiDetn70RdrDetnAzi 900;
BA_ "GenSigSendType" SG_ 327 FrntSideRdrRiDetn70RdrDetnAzi 0;
BA_ "GenSigSendType" SG_ 327 FrntSideRdrRiDetn70RdrDetnChks 0;
BA_ "GenSigFuncType" SG_ 327 FrntSideRdrRiDetn70RdrDetnChks 15;
BA_ "GenSigDataID" SG_ 327 FrntSideRdrRiDetn70RdrDetnChks "0x928";
BA_ "GenSigSendType" SG_ 327 FrntSideRdrRiDetn70RdrDetnCntr 0;
BA_ "GenSigFuncType" SG_ 327 FrntSideRdrRiDetn70RdrDetnCntr 16;
BA_ "GenSigSendType" SG_ 327 FrntSideRdrRiDetn70RdrDetnConf 0;
BA_ "GenSigStartValue" SG_ 327 FrntSideRdrRiDetn70RdrDetnElevn 15;
BA_ "GenSigSendType" SG_ 327 FrntSideRdrRiDetn70RdrDetnElevn 0;
BA_ "GenSigSendType" SG_ 327 FrntSideRdrRiDetn70RdrDetnPwr 0;
BA_ "GenSigStartValue" SG_ 327 FrntSideRdrRiDetn70RdrDetnRng 10050;
BA_ "GenSigSendType" SG_ 327 FrntSideRdrRiDetn70RdrDetnRng 0;
BA_ "GenSigStartValue" SG_ 327 FrntSideRdrRiDetn70RdrDetnRngV 4000;
BA_ "GenSigSendType" SG_ 327 FrntSideRdrRiDetn70RdrDetnRngV 0;
BA_ "GenSigStartValue" SG_ 327 FrntSideRdrRiDetn70RdrDetnSts 3;
BA_ "GenSigSendType" SG_ 327 FrntSideRdrRiDetn70RdrDetnSts 0;
BA_ "GenSigStartValue" SG_ 327 FrntSideRdrRiDetn71RdrDetnAzi 900;
BA_ "GenSigSendType" SG_ 327 FrntSideRdrRiDetn71RdrDetnAzi 0;
BA_ "GenSigSendType" SG_ 327 FrntSideRdrRiDetn71RdrDetnChks 0;
BA_ "GenSigFuncType" SG_ 327 FrntSideRdrRiDetn71RdrDetnChks 15;
BA_ "GenSigDataID" SG_ 327 FrntSideRdrRiDetn71RdrDetnChks "0x929";
BA_ "GenSigSendType" SG_ 327 FrntSideRdrRiDetn71RdrDetnCntr 0;
BA_ "GenSigFuncType" SG_ 327 FrntSideRdrRiDetn71RdrDetnCntr 16;
BA_ "GenSigSendType" SG_ 327 FrntSideRdrRiDetn71RdrDetnConf 0;
BA_ "GenSigStartValue" SG_ 327 FrntSideRdrRiDetn71RdrDetnElevn 15;
BA_ "GenSigSendType" SG_ 327 FrntSideRdrRiDetn71RdrDetnElevn 0;
BA_ "GenSigSendType" SG_ 327 FrntSideRdrRiDetn71RdrDetnPwr 0;
BA_ "GenSigStartValue" SG_ 327 FrntSideRdrRiDetn71RdrDetnRng 10050;
BA_ "GenSigSendType" SG_ 327 FrntSideRdrRiDetn71RdrDetnRng 0;
BA_ "GenSigStartValue" SG_ 327 FrntSideRdrRiDetn71RdrDetnRngV 4000;
BA_ "GenSigSendType" SG_ 327 FrntSideRdrRiDetn71RdrDetnRngV 0;
BA_ "GenSigStartValue" SG_ 327 FrntSideRdrRiDetn71RdrDetnSts 3;
BA_ "GenSigSendType" SG_ 327 FrntSideRdrRiDetn71RdrDetnSts 0;
BA_ "GenSigStartValue" SG_ 327 FrntSideRdrRiDetn72RdrDetnAzi 900;
BA_ "GenSigSendType" SG_ 327 FrntSideRdrRiDetn72RdrDetnAzi 0;
BA_ "GenSigSendType" SG_ 327 FrntSideRdrRiDetn72RdrDetnChks 0;
BA_ "GenSigFuncType" SG_ 327 FrntSideRdrRiDetn72RdrDetnChks 15;
BA_ "GenSigDataID" SG_ 327 FrntSideRdrRiDetn72RdrDetnChks "0x92A";
BA_ "GenSigSendType" SG_ 327 FrntSideRdrRiDetn72RdrDetnCntr 0;
BA_ "GenSigFuncType" SG_ 327 FrntSideRdrRiDetn72RdrDetnCntr 16;
BA_ "GenSigSendType" SG_ 327 FrntSideRdrRiDetn72RdrDetnConf 0;
BA_ "GenSigStartValue" SG_ 327 FrntSideRdrRiDetn72RdrDetnElevn 15;
BA_ "GenSigSendType" SG_ 327 FrntSideRdrRiDetn72RdrDetnElevn 0;
BA_ "GenSigSendType" SG_ 327 FrntSideRdrRiDetn72RdrDetnPwr 0;
BA_ "GenSigStartValue" SG_ 327 FrntSideRdrRiDetn72RdrDetnRng 10050;
BA_ "GenSigSendType" SG_ 327 FrntSideRdrRiDetn72RdrDetnRng 0;
BA_ "GenSigStartValue" SG_ 327 FrntSideRdrRiDetn72RdrDetnRngV 4000;
BA_ "GenSigSendType" SG_ 327 FrntSideRdrRiDetn72RdrDetnRngV 0;
BA_ "GenSigStartValue" SG_ 327 FrntSideRdrRiDetn72RdrDetnSts 3;
BA_ "GenSigSendType" SG_ 327 FrntSideRdrRiDetn72RdrDetnSts 0;
// Frame: FSRRSafetyCANFD1Frame13
BA_ "VFrameFormat" BO_ 329 14;
BA_ "GenMsgSendType" BO_ 329 0;
BA_ "GenMsgCycleTime" BO_ 329 50.000;
BA_ "GenSigStartValue" SG_ 329 FrntSideRdrRiDetn73RdrDetnAzi 900;
BA_ "GenSigSendType" SG_ 329 FrntSideRdrRiDetn73RdrDetnAzi 0;
BA_ "GenSigSendType" SG_ 329 FrntSideRdrRiDetn73RdrDetnChks 0;
BA_ "GenSigFuncType" SG_ 329 FrntSideRdrRiDetn73RdrDetnChks 15;
BA_ "GenSigDataID" SG_ 329 FrntSideRdrRiDetn73RdrDetnChks "0x92B";
BA_ "GenSigSendType" SG_ 329 FrntSideRdrRiDetn73RdrDetnCntr 0;
BA_ "GenSigFuncType" SG_ 329 FrntSideRdrRiDetn73RdrDetnCntr 16;
BA_ "GenSigSendType" SG_ 329 FrntSideRdrRiDetn73RdrDetnConf 0;
BA_ "GenSigStartValue" SG_ 329 FrntSideRdrRiDetn73RdrDetnElevn 15;
BA_ "GenSigSendType" SG_ 329 FrntSideRdrRiDetn73RdrDetnElevn 0;
BA_ "GenSigSendType" SG_ 329 FrntSideRdrRiDetn73RdrDetnPwr 0;
BA_ "GenSigStartValue" SG_ 329 FrntSideRdrRiDetn73RdrDetnRng 10050;
BA_ "GenSigSendType" SG_ 329 FrntSideRdrRiDetn73RdrDetnRng 0;
BA_ "GenSigStartValue" SG_ 329 FrntSideRdrRiDetn73RdrDetnRngV 4000;
BA_ "GenSigSendType" SG_ 329 FrntSideRdrRiDetn73RdrDetnRngV 0;
BA_ "GenSigStartValue" SG_ 329 FrntSideRdrRiDetn73RdrDetnSts 3;
BA_ "GenSigSendType" SG_ 329 FrntSideRdrRiDetn73RdrDetnSts 0;
BA_ "GenSigStartValue" SG_ 329 FrntSideRdrRiDetn74RdrDetnAzi 900;
BA_ "GenSigSendType" SG_ 329 FrntSideRdrRiDetn74RdrDetnAzi 0;
BA_ "GenSigSendType" SG_ 329 FrntSideRdrRiDetn74RdrDetnChks 0;
BA_ "GenSigFuncType" SG_ 329 FrntSideRdrRiDetn74RdrDetnChks 15;
BA_ "GenSigDataID" SG_ 329 FrntSideRdrRiDetn74RdrDetnChks "0x92C";
BA_ "GenSigSendType" SG_ 329 FrntSideRdrRiDetn74RdrDetnCntr 0;
BA_ "GenSigFuncType" SG_ 329 FrntSideRdrRiDetn74RdrDetnCntr 16;
BA_ "GenSigSendType" SG_ 329 FrntSideRdrRiDetn74RdrDetnConf 0;
BA_ "GenSigStartValue" SG_ 329 FrntSideRdrRiDetn74RdrDetnElevn 15;
BA_ "GenSigSendType" SG_ 329 FrntSideRdrRiDetn74RdrDetnElevn 0;
BA_ "GenSigSendType" SG_ 329 FrntSideRdrRiDetn74RdrDetnPwr 0;
BA_ "GenSigStartValue" SG_ 329 FrntSideRdrRiDetn74RdrDetnRng 10050;
BA_ "GenSigSendType" SG_ 329 FrntSideRdrRiDetn74RdrDetnRng 0;
BA_ "GenSigStartValue" SG_ 329 FrntSideRdrRiDetn74RdrDetnRngV 4000;
BA_ "GenSigSendType" SG_ 329 FrntSideRdrRiDetn74RdrDetnRngV 0;
BA_ "GenSigStartValue" SG_ 329 FrntSideRdrRiDetn74RdrDetnSts 3;
BA_ "GenSigSendType" SG_ 329 FrntSideRdrRiDetn74RdrDetnSts 0;
BA_ "GenSigStartValue" SG_ 329 FrntSideRdrRiDetn75RdrDetnAzi 900;
BA_ "GenSigSendType" SG_ 329 FrntSideRdrRiDetn75RdrDetnAzi 0;
BA_ "GenSigSendType" SG_ 329 FrntSideRdrRiDetn75RdrDetnChks 0;
BA_ "GenSigFuncType" SG_ 329 FrntSideRdrRiDetn75RdrDetnChks 15;
BA_ "GenSigDataID" SG_ 329 FrntSideRdrRiDetn75RdrDetnChks "0x92D";
BA_ "GenSigSendType" SG_ 329 FrntSideRdrRiDetn75RdrDetnCntr 0;
BA_ "GenSigFuncType" SG_ 329 FrntSideRdrRiDetn75RdrDetnCntr 16;
BA_ "GenSigSendType" SG_ 329 FrntSideRdrRiDetn75RdrDetnConf 0;
BA_ "GenSigStartValue" SG_ 329 FrntSideRdrRiDetn75RdrDetnElevn 15;
BA_ "GenSigSendType" SG_ 329 FrntSideRdrRiDetn75RdrDetnElevn 0;
BA_ "GenSigSendType" SG_ 329 FrntSideRdrRiDetn75RdrDetnPwr 0;
BA_ "GenSigStartValue" SG_ 329 FrntSideRdrRiDetn75RdrDetnRng 10050;
BA_ "GenSigSendType" SG_ 329 FrntSideRdrRiDetn75RdrDetnRng 0;
BA_ "GenSigStartValue" SG_ 329 FrntSideRdrRiDetn75RdrDetnRngV 4000;
BA_ "GenSigSendType" SG_ 329 FrntSideRdrRiDetn75RdrDetnRngV 0;
BA_ "GenSigStartValue" SG_ 329 FrntSideRdrRiDetn75RdrDetnSts 3;
BA_ "GenSigSendType" SG_ 329 FrntSideRdrRiDetn75RdrDetnSts 0;
BA_ "GenSigStartValue" SG_ 329 FrntSideRdrRiDetn76RdrDetnAzi 900;
BA_ "GenSigSendType" SG_ 329 FrntSideRdrRiDetn76RdrDetnAzi 0;
BA_ "GenSigSendType" SG_ 329 FrntSideRdrRiDetn76RdrDetnChks 0;
BA_ "GenSigFuncType" SG_ 329 FrntSideRdrRiDetn76RdrDetnChks 15;
BA_ "GenSigDataID" SG_ 329 FrntSideRdrRiDetn76RdrDetnChks "0x92E";
BA_ "GenSigSendType" SG_ 329 FrntSideRdrRiDetn76RdrDetnCntr 0;
BA_ "GenSigFuncType" SG_ 329 FrntSideRdrRiDetn76RdrDetnCntr 16;
BA_ "GenSigSendType" SG_ 329 FrntSideRdrRiDetn76RdrDetnConf 0;
BA_ "GenSigStartValue" SG_ 329 FrntSideRdrRiDetn76RdrDetnElevn 15;
BA_ "GenSigSendType" SG_ 329 FrntSideRdrRiDetn76RdrDetnElevn 0;
BA_ "GenSigSendType" SG_ 329 FrntSideRdrRiDetn76RdrDetnPwr 0;
BA_ "GenSigStartValue" SG_ 329 FrntSideRdrRiDetn76RdrDetnRng 10050;
BA_ "GenSigSendType" SG_ 329 FrntSideRdrRiDetn76RdrDetnRng 0;
BA_ "GenSigStartValue" SG_ 329 FrntSideRdrRiDetn76RdrDetnRngV 4000;
BA_ "GenSigSendType" SG_ 329 FrntSideRdrRiDetn76RdrDetnRngV 0;
BA_ "GenSigStartValue" SG_ 329 FrntSideRdrRiDetn76RdrDetnSts 3;
BA_ "GenSigSendType" SG_ 329 FrntSideRdrRiDetn76RdrDetnSts 0;
BA_ "GenSigStartValue" SG_ 329 FrntSideRdrRiDetn77RdrDetnAzi 900;
BA_ "GenSigSendType" SG_ 329 FrntSideRdrRiDetn77RdrDetnAzi 0;
BA_ "GenSigSendType" SG_ 329 FrntSideRdrRiDetn77RdrDetnChks 0;
BA_ "GenSigFuncType" SG_ 329 FrntSideRdrRiDetn77RdrDetnChks 15;
BA_ "GenSigDataID" SG_ 329 FrntSideRdrRiDetn77RdrDetnChks "0x92F";
BA_ "GenSigSendType" SG_ 329 FrntSideRdrRiDetn77RdrDetnCntr 0;
BA_ "GenSigFuncType" SG_ 329 FrntSideRdrRiDetn77RdrDetnCntr 16;
BA_ "GenSigSendType" SG_ 329 FrntSideRdrRiDetn77RdrDetnConf 0;
BA_ "GenSigStartValue" SG_ 329 FrntSideRdrRiDetn77RdrDetnElevn 15;
BA_ "GenSigSendType" SG_ 329 FrntSideRdrRiDetn77RdrDetnElevn 0;
BA_ "GenSigSendType" SG_ 329 FrntSideRdrRiDetn77RdrDetnPwr 0;
BA_ "GenSigStartValue" SG_ 329 FrntSideRdrRiDetn77RdrDetnRng 10050;
BA_ "GenSigSendType" SG_ 329 FrntSideRdrRiDetn77RdrDetnRng 0;
BA_ "GenSigStartValue" SG_ 329 FrntSideRdrRiDetn77RdrDetnRngV 4000;
BA_ "GenSigSendType" SG_ 329 FrntSideRdrRiDetn77RdrDetnRngV 0;
BA_ "GenSigStartValue" SG_ 329 FrntSideRdrRiDetn77RdrDetnSts 3;
BA_ "GenSigSendType" SG_ 329 FrntSideRdrRiDetn77RdrDetnSts 0;
BA_ "GenSigStartValue" SG_ 329 FrntSideRdrRiDetn78RdrDetnAzi 900;
BA_ "GenSigSendType" SG_ 329 FrntSideRdrRiDetn78RdrDetnAzi 0;
BA_ "GenSigSendType" SG_ 329 FrntSideRdrRiDetn78RdrDetnChks 0;
BA_ "GenSigFuncType" SG_ 329 FrntSideRdrRiDetn78RdrDetnChks 15;
BA_ "GenSigDataID" SG_ 329 FrntSideRdrRiDetn78RdrDetnChks "0x930";
BA_ "GenSigSendType" SG_ 329 FrntSideRdrRiDetn78RdrDetnCntr 0;
BA_ "GenSigFuncType" SG_ 329 FrntSideRdrRiDetn78RdrDetnCntr 16;
BA_ "GenSigSendType" SG_ 329 FrntSideRdrRiDetn78RdrDetnConf 0;
BA_ "GenSigStartValue" SG_ 329 FrntSideRdrRiDetn78RdrDetnElevn 15;
BA_ "GenSigSendType" SG_ 329 FrntSideRdrRiDetn78RdrDetnElevn 0;
BA_ "GenSigSendType" SG_ 329 FrntSideRdrRiDetn78RdrDetnPwr 0;
BA_ "GenSigStartValue" SG_ 329 FrntSideRdrRiDetn78RdrDetnRng 10050;
BA_ "GenSigSendType" SG_ 329 FrntSideRdrRiDetn78RdrDetnRng 0;
BA_ "GenSigStartValue" SG_ 329 FrntSideRdrRiDetn78RdrDetnRngV 4000;
BA_ "GenSigSendType" SG_ 329 FrntSideRdrRiDetn78RdrDetnRngV 0;
BA_ "GenSigStartValue" SG_ 329 FrntSideRdrRiDetn78RdrDetnSts 3;
BA_ "GenSigSendType" SG_ 329 FrntSideRdrRiDetn78RdrDetnSts 0;
// Frame: FSRRSafetyCANFD1Frame14
BA_ "VFrameFormat" BO_ 331 14;
BA_ "GenMsgSendType" BO_ 331 0;
BA_ "GenMsgCycleTime" BO_ 331 50.000;
BA_ "GenSigStartValue" SG_ 331 FrntSideRdrRiDetn79RdrDetnAzi 900;
BA_ "GenSigSendType" SG_ 331 FrntSideRdrRiDetn79RdrDetnAzi 0;
BA_ "GenSigSendType" SG_ 331 FrntSideRdrRiDetn79RdrDetnChks 0;
BA_ "GenSigFuncType" SG_ 331 FrntSideRdrRiDetn79RdrDetnChks 15;
BA_ "GenSigDataID" SG_ 331 FrntSideRdrRiDetn79RdrDetnChks "0x931";
BA_ "GenSigSendType" SG_ 331 FrntSideRdrRiDetn79RdrDetnCntr 0;
BA_ "GenSigFuncType" SG_ 331 FrntSideRdrRiDetn79RdrDetnCntr 16;
BA_ "GenSigSendType" SG_ 331 FrntSideRdrRiDetn79RdrDetnConf 0;
BA_ "GenSigStartValue" SG_ 331 FrntSideRdrRiDetn79RdrDetnElevn 15;
BA_ "GenSigSendType" SG_ 331 FrntSideRdrRiDetn79RdrDetnElevn 0;
BA_ "GenSigSendType" SG_ 331 FrntSideRdrRiDetn79RdrDetnPwr 0;
BA_ "GenSigStartValue" SG_ 331 FrntSideRdrRiDetn79RdrDetnRng 10050;
BA_ "GenSigSendType" SG_ 331 FrntSideRdrRiDetn79RdrDetnRng 0;
BA_ "GenSigStartValue" SG_ 331 FrntSideRdrRiDetn79RdrDetnRngV 4000;
BA_ "GenSigSendType" SG_ 331 FrntSideRdrRiDetn79RdrDetnRngV 0;
BA_ "GenSigStartValue" SG_ 331 FrntSideRdrRiDetn79RdrDetnSts 3;
BA_ "GenSigSendType" SG_ 331 FrntSideRdrRiDetn79RdrDetnSts 0;
BA_ "GenSigStartValue" SG_ 331 FrntSideRdrRiDetn80RdrDetnAzi 900;
BA_ "GenSigSendType" SG_ 331 FrntSideRdrRiDetn80RdrDetnAzi 0;
BA_ "GenSigSendType" SG_ 331 FrntSideRdrRiDetn80RdrDetnChks 0;
BA_ "GenSigFuncType" SG_ 331 FrntSideRdrRiDetn80RdrDetnChks 15;
BA_ "GenSigDataID" SG_ 331 FrntSideRdrRiDetn80RdrDetnChks "0x932";
BA_ "GenSigSendType" SG_ 331 FrntSideRdrRiDetn80RdrDetnCntr 0;
BA_ "GenSigFuncType" SG_ 331 FrntSideRdrRiDetn80RdrDetnCntr 16;
BA_ "GenSigSendType" SG_ 331 FrntSideRdrRiDetn80RdrDetnConf 0;
BA_ "GenSigStartValue" SG_ 331 FrntSideRdrRiDetn80RdrDetnElevn 15;
BA_ "GenSigSendType" SG_ 331 FrntSideRdrRiDetn80RdrDetnElevn 0;
BA_ "GenSigSendType" SG_ 331 FrntSideRdrRiDetn80RdrDetnPwr 0;
BA_ "GenSigStartValue" SG_ 331 FrntSideRdrRiDetn80RdrDetnRng 10050;
BA_ "GenSigSendType" SG_ 331 FrntSideRdrRiDetn80RdrDetnRng 0;
BA_ "GenSigStartValue" SG_ 331 FrntSideRdrRiDetn80RdrDetnRngV 4000;
BA_ "GenSigSendType" SG_ 331 FrntSideRdrRiDetn80RdrDetnRngV 0;
BA_ "GenSigStartValue" SG_ 331 FrntSideRdrRiDetn80RdrDetnSts 3;
BA_ "GenSigSendType" SG_ 331 FrntSideRdrRiDetn80RdrDetnSts 0;
BA_ "GenSigStartValue" SG_ 331 FrntSideRdrRiDetn81RdrDetnAzi 900;
BA_ "GenSigSendType" SG_ 331 FrntSideRdrRiDetn81RdrDetnAzi 0;
BA_ "GenSigSendType" SG_ 331 FrntSideRdrRiDetn81RdrDetnChks 0;
BA_ "GenSigFuncType" SG_ 331 FrntSideRdrRiDetn81RdrDetnChks 15;
BA_ "GenSigDataID" SG_ 331 FrntSideRdrRiDetn81RdrDetnChks "0x933";
BA_ "GenSigSendType" SG_ 331 FrntSideRdrRiDetn81RdrDetnCntr 0;
BA_ "GenSigFuncType" SG_ 331 FrntSideRdrRiDetn81RdrDetnCntr 16;
BA_ "GenSigSendType" SG_ 331 FrntSideRdrRiDetn81RdrDetnConf 0;
BA_ "GenSigStartValue" SG_ 331 FrntSideRdrRiDetn81RdrDetnElevn 15;
BA_ "GenSigSendType" SG_ 331 FrntSideRdrRiDetn81RdrDetnElevn 0;
BA_ "GenSigSendType" SG_ 331 FrntSideRdrRiDetn81RdrDetnPwr 0;
BA_ "GenSigStartValue" SG_ 331 FrntSideRdrRiDetn81RdrDetnRng 10050;
BA_ "GenSigSendType" SG_ 331 FrntSideRdrRiDetn81RdrDetnRng 0;
BA_ "GenSigStartValue" SG_ 331 FrntSideRdrRiDetn81RdrDetnRngV 4000;
BA_ "GenSigSendType" SG_ 331 FrntSideRdrRiDetn81RdrDetnRngV 0;
BA_ "GenSigStartValue" SG_ 331 FrntSideRdrRiDetn81RdrDetnSts 3;
BA_ "GenSigSendType" SG_ 331 FrntSideRdrRiDetn81RdrDetnSts 0;
BA_ "GenSigStartValue" SG_ 331 FrntSideRdrRiDetn82RdrDetnAzi 900;
BA_ "GenSigSendType" SG_ 331 FrntSideRdrRiDetn82RdrDetnAzi 0;
BA_ "GenSigSendType" SG_ 331 FrntSideRdrRiDetn82RdrDetnChks 0;
BA_ "GenSigFuncType" SG_ 331 FrntSideRdrRiDetn82RdrDetnChks 15;
BA_ "GenSigDataID" SG_ 331 FrntSideRdrRiDetn82RdrDetnChks "0x934";
BA_ "GenSigSendType" SG_ 331 FrntSideRdrRiDetn82RdrDetnCntr 0;
BA_ "GenSigFuncType" SG_ 331 FrntSideRdrRiDetn82RdrDetnCntr 16;
BA_ "GenSigSendType" SG_ 331 FrntSideRdrRiDetn82RdrDetnConf 0;
BA_ "GenSigStartValue" SG_ 331 FrntSideRdrRiDetn82RdrDetnElevn 15;
BA_ "GenSigSendType" SG_ 331 FrntSideRdrRiDetn82RdrDetnElevn 0;
BA_ "GenSigSendType" SG_ 331 FrntSideRdrRiDetn82RdrDetnPwr 0;
BA_ "GenSigStartValue" SG_ 331 FrntSideRdrRiDetn82RdrDetnRng 10050;
BA_ "GenSigSendType" SG_ 331 FrntSideRdrRiDetn82RdrDetnRng 0;
BA_ "GenSigStartValue" SG_ 331 FrntSideRdrRiDetn82RdrDetnRngV 4000;
BA_ "GenSigSendType" SG_ 331 FrntSideRdrRiDetn82RdrDetnRngV 0;
BA_ "GenSigStartValue" SG_ 331 FrntSideRdrRiDetn82RdrDetnSts 3;
BA_ "GenSigSendType" SG_ 331 FrntSideRdrRiDetn82RdrDetnSts 0;
BA_ "GenSigStartValue" SG_ 331 FrntSideRdrRiDetn83RdrDetnAzi 900;
BA_ "GenSigSendType" SG_ 331 FrntSideRdrRiDetn83RdrDetnAzi 0;
BA_ "GenSigSendType" SG_ 331 FrntSideRdrRiDetn83RdrDetnChks 0;
BA_ "GenSigFuncType" SG_ 331 FrntSideRdrRiDetn83RdrDetnChks 15;
BA_ "GenSigDataID" SG_ 331 FrntSideRdrRiDetn83RdrDetnChks "0x935";
BA_ "GenSigSendType" SG_ 331 FrntSideRdrRiDetn83RdrDetnCntr 0;
BA_ "GenSigFuncType" SG_ 331 FrntSideRdrRiDetn83RdrDetnCntr 16;
BA_ "GenSigSendType" SG_ 331 FrntSideRdrRiDetn83RdrDetnConf 0;
BA_ "GenSigStartValue" SG_ 331 FrntSideRdrRiDetn83RdrDetnElevn 15;
BA_ "GenSigSendType" SG_ 331 FrntSideRdrRiDetn83RdrDetnElevn 0;
BA_ "GenSigSendType" SG_ 331 FrntSideRdrRiDetn83RdrDetnPwr 0;
BA_ "GenSigStartValue" SG_ 331 FrntSideRdrRiDetn83RdrDetnRng 10050;
BA_ "GenSigSendType" SG_ 331 FrntSideRdrRiDetn83RdrDetnRng 0;
BA_ "GenSigStartValue" SG_ 331 FrntSideRdrRiDetn83RdrDetnRngV 4000;
BA_ "GenSigSendType" SG_ 331 FrntSideRdrRiDetn83RdrDetnRngV 0;
BA_ "GenSigStartValue" SG_ 331 FrntSideRdrRiDetn83RdrDetnSts 3;
BA_ "GenSigSendType" SG_ 331 FrntSideRdrRiDetn83RdrDetnSts 0;
BA_ "GenSigStartValue" SG_ 331 FrntSideRdrRiDetn84RdrDetnAzi 900;
BA_ "GenSigSendType" SG_ 331 FrntSideRdrRiDetn84RdrDetnAzi 0;
BA_ "GenSigSendType" SG_ 331 FrntSideRdrRiDetn84RdrDetnChks 0;
BA_ "GenSigFuncType" SG_ 331 FrntSideRdrRiDetn84RdrDetnChks 15;
BA_ "GenSigDataID" SG_ 331 FrntSideRdrRiDetn84RdrDetnChks "0x936";
BA_ "GenSigSendType" SG_ 331 FrntSideRdrRiDetn84RdrDetnCntr 0;
BA_ "GenSigFuncType" SG_ 331 FrntSideRdrRiDetn84RdrDetnCntr 16;
BA_ "GenSigSendType" SG_ 331 FrntSideRdrRiDetn84RdrDetnConf 0;
BA_ "GenSigStartValue" SG_ 331 FrntSideRdrRiDetn84RdrDetnElevn 15;
BA_ "GenSigSendType" SG_ 331 FrntSideRdrRiDetn84RdrDetnElevn 0;
BA_ "GenSigSendType" SG_ 331 FrntSideRdrRiDetn84RdrDetnPwr 0;
BA_ "GenSigStartValue" SG_ 331 FrntSideRdrRiDetn84RdrDetnRng 10050;
BA_ "GenSigSendType" SG_ 331 FrntSideRdrRiDetn84RdrDetnRng 0;
BA_ "GenSigStartValue" SG_ 331 FrntSideRdrRiDetn84RdrDetnRngV 4000;
BA_ "GenSigSendType" SG_ 331 FrntSideRdrRiDetn84RdrDetnRngV 0;
BA_ "GenSigStartValue" SG_ 331 FrntSideRdrRiDetn84RdrDetnSts 3;
BA_ "GenSigSendType" SG_ 331 FrntSideRdrRiDetn84RdrDetnSts 0;
// Frame: FSRRSafetyCANFD1Frame15
BA_ "VFrameFormat" BO_ 333 14;
BA_ "GenMsgSendType" BO_ 333 0;
BA_ "GenMsgCycleTime" BO_ 333 50.000;
BA_ "GenSigStartValue" SG_ 333 FrntSideRdrRiDetn85RdrDetnAzi 900;
BA_ "GenSigSendType" SG_ 333 FrntSideRdrRiDetn85RdrDetnAzi 0;
BA_ "GenSigSendType" SG_ 333 FrntSideRdrRiDetn85RdrDetnChks 0;
BA_ "GenSigFuncType" SG_ 333 FrntSideRdrRiDetn85RdrDetnChks 15;
BA_ "GenSigDataID" SG_ 333 FrntSideRdrRiDetn85RdrDetnChks "0x937";
BA_ "GenSigSendType" SG_ 333 FrntSideRdrRiDetn85RdrDetnCntr 0;
BA_ "GenSigFuncType" SG_ 333 FrntSideRdrRiDetn85RdrDetnCntr 16;
BA_ "GenSigSendType" SG_ 333 FrntSideRdrRiDetn85RdrDetnConf 0;
BA_ "GenSigStartValue" SG_ 333 FrntSideRdrRiDetn85RdrDetnElevn 15;
BA_ "GenSigSendType" SG_ 333 FrntSideRdrRiDetn85RdrDetnElevn 0;
BA_ "GenSigSendType" SG_ 333 FrntSideRdrRiDetn85RdrDetnPwr 0;
BA_ "GenSigStartValue" SG_ 333 FrntSideRdrRiDetn85RdrDetnRng 10050;
BA_ "GenSigSendType" SG_ 333 FrntSideRdrRiDetn85RdrDetnRng 0;
BA_ "GenSigStartValue" SG_ 333 FrntSideRdrRiDetn85RdrDetnRngV 4000;
BA_ "GenSigSendType" SG_ 333 FrntSideRdrRiDetn85RdrDetnRngV 0;
BA_ "GenSigStartValue" SG_ 333 FrntSideRdrRiDetn85RdrDetnSts 3;
BA_ "GenSigSendType" SG_ 333 FrntSideRdrRiDetn85RdrDetnSts 0;
BA_ "GenSigStartValue" SG_ 333 FrntSideRdrRiDetn86RdrDetnAzi 900;
BA_ "GenSigSendType" SG_ 333 FrntSideRdrRiDetn86RdrDetnAzi 0;
BA_ "GenSigSendType" SG_ 333 FrntSideRdrRiDetn86RdrDetnChks 0;
BA_ "GenSigFuncType" SG_ 333 FrntSideRdrRiDetn86RdrDetnChks 15;
BA_ "GenSigDataID" SG_ 333 FrntSideRdrRiDetn86RdrDetnChks "0x938";
BA_ "GenSigSendType" SG_ 333 FrntSideRdrRiDetn86RdrDetnCntr 0;
BA_ "GenSigFuncType" SG_ 333 FrntSideRdrRiDetn86RdrDetnCntr 16;
BA_ "GenSigSendType" SG_ 333 FrntSideRdrRiDetn86RdrDetnConf 0;
BA_ "GenSigStartValue" SG_ 333 FrntSideRdrRiDetn86RdrDetnElevn 15;
BA_ "GenSigSendType" SG_ 333 FrntSideRdrRiDetn86RdrDetnElevn 0;
BA_ "GenSigSendType" SG_ 333 FrntSideRdrRiDetn86RdrDetnPwr 0;
BA_ "GenSigStartValue" SG_ 333 FrntSideRdrRiDetn86RdrDetnRng 10050;
BA_ "GenSigSendType" SG_ 333 FrntSideRdrRiDetn86RdrDetnRng 0;
BA_ "GenSigStartValue" SG_ 333 FrntSideRdrRiDetn86RdrDetnRngV 4000;
BA_ "GenSigSendType" SG_ 333 FrntSideRdrRiDetn86RdrDetnRngV 0;
BA_ "GenSigStartValue" SG_ 333 FrntSideRdrRiDetn86RdrDetnSts 3;
BA_ "GenSigSendType" SG_ 333 FrntSideRdrRiDetn86RdrDetnSts 0;
BA_ "GenSigStartValue" SG_ 333 FrntSideRdrRiDetn87RdrDetnAzi 900;
BA_ "GenSigSendType" SG_ 333 FrntSideRdrRiDetn87RdrDetnAzi 0;
BA_ "GenSigSendType" SG_ 333 FrntSideRdrRiDetn87RdrDetnChks 0;
BA_ "GenSigFuncType" SG_ 333 FrntSideRdrRiDetn87RdrDetnChks 15;
BA_ "GenSigDataID" SG_ 333 FrntSideRdrRiDetn87RdrDetnChks "0x939";
BA_ "GenSigSendType" SG_ 333 FrntSideRdrRiDetn87RdrDetnCntr 0;
BA_ "GenSigFuncType" SG_ 333 FrntSideRdrRiDetn87RdrDetnCntr 16;
BA_ "GenSigSendType" SG_ 333 FrntSideRdrRiDetn87RdrDetnConf 0;
BA_ "GenSigStartValue" SG_ 333 FrntSideRdrRiDetn87RdrDetnElevn 15;
BA_ "GenSigSendType" SG_ 333 FrntSideRdrRiDetn87RdrDetnElevn 0;
BA_ "GenSigSendType" SG_ 333 FrntSideRdrRiDetn87RdrDetnPwr 0;
BA_ "GenSigStartValue" SG_ 333 FrntSideRdrRiDetn87RdrDetnRng 10050;
BA_ "GenSigSendType" SG_ 333 FrntSideRdrRiDetn87RdrDetnRng 0;
BA_ "GenSigStartValue" SG_ 333 FrntSideRdrRiDetn87RdrDetnRngV 4000;
BA_ "GenSigSendType" SG_ 333 FrntSideRdrRiDetn87RdrDetnRngV 0;
BA_ "GenSigStartValue" SG_ 333 FrntSideRdrRiDetn87RdrDetnSts 3;
BA_ "GenSigSendType" SG_ 333 FrntSideRdrRiDetn87RdrDetnSts 0;
BA_ "GenSigStartValue" SG_ 333 FrntSideRdrRiDetn88RdrDetnAzi 900;
BA_ "GenSigSendType" SG_ 333 FrntSideRdrRiDetn88RdrDetnAzi 0;
BA_ "GenSigSendType" SG_ 333 FrntSideRdrRiDetn88RdrDetnChks 0;
BA_ "GenSigFuncType" SG_ 333 FrntSideRdrRiDetn88RdrDetnChks 15;
BA_ "GenSigDataID" SG_ 333 FrntSideRdrRiDetn88RdrDetnChks "0x93A";
BA_ "GenSigSendType" SG_ 333 FrntSideRdrRiDetn88RdrDetnCntr 0;
BA_ "GenSigFuncType" SG_ 333 FrntSideRdrRiDetn88RdrDetnCntr 16;
BA_ "GenSigSendType" SG_ 333 FrntSideRdrRiDetn88RdrDetnConf 0;
BA_ "GenSigStartValue" SG_ 333 FrntSideRdrRiDetn88RdrDetnElevn 15;
BA_ "GenSigSendType" SG_ 333 FrntSideRdrRiDetn88RdrDetnElevn 0;
BA_ "GenSigSendType" SG_ 333 FrntSideRdrRiDetn88RdrDetnPwr 0;
BA_ "GenSigStartValue" SG_ 333 FrntSideRdrRiDetn88RdrDetnRng 10050;
BA_ "GenSigSendType" SG_ 333 FrntSideRdrRiDetn88RdrDetnRng 0;
BA_ "GenSigStartValue" SG_ 333 FrntSideRdrRiDetn88RdrDetnRngV 4000;
BA_ "GenSigSendType" SG_ 333 FrntSideRdrRiDetn88RdrDetnRngV 0;
BA_ "GenSigStartValue" SG_ 333 FrntSideRdrRiDetn88RdrDetnSts 3;
BA_ "GenSigSendType" SG_ 333 FrntSideRdrRiDetn88RdrDetnSts 0;
BA_ "GenSigStartValue" SG_ 333 FrntSideRdrRiDetn89RdrDetnAzi 900;
BA_ "GenSigSendType" SG_ 333 FrntSideRdrRiDetn89RdrDetnAzi 0;
BA_ "GenSigSendType" SG_ 333 FrntSideRdrRiDetn89RdrDetnChks 0;
BA_ "GenSigFuncType" SG_ 333 FrntSideRdrRiDetn89RdrDetnChks 15;
BA_ "GenSigDataID" SG_ 333 FrntSideRdrRiDetn89RdrDetnChks "0x93B";
BA_ "GenSigSendType" SG_ 333 FrntSideRdrRiDetn89RdrDetnCntr 0;
BA_ "GenSigFuncType" SG_ 333 FrntSideRdrRiDetn89RdrDetnCntr 16;
BA_ "GenSigSendType" SG_ 333 FrntSideRdrRiDetn89RdrDetnConf 0;
BA_ "GenSigStartValue" SG_ 333 FrntSideRdrRiDetn89RdrDetnElevn 15;
BA_ "GenSigSendType" SG_ 333 FrntSideRdrRiDetn89RdrDetnElevn 0;
BA_ "GenSigSendType" SG_ 333 FrntSideRdrRiDetn89RdrDetnPwr 0;
BA_ "GenSigStartValue" SG_ 333 FrntSideRdrRiDetn89RdrDetnRng 10050;
BA_ "GenSigSendType" SG_ 333 FrntSideRdrRiDetn89RdrDetnRng 0;
BA_ "GenSigStartValue" SG_ 333 FrntSideRdrRiDetn89RdrDetnRngV 4000;
BA_ "GenSigSendType" SG_ 333 FrntSideRdrRiDetn89RdrDetnRngV 0;
BA_ "GenSigStartValue" SG_ 333 FrntSideRdrRiDetn89RdrDetnSts 3;
BA_ "GenSigSendType" SG_ 333 FrntSideRdrRiDetn89RdrDetnSts 0;
BA_ "GenSigStartValue" SG_ 333 FrntSideRdrRiDetn90RdrDetnAzi 900;
BA_ "GenSigSendType" SG_ 333 FrntSideRdrRiDetn90RdrDetnAzi 0;
BA_ "GenSigSendType" SG_ 333 FrntSideRdrRiDetn90RdrDetnChks 0;
BA_ "GenSigFuncType" SG_ 333 FrntSideRdrRiDetn90RdrDetnChks 15;
BA_ "GenSigDataID" SG_ 333 FrntSideRdrRiDetn90RdrDetnChks "0x93C";
BA_ "GenSigSendType" SG_ 333 FrntSideRdrRiDetn90RdrDetnCntr 0;
BA_ "GenSigFuncType" SG_ 333 FrntSideRdrRiDetn90RdrDetnCntr 16;
BA_ "GenSigSendType" SG_ 333 FrntSideRdrRiDetn90RdrDetnConf 0;
BA_ "GenSigStartValue" SG_ 333 FrntSideRdrRiDetn90RdrDetnElevn 15;
BA_ "GenSigSendType" SG_ 333 FrntSideRdrRiDetn90RdrDetnElevn 0;
BA_ "GenSigSendType" SG_ 333 FrntSideRdrRiDetn90RdrDetnPwr 0;
BA_ "GenSigStartValue" SG_ 333 FrntSideRdrRiDetn90RdrDetnRng 10050;
BA_ "GenSigSendType" SG_ 333 FrntSideRdrRiDetn90RdrDetnRng 0;
BA_ "GenSigStartValue" SG_ 333 FrntSideRdrRiDetn90RdrDetnRngV 4000;
BA_ "GenSigSendType" SG_ 333 FrntSideRdrRiDetn90RdrDetnRngV 0;
BA_ "GenSigStartValue" SG_ 333 FrntSideRdrRiDetn90RdrDetnSts 3;
BA_ "GenSigSendType" SG_ 333 FrntSideRdrRiDetn90RdrDetnSts 0;
VAL_ 319 FrntSideRdrRiDetn43RdrDetnSts 0 "RdrDetnSts_Ukwn" 1 "RdrDetnSts_Movg" 2 "RdrDetnSts_Staty" 3 "RdrDetnSts_Invalid";
VAL_ 319 FrntSideRdrRiDetn44RdrDetnSts 0 "RdrDetnSts_Ukwn" 1 "RdrDetnSts_Movg" 2 "RdrDetnSts_Staty" 3 "RdrDetnSts_Invalid";
VAL_ 319 FrntSideRdrRiDetn45RdrDetnSts 0 "RdrDetnSts_Ukwn" 1 "RdrDetnSts_Movg" 2 "RdrDetnSts_Staty" 3 "RdrDetnSts_Invalid";
VAL_ 319 FrntSideRdrRiDetn46RdrDetnSts 0 "RdrDetnSts_Ukwn" 1 "RdrDetnSts_Movg" 2 "RdrDetnSts_Staty" 3 "RdrDetnSts_Invalid";
VAL_ 319 FrntSideRdrRiDetn47RdrDetnSts 0 "RdrDetnSts_Ukwn" 1 "RdrDetnSts_Movg" 2 "RdrDetnSts_Staty" 3 "RdrDetnSts_Invalid";
VAL_ 319 FrntSideRdrRiDetn48RdrDetnSts 0 "RdrDetnSts_Ukwn" 1 "RdrDetnSts_Movg" 2 "RdrDetnSts_Staty" 3 "RdrDetnSts_Invalid";
VAL_ 321 FrntSideRdrRiDetn49RdrDetnSts 0 "RdrDetnSts_Ukwn" 1 "RdrDetnSts_Movg" 2 "RdrDetnSts_Staty" 3 "RdrDetnSts_Invalid";
VAL_ 321 FrntSideRdrRiDetn50RdrDetnSts 0 "RdrDetnSts_Ukwn" 1 "RdrDetnSts_Movg" 2 "RdrDetnSts_Staty" 3 "RdrDetnSts_Invalid";
VAL_ 321 FrntSideRdrRiDetn51RdrDetnSts 0 "RdrDetnSts_Ukwn" 1 "RdrDetnSts_Movg" 2 "RdrDetnSts_Staty" 3 "RdrDetnSts_Invalid";
VAL_ 321 FrntSideRdrRiDetn52RdrDetnSts 0 "RdrDetnSts_Ukwn" 1 "RdrDetnSts_Movg" 2 "RdrDetnSts_Staty" 3 "RdrDetnSts_Invalid";
VAL_ 321 FrntSideRdrRiDetn53RdrDetnSts 0 "RdrDetnSts_Ukwn" 1 "RdrDetnSts_Movg" 2 "RdrDetnSts_Staty" 3 "RdrDetnSts_Invalid";
VAL_ 321 FrntSideRdrRiDetn54RdrDetnSts 0 "RdrDetnSts_Ukwn" 1 "RdrDetnSts_Movg" 2 "RdrDetnSts_Staty" 3 "RdrDetnSts_Invalid";
VAL_ 323 FrntSideRdrRiDetn55RdrDetnSts 0 "RdrDetnSts_Ukwn" 1 "RdrDetnSts_Movg" 2 "RdrDetnSts_Staty" 3 "RdrDetnSts_Invalid";
VAL_ 323 FrntSideRdrRiDetn56RdrDetnSts 0 "RdrDetnSts_Ukwn" 1 "RdrDetnSts_Movg" 2 "RdrDetnSts_Staty" 3 "RdrDetnSts_Invalid";
VAL_ 323 FrntSideRdrRiDetn57RdrDetnSts 0 "RdrDetnSts_Ukwn" 1 "RdrDetnSts_Movg" 2 "RdrDetnSts_Staty" 3 "RdrDetnSts_Invalid";
VAL_ 323 FrntSideRdrRiDetn58RdrDetnSts 0 "RdrDetnSts_Ukwn" 1 "RdrDetnSts_Movg" 2 "RdrDetnSts_Staty" 3 "RdrDetnSts_Invalid";
VAL_ 323 FrntSideRdrRiDetn59RdrDetnSts 0 "RdrDetnSts_Ukwn" 1 "RdrDetnSts_Movg" 2 "RdrDetnSts_Staty" 3 "RdrDetnSts_Invalid";
VAL_ 323 FrntSideRdrRiDetn60RdrDetnSts 0 "RdrDetnSts_Ukwn" 1 "RdrDetnSts_Movg" 2 "RdrDetnSts_Staty" 3 "RdrDetnSts_Invalid";
VAL_ 325 FrntSideRdrRiDetn61RdrDetnSts 0 "RdrDetnSts_Ukwn" 1 "RdrDetnSts_Movg" 2 "RdrDetnSts_Staty" 3 "RdrDetnSts_Invalid";
VAL_ 325 FrntSideRdrRiDetn62RdrDetnSts 0 "RdrDetnSts_Ukwn" 1 "RdrDetnSts_Movg" 2 "RdrDetnSts_Staty" 3 "RdrDetnSts_Invalid";
VAL_ 325 FrntSideRdrRiDetn63RdrDetnSts 0 "RdrDetnSts_Ukwn" 1 "RdrDetnSts_Movg" 2 "RdrDetnSts_Staty" 3 "RdrDetnSts_Invalid";
VAL_ 325 FrntSideRdrRiDetn64RdrDetnSts 0 "RdrDetnSts_Ukwn" 1 "RdrDetnSts_Movg" 2 "RdrDetnSts_Staty" 3 "RdrDetnSts_Invalid";
VAL_ 325 FrntSideRdrRiDetn65RdrDetnSts 0 "RdrDetnSts_Ukwn" 1 "RdrDetnSts_Movg" 2 "RdrDetnSts_Staty" 3 "RdrDetnSts_Invalid";
VAL_ 325 FrntSideRdrRiDetn66RdrDetnSts 0 "RdrDetnSts_Ukwn" 1 "RdrDetnSts_Movg" 2 "RdrDetnSts_Staty" 3 "RdrDetnSts_Invalid";
VAL_ 327 FrntSideRdrRiDetn67RdrDetnSts 0 "RdrDetnSts_Ukwn" 1 "RdrDetnSts_Movg" 2 "RdrDetnSts_Staty" 3 "RdrDetnSts_Invalid";
VAL_ 327 FrntSideRdrRiDetn68RdrDetnSts 0 "RdrDetnSts_Ukwn" 1 "RdrDetnSts_Movg" 2 "RdrDetnSts_Staty" 3 "RdrDetnSts_Invalid";
VAL_ 327 FrntSideRdrRiDetn69RdrDetnSts 0 "RdrDetnSts_Ukwn" 1 "RdrDetnSts_Movg" 2 "RdrDetnSts_Staty" 3 "RdrDetnSts_Invalid";
VAL_ 327 FrntSideRdrRiDetn70RdrDetnSts 0 "RdrDetnSts_Ukwn" 1 "RdrDetnSts_Movg" 2 "RdrDetnSts_Staty" 3 "RdrDetnSts_Invalid";
VAL_ 327 FrntSideRdrRiDetn71RdrDetnSts 0 "RdrDetnSts_Ukwn" 1 "RdrDetnSts_Movg" 2 "RdrDetnSts_Staty" 3 "RdrDetnSts_Invalid";
VAL_ 327 FrntSideRdrRiDetn72RdrDetnSts 0 "RdrDetnSts_Ukwn" 1 "RdrDetnSts_Movg" 2 "RdrDetnSts_Staty" 3 "RdrDetnSts_Invalid";
VAL_ 329 FrntSideRdrRiDetn73RdrDetnSts 0 "RdrDetnSts_Ukwn" 1 "RdrDetnSts_Movg" 2 "RdrDetnSts_Staty" 3 "RdrDetnSts_Invalid";
VAL_ 329 FrntSideRdrRiDetn74RdrDetnSts 0 "RdrDetnSts_Ukwn" 1 "RdrDetnSts_Movg" 2 "RdrDetnSts_Staty" 3 "RdrDetnSts_Invalid";
VAL_ 329 FrntSideRdrRiDetn75RdrDetnSts 0 "RdrDetnSts_Ukwn" 1 "RdrDetnSts_Movg" 2 "RdrDetnSts_Staty" 3 "RdrDetnSts_Invalid";
VAL_ 329 FrntSideRdrRiDetn76RdrDetnSts 0 "RdrDetnSts_Ukwn" 1 "RdrDetnSts_Movg" 2 "RdrDetnSts_Staty" 3 "RdrDetnSts_Invalid";
VAL_ 329 FrntSideRdrRiDetn77RdrDetnSts 0 "RdrDetnSts_Ukwn" 1 "RdrDetnSts_Movg" 2 "RdrDetnSts_Staty" 3 "RdrDetnSts_Invalid";
VAL_ 329 FrntSideRdrRiDetn78RdrDetnSts 0 "RdrDetnSts_Ukwn" 1 "RdrDetnSts_Movg" 2 "RdrDetnSts_Staty" 3 "RdrDetnSts_Invalid";
VAL_ 331 FrntSideRdrRiDetn79RdrDetnSts 0 "RdrDetnSts_Ukwn" 1 "RdrDetnSts_Movg" 2 "RdrDetnSts_Staty" 3 "RdrDetnSts_Invalid";
VAL_ 331 FrntSideRdrRiDetn80RdrDetnSts 0 "RdrDetnSts_Ukwn" 1 "RdrDetnSts_Movg" 2 "RdrDetnSts_Staty" 3 "RdrDetnSts_Invalid";
VAL_ 331 FrntSideRdrRiDetn81RdrDetnSts 0 "RdrDetnSts_Ukwn" 1 "RdrDetnSts_Movg" 2 "RdrDetnSts_Staty" 3 "RdrDetnSts_Invalid";
VAL_ 331 FrntSideRdrRiDetn82RdrDetnSts 0 "RdrDetnSts_Ukwn" 1 "RdrDetnSts_Movg" 2 "RdrDetnSts_Staty" 3 "RdrDetnSts_Invalid";
VAL_ 331 FrntSideRdrRiDetn83RdrDetnSts 0 "RdrDetnSts_Ukwn" 1 "RdrDetnSts_Movg" 2 "RdrDetnSts_Staty" 3 "RdrDetnSts_Invalid";
VAL_ 331 FrntSideRdrRiDetn84RdrDetnSts 0 "RdrDetnSts_Ukwn" 1 "RdrDetnSts_Movg" 2 "RdrDetnSts_Staty" 3 "RdrDetnSts_Invalid";
VAL_ 333 FrntSideRdrRiDetn85RdrDetnSts 0 "RdrDetnSts_Ukwn" 1 "RdrDetnSts_Movg" 2 "RdrDetnSts_Staty" 3 "RdrDetnSts_Invalid";
VAL_ 333 FrntSideRdrRiDetn86RdrDetnSts 0 "RdrDetnSts_Ukwn" 1 "RdrDetnSts_Movg" 2 "RdrDetnSts_Staty" 3 "RdrDetnSts_Invalid";
VAL_ 333 FrntSideRdrRiDetn87RdrDetnSts 0 "RdrDetnSts_Ukwn" 1 "RdrDetnSts_Movg" 2 "RdrDetnSts_Staty" 3 "RdrDetnSts_Invalid";
VAL_ 333 FrntSideRdrRiDetn88RdrDetnSts 0 "RdrDetnSts_Ukwn" 1 "RdrDetnSts_Movg" 2 "RdrDetnSts_Staty" 3 "RdrDetnSts_Invalid";
VAL_ 333 FrntSideRdrRiDetn89RdrDetnSts 0 "RdrDetnSts_Ukwn" 1 "RdrDetnSts_Movg" 2 "RdrDetnSts_Staty" 3 "RdrDetnSts_Invalid";
VAL_ 333 FrntSideRdrRiDetn90RdrDetnSts 0 "RdrDetnSts_Ukwn" 1 "RdrDetnSts_Movg" 2 "RdrDetnSts_Staty" 3 "RdrDetnSts_Invalid";
SIG_GROUP_ 319 FrntSideRdrRiDetn43 1 : FrntSideRdrRiDetn43RdrDetnAzi FrntSideRdrRiDetn43RdrDetnChks FrntSideRdrRiDetn43RdrDetnCntr FrntSideRdrRiDetn43RdrDetnConf FrntSideRdrRiDetn43RdrDetnElevn FrntSideRdrRiDetn43RdrDetnPwr FrntSideRdrRiDetn43RdrDetnRng FrntSideRdrRiDetn43RdrDetnRngV FrntSideRdrRiDetn43RdrDetnSts;
SIG_GROUP_ 319 FrntSideRdrRiDetn44 1 : FrntSideRdrRiDetn44RdrDetnAzi FrntSideRdrRiDetn44RdrDetnChks FrntSideRdrRiDetn44RdrDetnCntr FrntSideRdrRiDetn44RdrDetnConf FrntSideRdrRiDetn44RdrDetnElevn FrntSideRdrRiDetn44RdrDetnPwr FrntSideRdrRiDetn44RdrDetnRng FrntSideRdrRiDetn44RdrDetnRngV FrntSideRdrRiDetn44RdrDetnSts;
SIG_GROUP_ 319 FrntSideRdrRiDetn45 1 : FrntSideRdrRiDetn45RdrDetnAzi FrntSideRdrRiDetn45RdrDetnChks FrntSideRdrRiDetn45RdrDetnCntr FrntSideRdrRiDetn45RdrDetnConf FrntSideRdrRiDetn45RdrDetnElevn FrntSideRdrRiDetn45RdrDetnPwr FrntSideRdrRiDetn45RdrDetnRng FrntSideRdrRiDetn45RdrDetnRngV FrntSideRdrRiDetn45RdrDetnSts;
SIG_GROUP_ 319 FrntSideRdrRiDetn46 1 : FrntSideRdrRiDetn46RdrDetnAzi FrntSideRdrRiDetn46RdrDetnChks FrntSideRdrRiDetn46RdrDetnCntr FrntSideRdrRiDetn46RdrDetnConf FrntSideRdrRiDetn46RdrDetnElevn FrntSideRdrRiDetn46RdrDetnPwr FrntSideRdrRiDetn46RdrDetnRng FrntSideRdrRiDetn46RdrDetnRngV FrntSideRdrRiDetn46RdrDetnSts;
SIG_GROUP_ 319 FrntSideRdrRiDetn47 1 : FrntSideRdrRiDetn47RdrDetnAzi FrntSideRdrRiDetn47RdrDetnChks FrntSideRdrRiDetn47RdrDetnCntr FrntSideRdrRiDetn47RdrDetnConf FrntSideRdrRiDetn47RdrDetnElevn FrntSideRdrRiDetn47RdrDetnPwr FrntSideRdrRiDetn47RdrDetnRng FrntSideRdrRiDetn47RdrDetnRngV FrntSideRdrRiDetn47RdrDetnSts;
SIG_GROUP_ 319 FrntSideRdrRiDetn48 1 : FrntSideRdrRiDetn48RdrDetnAzi FrntSideRdrRiDetn48RdrDetnChks FrntSideRdrRiDetn48RdrDetnCntr FrntSideRdrRiDetn48RdrDetnConf FrntSideRdrRiDetn48RdrDetnElevn FrntSideRdrRiDetn48RdrDetnPwr FrntSideRdrRiDetn48RdrDetnRng FrntSideRdrRiDetn48RdrDetnRngV FrntSideRdrRiDetn48RdrDetnSts;
SIG_GROUP_ 321 FrntSideRdrRiDetn49 1 : FrntSideRdrRiDetn49RdrDetnAzi FrntSideRdrRiDetn49RdrDetnChks FrntSideRdrRiDetn49RdrDetnCntr FrntSideRdrRiDetn49RdrDetnConf FrntSideRdrRiDetn49RdrDetnElevn FrntSideRdrRiDetn49RdrDetnPwr FrntSideRdrRiDetn49RdrDetnRng FrntSideRdrRiDetn49RdrDetnRngV FrntSideRdrRiDetn49RdrDetnSts;
SIG_GROUP_ 321 FrntSideRdrRiDetn50 1 : FrntSideRdrRiDetn50RdrDetnAzi FrntSideRdrRiDetn50RdrDetnChks FrntSideRdrRiDetn50RdrDetnCntr FrntSideRdrRiDetn50RdrDetnConf FrntSideRdrRiDetn50RdrDetnElevn FrntSideRdrRiDetn50RdrDetnPwr FrntSideRdrRiDetn50RdrDetnRng FrntSideRdrRiDetn50RdrDetnRngV FrntSideRdrRiDetn50RdrDetnSts;
SIG_GROUP_ 321 FrntSideRdrRiDetn51 1 : FrntSideRdrRiDetn51RdrDetnAzi FrntSideRdrRiDetn51RdrDetnChks FrntSideRdrRiDetn51RdrDetnCntr FrntSideRdrRiDetn51RdrDetnConf FrntSideRdrRiDetn51RdrDetnElevn FrntSideRdrRiDetn51RdrDetnPwr FrntSideRdrRiDetn51RdrDetnRng FrntSideRdrRiDetn51RdrDetnRngV FrntSideRdrRiDetn51RdrDetnSts;
SIG_GROUP_ 321 FrntSideRdrRiDetn52 1 : FrntSideRdrRiDetn52RdrDetnAzi FrntSideRdrRiDetn52RdrDetnChks FrntSideRdrRiDetn52RdrDetnCntr FrntSideRdrRiDetn52RdrDetnConf FrntSideRdrRiDetn52RdrDetnElevn FrntSideRdrRiDetn52RdrDetnPwr FrntSideRdrRiDetn52RdrDetnRng FrntSideRdrRiDetn52RdrDetnRngV FrntSideRdrRiDetn52RdrDetnSts;
SIG_GROUP_ 321 FrntSideRdrRiDetn53 1 : FrntSideRdrRiDetn53RdrDetnAzi FrntSideRdrRiDetn53RdrDetnChks FrntSideRdrRiDetn53RdrDetnCntr FrntSideRdrRiDetn53RdrDetnConf FrntSideRdrRiDetn53RdrDetnElevn FrntSideRdrRiDetn53RdrDetnPwr FrntSideRdrRiDetn53RdrDetnRng FrntSideRdrRiDetn53RdrDetnRngV FrntSideRdrRiDetn53RdrDetnSts;
SIG_GROUP_ 321 FrntSideRdrRiDetn54 1 : FrntSideRdrRiDetn54RdrDetnAzi FrntSideRdrRiDetn54RdrDetnChks FrntSideRdrRiDetn54RdrDetnCntr FrntSideRdrRiDetn54RdrDetnConf FrntSideRdrRiDetn54RdrDetnElevn FrntSideRdrRiDetn54RdrDetnPwr FrntSideRdrRiDetn54RdrDetnRng FrntSideRdrRiDetn54RdrDetnRngV FrntSideRdrRiDetn54RdrDetnSts;
SIG_GROUP_ 323 FrntSideRdrRiDetn55 1 : FrntSideRdrRiDetn55RdrDetnAzi FrntSideRdrRiDetn55RdrDetnChks FrntSideRdrRiDetn55RdrDetnCntr FrntSideRdrRiDetn55RdrDetnConf FrntSideRdrRiDetn55RdrDetnElevn FrntSideRdrRiDetn55RdrDetnPwr FrntSideRdrRiDetn55RdrDetnRng FrntSideRdrRiDetn55RdrDetnRngV FrntSideRdrRiDetn55RdrDetnSts;
SIG_GROUP_ 323 FrntSideRdrRiDetn56 1 : FrntSideRdrRiDetn56RdrDetnAzi FrntSideRdrRiDetn56RdrDetnChks FrntSideRdrRiDetn56RdrDetnCntr FrntSideRdrRiDetn56RdrDetnConf FrntSideRdrRiDetn56RdrDetnElevn FrntSideRdrRiDetn56RdrDetnPwr FrntSideRdrRiDetn56RdrDetnRng FrntSideRdrRiDetn56RdrDetnRngV FrntSideRdrRiDetn56RdrDetnSts;
SIG_GROUP_ 323 FrntSideRdrRiDetn57 1 : FrntSideRdrRiDetn57RdrDetnAzi FrntSideRdrRiDetn57RdrDetnChks FrntSideRdrRiDetn57RdrDetnCntr FrntSideRdrRiDetn57RdrDetnConf FrntSideRdrRiDetn57RdrDetnElevn FrntSideRdrRiDetn57RdrDetnPwr FrntSideRdrRiDetn57RdrDetnRng FrntSideRdrRiDetn57RdrDetnRngV FrntSideRdrRiDetn57RdrDetnSts;
SIG_GROUP_ 323 FrntSideRdrRiDetn58 1 : FrntSideRdrRiDetn58RdrDetnAzi FrntSideRdrRiDetn58RdrDetnChks FrntSideRdrRiDetn58RdrDetnCntr FrntSideRdrRiDetn58RdrDetnConf FrntSideRdrRiDetn58RdrDetnElevn FrntSideRdrRiDetn58RdrDetnPwr FrntSideRdrRiDetn58RdrDetnRng FrntSideRdrRiDetn58RdrDetnRngV FrntSideRdrRiDetn58RdrDetnSts;
SIG_GROUP_ 323 FrntSideRdrRiDetn59 1 : FrntSideRdrRiDetn59RdrDetnAzi FrntSideRdrRiDetn59RdrDetnChks FrntSideRdrRiDetn59RdrDetnCntr FrntSideRdrRiDetn59RdrDetnConf FrntSideRdrRiDetn59RdrDetnElevn FrntSideRdrRiDetn59RdrDetnPwr FrntSideRdrRiDetn59RdrDetnRng FrntSideRdrRiDetn59RdrDetnRngV FrntSideRdrRiDetn59RdrDetnSts;
SIG_GROUP_ 323 FrntSideRdrRiDetn60 1 : FrntSideRdrRiDetn60RdrDetnAzi FrntSideRdrRiDetn60RdrDetnChks FrntSideRdrRiDetn60RdrDetnCntr FrntSideRdrRiDetn60RdrDetnConf FrntSideRdrRiDetn60RdrDetnElevn FrntSideRdrRiDetn60RdrDetnPwr FrntSideRdrRiDetn60RdrDetnRng FrntSideRdrRiDetn60RdrDetnRngV FrntSideRdrRiDetn60RdrDetnSts;
SIG_GROUP_ 325 FrntSideRdrRiDetn61 1 : FrntSideRdrRiDetn61RdrDetnAzi FrntSideRdrRiDetn61RdrDetnChks FrntSideRdrRiDetn61RdrDetnCntr FrntSideRdrRiDetn61RdrDetnConf FrntSideRdrRiDetn61RdrDetnElevn FrntSideRdrRiDetn61RdrDetnPwr FrntSideRdrRiDetn61RdrDetnRng FrntSideRdrRiDetn61RdrDetnRngV FrntSideRdrRiDetn61RdrDetnSts;
SIG_GROUP_ 325 FrntSideRdrRiDetn62 1 : FrntSideRdrRiDetn62RdrDetnAzi FrntSideRdrRiDetn62RdrDetnChks FrntSideRdrRiDetn62RdrDetnCntr FrntSideRdrRiDetn62RdrDetnConf FrntSideRdrRiDetn62RdrDetnElevn FrntSideRdrRiDetn62RdrDetnPwr FrntSideRdrRiDetn62RdrDetnRng FrntSideRdrRiDetn62RdrDetnRngV FrntSideRdrRiDetn62RdrDetnSts;
SIG_GROUP_ 325 FrntSideRdrRiDetn63 1 : FrntSideRdrRiDetn63RdrDetnAzi FrntSideRdrRiDetn63RdrDetnChks FrntSideRdrRiDetn63RdrDetnCntr FrntSideRdrRiDetn63RdrDetnConf FrntSideRdrRiDetn63RdrDetnElevn FrntSideRdrRiDetn63RdrDetnPwr FrntSideRdrRiDetn63RdrDetnRng FrntSideRdrRiDetn63RdrDetnRngV FrntSideRdrRiDetn63RdrDetnSts;
SIG_GROUP_ 325 FrntSideRdrRiDetn64 1 : FrntSideRdrRiDetn64RdrDetnAzi FrntSideRdrRiDetn64RdrDetnChks FrntSideRdrRiDetn64RdrDetnCntr FrntSideRdrRiDetn64RdrDetnConf FrntSideRdrRiDetn64RdrDetnElevn FrntSideRdrRiDetn64RdrDetnPwr FrntSideRdrRiDetn64RdrDetnRng FrntSideRdrRiDetn64RdrDetnRngV FrntSideRdrRiDetn64RdrDetnSts;
SIG_GROUP_ 325 FrntSideRdrRiDetn65 1 : FrntSideRdrRiDetn65RdrDetnAzi FrntSideRdrRiDetn65RdrDetnChks FrntSideRdrRiDetn65RdrDetnCntr FrntSideRdrRiDetn65RdrDetnConf FrntSideRdrRiDetn65RdrDetnElevn FrntSideRdrRiDetn65RdrDetnPwr FrntSideRdrRiDetn65RdrDetnRng FrntSideRdrRiDetn65RdrDetnRngV FrntSideRdrRiDetn65RdrDetnSts;
SIG_GROUP_ 325 FrntSideRdrRiDetn66 1 : FrntSideRdrRiDetn66RdrDetnAzi FrntSideRdrRiDetn66RdrDetnChks FrntSideRdrRiDetn66RdrDetnCntr FrntSideRdrRiDetn66RdrDetnConf FrntSideRdrRiDetn66RdrDetnElevn FrntSideRdrRiDetn66RdrDetnPwr FrntSideRdrRiDetn66RdrDetnRng FrntSideRdrRiDetn66RdrDetnRngV FrntSideRdrRiDetn66RdrDetnSts;
SIG_GROUP_ 327 FrntSideRdrRiDetn67 1 : FrntSideRdrRiDetn67RdrDetnAzi FrntSideRdrRiDetn67RdrDetnChks FrntSideRdrRiDetn67RdrDetnCntr FrntSideRdrRiDetn67RdrDetnConf FrntSideRdrRiDetn67RdrDetnElevn FrntSideRdrRiDetn67RdrDetnPwr FrntSideRdrRiDetn67RdrDetnRng FrntSideRdrRiDetn67RdrDetnRngV FrntSideRdrRiDetn67RdrDetnSts;
SIG_GROUP_ 327 FrntSideRdrRiDetn68 1 : FrntSideRdrRiDetn68RdrDetnAzi FrntSideRdrRiDetn68RdrDetnChks FrntSideRdrRiDetn68RdrDetnCntr FrntSideRdrRiDetn68RdrDetnConf FrntSideRdrRiDetn68RdrDetnElevn FrntSideRdrRiDetn68RdrDetnPwr FrntSideRdrRiDetn68RdrDetnRng FrntSideRdrRiDetn68RdrDetnRngV FrntSideRdrRiDetn68RdrDetnSts;
SIG_GROUP_ 327 FrntSideRdrRiDetn69 1 : FrntSideRdrRiDetn69RdrDetnAzi FrntSideRdrRiDetn69RdrDetnChks FrntSideRdrRiDetn69RdrDetnCntr FrntSideRdrRiDetn69RdrDetnConf FrntSideRdrRiDetn69RdrDetnElevn FrntSideRdrRiDetn69RdrDetnPwr FrntSideRdrRiDetn69RdrDetnRng FrntSideRdrRiDetn69RdrDetnRngV FrntSideRdrRiDetn69RdrDetnSts;
SIG_GROUP_ 327 FrntSideRdrRiDetn70 1 : FrntSideRdrRiDetn70RdrDetnAzi FrntSideRdrRiDetn70RdrDetnChks FrntSideRdrRiDetn70RdrDetnCntr FrntSideRdrRiDetn70RdrDetnConf FrntSideRdrRiDetn70RdrDetnElevn FrntSideRdrRiDetn70RdrDetnPwr FrntSideRdrRiDetn70RdrDetnRng FrntSideRdrRiDetn70RdrDetnRngV FrntSideRdrRiDetn70RdrDetnSts;
SIG_GROUP_ 327 FrntSideRdrRiDetn71 1 : FrntSideRdrRiDetn71RdrDetnAzi FrntSideRdrRiDetn71RdrDetnChks FrntSideRdrRiDetn71RdrDetnCntr FrntSideRdrRiDetn71RdrDetnConf FrntSideRdrRiDetn71RdrDetnElevn FrntSideRdrRiDetn71RdrDetnPwr FrntSideRdrRiDetn71RdrDetnRng FrntSideRdrRiDetn71RdrDetnRngV FrntSideRdrRiDetn71RdrDetnSts;
SIG_GROUP_ 327 FrntSideRdrRiDetn72 1 : FrntSideRdrRiDetn72RdrDetnAzi FrntSideRdrRiDetn72RdrDetnChks FrntSideRdrRiDetn72RdrDetnCntr FrntSideRdrRiDetn72RdrDetnConf FrntSideRdrRiDetn72RdrDetnElevn FrntSideRdrRiDetn72RdrDetnPwr FrntSideRdrRiDetn72RdrDetnRng FrntSideRdrRiDetn72RdrDetnRngV FrntSideRdrRiDetn72RdrDetnSts;
SIG_GROUP_ 329 FrntSideRdrRiDetn73 1 : FrntSideRdrRiDetn73RdrDetnAzi FrntSideRdrRiDetn73RdrDetnChks FrntSideRdrRiDetn73RdrDetnCntr FrntSideRdrRiDetn73RdrDetnConf FrntSideRdrRiDetn73RdrDetnElevn FrntSideRdrRiDetn73RdrDetnPwr FrntSideRdrRiDetn73RdrDetnRng FrntSideRdrRiDetn73RdrDetnRngV FrntSideRdrRiDetn73RdrDetnSts;
SIG_GROUP_ 329 FrntSideRdrRiDetn74 1 : FrntSideRdrRiDetn74RdrDetnAzi FrntSideRdrRiDetn74RdrDetnChks FrntSideRdrRiDetn74RdrDetnCntr FrntSideRdrRiDetn74RdrDetnConf FrntSideRdrRiDetn74RdrDetnElevn FrntSideRdrRiDetn74RdrDetnPwr FrntSideRdrRiDetn74RdrDetnRng FrntSideRdrRiDetn74RdrDetnRngV FrntSideRdrRiDetn74RdrDetnSts;
SIG_GROUP_ 329 FrntSideRdrRiDetn75 1 : FrntSideRdrRiDetn75RdrDetnAzi FrntSideRdrRiDetn75RdrDetnChks FrntSideRdrRiDetn75RdrDetnCntr FrntSideRdrRiDetn75RdrDetnConf FrntSideRdrRiDetn75RdrDetnElevn FrntSideRdrRiDetn75RdrDetnPwr FrntSideRdrRiDetn75RdrDetnRng FrntSideRdrRiDetn75RdrDetnRngV FrntSideRdrRiDetn75RdrDetnSts;
SIG_GROUP_ 329 FrntSideRdrRiDetn76 1 : FrntSideRdrRiDetn76RdrDetnAzi FrntSideRdrRiDetn76RdrDetnChks FrntSideRdrRiDetn76RdrDetnCntr FrntSideRdrRiDetn76RdrDetnConf FrntSideRdrRiDetn76RdrDetnElevn FrntSideRdrRiDetn76RdrDetnPwr FrntSideRdrRiDetn76RdrDetnRng FrntSideRdrRiDetn76RdrDetnRngV FrntSideRdrRiDetn76RdrDetnSts;
SIG_GROUP_ 329 FrntSideRdrRiDetn77 1 : FrntSideRdrRiDetn77RdrDetnAzi FrntSideRdrRiDetn77RdrDetnChks FrntSideRdrRiDetn77RdrDetnCntr FrntSideRdrRiDetn77RdrDetnConf FrntSideRdrRiDetn77RdrDetnElevn FrntSideRdrRiDetn77RdrDetnPwr FrntSideRdrRiDetn77RdrDetnRng FrntSideRdrRiDetn77RdrDetnRngV FrntSideRdrRiDetn77RdrDetnSts;
SIG_GROUP_ 329 FrntSideRdrRiDetn78 1 : FrntSideRdrRiDetn78RdrDetnAzi FrntSideRdrRiDetn78RdrDetnChks FrntSideRdrRiDetn78RdrDetnCntr FrntSideRdrRiDetn78RdrDetnConf FrntSideRdrRiDetn78RdrDetnElevn FrntSideRdrRiDetn78RdrDetnPwr FrntSideRdrRiDetn78RdrDetnRng FrntSideRdrRiDetn78RdrDetnRngV FrntSideRdrRiDetn78RdrDetnSts;
SIG_GROUP_ 331 FrntSideRdrRiDetn79 1 : FrntSideRdrRiDetn79RdrDetnAzi FrntSideRdrRiDetn79RdrDetnChks FrntSideRdrRiDetn79RdrDetnCntr FrntSideRdrRiDetn79RdrDetnConf FrntSideRdrRiDetn79RdrDetnElevn FrntSideRdrRiDetn79RdrDetnPwr FrntSideRdrRiDetn79RdrDetnRng FrntSideRdrRiDetn79RdrDetnRngV FrntSideRdrRiDetn79RdrDetnSts;
SIG_GROUP_ 331 FrntSideRdrRiDetn80 1 : FrntSideRdrRiDetn80RdrDetnAzi FrntSideRdrRiDetn80RdrDetnChks FrntSideRdrRiDetn80RdrDetnCntr FrntSideRdrRiDetn80RdrDetnConf FrntSideRdrRiDetn80RdrDetnElevn FrntSideRdrRiDetn80RdrDetnPwr FrntSideRdrRiDetn80RdrDetnRng FrntSideRdrRiDetn80RdrDetnRngV FrntSideRdrRiDetn80RdrDetnSts;
SIG_GROUP_ 331 FrntSideRdrRiDetn81 1 : FrntSideRdrRiDetn81RdrDetnAzi FrntSideRdrRiDetn81RdrDetnChks FrntSideRdrRiDetn81RdrDetnCntr FrntSideRdrRiDetn81RdrDetnConf FrntSideRdrRiDetn81RdrDetnElevn FrntSideRdrRiDetn81RdrDetnPwr FrntSideRdrRiDetn81RdrDetnRng FrntSideRdrRiDetn81RdrDetnRngV FrntSideRdrRiDetn81RdrDetnSts;
SIG_GROUP_ 331 FrntSideRdrRiDetn82 1 : FrntSideRdrRiDetn82RdrDetnAzi FrntSideRdrRiDetn82RdrDetnChks FrntSideRdrRiDetn82RdrDetnCntr FrntSideRdrRiDetn82RdrDetnConf FrntSideRdrRiDetn82RdrDetnElevn FrntSideRdrRiDetn82RdrDetnPwr FrntSideRdrRiDetn82RdrDetnRng FrntSideRdrRiDetn82RdrDetnRngV FrntSideRdrRiDetn82RdrDetnSts;
SIG_GROUP_ 331 FrntSideRdrRiDetn83 1 : FrntSideRdrRiDetn83RdrDetnAzi FrntSideRdrRiDetn83RdrDetnChks FrntSideRdrRiDetn83RdrDetnCntr FrntSideRdrRiDetn83RdrDetnConf FrntSideRdrRiDetn83RdrDetnElevn FrntSideRdrRiDetn83RdrDetnPwr FrntSideRdrRiDetn83RdrDetnRng FrntSideRdrRiDetn83RdrDetnRngV FrntSideRdrRiDetn83RdrDetnSts;
SIG_GROUP_ 331 FrntSideRdrRiDetn84 1 : FrntSideRdrRiDetn84RdrDetnAzi FrntSideRdrRiDetn84RdrDetnChks FrntSideRdrRiDetn84RdrDetnCntr FrntSideRdrRiDetn84RdrDetnConf FrntSideRdrRiDetn84RdrDetnElevn FrntSideRdrRiDetn84RdrDetnPwr FrntSideRdrRiDetn84RdrDetnRng FrntSideRdrRiDetn84RdrDetnRngV FrntSideRdrRiDetn84RdrDetnSts;
SIG_GROUP_ 333 FrntSideRdrRiDetn85 1 : FrntSideRdrRiDetn85RdrDetnAzi FrntSideRdrRiDetn85RdrDetnChks FrntSideRdrRiDetn85RdrDetnCntr FrntSideRdrRiDetn85RdrDetnConf FrntSideRdrRiDetn85RdrDetnElevn FrntSideRdrRiDetn85RdrDetnPwr FrntSideRdrRiDetn85RdrDetnRng FrntSideRdrRiDetn85RdrDetnRngV FrntSideRdrRiDetn85RdrDetnSts;
SIG_GROUP_ 333 FrntSideRdrRiDetn86 1 : FrntSideRdrRiDetn86RdrDetnAzi FrntSideRdrRiDetn86RdrDetnChks FrntSideRdrRiDetn86RdrDetnCntr FrntSideRdrRiDetn86RdrDetnConf FrntSideRdrRiDetn86RdrDetnElevn FrntSideRdrRiDetn86RdrDetnPwr FrntSideRdrRiDetn86RdrDetnRng FrntSideRdrRiDetn86RdrDetnRngV FrntSideRdrRiDetn86RdrDetnSts;
SIG_GROUP_ 333 FrntSideRdrRiDetn87 1 : FrntSideRdrRiDetn87RdrDetnAzi FrntSideRdrRiDetn87RdrDetnChks FrntSideRdrRiDetn87RdrDetnCntr FrntSideRdrRiDetn87RdrDetnConf FrntSideRdrRiDetn87RdrDetnElevn FrntSideRdrRiDetn87RdrDetnPwr FrntSideRdrRiDetn87RdrDetnRng FrntSideRdrRiDetn87RdrDetnRngV FrntSideRdrRiDetn87RdrDetnSts;
SIG_GROUP_ 333 FrntSideRdrRiDetn88 1 : FrntSideRdrRiDetn88RdrDetnAzi FrntSideRdrRiDetn88RdrDetnChks FrntSideRdrRiDetn88RdrDetnCntr FrntSideRdrRiDetn88RdrDetnConf FrntSideRdrRiDetn88RdrDetnElevn FrntSideRdrRiDetn88RdrDetnPwr FrntSideRdrRiDetn88RdrDetnRng FrntSideRdrRiDetn88RdrDetnRngV FrntSideRdrRiDetn88RdrDetnSts;
SIG_GROUP_ 333 FrntSideRdrRiDetn89 1 : FrntSideRdrRiDetn89RdrDetnAzi FrntSideRdrRiDetn89RdrDetnChks FrntSideRdrRiDetn89RdrDetnCntr FrntSideRdrRiDetn89RdrDetnConf FrntSideRdrRiDetn89RdrDetnElevn FrntSideRdrRiDetn89RdrDetnPwr FrntSideRdrRiDetn89RdrDetnRng FrntSideRdrRiDetn89RdrDetnRngV FrntSideRdrRiDetn89RdrDetnSts;
SIG_GROUP_ 333 FrntSideRdrRiDetn90 1 : FrntSideRdrRiDetn90RdrDetnAzi FrntSideRdrRiDetn90RdrDetnChks FrntSideRdrRiDetn90RdrDetnCntr FrntSideRdrRiDetn90RdrDetnConf FrntSideRdrRiDetn90RdrDetnElevn FrntSideRdrRiDetn90RdrDetnPwr FrntSideRdrRiDetn90RdrDetnRng FrntSideRdrRiDetn90RdrDetnRngV FrntSideRdrRiDetn90RdrDetnSts;
