VERSION "SafetyCANFD4"

NS_ :

BS_:

BU_: ASDM ETC PAS Vector_XXX

BO_ 384 ASDMSafetyCANFD4Fr06: 64 ASDM
 SG_ DoorDrvrLockSts : 103|2@0+ (1,0) [0|3] ""  PAS
 SG_ DoorDrvrLockSts_UB : 101|1@0+ (1,0) [0|1] ""  PAS
 SG_ DoorLeReLockSts : 100|2@0+ (1,0) [0|3] ""  PAS
 SG_ DoorLeReLockSts_UB : 98|1@0+ (1,0) [0|1] ""  PAS
 SG_ DoorPassLockSts : 111|2@0+ (1,0) [0|3] ""  PAS
 SG_ DoorPassLockSts_UB : 109|1@0+ (1,0) [0|1] ""  PAS
 SG_ DoorRiReLockSts : 108|2@0+ (1,0) [0|3] ""  PAS
 SG_ DoorRiReLockSts_UB : 106|1@0+ (1,0) [0|1] ""  PAS
 SG_ DrvrPrsntSts_UB : 23|1@0+ (1,0) [0|1] ""  PAS
 SG_ DrvrPrsntStsDrvrPrsnt : 7|2@0+ (1,0) [0|3] ""  PAS
 SG_ DrvrPrsntStsDrvrPrsntChks : 15|8@0+ (1,0) [0|255] "Unitless"  PAS
 SG_ DrvrPrsntStsDrvrPrsntCntr : 3|4@0+ (1,0) [0|15] "Unitless"  PAS
 SG_ DrvrPrsntStsDrvrPrsntQf : 5|2@0+ (1,0) [0|3] ""  PAS
 SG_ ExtrLtgSts_UB : 124|1@0+ (1,0) [0|1] ""  PAS
 SG_ ExtrLtgStsAFS : 143|2@0+ (1,0) [0|3] ""  PAS
 SG_ ExtrLtgStsAHBC : 141|2@0+ (1,0) [0|3] ""  PAS
 SG_ ExtrLtgStsAHL : 139|2@0+ (1,0) [0|3] ""  PAS
 SG_ ExtrLtgStsAllWL : 137|2@0+ (1,0) [0|3] ""  PAS
 SG_ ExtrLtgStsApproach : 151|2@0+ (1,0) [0|3] ""  PAS
 SG_ ExtrLtgStsChks : 135|8@0+ (1,0) [0|255] "Unitless"  PAS
 SG_ ExtrLtgStsCntr : 123|4@0+ (1,0) [0|15] "Unitless"  PAS
 SG_ ExtrLtgStsCornrgLi : 149|2@0+ (1,0) [0|3] ""  PAS
 SG_ ExtrLtgStsDBL : 147|2@0+ (1,0) [0|3] ""  PAS
 SG_ ExtrLtgStsDRL : 145|2@0+ (1,0) [0|3] ""  PAS
 SG_ ExtrLtgStsFlash : 159|2@0+ (1,0) [0|3] ""  PAS
 SG_ ExtrLtgStsFrntFog : 157|2@0+ (1,0) [0|3] ""  PAS
 SG_ ExtrLtgStsGoodbye : 155|2@0+ (1,0) [0|3] ""  PAS
 SG_ ExtrLtgStsHiBeam : 153|2@0+ (1,0) [0|3] ""  PAS
 SG_ ExtrLtgStsHomeSafe : 167|2@0+ (1,0) [0|3] ""  PAS
 SG_ ExtrLtgStsHWL : 165|2@0+ (1,0) [0|3] ""  PAS
 SG_ ExtrLtgStsLoBeam : 163|2@0+ (1,0) [0|3] ""  PAS
 SG_ ExtrLtgStsLtgShow : 161|2@0+ (1,0) [0|3] ""  PAS
 SG_ ExtrLtgStsPosLiFrnt : 175|2@0+ (1,0) [0|3] ""  PAS
 SG_ ExtrLtgStsPosLiRe : 173|2@0+ (1,0) [0|3] ""  PAS
 SG_ ExtrLtgStsReFog : 171|2@0+ (1,0) [0|3] ""  PAS
 SG_ ExtrLtgStsReverseLi : 169|2@0+ (1,0) [0|3] ""  PAS
 SG_ ExtrLtgStsStopLi : 183|2@0+ (1,0) [0|3] ""  PAS
 SG_ ExtrLtgStsTurnIndrLe : 181|2@0+ (1,0) [0|3] ""  PAS
 SG_ ExtrLtgStsTurnIndrRi : 179|2@0+ (1,0) [0|3] ""  PAS
 SG_ ExtrLtgStsWelcome : 177|2@0+ (1,0) [0|3] ""  PAS
 SG_ IndcrSts : 22|2@0+ (1,0) [0|3] ""  PAS
 SG_ IndcrSts_UB : 20|1@0+ (1,0) [0|1] ""  PAS
 SG_ TrLockSts : 114|2@0+ (1,0) [0|3] ""  PAS
 SG_ TrLockSts_UB : 105|1@0+ (1,0) [0|1] ""  PAS
 SG_ TrlrPrsnt : 97|1@0+ (1,0) [0|1] ""  PAS
 SG_ TrlrPrsnt_UB : 96|1@0+ (1,0) [0|1] ""  PAS

BO_ 781 AsdmSafetyCANFD4Fr07: 64 ASDM
 SG_ PrkgDstCtrlSysSwt : 142|1@0+ (1,0) [0|1] ""  PAS
 SG_ PrkgDstCtrlSysSwt_UB : 143|1@0+ (1,0) [0|1] ""  PAS
 SG_ PrkgIntrptReldBtn : 130|2@0+ (1,0) [0|3] ""  PAS
 SG_ PrkgIntrptReldBtn_UB : 131|1@0+ (1,0) [0|1] ""  PAS
 SG_ PrkgTypAutBtn : 132|1@0+ (1,0) [0|1] ""  PAS
 SG_ PrkgTypAutBtn_UB : 133|1@0+ (1,0) [0|1] ""  PAS
 SG_ VehCfgPrm_UB : 134|1@0+ (1,0) [0|1] ""  PAS
 SG_ VehCfgPrmBlkIDBytePosn1 : 7|8@0+ (1,0) [0|255] "Unitless"  PAS
 SG_ VehCfgPrmCCPBytePosn2 : 15|8@0+ (1,0) [0|255] "Unitless"  PAS
 SG_ VehCfgPrmCCPBytePosn3 : 23|8@0+ (1,0) [0|255] "Unitless"  PAS
 SG_ VehCfgPrmCCPBytePosn4 : 31|8@0+ (1,0) [0|255] "Unitless"  PAS
 SG_ VehCfgPrmCCPBytePosn5 : 39|8@0+ (1,0) [0|255] "Unitless"  PAS
 SG_ VehCfgPrmCCPBytePosn6 : 47|8@0+ (1,0) [0|255] "Unitless"  PAS
 SG_ VehCfgPrmCCPBytePosn7 : 55|8@0+ (1,0) [0|255] "Unitless"  PAS
 SG_ VehCfgPrmCCPBytePosn8 : 63|8@0+ (1,0) [0|255] "Unitless"  PAS
 SG_ VehCfgPrmExt_UB : 135|1@0+ (1,0) [0|1] ""  PAS
 SG_ VehCfgPrmExtBlkIDBytePosn1 : 71|8@0+ (1,0) [0|255] "Unitless"  PAS
 SG_ VehCfgPrmExtCCPBytePosn2 : 79|8@0+ (1,0) [0|255] "Unitless"  PAS
 SG_ VehCfgPrmExtCCPBytePosn3 : 87|8@0+ (1,0) [0|255] "Unitless"  PAS
 SG_ VehCfgPrmExtCCPBytePosn4 : 95|8@0+ (1,0) [0|255] "Unitless"  PAS
 SG_ VehCfgPrmExtCCPBytePosn5 : 103|8@0+ (1,0) [0|255] "Unitless"  PAS
 SG_ VehCfgPrmExtCCPBytePosn6 : 111|8@0+ (1,0) [0|255] "Unitless"  PAS
 SG_ VehCfgPrmExtCCPBytePosn7 : 119|8@0+ (1,0) [0|255] "Unitless"  PAS
 SG_ VehCfgPrmExtCCPBytePosn8 : 127|8@0+ (1,0) [0|255] "Unitless"  PAS

BO_ 89 ASDMSafetyCANFD4Fr08: 64 ASDM
 SG_ BkpOfDstTrvld : 70|21@0+ (1,0) [0|2000000] "km"  PAS
 SG_ BkpOfDstTrvld_UB : 81|1@0+ (1,0) [0|1] ""  PAS
 SG_ CarTiGlb : 39|32@0+ (0.1,0) [0|429496729.5] "s"  PAS
 SG_ CarTiGlb_UB : 71|1@0+ (1,0) [0|1] ""  PAS
 SG_ VehBattU_UB : 18|1@0+ (1,0) [0|1] ""  PAS
 SG_ VehBattUSysU : 31|8@0+ (0.1,0) [0|25] "Volt"  PAS
 SG_ VehBattUSysUQf : 17|2@0+ (1,0) [0|3] ""  PAS

BO_ 69 ASDMSafetyCANFD4Fr09: 64 ASDM
 SG_ DrvrAsscSysParkMod : 119|4@0+ (1,0) [0|15] ""  PAS
 SG_ DrvrAsscSysParkMod_UB : 115|1@0+ (1,0) [0|1] ""  PAS
 SG_ PlaModReq : 114|1@0+ (1,0) [0|1] ""  PAS
 SG_ PlaModReq_UB : 113|1@0+ (1,0) [0|1] ""  PAS
 SG_ PrkgEmgBrkSysSwt : 0|1@0+ (1,0) [0|1] ""  PAS
 SG_ PrkgEmgBrkSysSwt_UB : 1|1@0+ (1,0) [0|1] ""  PAS
 SG_ PrkgIndcrLineReq_UB : 2|1@0+ (1,0) [0|1] ""  PAS
 SG_ PrkgIndcrLineReqIdPen : 7|4@0+ (1,0) [0|15] ""  PAS
 SG_ PrkgIndcrLineReqOnOff1 : 3|1@0+ (1,0) [0|1] ""  PAS
 SG_ PrkgInOrOutAndCncl : 81|2@0+ (1,0) [0|3] ""  PAS
 SG_ PrkgInOrOutAndCncl_UB : 112|1@0+ (1,0) [0|1] ""  PAS
 SG_ RemPrkgEnaReq : 89|1@0+ (1,0) [0|1] ""  PAS
 SG_ RemPrkgEnaReq_UB : 88|1@0+ (1,0) [0|1] ""  PAS
 SG_ SurrndgsObjDetnReq_UB : 15|1@0+ (1,0) [0|1] ""  PAS
 SG_ SurrndgsObjDetnReqIdPen : 14|4@0+ (1,0) [0|15] ""  PAS
 SG_ SurrndgsObjDetnReqOnOff1 : 10|1@0+ (1,0) [0|1] ""  PAS
 SG_ SwtDispOnAndOffReq : 106|1@0+ (1,0) [0|1] ""  PAS
 SG_ SwtDispOnAndOffReq_UB : 105|1@0+ (1,0) [0|1] ""  PAS
 SG_ ThrDTouringViewReq_UB : 66|1@0+ (1,0) [0|1] ""  PAS
 SG_ ThrDTouringViewReqIdPen : 71|4@0+ (1,0) [0|15] ""  PAS
 SG_ ThrDTouringViewReqOnOff1 : 67|1@0+ (1,0) [0|1] ""  PAS
 SG_ TopVisnDispExtnReq_UB : 74|1@0+ (1,0) [0|1] ""  PAS
 SG_ TopVisnDispExtnReqIdPen : 79|4@0+ (1,0) [0|15] ""  PAS
 SG_ TopVisnDispExtnReqOnOff1 : 75|1@0+ (1,0) [0|1] ""  PAS
 SG_ TurnEntryAgWideVisReq_UB : 82|1@0+ (1,0) [0|1] ""  PAS
 SG_ TurnEntryAgWideVisReqIdPen : 86|4@0+ (1,0) [0|15] ""  PAS
 SG_ TurnEntryAgWideVisReqOnOff1 : 87|1@0+ (1,0) [0|1] ""  PAS
 SG_ VehMdlClrReq_UB : 90|1@0+ (1,0) [0|1] ""  PAS
 SG_ VehMdlClrReqIdPen : 94|4@0+ (1,0) [0|15] ""  PAS
 SG_ VehMdlClrReqOnOff1 : 95|1@0+ (1,0) [0|1] ""  PAS
 SG_ VisnAgExtnReq : 98|1@0+ (1,0) [0|1] ""  PAS
 SG_ VisnAgExtnReq_UB : 97|1@0+ (1,0) [0|1] ""  PAS

BO_ 112 ASDMSafetyCANFD4Fr10: 64 ASDM
 SG_ DvrErrSts : 7|4@0+ (1,0) [0|15] ""  PAS
 SG_ DvrErrSts_UB : 3|1@0+ (1,0) [0|1] ""  PAS
 SG_ DVRSysSts : 39|3@0+ (1,0) [0|7] ""  PAS
 SG_ DVRSysSts_UB : 36|1@0+ (1,0) [0|1] ""  PAS
 SG_ PrkgTouchCoornReq_UB : 2|1@0+ (1,0) [0|1] ""  PAS
 SG_ PrkgTouchCoornReqCoordinateX : 15|11@0+ (1,0) [0|2047] "Unitless"  PAS
 SG_ PrkgTouchCoornReqCoordinateY : 20|11@0+ (1,0) [0|2047] "Unitless"  PAS
 SG_ PrkgTouchCoornReqFingerIndex : 25|2@0+ (1,0) [0|3] ""  PAS
 SG_ PrkgTouchCoornReqTouchEveTyp : 1|2@0+ (1,0) [0|3] ""  PAS

BO_ 1281 AsdmSafetyCanFD4NmFr: 8 ASDM
 SG_ PNC16_ASDM : 16|1@0+ (1,0) [0|0] ""  PAS
 SG_ PNC17_ASDM : 17|1@0+ (1,0) [0|0] ""  PAS
 SG_ PNC18_ASDM : 18|1@0+ (1,0) [0|0] ""  PAS
 SG_ PNC19_ASDM : 19|1@0+ (1,0) [0|0] ""  PAS
 SG_ PNC20_ASDM : 20|1@0+ (1,0) [0|0] ""  PAS
 SG_ PNC21_ASDM : 21|1@0+ (1,0) [0|0] ""  PAS
 SG_ PNC22_ASDM : 22|1@0+ (1,0) [0|0] ""  PAS
 SG_ PNC23_ASDM : 23|1@0+ (1,0) [0|0] ""  PAS
 SG_ PNC24_ASDM : 24|1@0+ (1,0) [0|0] ""  PAS
 SG_ PNC25_ASDM : 25|1@0+ (1,0) [0|0] ""  PAS
 SG_ PNC26_ASDM : 26|1@0+ (1,0) [0|0] ""  PAS
 SG_ PNC27_ASDM : 27|1@0+ (1,0) [0|0] ""  PAS
 SG_ PNC28_ASDM : 28|1@0+ (1,0) [0|0] ""  PAS
 SG_ PNC29_ASDM : 29|1@0+ (1,0) [0|0] ""  PAS
 SG_ PNC30_ASDM : 30|1@0+ (1,0) [0|0] ""  PAS
 SG_ PNC31_ASDM : 31|1@0+ (1,0) [0|0] ""  PAS
 SG_ PNC32_ASDM : 32|1@0+ (1,0) [0|0] ""  PAS
 SG_ PNC33_ASDM : 33|1@0+ (1,0) [0|0] ""  PAS
 SG_ PNC34_ASDM : 34|1@0+ (1,0) [0|0] ""  PAS
 SG_ PNC35_ASDM : 35|1@0+ (1,0) [0|0] ""  PAS
 SG_ PNC36_ASDM : 36|1@0+ (1,0) [0|0] ""  PAS
 SG_ PNC37_ASDM : 37|1@0+ (1,0) [0|0] ""  PAS
 SG_ PNC38_ASDM : 38|1@0+ (1,0) [0|0] ""  PAS
 SG_ PNC39_ASDM : 39|1@0+ (1,0) [0|0] ""  PAS
 SG_ NM_PNI_ASDM : 14|1@0+ (1,0) [0|0] ""  PAS
 SG_ NM_AW_ASDM : 12|1@0+ (1,0) [0|0] ""  PAS
 SG_ NM_CS_ASDM : 11|1@0+ (1,0) [0|0] ""  PAS
 SG_ NM_RMR_ASDM : 8|1@0+ (1,0) [0|0] ""  PAS
 SG_ NM_NodeID_ASDM : 7|8@0+ (1,0) [0|0] ""  PAS

BO_ 2047 AsdmToAllFuncSafetyCanFD4DiagReq: 8 ASDM
 SG_ AsdmToAllFuncSafetyCanFD4DiagReq : 7|64@0+ (1,0) [0|0] ""  PAS

BO_ 1888 AsdmToPasSafetyCanFD4DiagReqFram: 64 ASDM
 SG_ AsdmToPasSafetyCanFD4DiagReqNpdu : 7|512@0+ (1,0) [0|0] ""  PAS

BO_ 1424 PasSafetyCANFD4DevelpFr01: 64 PAS
 SG_ PASdevelpsignalgroup1Functiondev : 7|8@0+ (1,0) [0|255] "Unitless"  ETC
 SG_ PASdevelpsignalgroup1Functi_0000 : 15|8@0+ (1,0) [0|255] "Unitless"  ETC
 SG_ PASdevelpsignalgroup1Functi_0001 : 23|8@0+ (1,0) [0|255] "Unitless"  ETC
 SG_ PASdevelpsignalgroup1Functi_0002 : 31|8@0+ (1,0) [0|255] "Unitless"  ETC
 SG_ PASdevelpsignalgroup1Functi_0003 : 39|8@0+ (1,0) [0|255] "Unitless"  ETC
 SG_ PASdevelpsignalgroup1Functi_0004 : 47|8@0+ (1,0) [0|255] "Unitless"  ETC
 SG_ PASdevelpsignalgroup1Functi_0005 : 55|8@0+ (1,0) [0|255] "Unitless"  ETC
 SG_ PASdevelpsignalgroup1Functi_0006 : 63|8@0+ (1,0) [0|255] "Unitless"  ETC

BO_ 1425 PasSafetyCANFD4DevelpFr02: 64 PAS
 SG_ PASdevelpsignalgroup2Functiondev : 7|8@0+ (1,0) [0|255] "Unitless"  ETC
 SG_ PASdevelpsignalgroup2Functi_0000 : 15|8@0+ (1,0) [0|255] "Unitless"  ETC
 SG_ PASdevelpsignalgroup2Functi_0001 : 23|8@0+ (1,0) [0|255] "Unitless"  ETC
 SG_ PASdevelpsignalgroup2Functi_0002 : 31|8@0+ (1,0) [0|255] "Unitless"  ETC
 SG_ PASdevelpsignalgroup2Functi_0003 : 39|8@0+ (1,0) [0|255] "Unitless"  ETC
 SG_ PASdevelpsignalgroup2Functi_0004 : 47|8@0+ (1,0) [0|255] "Unitless"  ETC
 SG_ PASdevelpsignalgroup2Functi_0005 : 55|8@0+ (1,0) [0|255] "Unitless"  ETC
 SG_ PASdevelpsignalgroup2Functi_0006 : 63|8@0+ (1,0) [0|255] "Unitless"  ETC

BO_ 1426 PasSafetyCANFD4DevelpFr03: 64 PAS
 SG_ PASdevelpsignalgroup3Functiondev : 7|8@0+ (1,0) [0|255] "Unitless"  ETC
 SG_ PASdevelpsignalgroup3Functi_0000 : 15|8@0+ (1,0) [0|255] "Unitless"  ETC
 SG_ PASdevelpsignalgroup3Functi_0001 : 23|8@0+ (1,0) [0|255] "Unitless"  ETC
 SG_ PASdevelpsignalgroup3Functi_0002 : 31|8@0+ (1,0) [0|255] "Unitless"  ETC
 SG_ PASdevelpsignalgroup3Functi_0003 : 39|8@0+ (1,0) [0|255] "Unitless"  ETC
 SG_ PASdevelpsignalgroup3Functi_0004 : 47|8@0+ (1,0) [0|255] "Unitless"  ETC
 SG_ PASdevelpsignalgroup3Functi_0005 : 55|8@0+ (1,0) [0|255] "Unitless"  ETC
 SG_ PASdevelpsignalgroup3Functi_0006 : 63|8@0+ (1,0) [0|255] "Unitless"  ETC

BO_ 96 PASSafetyCANFD4Fr01: 64 PAS
 SG_ EngRunngReqByParkAssi_UB : 174|1@0+ (1,0) [0|1] ""  ASDM
 SG_ EngRunngReqByParkAssi1 : 173|2@0+ (1,0) [0|3] ""  ASDM
 SG_ EngRunngReqByParkAssiChks : 183|8@0+ (1,0) [0|255] "Unitless"  ASDM
 SG_ EngRunngReqByParkAssiCntr : 171|4@0+ (1,0) [0|15] "Unitless"  ASDM
 SG_ FctSt_UB : 247|1@0+ (1,0) [0|1] ""  ASDM
 SG_ FctStDisp : 239|2@0+ (1,0) [0|3] ""  ASDM
 SG_ FctStRemPrkgWarn : 237|6@0+ (1,0) [0|63] ""  ASDM
 SG_ GearPrkgAssiReqGroup_UB : 25|1@0+ (1,0) [0|1] ""  ASDM
 SG_ GearPrkgAssiReqGroupChks : 23|8@0+ (1,0) [0|255] "Unitless"  ASDM
 SG_ GearPrkgAssiReqGroupCntr : 31|4@0+ (1,0) [0|15] "Unitless"  ASDM
 SG_ GearPrkgAssiReqGroupGearPrkgAssi : 27|2@0+ (1,0) [0|3] ""  ASDM
 SG_ ImgSnsrFrntWrg : 39|1@0+ (1,0) [0|1] ""  ASDM
 SG_ ImgSnsrFrntWrg_UB : 38|1@0+ (1,0) [0|1] ""  ASDM
 SG_ MobDevRPAAuthentReq_UB : 191|1@0+ (1,0) [0|1] ""  ASDM
 SG_ MobDevRPAAuthentReqAuthentSts : 190|3@0+ (1,0) [0|7] ""  ASDM
 SG_ MobDevRPAAuthentReqChks : 199|8@0+ (1,0) [0|255] "Unitless"  ASDM
 SG_ MobDevRPAAuthentReqCntr : 187|4@0+ (1,0) [0|15] "Unitless"  ASDM
 SG_ MobDevRPAAuthentReqRndX : 207|8@0+ (1,0) [0|255] "Unitless"  ASDM
 SG_ MobDevRPAAuthentReqRndY : 215|8@0+ (1,0) [0|255] "Unitless"  ASDM
 SG_ NetPASActvt_UB : 57|1@0+ (1,0) [0|1] ""  ASDM
 SG_ NetPASActvtPrio : 56|1@0+ (1,0) [0|1] ""  ASDM
 SG_ NetPASActvtResourceGroup : 71|8@0+ (1,0) [0|255] "Unitless"  ASDM
 SG_ PrkgAsscSysEcuTyp : 103|2@0+ (1,0) [0|3] ""  ASDM
 SG_ PrkgAsscSysEcuTyp_UB : 101|1@0+ (1,0) [0|1] ""  ASDM
 SG_ PrkgAssiElectcStabyProgCtrlModRe : 47|1@0+ (1,0) [0|1] ""  ASDM
 SG_ PrkgAssiElectcStabyProgCtrl_0000 : 55|8@0+ (1,0) [0|255] "Unitless"  ASDM
 SG_ PrkgAssiElectcStabyProgCtrl_0001 : 43|4@0+ (1,0) [0|15] "Unitless"  ASDM
 SG_ PrkgAssiElectcStabyProgCtrl_0002 : 46|3@0+ (1,0) [0|7] ""  ASDM
 SG_ PrkgAssiSysRemPrkgSts : 227|4@0+ (1,0) [0|15] ""  ASDM
 SG_ PrkgAssiSysRemPrkgSts_UB : 96|1@0+ (1,0) [0|1] ""  ASDM
 SG_ PrkgBrkElectcCtrlReq_UB : 6|1@0+ (1,0) [0|1] ""  ASDM
 SG_ PrkgBrkElectcCtrlReqChks : 15|8@0+ (1,0) [0|255] "Unitless"  ASDM
 SG_ PrkgBrkElectcCtrlReqCntr : 3|4@0+ (1,0) [0|15] "Unitless"  ASDM
 SG_ PrkgBrkElectcCtrlReqReq : 5|2@0+ (1,0) [0|3] ""  ASDM
 SG_ PrkgEmgyBrkEmgyBrkReq : 32|1@0+ (1,0) [0|1] ""  ASDM
 SG_ PrkgEmgyBrkEmgyBrkReq_UB : 33|1@0+ (1,0) [0|1] ""  ASDM
 SG_ PrkgEmgyBrkEpbApplyReq : 162|1@0+ (1,0) [0|1] ""  ASDM
 SG_ PrkgEmgyBrkEpbApplyReq_UB : 163|1@0+ (1,0) [0|1] ""  ASDM
 SG_ PrkgEmgyBrkStandStillReq : 98|1@0+ (1,0) [0|1] ""  ASDM
 SG_ PrkgEmgyBrkStandStillReq_UB : 97|1@0+ (1,0) [0|1] ""  ASDM
 SG_ PrkgSpdCtrlSafeGroup_UB : 152|1@0+ (1,0) [0|1] ""  ASDM
 SG_ PrkgSpdCtrlSafeGroupChks : 111|8@0+ (1,0) [0|255] "Unitless"  ASDM
 SG_ PrkgSpdCtrlSafeGroupCntr : 119|4@0+ (1,0) [0|15] "Unitless"  ASDM
 SG_ PrkgSpdCtrlSafeGroupDrvrAsscSysB : 115|2@0+ (1,0) [0|3] ""  ASDM
 SG_ PrkgSpdCtrlSafeGroupPrkgAssiALow : 127|8@0+ (0.01,-1.28) [-1.28|1.27] "m/s^2"  ASDM
 SG_ PrkgSpdCtrlSafeGroupPrkgAss_0000 : 151|7@0+ (0.1,-12.7) [-12.7|1.776E-015] "m/s^3"  ASDM
 SG_ PrkgSpdCtrlSafeGroupPrkgAssiAReq : 135|8@0+ (0.01,-1.28) [-1.28|1.27] "m/s^2"  ASDM
 SG_ PrkgSpdCtrlSafeGroupPrkgAssiAUpp : 143|8@0+ (0.01,-1.28) [-1.28|1.27] "m/s^2"  ASDM
 SG_ PrkgSpdCtrlSafeGroupPrkgAss_0001 : 159|7@0+ (0.1,0) [0|12.7] "m/s^3"  ASDM
 SG_ PrkgStandstillReq_UB : 82|1@0+ (1,0) [0|1] ""  ASDM
 SG_ PrkgStandstillReqChks : 79|8@0+ (1,0) [0|255] "Unitless"  ASDM
 SG_ PrkgStandstillReqCntr : 87|4@0+ (1,0) [0|15] "Unitless"  ASDM
 SG_ PrkgStandstillReqReqSts1 : 83|1@0+ (1,0) [0|1] ""  ASDM
 SG_ PrkgUsgDrvModTranReq : 80|1@0+ (1,0) [0|1] ""  ASDM
 SG_ PrkgUsgDrvModTranReq_UB : 81|1@0+ (1,0) [0|1] ""  ASDM
 SG_ VehBeamLoModReq : 95|2@0+ (1,0) [0|3] ""  ASDM
 SG_ VehBeamLoModReq_UB : 93|1@0+ (1,0) [0|1] ""  ASDM
 SG_ VehPrkgToHorn : 246|1@0+ (1,0) [0|1] ""  ASDM
 SG_ VehPrkgToHorn_UB : 245|1@0+ (1,0) [0|1] ""  ASDM

BO_ 528 PASSafetyCANFD4Fr02: 64 PAS
 SG_ AudWarnOfSnsrParkAssiFrnt : 22|4@0+ (1,0) [0|15] ""  ASDM
 SG_ AudWarnOfSnsrParkAssiFrnt_UB : 23|1@0+ (1,0) [0|1] ""  ASDM
 SG_ AudWarnOfSnsrParkAssiRe : 51|4@0+ (1,0) [0|15] ""  ASDM
 SG_ AudWarnOfSnsrParkAssiRe_UB : 52|1@0+ (1,0) [0|1] ""  ASDM
 SG_ DispAndSwtOfPrkgMod : 91|4@0+ (1,0) [0|15] ""  ASDM
 SG_ DispAndSwtOfPrkgMod_UB : 136|1@0+ (1,0) [0|1] ""  ASDM
 SG_ DispPrkgStallBtn : 26|1@0+ (1,0) [0|1] ""  ASDM
 SG_ DispPrkgStallBtn_UB : 25|1@0+ (1,0) [0|1] ""  ASDM
 SG_ FrntLeOfSnsrOfPrkgAssiSide : 6|3@0+ (1,0) [0|7] ""  ASDM
 SG_ FrntLeOfSnsrOfPrkgAssiSide_UB : 7|1@0+ (1,0) [0|1] ""  ASDM
 SG_ FrntRiOfSnsrOfPrkgAssiSide : 2|3@0+ (1,0) [0|7] ""  ASDM
 SG_ FrntRiOfSnsrOfPrkgAssiSide_UB : 3|1@0+ (1,0) [0|1] ""  ASDM
 SG_ ImgSnsrLeWrg : 151|1@0+ (1,0) [0|1] ""  ASDM
 SG_ ImgSnsrLeWrg_UB : 150|1@0+ (1,0) [0|1] ""  ASDM
 SG_ InsdLeOfSnsrPrkgAssiFrnt : 58|3@0+ (1,0) [0|7] ""  ASDM
 SG_ InsdLeOfSnsrPrkgAssiFrnt_UB : 241|1@0+ (1,0) [0|1] ""  ASDM
 SG_ InsdLeOfSnsrPrkgAssiRe : 87|3@0+ (1,0) [0|7] ""  ASDM
 SG_ InsdLeOfSnsrPrkgAssiRe_UB : 247|1@0+ (1,0) [0|1] ""  ASDM
 SG_ InsdRiOfSnsrPrkgAssiFrnt : 70|3@0+ (1,0) [0|7] ""  ASDM
 SG_ InsdRiOfSnsrPrkgAssiFrnt_UB : 242|1@0+ (1,0) [0|1] ""  ASDM
 SG_ InsdRiOfSnsrPrkgAssiRe : 84|3@0+ (1,0) [0|7] ""  ASDM
 SG_ InsdRiOfSnsrPrkgAssiRe_UB : 232|1@0+ (1,0) [0|1] ""  ASDM
 SG_ OutdLeOfSnsrPrkgAssiFrnt : 67|3@0+ (1,0) [0|7] ""  ASDM
 SG_ OutdLeOfSnsrPrkgAssiFrnt_UB : 243|1@0+ (1,0) [0|1] ""  ASDM
 SG_ OutdLeOfSnsrPrkgAssiRe : 81|3@0+ (1,0) [0|7] ""  ASDM
 SG_ OutdLeOfSnsrPrkgAssiRe_UB : 233|1@0+ (1,0) [0|1] ""  ASDM
 SG_ OutdRiOfSnsrPrkgAssiFrnt : 61|3@0+ (1,0) [0|7] ""  ASDM
 SG_ OutdRiOfSnsrPrkgAssiFrnt_UB : 244|1@0+ (1,0) [0|1] ""  ASDM
 SG_ OutdRiOfSnsrPrkgAssiRe : 94|3@0+ (1,0) [0|7] ""  ASDM
 SG_ OutdRiOfSnsrPrkgAssiRe_UB : 234|1@0+ (1,0) [0|1] ""  ASDM
 SG_ PrkgBackDisp : 315|1@0+ (1,0) [0|1] ""  ASDM
 SG_ PrkgBackDisp_UB : 314|1@0+ (1,0) [0|1] ""  ASDM
 SG_ PrkgEmgyBrkFltDisp : 31|2@0+ (1,0) [0|3] ""  ASDM
 SG_ PrkgEmgyBrkFltDisp_UB : 27|1@0+ (1,0) [0|1] ""  ASDM
 SG_ PrkgProgsDisp : 103|7@0+ (1,0) [0|127] "%"  ASDM
 SG_ PrkgProgsDisp_UB : 96|1@0+ (1,0) [0|1] ""  ASDM
 SG_ ReLeOfSnsrOfPrkgAssiSide : 42|3@0+ (1,0) [0|7] ""  ASDM
 SG_ ReLeOfSnsrOfPrkgAssiSide_UB : 43|1@0+ (1,0) [0|1] ""  ASDM
 SG_ ReRiOfSnsrOfPrkgAssiSide : 18|3@0+ (1,0) [0|7] ""  ASDM
 SG_ ReRiOfSnsrOfPrkgAssiSide_UB : 64|1@0+ (1,0) [0|1] ""  ASDM
 SG_ ValtPrkgFailrNotif : 177|1@0+ (1,0) [0|1] ""  ASDM
 SG_ ValtPrkgFailrNotif_UB : 176|1@0+ (1,0) [0|1] ""  ASDM
 SG_ ValtSysSts : 175|5@0+ (1,0) [0|31] ""  ASDM
 SG_ ValtSysSts_UB : 170|1@0+ (1,0) [0|1] ""  ASDM
 SG_ VehHomePrkgSysSts : 183|5@0+ (1,0) [0|31] ""  ASDM
 SG_ VehHomePrkgSysSts_UB : 178|1@0+ (1,0) [0|1] ""  ASDM
 SG_ VehPrkgLockTheftReq : 191|2@0+ (1,0) [0|3] ""  ASDM
 SG_ VehPrkgLockTheftReq_UB : 189|1@0+ (1,0) [0|1] ""  ASDM
 SG_ VehWinSunRoofClsReq : 188|2@0+ (1,0) [0|3] ""  ASDM
 SG_ VehWinSunRoofClsReq_UB : 186|1@0+ (1,0) [0|1] ""  ASDM

BO_ 821 PASSafetyCANFD4Fr03: 64 PAS
 SG_ DstToCllsnOfPrkgEmgyBrk : 7|13@0+ (1,0) [0|8191] "mm"  ASDM
 SG_ DstToCllsnOfPrkgEmgyBrk_UB : 10|1@0+ (1,0) [0|1] ""  ASDM
 SG_ ImgSnsrClrReq_UB : 19|1@0+ (1,0) [0|1] ""  ASDM
 SG_ ImgSnsrClrReqFrnt : 23|1@0+ (1,0) [0|1] ""  ASDM
 SG_ ImgSnsrClrReqLe : 22|1@0+ (1,0) [0|1] ""  ASDM
 SG_ ImgSnsrClrReqRe : 21|1@0+ (1,0) [0|1] ""  ASDM
 SG_ ImgSnsrClrReqRi : 20|1@0+ (1,0) [0|1] ""  ASDM
 SG_ MirrOpenClsReq : 17|2@0+ (1,0) [0|3] ""  ASDM
 SG_ MirrOpenClsReq_UB : 18|1@0+ (1,0) [0|1] ""  ASDM
 SG_ MobDevRPASts_UB : 46|1@0+ (1,0) [0|1] ""  ASDM
 SG_ MobDevRPAStsOnOff1 : 47|1@0+ (1,0) [0|1] ""  ASDM
 SG_ MobDevRPAStsUInt8 : 39|8@0+ (1,0) [0|255] "Unitless"  ASDM
 SG_ PrkgFctDiDisp : 44|5@0+ (1,0) [0|31] ""  ASDM
 SG_ PrkgFctDiDisp_UB : 45|1@0+ (1,0) [0|1] ""  ASDM

BO_ 529 PASSafetyCANFD4Fr04: 64 PAS
 SG_ InsdSnsrDstFrntShoLe : 15|9@0+ (1,0) [0|511] "cm"  ASDM
 SG_ InsdSnsrDstFrntShoLe_UB : 22|1@0+ (1,0) [0|1] ""  ASDM
 SG_ InsdSnsrDstFrntShoRi : 16|9@0+ (1,0) [0|511] "cm"  ASDM
 SG_ InsdSnsrDstFrntShoRi_UB : 45|1@0+ (1,0) [0|1] ""  ASDM
 SG_ InsdSnsrDstReShoLe : 39|9@0+ (1,0) [0|511] "cm"  ASDM
 SG_ InsdSnsrDstReShoLe_UB : 46|1@0+ (1,0) [0|1] ""  ASDM
 SG_ InsdSnsrDstReShoRi : 40|9@0+ (1,0) [0|511] "cm"  ASDM
 SG_ InsdSnsrDstReShoRi_UB : 63|1@0+ (1,0) [0|1] ""  ASDM
 SG_ InsdSnsrFltFrntShoLe : 183|2@0+ (1,0) [0|3] ""  ASDM
 SG_ InsdSnsrFltFrntShoLe_UB : 181|1@0+ (1,0) [0|1] ""  ASDM
 SG_ InsdSnsrFltFrntShoRi : 180|2@0+ (1,0) [0|3] ""  ASDM
 SG_ InsdSnsrFltFrntShoRi_UB : 178|1@0+ (1,0) [0|1] ""  ASDM
 SG_ InsdSnsrFltReShoLe : 177|2@0+ (1,0) [0|3] ""  ASDM
 SG_ InsdSnsrFltReShoLe_UB : 168|1@0+ (1,0) [0|1] ""  ASDM
 SG_ InsdSnsrFltReShoRi : 7|2@0+ (1,0) [0|3] ""  ASDM
 SG_ InsdSnsrFltReShoRi_UB : 5|1@0+ (1,0) [0|1] ""  ASDM
 SG_ ObjOnIfOfSnsr : 174|2@0+ (1,0) [0|3] ""  ASDM
 SG_ ObjOnIfOfSnsr_UB : 175|1@0+ (1,0) [0|1] ""  ASDM
 SG_ OutdSnsrDstFrntShoLe : 71|9@0+ (1,0) [0|511] "cm"  ASDM
 SG_ OutdSnsrDstFrntShoLe_UB : 78|1@0+ (1,0) [0|1] ""  ASDM
 SG_ OutdSnsrDstFrntShoRi : 129|9@0+ (1,0) [0|511] "cm"  ASDM
 SG_ OutdSnsrDstFrntShoRi_UB : 136|1@0+ (1,0) [0|1] ""  ASDM
 SG_ OutdSnsrDstReShoLe : 122|9@0+ (1,0) [0|511] "cm"  ASDM
 SG_ OutdSnsrDstReShoLe_UB : 151|1@0+ (1,0) [0|1] ""  ASDM
 SG_ OutdSnsrDstReShoRi : 115|9@0+ (1,0) [0|511] "cm"  ASDM
 SG_ OutdSnsrDstReShoRi_UB : 150|1@0+ (1,0) [0|1] ""  ASDM
 SG_ OutdSnsrFltFrntShoLe : 4|2@0+ (1,0) [0|3] ""  ASDM
 SG_ OutdSnsrFltFrntShoLe_UB : 2|1@0+ (1,0) [0|1] ""  ASDM
 SG_ OutdSnsrFltFrntShoRi : 191|2@0+ (1,0) [0|3] ""  ASDM
 SG_ OutdSnsrFltFrntShoRi_UB : 1|1@0+ (1,0) [0|1] ""  ASDM
 SG_ OutdSnsrFltReShoLe : 189|2@0+ (1,0) [0|3] ""  ASDM
 SG_ OutdSnsrFltReShoLe_UB : 0|1@0+ (1,0) [0|1] ""  ASDM
 SG_ OutdSnsrFltReShoRi : 187|2@0+ (1,0) [0|3] ""  ASDM
 SG_ OutdSnsrFltReShoRi_UB : 185|1@0+ (1,0) [0|1] ""  ASDM
 SG_ PrkgDstCtrlWarn : 160|1@0+ (1,0) [0|1] ""  ASDM
 SG_ PrkgDstCtrlWarn_UB : 161|1@0+ (1,0) [0|1] ""  ASDM
 SG_ SnsrDstFrntShoSideLe : 87|9@0+ (1,0) [0|511] "cm"  ASDM
 SG_ SnsrDstFrntShoSideLe_UB : 149|1@0+ (1,0) [0|1] ""  ASDM
 SG_ SnsrDstFrntShoSideRi : 94|9@0+ (1,0) [0|511] "cm"  ASDM
 SG_ SnsrDstFrntShoSideRi_UB : 148|1@0+ (1,0) [0|1] ""  ASDM
 SG_ SnsrDstReShoSideLe : 101|9@0+ (1,0) [0|511] "cm"  ASDM
 SG_ SnsrDstReShoSideLe_UB : 147|1@0+ (1,0) [0|1] ""  ASDM
 SG_ SnsrDstReShoSideRi : 108|9@0+ (1,0) [0|511] "cm"  ASDM
 SG_ SnsrDstReShoSideRi_UB : 146|1@0+ (1,0) [0|1] ""  ASDM
 SG_ SnsrFltFrntShoSideLe : 199|2@0+ (1,0) [0|3] ""  ASDM
 SG_ SnsrFltFrntShoSideLe_UB : 197|1@0+ (1,0) [0|1] ""  ASDM
 SG_ SnsrFltFrntShoSideRi : 196|2@0+ (1,0) [0|3] ""  ASDM
 SG_ SnsrFltFrntShoSideRi_UB : 192|1@0+ (1,0) [0|1] ""  ASDM
 SG_ SnsrFltOfPrkgDstCtrl : 20|2@0+ (1,0) [0|3] ""  ASDM
 SG_ SnsrFltOfPrkgDstCtrl_UB : 21|1@0+ (1,0) [0|1] ""  ASDM
 SG_ SnsrFltReShoSideLe : 60|2@0+ (1,0) [0|3] ""  ASDM
 SG_ SnsrFltReShoSideLe_UB : 57|1@0+ (1,0) [0|1] ""  ASDM
 SG_ SnsrFltReShoSideRi : 194|2@0+ (1,0) [0|3] ""  ASDM
 SG_ SnsrFltReShoSideRi_UB : 184|1@0+ (1,0) [0|1] ""  ASDM

BO_ 587 PASSafetyCANFD4Fr15: 64 PAS
 SG_ DrvrAsscSysDisp : 71|7@0+ (1,0) [0|127] ""  ASDM
 SG_ DrvrAsscSysDisp_UB : 64|1@0+ (1,0) [0|1] ""  ASDM
 SG_ MobDevFctStTip : 15|4@0+ (1,0) [0|15] ""  ASDM
 SG_ MobDevFctStTip_UB : 11|1@0+ (1,0) [0|1] ""  ASDM
 SG_ PdcMuteBtnSts : 23|1@0+ (1,0) [0|1] ""  ASDM
 SG_ PdcMuteBtnSts_UB : 22|1@0+ (1,0) [0|1] ""  ASDM
 SG_ PlaModStsResp : 10|1@0+ (1,0) [0|1] ""  ASDM
 SG_ PlaModStsResp_UB : 9|1@0+ (1,0) [0|1] ""  ASDM
 SG_ PrkgAuxInfoDisp : 438|4@0+ (1,0) [0|15] ""  ASDM
 SG_ PrkgAuxInfoDisp_UB : 439|1@0+ (1,0) [0|1] ""  ASDM
 SG_ PrkgDispGroup_UB : 21|1@0+ (1,0) [0|1] ""  ASDM
 SG_ PrkgDispGroupLeCornrCoornx : 31|6@0+ (1,-20) [-20|43] "Unitless"  ASDM
 SG_ PrkgDispGroupLeCornrCoorny : 20|5@0+ (1,-5) [-5|26] "Unitless"  ASDM
 SG_ PrkgDispGroupLeCornrLocn : 25|2@0+ (1,0) [0|3] ""  ASDM
 SG_ PrkgDispGroupPrkgTyp : 39|3@0+ (1,0) [0|7] ""  ASDM
 SG_ PrkgDispGroupRiCornrCoornx : 47|6@0+ (1,-20) [-20|43] "Unitless"  ASDM
 SG_ PrkgDispGroupRiCornrCoorny : 36|5@0+ (1,-5) [-5|26] "Unitless"  ASDM
 SG_ PrkgDispGroupStallNr : 41|2@0+ (1,0) [0|3] "Unitless"  ASDM
 SG_ PrkgDstCtrlSts : 95|4@0+ (1,0) [0|15] ""  ASDM
 SG_ PrkgDstCtrlSts_UB : 91|1@0+ (1,0) [0|1] ""  ASDM
 SG_ PrkgEmgyBrkWarn : 3|3@0+ (1,0) [0|7] ""  ASDM
 SG_ PrkgEmgyBrkWarn_UB : 0|1@0+ (1,0) [0|1] ""  ASDM
 SG_ PrkgImgDispReq : 7|3@0+ (1,0) [0|7] ""  ASDM
 SG_ PrkgImgDispReq_UB : 4|1@0+ (1,0) [0|1] ""  ASDM
 SG_ PrkgIndcrLineResp : 82|1@0+ (1,0) [0|1] ""  ASDM
 SG_ PrkgIndcrLineResp_UB : 81|1@0+ (1,0) [0|1] ""  ASDM
 SG_ PrkgOutModBtnSts_UB : 83|1@0+ (1,0) [0|1] ""  ASDM
 SG_ PrkgOutModBtnSts1 : 79|2@0+ (1,0) [0|3] ""  ASDM
 SG_ PrkgOutModBtnSts2 : 77|2@0+ (1,0) [0|3] ""  ASDM
 SG_ PrkgOutModBtnSts3 : 75|2@0+ (1,0) [0|3] ""  ASDM
 SG_ PrkgOutModBtnSts4 : 73|2@0+ (1,0) [0|3] ""  ASDM
 SG_ PrkgOutModBtnSts5 : 87|2@0+ (1,0) [0|3] ""  ASDM
 SG_ PrkgOutModBtnSts6 : 85|2@0+ (1,0) [0|3] ""  ASDM
 SG_ PrkgOutModBtnStsToAPP_UB : 52|1@0+ (1,0) [0|1] ""  ASDM
 SG_ PrkgOutModBtnStsToAPPPrkgOutModB : 51|2@0+ (1,0) [0|3] ""  ASDM
 SG_ PrkgOutModBtnStsToAPPPrkgOu_0000 : 49|2@0+ (1,0) [0|3] ""  ASDM
 SG_ PrkgOutModBtnStsToAPPPrkgOu_0001 : 63|2@0+ (1,0) [0|3] ""  ASDM
 SG_ PrkgOutModBtnStsToAPPPrkgOu_0002 : 61|2@0+ (1,0) [0|3] ""  ASDM
 SG_ PrkgOutModBtnStsToAPPPrkgOu_0003 : 59|2@0+ (1,0) [0|3] ""  ASDM
 SG_ PrkgOutModBtnStsToAPPPrkgOu_0004 : 57|2@0+ (1,0) [0|3] ""  ASDM
 SG_ PrkgStopAudWarnReq : 442|1@0+ (1,0) [0|1] ""  ASDM
 SG_ PrkgStopAudWarnReq_UB : 441|1@0+ (1,0) [0|1] ""  ASDM
 SG_ PrkgTypAutBtnCfmd : 425|1@0+ (1,0) [0|1] ""  ASDM
 SG_ PrkgTypAutBtnCfmd_UB : 426|1@0+ (1,0) [0|1] ""  ASDM
 SG_ RemPrkgEnaSts : 90|1@0+ (1,0) [0|1] ""  ASDM
 SG_ RemPrkgEnaSts_UB : 89|1@0+ (1,0) [0|1] ""  ASDM
 SG_ SurrndgsObjDetnResp : 99|1@0+ (1,0) [0|1] ""  ASDM
 SG_ SurrndgsObjDetnResp_UB : 98|1@0+ (1,0) [0|1] ""  ASDM
 SG_ SwtDispOnAndOffStsResp : 103|4@0+ (1,0) [0|15] ""  ASDM
 SG_ SwtDispOnAndOffStsResp_UB : 88|1@0+ (1,0) [0|1] ""  ASDM
 SG_ ThrDTouringViewResp : 97|1@0+ (1,0) [0|1] ""  ASDM
 SG_ ThrDTouringViewResp_UB : 96|1@0+ (1,0) [0|1] ""  ASDM
 SG_ TopVisnDispExtnResp : 111|1@0+ (1,0) [0|1] ""  ASDM
 SG_ TopVisnDispExtnResp_UB : 110|1@0+ (1,0) [0|1] ""  ASDM
 SG_ TurnEntryAgWideVisResp : 109|1@0+ (1,0) [0|1] ""  ASDM
 SG_ TurnEntryAgWideVisResp_UB : 108|1@0+ (1,0) [0|1] ""  ASDM
 SG_ VehMdlClrResp : 107|1@0+ (1,0) [0|1] ""  ASDM
 SG_ VehMdlClrResp_UB : 106|1@0+ (1,0) [0|1] ""  ASDM
 SG_ VisnAgExtnResp : 105|1@0+ (1,0) [0|1] ""  ASDM
 SG_ VisnAgExtnResp_UB : 104|1@0+ (1,0) [0|1] ""  ASDM
 SG_ VisnImgDispModResp : 447|5@0+ (1,0) [0|31] ""  ASDM
 SG_ VisnImgDispModResp_UB : 440|1@0+ (1,0) [0|1] ""  ASDM

BO_ 784 PASSafetyCANFD4Fr18: 64 PAS
 SG_ MonrSysSts : 7|3@0+ (1,0) [0|7] ""  ASDM
 SG_ MonrSysSts_UB : 1|1@0+ (1,0) [0|1] ""  ASDM

BO_ 1105 PASSafetyCANFD4Fr19: 64 PAS
 SG_ InhbCdnOfPrkgEmgyBrk : 7|6@0+ (1,0) [0|63] ""  ASDM
 SG_ InhbCdnOfPrkgEmgyBrk_UB : 1|1@0+ (1,0) [0|1] ""  ASDM

BO_ 274 PASSafetyCANFD4Fr20: 64 PAS
 SG_ DrvrAsscSysIndcrReq : 231|2@0+ (1,0) [0|3] ""  ASDM
 SG_ DrvrAsscSysIndcrReq_UB : 229|1@0+ (1,0) [0|1] ""  ASDM
 SG_ DrvrAsscSysSts : 223|4@0+ (1,0) [0|15] ""  ASDM
 SG_ DrvrAsscSysSts_UB : 217|1@0+ (1,0) [0|1] ""  ASDM
 SG_ ImgSnsrReWrg : 228|1@0+ (1,0) [0|1] ""  ASDM
 SG_ ImgSnsrReWrg_UB : 226|1@0+ (1,0) [0|1] ""  ASDM
 SG_ ImgSnsrRiWrg : 227|1@0+ (1,0) [0|1] ""  ASDM
 SG_ ImgSnsrRiWrg_UB : 225|1@0+ (1,0) [0|1] ""  ASDM
 SG_ LineDetnPptyLe_UB : 104|1@0+ (1,0) [0|1] ""  ASDM
 SG_ LineDetnPptyLeAgOffCenAndLine : 49|9@0+ (0.01,-2) [-2|2] "rad"  ASDM
 SG_ LineDetnPptyLeChks : 23|8@0+ (1,0) [0|255] "Unitless"  ASDM
 SG_ LineDetnPptyLeCntr : 31|4@0+ (1,0) [0|15] "Unitless"  ASDM
 SG_ LineDetnPptyLeDstVertCenAndLine : 47|11@0+ (0.01,0) [0|11] "m"  ASDM
 SG_ LineDetnPptyLeLineCrvt : 111|7@0+ (0.001,-0.032) [-0.032|0.032] "1/m"  ASDM
 SG_ LineDetnPptyLeLineDetdDe : 39|8@0+ (1,0) [0|100] "%"  ASDM
 SG_ LineDetnPptyLeLineDetdEfc : 24|1@0+ (1,0) [0|1] ""  ASDM
 SG_ LineDetnPptyLeLineTintg : 27|3@0+ (1,0) [0|7] ""  ASDM
 SG_ LineDetnPptyLeLineTyp : 52|3@0+ (1,0) [0|7] ""  ASDM
 SG_ LineDetnPptyLeLineWidth : 103|7@0+ (0.01,0) [0|0.63] "m"  ASDM
 SG_ LineDetnPptyLeTiStamp : 71|32@0+ (0.0001,0) [0|429496.7295] "s"  ASDM
 SG_ LineDetnPptyRi_UB : 201|1@0+ (1,0) [0|1] ""  ASDM
 SG_ LineDetnPptyRiAgOffCenAndLine : 160|9@0+ (0.01,-2) [-2|2] "rad"  ASDM
 SG_ LineDetnPptyRiChks : 119|8@0+ (1,0) [0|255] "Unitless"  ASDM
 SG_ LineDetnPptyRiCntr : 127|4@0+ (1,0) [0|15] "Unitless"  ASDM
 SG_ LineDetnPptyRiDstVertCenAndLine : 199|11@0+ (0.01,0) [0|11] "m"  ASDM
 SG_ LineDetnPptyRiLineCrvt : 167|7@0+ (0.001,-0.032) [-0.032|0.032] "1/m"  ASDM
 SG_ LineDetnPptyRiLineDetdDe : 183|8@0+ (1,0) [0|100] "%"  ASDM
 SG_ LineDetnPptyRiLineDetdEfc : 120|1@0+ (1,0) [0|1] ""  ASDM
 SG_ LineDetnPptyRiLineTintg : 123|3@0+ (1,0) [0|7] ""  ASDM
 SG_ LineDetnPptyRiLineTyp : 204|3@0+ (1,0) [0|7] ""  ASDM
 SG_ LineDetnPptyRiLineWidth : 191|7@0+ (0.01,0) [0|0.63] "m"  ASDM
 SG_ LineDetnPptyRiTiStamp : 135|32@0+ (0.0001,0) [0|429496.7295] "s"  ASDM
 SG_ PrkgEmgyBrkSysSts : 239|4@0+ (1,0) [0|15] ""  ASDM
 SG_ PrkgEmgyBrkSysSts_UB : 235|1@0+ (1,0) [0|1] ""  ASDM
 SG_ PrkgLockReq : 234|2@0+ (1,0) [0|3] ""  ASDM
 SG_ PrkgLockReq_UB : 232|1@0+ (1,0) [0|1] ""  ASDM

BO_ 1282 PasSafetyCanFD4NmFr: 8 PAS
 SG_ PNC16_PAS : 16|1@0+ (1,0) [0|0] ""  ASDM
 SG_ PNC17_PAS : 17|1@0+ (1,0) [0|0] ""  ASDM
 SG_ PNC18_PAS : 18|1@0+ (1,0) [0|0] ""  ASDM
 SG_ PNC19_PAS : 19|1@0+ (1,0) [0|0] ""  ASDM
 SG_ PNC20_PAS : 20|1@0+ (1,0) [0|0] ""  ASDM
 SG_ PNC21_PAS : 21|1@0+ (1,0) [0|0] ""  ASDM
 SG_ PNC22_PAS : 22|1@0+ (1,0) [0|0] ""  ASDM
 SG_ PNC23_PAS : 23|1@0+ (1,0) [0|0] ""  ASDM
 SG_ PNC24_PAS : 24|1@0+ (1,0) [0|0] ""  ASDM
 SG_ PNC25_PAS : 25|1@0+ (1,0) [0|0] ""  ASDM
 SG_ PNC26_PAS : 26|1@0+ (1,0) [0|0] ""  ASDM
 SG_ PNC27_PAS : 27|1@0+ (1,0) [0|0] ""  ASDM
 SG_ PNC28_PAS : 28|1@0+ (1,0) [0|0] ""  ASDM
 SG_ PNC29_PAS : 29|1@0+ (1,0) [0|0] ""  ASDM
 SG_ PNC30_PAS : 30|1@0+ (1,0) [0|0] ""  ASDM
 SG_ PNC31_PAS : 31|1@0+ (1,0) [0|0] ""  ASDM
 SG_ PNC32_PAS : 32|1@0+ (1,0) [0|0] ""  ASDM
 SG_ PNC33_PAS : 33|1@0+ (1,0) [0|0] ""  ASDM
 SG_ PNC34_PAS : 34|1@0+ (1,0) [0|0] ""  ASDM
 SG_ PNC35_PAS : 35|1@0+ (1,0) [0|0] ""  ASDM
 SG_ PNC36_PAS : 36|1@0+ (1,0) [0|0] ""  ASDM
 SG_ PNC37_PAS : 37|1@0+ (1,0) [0|0] ""  ASDM
 SG_ PNC38_PAS : 38|1@0+ (1,0) [0|0] ""  ASDM
 SG_ PNC39_PAS : 39|1@0+ (1,0) [0|0] ""  ASDM
 SG_ NM_PNI_PAS : 14|1@0+ (1,0) [0|0] ""  ASDM
 SG_ NM_AW_PAS : 12|1@0+ (1,0) [0|0] ""  ASDM
 SG_ NM_CS_PAS : 11|1@0+ (1,0) [0|0] ""  ASDM
 SG_ NM_RMR_PAS : 8|1@0+ (1,0) [0|0] ""  ASDM
 SG_ NM_NodeID_PAS : 7|8@0+ (1,0) [0|0] ""  ASDM

BO_ 1632 PasToAsdmSafetyCanFD4DiagResFram: 64 PAS
 SG_ PasToAsdmSafetyCanFD4DiagResNpdu : 7|512@0+ (1,0) [0|0] ""  ASDM

CM_ SG_ 384 DoorDrvrLockSts "DoorDrvrLockSts - Driver Door Lock Status
Lock status
LockStsUkwn - Lock Status Unknown
Unlckd - Unlocked
Lockd - Locked
SafeLockd - Safe Locked (Double Locked)";
CM_ SG_ 384 DoorLeReLockSts "DoorLeReLockSts - Left Rear Door Lock Status
Lock status
LockStsUkwn - Lock Status Unknown
Unlckd - Unlocked
Lockd - Locked
SafeLockd - Safe Locked (Double Locked)";
CM_ SG_ 384 DoorPassLockSts "DoorPassLockSts - Passenger Door Lock Status
Lock status
LockStsUkwn - Lock Status Unknown
Unlckd - Unlocked
Lockd - Locked
SafeLockd - Safe Locked (Double Locked)";
CM_ SG_ 384 DoorRiReLockSts "DoorRiReLockSts - Right Rear Door Lock Status
Lock status
LockStsUkwn - Lock Status Unknown
Unlckd - Unlocked
Lockd - Locked
SafeLockd - Safe Locked (Double Locked)";
CM_ SG_ 384 DrvrPrsntStsDrvrPrsnt "Driver present";
CM_ SG_ 384 DrvrPrsntStsDrvrPrsntChks "Checksum";
CM_ SG_ 384 DrvrPrsntStsDrvrPrsntCntr "Counter";
CM_ SG_ 384 DrvrPrsntStsDrvrPrsntQf "Driver present";
CM_ SG_ 384 ExtrLtgStsAFS "AFS status";
CM_ SG_ 384 ExtrLtgStsAHBC "AHBC Status";
CM_ SG_ 384 ExtrLtgStsAHL "AHL Status";
CM_ SG_ 384 ExtrLtgStsAllWL "All Weather Light Status";
CM_ SG_ 384 ExtrLtgStsApproach "Approach Light Status";
CM_ SG_ 384 ExtrLtgStsChks "Checksum";
CM_ SG_ 384 ExtrLtgStsCntr "Counter";
CM_ SG_ 384 ExtrLtgStsCornrgLi "Cornering Light Status";
CM_ SG_ 384 ExtrLtgStsDBL "DBL Stataus";
CM_ SG_ 384 ExtrLtgStsDRL "DRL Status";
CM_ SG_ 384 ExtrLtgStsFlash "Flash Light Status";
CM_ SG_ 384 ExtrLtgStsFrntFog "Front Fog Light Status";
CM_ SG_ 384 ExtrLtgStsGoodbye "Good Bye Light Status";
CM_ SG_ 384 ExtrLtgStsHiBeam "Hi Beam Status";
CM_ SG_ 384 ExtrLtgStsHomeSafe "Home Safe Light Status";
CM_ SG_ 384 ExtrLtgStsHWL "HWL Status";
CM_ SG_ 384 ExtrLtgStsLoBeam "Low Beam Status";
CM_ SG_ 384 ExtrLtgStsLtgShow "Light Show Status";
CM_ SG_ 384 ExtrLtgStsPosLiFrnt "Position Light Front Status";
CM_ SG_ 384 ExtrLtgStsPosLiRe "Position Light Rear Status";
CM_ SG_ 384 ExtrLtgStsReFog "Rear Fog Light Status";
CM_ SG_ 384 ExtrLtgStsReverseLi "Reverse Light Status";
CM_ SG_ 384 ExtrLtgStsStopLi "Stop Light Status";
CM_ SG_ 384 ExtrLtgStsTurnIndrLe "Turn Indicator Left Status";
CM_ SG_ 384 ExtrLtgStsTurnIndrRi "Turn Indicator Right Status
";
CM_ SG_ 384 ExtrLtgStsWelcome "Welcome Light Status";
CM_ SG_ 384 IndcrSts "Provides the state and not the event of HWL/Direction Indicator.";
CM_ SG_ 384 TrLockSts "TrLockSts - Tailgate or bootlid lock status
LockStsUkwn - Lock status of tailgate or bootlid Unknown
Unlckd - Tailgate or Bootlid is unlocked
Lockd - Tailgate or Bootlid is locked
SafeLockd - Not used for Tailgate or Bootlid";
CM_ SG_ 384 TrlrPrsnt "TrlrNotPrsnt - Trailer caravan is not connected to the vehicle.
TrlrPrsnt - Trailer caravan is connected to the vehicle.";
CM_ SG_ 781 PrkgDstCtrlSysSwt "Signal indicates whether PDC Switch is being pressed,Default is 1";
CM_ SG_ 781 PrkgIntrptReldBtn "Select Yes or No when parking interrupt";
CM_ SG_ 781 PrkgTypAutBtn "Signal indicates whether auto APA is selected.";
CM_ SG_ 781 VehCfgPrmBlkIDBytePosn1 "signal block counter.";
CM_ SG_ 781 VehCfgPrmCCPBytePosn2 " (BlockID-1)*7 + 1. ";
CM_ SG_ 781 VehCfgPrmCCPBytePosn3 " (BlockID-1)*7 + 2. ";
CM_ SG_ 781 VehCfgPrmCCPBytePosn4 " (BlockID-1)*7 + 3. ";
CM_ SG_ 781 VehCfgPrmCCPBytePosn5 " (BlockID-1)*7 + 4. ";
CM_ SG_ 781 VehCfgPrmCCPBytePosn6 " (BlockID-1)*7 + 5. ";
CM_ SG_ 781 VehCfgPrmCCPBytePosn7 " (BlockID-1)*7 + 6. ";
CM_ SG_ 781 VehCfgPrmCCPBytePosn8 " (BlockID-1)*7 + 7. ";
CM_ SG_ 781 VehCfgPrmExtBlkIDBytePosn1 "CarConfigExtended BlockID";
CM_ SG_ 781 VehCfgPrmExtCCPBytePosn2 "CarConfigExtended BytePos2";
CM_ SG_ 781 VehCfgPrmExtCCPBytePosn3 "CarConfigExtended BytePos3";
CM_ SG_ 781 VehCfgPrmExtCCPBytePosn4 "CarConfigExtended BytePos4";
CM_ SG_ 781 VehCfgPrmExtCCPBytePosn5 "CarConfigExtended BytePos5";
CM_ SG_ 781 VehCfgPrmExtCCPBytePosn6 "CarConfigExtended BytePos6";
CM_ SG_ 781 VehCfgPrmExtCCPBytePosn7 "CarConfigExtended BytePos7";
CM_ SG_ 781 VehCfgPrmExtCCPBytePosn8 "CarConfigExtended BytePos8";
CM_ SG_ 89 BkpOfDstTrvld "total traveled distance.";
CM_ SG_ 89 CarTiGlb "Presents a tiime value that shall be used by all ECUs to time-stamp diagnsotic trouble codes (DTC) according to the requirements for Global DTC snapshot data.";
CM_ SG_ 89 VehBattUSysU "Vehicle System Voltage At 12V side";
CM_ SG_ 89 VehBattUSysUQf "Present vehicle voltage measured by CEM with QF";
CM_ SG_ 69 DrvrAsscSysParkMod "Park mode";
CM_ SG_ 69 PlaModReq "AVM factory pattern";
CM_ SG_ 69 PrkgEmgBrkSysSwt "Signal indicates whether PEB Switch is being pressed,Default is 1";
CM_ SG_ 69 PrkgIndcrLineReqIdPen "user profie ID";
CM_ SG_ 69 PrkgIndcrLineReqOnOff1 "parking line indicator state display ";
CM_ SG_ 69 PrkgInOrOutAndCncl "cancel park in and park out.";
CM_ SG_ 69 RemPrkgEnaReq "RPA enable or disable request from HMI";
CM_ SG_ 69 SurrndgsObjDetnReqIdPen "user profile ID ";
CM_ SG_ 69 SurrndgsObjDetnReqOnOff1 "3DODfunction ON state";
CM_ SG_ 69 SwtDispOnAndOffReq "IHU request AVM display switch";
CM_ SG_ 69 ThrDTouringViewReqIdPen "user profile ID";
CM_ SG_ 69 ThrDTouringViewReqOnOff1 "3D touring view switch";
CM_ SG_ 69 TopVisnDispExtnReqIdPen "user profile ID ";
CM_ SG_ 69 TopVisnDispExtnReqOnOff1 "pedestrain detection function state";
CM_ SG_ 69 TurnEntryAgWideVisReqIdPen "user profile ID";
CM_ SG_ 69 TurnEntryAgWideVisReqOnOff1 "AVM side video start with vehicle steering function ";
CM_ SG_ 69 VehMdlClrReqIdPen "user profile ID";
CM_ SG_ 69 VehMdlClrReqOnOff1 "vehicle transparent model display switch";
CM_ SG_ 69 VisnAgExtnReq "Whether AVM feedback has entered 3D view mode";
CM_ SG_ 112 DvrErrSts "The other error code of DVR";
CM_ SG_ 112 DVRSysSts "The working status of DVR";
CM_ SG_ 112 PrkgTouchCoornReqCoordinateX "The coordinate of finger when user clicks the screen";
CM_ SG_ 112 PrkgTouchCoornReqCoordinateY "The coordinate of finger when user clicks the screen";
CM_ SG_ 112 PrkgTouchCoornReqFingerIndex "The coordinate of finger when user clicks the screen";
CM_ SG_ 112 PrkgTouchCoornReqTouchEveTyp "The coordinate of finger when user clicks the screen";
CM_ SG_ 1424 PASdevelpsignalgroup1Functiondev "develop signal group";
CM_ SG_ 1424 PASdevelpsignalgroup1Functi_0000 "develop signal group";
CM_ SG_ 1424 PASdevelpsignalgroup1Functi_0001 "develop signal group";
CM_ SG_ 1424 PASdevelpsignalgroup1Functi_0002 "develop signal group";
CM_ SG_ 1424 PASdevelpsignalgroup1Functi_0003 "develop signal group";
CM_ SG_ 1424 PASdevelpsignalgroup1Functi_0004 "develop signal group";
CM_ SG_ 1424 PASdevelpsignalgroup1Functi_0005 "develop signal group";
CM_ SG_ 1424 PASdevelpsignalgroup1Functi_0006 "develop signal group";
CM_ SG_ 1425 PASdevelpsignalgroup2Functiondev "develop signal group";
CM_ SG_ 1425 PASdevelpsignalgroup2Functi_0000 "develop signal group";
CM_ SG_ 1425 PASdevelpsignalgroup2Functi_0001 "develop signal group";
CM_ SG_ 1425 PASdevelpsignalgroup2Functi_0002 "develop signal group";
CM_ SG_ 1425 PASdevelpsignalgroup2Functi_0003 "develop signal group";
CM_ SG_ 1425 PASdevelpsignalgroup2Functi_0004 "develop signal group";
CM_ SG_ 1425 PASdevelpsignalgroup2Functi_0005 "develop signal group";
CM_ SG_ 1425 PASdevelpsignalgroup2Functi_0006 "develop signal group";
CM_ SG_ 1426 PASdevelpsignalgroup3Functiondev "develop signal group";
CM_ SG_ 1426 PASdevelpsignalgroup3Functi_0000 "develop signal group";
CM_ SG_ 1426 PASdevelpsignalgroup3Functi_0001 "develop signal group";
CM_ SG_ 1426 PASdevelpsignalgroup3Functi_0002 "develop signal group";
CM_ SG_ 1426 PASdevelpsignalgroup3Functi_0003 "develop signal group";
CM_ SG_ 1426 PASdevelpsignalgroup3Functi_0004 "develop signal group";
CM_ SG_ 1426 PASdevelpsignalgroup3Functi_0005 "develop signal group";
CM_ SG_ 1426 PASdevelpsignalgroup3Functi_0006 "develop signal group";
CM_ SG_ 96 EngRunngReqByParkAssi1 "Request to keep engine running during a Semi automatic parking manoeuvre.";
CM_ SG_ 96 EngRunngReqByParkAssiChks "counter,For E2E Protection";
CM_ SG_ 96 EngRunngReqByParkAssiCntr "CRC,to check the signal,For E2E Protection";
CM_ SG_ 96 FctStDisp "display RSPA status tip";
CM_ SG_ 96 FctStRemPrkgWarn "display RSPA abort/suspend warning tip";
CM_ SG_ 96 GearPrkgAssiReqGroupChks "checksum";
CM_ SG_ 96 GearPrkgAssiReqGroupCntr "counter";
CM_ SG_ 96 GearPrkgAssiReqGroupGearPrkgAssi "The target gear request";
CM_ SG_ 96 ImgSnsrFrntWrg "The error status of AVM front camera.";
CM_ SG_ 96 MobDevRPAAuthentReqAuthentSts "AuthentSts";
CM_ SG_ 96 MobDevRPAAuthentReqChks "checksum";
CM_ SG_ 96 MobDevRPAAuthentReqCntr "counter";
CM_ SG_ 96 MobDevRPAAuthentReqRndX "randomX";
CM_ SG_ 96 MobDevRPAAuthentReqRndY "randomY";
CM_ SG_ 96 NetPASActvtPrio "Default values are Prio = PRIO-NORM and no resource group ( ResourceGroup = 0x00) is requested, which means that the vehicle internal IP network is not requested";
CM_ SG_ 96 NetPASActvtResourceGroup "It describes which state managers that are member of each resource group";
CM_ SG_ 96 PrkgAsscSysEcuTyp "PAS ECU TYPE";
CM_ SG_ 96 PrkgAssiElectcStabyProgCtrl_0000 "CRC,to check the signal,For E2E Protection";
CM_ SG_ 96 PrkgAssiElectcStabyProgCtrl_0001 "counter,For E2E Protection";
CM_ SG_ 96 PrkgAssiElectcStabyProgCtrl_0002 "Parking control mode request";
CM_ SG_ 96 PrkgAssiSysRemPrkgSts "RPA work status";
CM_ SG_ 96 PrkgBrkElectcCtrlReqChks "CRC,to check the signal,For E2E Protection";
CM_ SG_ 96 PrkgBrkElectcCtrlReqCntr "counter,For E2E Protection";
CM_ SG_ 96 PrkgBrkElectcCtrlReqReq "EPB control request status";
CM_ SG_ 96 PrkgEmgyBrkEmgyBrkReq "This is the PEB function emergency brake request to VDDM";
CM_ SG_ 96 PrkgEmgyBrkEpbApplyReq "EPB apply request by PEB";
CM_ SG_ 96 PrkgEmgyBrkStandStillReq "Keep the vehicle standstill";
CM_ SG_ 96 PrkgSpdCtrlSafeGroupChks "checksum";
CM_ SG_ 96 PrkgSpdCtrlSafeGroupCntr "counter";
CM_ SG_ 96 PrkgSpdCtrlSafeGroupDrvrAsscSysB "emergency and comfortable brake";
CM_ SG_ 96 PrkgSpdCtrlSafeGroupPrkgAssiALow "The lower limit of the target acceleration/deceleration";
CM_ SG_ 96 PrkgSpdCtrlSafeGroupPrkgAss_0000 "Target acceleration/deceleration lower slope limit";
CM_ SG_ 96 PrkgSpdCtrlSafeGroupPrkgAssiAReq "Target acceleration/deceleration request";
CM_ SG_ 96 PrkgSpdCtrlSafeGroupPrkgAssiAUpp "The upper limit of the target acceleration/deceleration";
CM_ SG_ 96 PrkgSpdCtrlSafeGroupPrkgAss_0001 "Target acceleration/deceleration upper slope limit";
CM_ SG_ 96 PrkgStandstillReqChks "CRC,to check the signal,For E2E Protection";
CM_ SG_ 96 PrkgStandstillReqCntr "counter,For E2E Protection";
CM_ SG_ 96 PrkgStandstillReqReqSts1 "stop the vehcile or maintain standstill request by brake pressure control";
CM_ SG_ 96 PrkgUsgDrvModTranReq "Request VMM change usage mode.";
CM_ SG_ 96 VehBeamLoModReq "Request open/close low beam mode.";
CM_ SG_ 96 VehPrkgToHorn "Request to active horn warning.";
CM_ SG_ 528 AudWarnOfSnsrParkAssiFrnt "Front audio warning Req";
CM_ SG_ 528 AudWarnOfSnsrParkAssiRe "Rear audio warning Req";
CM_ SG_ 528 DispAndSwtOfPrkgMod "Parking mode display and selector switch";
CM_ SG_ 528 DispPrkgStallBtn "Display self searching slot button on";
CM_ SG_ 528 FrntLeOfSnsrOfPrkgAssiSide "This is  the detected barriers distance range from front left side sector";
CM_ SG_ 528 FrntRiOfSnsrOfPrkgAssiSide "This is  the detected barriers distance range from front right side sector";
CM_ SG_ 528 ImgSnsrLeWrg "The error status of AVM left camera.";
CM_ SG_ 528 InsdLeOfSnsrPrkgAssiFrnt "This is the distance of detected barriers from front inside left USS";
CM_ SG_ 528 InsdLeOfSnsrPrkgAssiRe "This is the distance of detected barriers from rear inside left USS";
CM_ SG_ 528 InsdRiOfSnsrPrkgAssiFrnt "This is the distance of detected barriers from front inside right USS";
CM_ SG_ 528 InsdRiOfSnsrPrkgAssiRe "This is the distance of detected barriers from rear inside right USS";
CM_ SG_ 528 OutdLeOfSnsrPrkgAssiFrnt "This is the distance of detected barriers from front outside left USS";
CM_ SG_ 528 OutdLeOfSnsrPrkgAssiRe "This is the distance of detected barriers from rear outside left USS";
CM_ SG_ 528 OutdRiOfSnsrPrkgAssiFrnt "This is the distance of detected barriers from front outside right USS";
CM_ SG_ 528 OutdRiOfSnsrPrkgAssiRe "This is the distance of detected barriers from rear outside right USS";
CM_ SG_ 528 PrkgBackDisp "wordage(undo process)display";
CM_ SG_ 528 PrkgEmgyBrkFltDisp "PEB fault display";
CM_ SG_ 528 PrkgProgsDisp "Parking progress display:0-100%";
CM_ SG_ 528 ReLeOfSnsrOfPrkgAssiSide "This is  the detected barriers distance range from rear left side sector";
CM_ SG_ 528 ReRiOfSnsrOfPrkgAssiSide "This is  the detected barriers distance range from rear right side sector";
CM_ SG_ 528 ValtPrkgFailrNotif "Notify IHU parking function not available.";
CM_ SG_ 528 ValtSysSts "Represent the valet parking status.";
CM_ SG_ 528 VehHomePrkgSysSts "Represent the home zone parking status.";
CM_ SG_ 528 VehPrkgLockTheftReq "Request lock/arm(unlock/disarm) the vehicle.";
CM_ SG_ 528 VehWinSunRoofClsReq "Request close the vehicle windows and sunroof.";
CM_ SG_ 821 DstToCllsnOfPrkgEmgyBrk "DTC info for big data record";
CM_ SG_ 821 ImgSnsrClrReqFrnt "Send a Request signal to IHU to tell user the AVM front camera lens are dirty, need to be cleaned.";
CM_ SG_ 821 ImgSnsrClrReqLe "Send a Request signal to IHU to tell user the AVM left camera lens are dirty, need to be cleaned.";
CM_ SG_ 821 ImgSnsrClrReqRe "Send a Request signal to IHU to tell user the AVM rear camera lens are dirty, need to be cleaned.";
CM_ SG_ 821 ImgSnsrClrReqRi "Send a Request signal to IHU to tell user the AVM right camera lens are dirty, need to be cleaned.";
CM_ SG_ 821 MirrOpenClsReq "Send request to DCU to fold/unfold outside mirror.";
CM_ SG_ 821 MobDevRPAStsOnOff1 "undo button display on mobile device";
CM_ SG_ 821 MobDevRPAStsUInt8 "RPA status display on mobile device.";
CM_ SG_ 821 PrkgFctDiDisp "Parking function unavailable";
CM_ SG_ 529 InsdSnsrDstFrntShoLe "Front inside left ultrasonic sensor release the distance ";
CM_ SG_ 529 InsdSnsrDstFrntShoRi "Front inside right ultrasonic sensor release the distance ";
CM_ SG_ 529 InsdSnsrDstReShoLe "Rear inside left ultrasonic sensor release the distance ";
CM_ SG_ 529 InsdSnsrDstReShoRi "Rear inside right ultrasonic sensor release the distance ";
CM_ SG_ 529 InsdSnsrFltFrntShoLe "Front inside left ultrasonic sensor release fault";
CM_ SG_ 529 InsdSnsrFltFrntShoRi "Front inside right ultrasonic sensor release fault";
CM_ SG_ 529 InsdSnsrFltReShoLe "Rear inside left ultrasonic sensor release fault ";
CM_ SG_ 529 InsdSnsrFltReShoRi "Rear inside right ultrasonic sensor release fault ";
CM_ SG_ 529 ObjOnIfOfSnsr "Whether the USS is covered.";
CM_ SG_ 529 OutdSnsrDstFrntShoLe "Front inside right ultrasonic sensor release the distance";
CM_ SG_ 529 OutdSnsrDstFrntShoRi "Front inside right ultrasonic sensor release the distance ";
CM_ SG_ 529 OutdSnsrDstReShoLe "Rear inside left ultrasonic sensor release the distance ";
CM_ SG_ 529 OutdSnsrDstReShoRi "Rear inside left ultrasonic sensor release the distance ";
CM_ SG_ 529 OutdSnsrFltFrntShoLe "Front inside right ultrasonic sensor release fault";
CM_ SG_ 529 OutdSnsrFltFrntShoRi "Front inside right ultrasonic sensor release fault";
CM_ SG_ 529 OutdSnsrFltReShoLe "Rear inside left ultrasonic sensor release fault ";
CM_ SG_ 529 OutdSnsrFltReShoRi "Rear inside left ultrasonic sensor release fault";
CM_ SG_ 529 PrkgDstCtrlWarn "When PDC is Failure or Inhibited, release the warning sound. ";
CM_ SG_ 529 SnsrDstFrntShoSideLe "Front side left ultrasonic sensor release the distance ";
CM_ SG_ 529 SnsrDstFrntShoSideRi "Front side right ultrasonic sensor release the distance ";
CM_ SG_ 529 SnsrDstReShoSideLe "Rear side left ultrasonic sensor release the distance ";
CM_ SG_ 529 SnsrDstReShoSideRi "Rear side right ultrasonic sensor release the distance ";
CM_ SG_ 529 SnsrFltFrntShoSideLe "Front side left ultrasonic sensor release fault";
CM_ SG_ 529 SnsrFltFrntShoSideRi "Front side right ultrasonic sensor release fault";
CM_ SG_ 529 SnsrFltOfPrkgDstCtrl "Whether USS is fault.";
CM_ SG_ 529 SnsrFltReShoSideLe "Rear side left ultrasonic sensor release fault";
CM_ SG_ 529 SnsrFltReShoSideRi "Rear side right ultrasonic sensor release fault";
CM_ SG_ 587 DrvrAsscSysDisp "Parking function Bullet box information";
CM_ SG_ 587 MobDevFctStTip "display RPP function status tip";
CM_ SG_ 587 PdcMuteBtnSts "PDC Mute button status to HMI.";
CM_ SG_ 587 PlaModStsResp "Response to request to enter factory mode.";
CM_ SG_ 587 PrkgAuxInfoDisp "a signal to HMI to display guide information.";
CM_ SG_ 587 PrkgDispGroupLeCornrCoornx "left point x";
CM_ SG_ 587 PrkgDispGroupLeCornrCoorny "left point y";
CM_ SG_ 587 PrkgDispGroupLeCornrLocn "left point quadrant";
CM_ SG_ 587 PrkgDispGroupPrkgTyp "parking slot type";
CM_ SG_ 587 PrkgDispGroupRiCornrCoornx "right point x";
CM_ SG_ 587 PrkgDispGroupRiCornrCoorny "right point y";
CM_ SG_ 587 PrkgDispGroupStallNr "slot number";
CM_ SG_ 587 PrkgDstCtrlSts "This is the PDC function operation status";
CM_ SG_ 587 PrkgEmgyBrkWarn "PEB warning info";
CM_ SG_ 587 PrkgImgDispReq "Request IHU to open/close parking video stream.";
CM_ SG_ 587 PrkgIndcrLineResp "Response to dynamic trajectory switch request. ";
CM_ SG_ 587 PrkgOutModBtnSts1 "Vertical parking out front left button status display";
CM_ SG_ 587 PrkgOutModBtnSts2 "Vertical parking out front right button status display";
CM_ SG_ 587 PrkgOutModBtnSts3 "Vertical parking out rear left button status display";
CM_ SG_ 587 PrkgOutModBtnSts4 "Vertical parking out rear right button status display";
CM_ SG_ 587 PrkgOutModBtnSts5 "Horizontal left parking out button status dispaly";
CM_ SG_ 587 PrkgOutModBtnSts6 "Horizontal right parking out button status dispaly";
CM_ SG_ 587 PrkgOutModBtnStsToAPPPrkgOutModB "Vertical parking out front left button status display";
CM_ SG_ 587 PrkgOutModBtnStsToAPPPrkgOu_0000 "Vertical parking out front right button status display";
CM_ SG_ 587 PrkgOutModBtnStsToAPPPrkgOu_0001 "Vertical parking out rear left button status display";
CM_ SG_ 587 PrkgOutModBtnStsToAPPPrkgOu_0002 "Vertical parking out rear right button status display";
CM_ SG_ 587 PrkgOutModBtnStsToAPPPrkgOu_0003 "Horizontal left parking out button status dispaly";
CM_ SG_ 587 PrkgOutModBtnStsToAPPPrkgOu_0004 "Horizontal right parking out button status dispaly";
CM_ SG_ 587 PrkgStopAudWarnReq "Request for audible warning that the parking manouvre has been terminated";
CM_ SG_ 587 PrkgTypAutBtnCfmd "Self-recommended parking mode switch confirm and memory";
CM_ SG_ 587 RemPrkgEnaSts "RPA function enable or display by PAS memory";
CM_ SG_ 587 SurrndgsObjDetnResp "Response to the 3D object detection request from HMI Display and Management.";
CM_ SG_ 587 SwtDispOnAndOffStsResp "Response to IHU that AVM enter and exit manner.";
CM_ SG_ 587 ThrDTouringViewResp "Response to the 3D touring view request from HMI Display and Management.";
CM_ SG_ 587 TopVisnDispExtnResp "Response to the pedestrian detection request from HMI Display and Management.";
CM_ SG_ 587 TurnEntryAgWideVisResp "Response to the 3D touring view request from HMI Display and Management.";
CM_ SG_ 587 VehMdlClrResp "Response to transparent model request from HMI Display and Management.";
CM_ SG_ 587 VisnAgExtnResp "Response to the 3D view request from HMI Display and Management.";
CM_ SG_ 587 VisnImgDispModResp "Response to display mode request from IHU.";
CM_ SG_ 784 MonrSysSts "Indicate AVM working status.";
CM_ SG_ 1105 InhbCdnOfPrkgEmgyBrk "Inhibit Condition Of Parking Emergency Brake for big data record";
CM_ SG_ 274 DrvrAsscSysIndcrReq "direction indicator Request";
CM_ SG_ 274 DrvrAsscSysSts "APA status";
CM_ SG_ 274 ImgSnsrReWrg "The error status of AVM rear camera.";
CM_ SG_ 274 ImgSnsrRiWrg "The error status of AVM right camera.";
CM_ SG_ 274 LineDetnPptyLeAgOffCenAndLine "The angle between the vehicle center line and the tangent line, which passed the vehicle center line and the left lane line crossing point.";
CM_ SG_ 274 LineDetnPptyLeChks "Check sum for E2E.";
CM_ SG_ 274 LineDetnPptyLeCntr "Counter for E2E.";
CM_ SG_ 274 LineDetnPptyLeDstVertCenAndLine "The distance from the center of the vehicle to the left side lane line.";
CM_ SG_ 274 LineDetnPptyLeLineCrvt "Left lane line curvature.";
CM_ SG_ 274 LineDetnPptyLeLineDetdDe "Left lane line detected confidence coefficient.";
CM_ SG_ 274 LineDetnPptyLeLineDetdEfc "Left lane line detected effective.";
CM_ SG_ 274 LineDetnPptyLeLineTintg "The color of left lane line.";
CM_ SG_ 274 LineDetnPptyLeLineTyp "The type of left lane line.";
CM_ SG_ 274 LineDetnPptyLeLineWidth "Left lane line width.";
CM_ SG_ 274 LineDetnPptyLeTiStamp "TimeStamp";
CM_ SG_ 274 LineDetnPptyRiAgOffCenAndLine "The angle between the vehicle center line and the tangent line, which passed the vehicle center line and the right lane line crossing point.";
CM_ SG_ 274 LineDetnPptyRiChks "Check sum for E2E.";
CM_ SG_ 274 LineDetnPptyRiCntr "Counter for E2E.";
CM_ SG_ 274 LineDetnPptyRiDstVertCenAndLine "The distance from the center of the vehicle to the right side lane line.";
CM_ SG_ 274 LineDetnPptyRiLineCrvt "Right lane line curvature.";
CM_ SG_ 274 LineDetnPptyRiLineDetdDe "Right lane line detected confidence coefficient.";
CM_ SG_ 274 LineDetnPptyRiLineDetdEfc "Right lane line detected effective.";
CM_ SG_ 274 LineDetnPptyRiLineTintg "The color of right lane line.";
CM_ SG_ 274 LineDetnPptyRiLineTyp "The type of right lane line.";
CM_ SG_ 274 LineDetnPptyRiLineWidth "Right lane line width.";
CM_ SG_ 274 LineDetnPptyRiTiStamp "TimeStamp";
CM_ SG_ 274 PrkgEmgyBrkSysSts "This is the PEB function operation status";
CM_ SG_ 274 PrkgLockReq "lock/unlock request for RPA function";
BA_DEF_ BO_  "VFrameFormat" ENUM  "StandardCAN","ExtendedCAN","reserved","J1939PG","reserved","reserved","reserved","reserved","reserved","reserved","reserved","reserved","reserved","reserved","StandardCAN_FD","ExtendedCAN_FD";
BA_DEF_ BO_  "CANFD_BRS" ENUM  "0","1";
BA_DEF_ BO_  "GenMsgSendType" ENUM  "cyclic","spontaneous","not-used","not-used","not-used","cyclicAndSpontaneous","not-used","cyclicIfActive","NoMsgSendType";
BA_DEF_ BO_  "GenMsgCycleTime" INT 0 65536;
BA_DEF_ BO_  "GenMsgStartDelayTime" INT 0 65536;
BA_DEF_ BO_  "GenMsgDelayTime" INT 0 65536;
BA_DEF_ SG_  "GenSigSendType" ENUM  "Cyclic","OnWrite","OnWriteWithRepetition","OnChange","OnChangeWithRepetition","IfActive","IfActiveWithRepetition","NoSigSendType";
BA_DEF_ SG_  "GenSigStartValue" HEX 0 80000000;
BA_DEF_ BO_  "GenMsgILSupport" ENUM  "No","Yes";
BA_DEF_ BO_  "NmAsrMessage" ENUM  "No","Yes";
BA_DEF_ SG_  "GenSigFuncType" ENUM  "NoFunction","n/a","n/a","n/a","n/a","n/a","n/a","n/a","n/a","n/a","n/a","n/a","n/a","n/a","n/a","CHK","CNTR","n/a","n/a","n/a","CNTR_AR_01","CRC_AR_01_BOTH","CRC_AR_01_ALT","CRC_AR_01_LOW","CRC_AR_01_NIBBLE","CNTR_AR_04","CRC_AR_04A","CNTR_AR_05","CRC_AR_05";
BA_DEF_ SG_  "GenSigDataID" STRING ;
BA_DEF_ SG_  "SigGroup" STRING ;
BA_DEF_ SG_  "SystemSignalLongSymbol" STRING ;
BA_DEF_ BO_  "SystemMessageLongSymbol" STRING ;
BA_DEF_DEF_  "VFrameFormat" "J1939PG";
BA_DEF_DEF_  "CANFD_BRS" "1";
BA_DEF_DEF_  "GenMsgSendType" "NoMsgSendType";
BA_DEF_DEF_  "GenMsgCycleTime" 0;
BA_DEF_DEF_  "GenMsgStartDelayTime" 0;
BA_DEF_DEF_  "GenMsgDelayTime" 0;
BA_DEF_DEF_  "GenSigSendType" "NoSigSendType";
BA_DEF_DEF_  "GenSigStartValue" 0;
BA_DEF_DEF_  "GenMsgILSupport" "Yes";
BA_DEF_DEF_  "NmAsrMessage" "No";
BA_DEF_DEF_  "GenSigFuncType" "NoFunction";
BA_DEF_DEF_  "GenSigDataID" "";
BA_DEF_DEF_  "SigGroup" "";
BA_DEF_DEF_  "SystemSignalLongSymbol" "";
BA_DEF_DEF_  "SystemMessageLongSymbol" "";
BA_ "GenMsgSendType" BO_ 384 0;
BA_ "GenMsgCycleTime" BO_ 384 200;
BA_ "VFrameFormat" BO_ 384 14;
BA_ "GenMsgSendType" BO_ 781 0;
BA_ "GenMsgDelayTime" BO_ 781 20;
BA_ "GenMsgCycleTime" BO_ 781 20;
BA_ "VFrameFormat" BO_ 781 14;
BA_ "GenMsgSendType" BO_ 89 0;
BA_ "GenMsgCycleTime" BO_ 89 800;
BA_ "VFrameFormat" BO_ 89 14;
BA_ "GenMsgSendType" BO_ 69 0;
BA_ "GenMsgDelayTime" BO_ 69 20;
BA_ "GenMsgCycleTime" BO_ 69 20;
BA_ "VFrameFormat" BO_ 69 14;
BA_ "GenMsgSendType" BO_ 112 0;
BA_ "GenMsgCycleTime" BO_ 112 20;
BA_ "VFrameFormat" BO_ 112 14;
BA_ "VFrameFormat" BO_ 1281 0;
BA_ "GenMsgSendType" BO_ 1281 0;
BA_ "GenMsgDelayTime" BO_ 1281 20;
BA_ "GenMsgILSupport" BO_ 1281 0;
BA_ "NmAsrMessage" BO_ 1281 1;
BA_ "GenMsgCycleTime" BO_ 1281 1000;
BA_ "GenMsgSendType" BO_ 2047 1;
BA_ "GenMsgDelayTime" BO_ 2047 5;
BA_ "VFrameFormat" BO_ 2047 14;
BA_ "SystemMessageLongSymbol" BO_ 2047 "AsdmToAllFuncSafetyCanFD4DiagReqFrame1";
BA_ "GenMsgSendType" BO_ 1888 1;
BA_ "GenMsgDelayTime" BO_ 1888 5;
BA_ "VFrameFormat" BO_ 1888 14;
BA_ "SystemMessageLongSymbol" BO_ 1888 "AsdmToPasSafetyCanFD4DiagReqFrame1";
BA_ "GenMsgSendType" BO_ 1424 1;
BA_ "GenMsgDelayTime" BO_ 1424 95;
BA_ "VFrameFormat" BO_ 1424 14;
BA_ "GenMsgSendType" BO_ 1425 1;
BA_ "GenMsgDelayTime" BO_ 1425 95;
BA_ "VFrameFormat" BO_ 1425 14;
BA_ "GenMsgSendType" BO_ 1426 1;
BA_ "GenMsgDelayTime" BO_ 1426 95;
BA_ "VFrameFormat" BO_ 1426 14;
BA_ "GenMsgSendType" BO_ 96 0;
BA_ "GenMsgCycleTime" BO_ 96 10;
BA_ "VFrameFormat" BO_ 96 14;
BA_ "GenMsgSendType" BO_ 528 0;
BA_ "GenMsgCycleTime" BO_ 528 100;
BA_ "VFrameFormat" BO_ 528 14;
BA_ "GenMsgSendType" BO_ 821 1;
BA_ "GenMsgDelayTime" BO_ 821 25;
BA_ "VFrameFormat" BO_ 821 14;
BA_ "GenMsgSendType" BO_ 529 0;
BA_ "GenMsgCycleTime" BO_ 529 100;
BA_ "GenMsgStartDelayTime" BO_ 529 10;
BA_ "VFrameFormat" BO_ 529 14;
BA_ "GenMsgSendType" BO_ 587 0;
BA_ "GenMsgCycleTime" BO_ 587 50;
BA_ "GenMsgStartDelayTime" BO_ 587 5;
BA_ "VFrameFormat" BO_ 587 14;
BA_ "GenMsgSendType" BO_ 784 0;
BA_ "GenMsgCycleTime" BO_ 784 200;
BA_ "VFrameFormat" BO_ 784 14;
BA_ "GenMsgSendType" BO_ 1105 0;
BA_ "GenMsgCycleTime" BO_ 1105 1000;
BA_ "VFrameFormat" BO_ 1105 14;
BA_ "GenMsgSendType" BO_ 274 0;
BA_ "GenMsgCycleTime" BO_ 274 30;
BA_ "VFrameFormat" BO_ 274 14;
BA_ "VFrameFormat" BO_ 1282 0;
BA_ "GenMsgSendType" BO_ 1282 1;
BA_ "GenMsgDelayTime" BO_ 1282 20;
BA_ "GenMsgILSupport" BO_ 1282 0;
BA_ "NmAsrMessage" BO_ 1282 1;
BA_ "GenMsgSendType" BO_ 1632 1;
BA_ "GenMsgDelayTime" BO_ 1632 5;
BA_ "VFrameFormat" BO_ 1632 14;
BA_ "SystemMessageLongSymbol" BO_ 1632 "PasToAsdmSafetyCanFD4DiagResFrame1";
BA_ "GenSigSendType" SG_ 384 DoorDrvrLockSts 0;
BA_ "GenSigSendType" SG_ 384 DoorLeReLockSts 0;
BA_ "GenSigSendType" SG_ 384 DoorPassLockSts 0;
BA_ "GenSigSendType" SG_ 384 DoorRiReLockSts 0;
BA_ "GenSigSendType" SG_ 384 DrvrPrsntStsDrvrPrsnt 0;
BA_ "GenSigSendType" SG_ 384 DrvrPrsntStsDrvrPrsntChks 0;
BA_ "GenSigFuncType" SG_ 384 DrvrPrsntStsDrvrPrsntChks 15;
BA_ "GenSigDataID" SG_ 384 DrvrPrsntStsDrvrPrsntChks "0x79";
BA_ "GenSigSendType" SG_ 384 DrvrPrsntStsDrvrPrsntCntr 0;
BA_ "GenSigFuncType" SG_ 384 DrvrPrsntStsDrvrPrsntCntr 16;
BA_ "GenSigSendType" SG_ 384 DrvrPrsntStsDrvrPrsntQf 0;
BA_ "GenSigStartValue" SG_ 384 ExtrLtgSts_UB 1;
BA_ "GenSigSendType" SG_ 384 ExtrLtgStsAFS 0;
BA_ "GenSigSendType" SG_ 384 ExtrLtgStsAHBC 0;
BA_ "GenSigSendType" SG_ 384 ExtrLtgStsAHL 0;
BA_ "GenSigSendType" SG_ 384 ExtrLtgStsAllWL 0;
BA_ "GenSigSendType" SG_ 384 ExtrLtgStsApproach 0;
BA_ "GenSigSendType" SG_ 384 ExtrLtgStsChks 0;
BA_ "GenSigSendType" SG_ 384 ExtrLtgStsCntr 0;
BA_ "GenSigSendType" SG_ 384 ExtrLtgStsCornrgLi 0;
BA_ "GenSigSendType" SG_ 384 ExtrLtgStsDBL 0;
BA_ "GenSigSendType" SG_ 384 ExtrLtgStsDRL 0;
BA_ "GenSigSendType" SG_ 384 ExtrLtgStsFlash 0;
BA_ "GenSigSendType" SG_ 384 ExtrLtgStsFrntFog 0;
BA_ "GenSigSendType" SG_ 384 ExtrLtgStsGoodbye 0;
BA_ "GenSigSendType" SG_ 384 ExtrLtgStsHiBeam 0;
BA_ "GenSigSendType" SG_ 384 ExtrLtgStsHomeSafe 0;
BA_ "GenSigSendType" SG_ 384 ExtrLtgStsHWL 0;
BA_ "GenSigSendType" SG_ 384 ExtrLtgStsLoBeam 0;
BA_ "GenSigSendType" SG_ 384 ExtrLtgStsLtgShow 0;
BA_ "GenSigSendType" SG_ 384 ExtrLtgStsPosLiFrnt 0;
BA_ "GenSigSendType" SG_ 384 ExtrLtgStsPosLiRe 0;
BA_ "GenSigSendType" SG_ 384 ExtrLtgStsReFog 0;
BA_ "GenSigSendType" SG_ 384 ExtrLtgStsReverseLi 0;
BA_ "GenSigSendType" SG_ 384 ExtrLtgStsStopLi 0;
BA_ "GenSigSendType" SG_ 384 ExtrLtgStsTurnIndrLe 0;
BA_ "GenSigSendType" SG_ 384 ExtrLtgStsTurnIndrRi 0;
BA_ "GenSigSendType" SG_ 384 ExtrLtgStsWelcome 0;
BA_ "GenSigSendType" SG_ 384 IndcrSts 0;
BA_ "GenSigSendType" SG_ 384 TrLockSts 0;
BA_ "GenSigSendType" SG_ 384 TrlrPrsnt 0;
BA_ "GenSigSendType" SG_ 781 PrkgDstCtrlSysSwt 1;
BA_ "GenSigSendType" SG_ 781 PrkgIntrptReldBtn 1;
BA_ "GenSigStartValue" SG_ 781 PrkgIntrptReldBtn_UB 1;
BA_ "GenSigSendType" SG_ 781 PrkgTypAutBtn 1;
BA_ "GenSigSendType" SG_ 781 VehCfgPrmBlkIDBytePosn1 1;
BA_ "GenSigSendType" SG_ 781 VehCfgPrmCCPBytePosn2 1;
BA_ "GenSigSendType" SG_ 781 VehCfgPrmCCPBytePosn3 1;
BA_ "GenSigSendType" SG_ 781 VehCfgPrmCCPBytePosn4 1;
BA_ "GenSigSendType" SG_ 781 VehCfgPrmCCPBytePosn5 1;
BA_ "GenSigSendType" SG_ 781 VehCfgPrmCCPBytePosn6 1;
BA_ "GenSigSendType" SG_ 781 VehCfgPrmCCPBytePosn7 1;
BA_ "GenSigSendType" SG_ 781 VehCfgPrmCCPBytePosn8 1;
BA_ "GenSigSendType" SG_ 781 VehCfgPrmExtBlkIDBytePosn1 1;
BA_ "GenSigSendType" SG_ 781 VehCfgPrmExtCCPBytePosn2 1;
BA_ "GenSigSendType" SG_ 781 VehCfgPrmExtCCPBytePosn3 1;
BA_ "GenSigSendType" SG_ 781 VehCfgPrmExtCCPBytePosn4 1;
BA_ "GenSigSendType" SG_ 781 VehCfgPrmExtCCPBytePosn5 1;
BA_ "GenSigSendType" SG_ 781 VehCfgPrmExtCCPBytePosn6 1;
BA_ "GenSigSendType" SG_ 781 VehCfgPrmExtCCPBytePosn7 1;
BA_ "GenSigSendType" SG_ 781 VehCfgPrmExtCCPBytePosn8 1;
BA_ "GenSigSendType" SG_ 89 BkpOfDstTrvld 0;
BA_ "GenSigSendType" SG_ 89 CarTiGlb 0;
BA_ "GenSigSendType" SG_ 89 VehBattUSysU 0;
BA_ "GenSigStartValue" SG_ 89 VehBattUSysUQf 1;
BA_ "GenSigSendType" SG_ 89 VehBattUSysUQf 0;
BA_ "GenSigSendType" SG_ 69 DrvrAsscSysParkMod 1;
BA_ "GenSigStartValue" SG_ 69 DrvrAsscSysParkMod_UB 1;
BA_ "GenSigSendType" SG_ 69 PlaModReq 1;
BA_ "GenSigStartValue" SG_ 69 PlaModReq_UB 1;
BA_ "GenSigSendType" SG_ 69 PrkgEmgBrkSysSwt 1;
BA_ "GenSigStartValue" SG_ 69 PrkgEmgBrkSysSwt_UB 1;
BA_ "GenSigStartValue" SG_ 69 PrkgIndcrLineReq_UB 1;
BA_ "GenSigSendType" SG_ 69 PrkgIndcrLineReqIdPen 1;
BA_ "GenSigSendType" SG_ 69 PrkgIndcrLineReqOnOff1 1;
BA_ "GenSigSendType" SG_ 69 PrkgInOrOutAndCncl 1;
BA_ "GenSigStartValue" SG_ 69 PrkgInOrOutAndCncl_UB 1;
BA_ "GenSigSendType" SG_ 69 RemPrkgEnaReq 1;
BA_ "GenSigStartValue" SG_ 69 SurrndgsObjDetnReq_UB 1;
BA_ "GenSigSendType" SG_ 69 SurrndgsObjDetnReqIdPen 1;
BA_ "GenSigSendType" SG_ 69 SurrndgsObjDetnReqOnOff1 1;
BA_ "GenSigSendType" SG_ 69 SwtDispOnAndOffReq 1;
BA_ "GenSigStartValue" SG_ 69 SwtDispOnAndOffReq_UB 1;
BA_ "GenSigStartValue" SG_ 69 ThrDTouringViewReq_UB 1;
BA_ "GenSigSendType" SG_ 69 ThrDTouringViewReqIdPen 1;
BA_ "GenSigSendType" SG_ 69 ThrDTouringViewReqOnOff1 1;
BA_ "GenSigStartValue" SG_ 69 TopVisnDispExtnReq_UB 1;
BA_ "GenSigSendType" SG_ 69 TopVisnDispExtnReqIdPen 1;
BA_ "GenSigSendType" SG_ 69 TopVisnDispExtnReqOnOff1 1;
BA_ "GenSigStartValue" SG_ 69 TurnEntryAgWideVisReq_UB 1;
BA_ "GenSigSendType" SG_ 69 TurnEntryAgWideVisReqIdPen 1;
BA_ "GenSigSendType" SG_ 69 TurnEntryAgWideVisReqOnOff1 1;
BA_ "GenSigStartValue" SG_ 69 VehMdlClrReq_UB 1;
BA_ "GenSigSendType" SG_ 69 VehMdlClrReqIdPen 1;
BA_ "GenSigSendType" SG_ 69 VehMdlClrReqOnOff1 1;
BA_ "GenSigSendType" SG_ 69 VisnAgExtnReq 1;
BA_ "GenSigStartValue" SG_ 69 VisnAgExtnReq_UB 1;
BA_ "GenSigSendType" SG_ 112 DvrErrSts 0;
BA_ "GenSigSendType" SG_ 112 DVRSysSts 0;
BA_ "GenSigSendType" SG_ 112 PrkgTouchCoornReqCoordinateX 0;
BA_ "GenSigSendType" SG_ 112 PrkgTouchCoornReqCoordinateY 0;
BA_ "GenSigSendType" SG_ 112 PrkgTouchCoornReqFingerIndex 0;
BA_ "GenSigSendType" SG_ 112 PrkgTouchCoornReqTouchEveTyp 0;
BA_ "SystemSignalLongSymbol" SG_ 2047 AsdmToAllFuncSafetyCanFD4DiagReq "AsdmToAllFuncSafetyCanFD4DiagReqNpdu";
BA_ "GenSigSendType" SG_ 1424 PASdevelpsignalgroup1Functiondev 1;
BA_ "SystemSignalLongSymbol" SG_ 1424 PASdevelpsignalgroup1Functiondev "PASdevelpsignalgroup1Functiondevpsignalgroup1";
BA_ "GenSigSendType" SG_ 1424 PASdevelpsignalgroup1Functi_0000 1;
BA_ "SystemSignalLongSymbol" SG_ 1424 PASdevelpsignalgroup1Functi_0000 "PASdevelpsignalgroup1Functiondevpsignalgroup2";
BA_ "GenSigSendType" SG_ 1424 PASdevelpsignalgroup1Functi_0001 1;
BA_ "SystemSignalLongSymbol" SG_ 1424 PASdevelpsignalgroup1Functi_0001 "PASdevelpsignalgroup1Functiondevpsignalgroup3";
BA_ "GenSigSendType" SG_ 1424 PASdevelpsignalgroup1Functi_0002 1;
BA_ "SystemSignalLongSymbol" SG_ 1424 PASdevelpsignalgroup1Functi_0002 "PASdevelpsignalgroup1Functiondevpsignalgroup4";
BA_ "GenSigSendType" SG_ 1424 PASdevelpsignalgroup1Functi_0003 1;
BA_ "SystemSignalLongSymbol" SG_ 1424 PASdevelpsignalgroup1Functi_0003 "PASdevelpsignalgroup1Functiondevpsignalgroup5";
BA_ "GenSigSendType" SG_ 1424 PASdevelpsignalgroup1Functi_0004 1;
BA_ "SystemSignalLongSymbol" SG_ 1424 PASdevelpsignalgroup1Functi_0004 "PASdevelpsignalgroup1Functiondevpsignalgroup6";
BA_ "GenSigSendType" SG_ 1424 PASdevelpsignalgroup1Functi_0005 1;
BA_ "SystemSignalLongSymbol" SG_ 1424 PASdevelpsignalgroup1Functi_0005 "PASdevelpsignalgroup1Functiondevpsignalgroup7";
BA_ "GenSigSendType" SG_ 1424 PASdevelpsignalgroup1Functi_0006 1;
BA_ "SystemSignalLongSymbol" SG_ 1424 PASdevelpsignalgroup1Functi_0006 "PASdevelpsignalgroup1Functiondevpsignalgroup8";
BA_ "GenSigSendType" SG_ 1425 PASdevelpsignalgroup2Functiondev 1;
BA_ "SystemSignalLongSymbol" SG_ 1425 PASdevelpsignalgroup2Functiondev "PASdevelpsignalgroup2Functiondevpsignalgroup1";
BA_ "GenSigSendType" SG_ 1425 PASdevelpsignalgroup2Functi_0000 1;
BA_ "SystemSignalLongSymbol" SG_ 1425 PASdevelpsignalgroup2Functi_0000 "PASdevelpsignalgroup2Functiondevpsignalgroup2";
BA_ "GenSigSendType" SG_ 1425 PASdevelpsignalgroup2Functi_0001 1;
BA_ "SystemSignalLongSymbol" SG_ 1425 PASdevelpsignalgroup2Functi_0001 "PASdevelpsignalgroup2Functiondevpsignalgroup3";
BA_ "GenSigSendType" SG_ 1425 PASdevelpsignalgroup2Functi_0002 1;
BA_ "SystemSignalLongSymbol" SG_ 1425 PASdevelpsignalgroup2Functi_0002 "PASdevelpsignalgroup2Functiondevpsignalgroup4";
BA_ "GenSigSendType" SG_ 1425 PASdevelpsignalgroup2Functi_0003 1;
BA_ "SystemSignalLongSymbol" SG_ 1425 PASdevelpsignalgroup2Functi_0003 "PASdevelpsignalgroup2Functiondevpsignalgroup5";
BA_ "GenSigSendType" SG_ 1425 PASdevelpsignalgroup2Functi_0004 1;
BA_ "SystemSignalLongSymbol" SG_ 1425 PASdevelpsignalgroup2Functi_0004 "PASdevelpsignalgroup2Functiondevpsignalgroup6";
BA_ "GenSigSendType" SG_ 1425 PASdevelpsignalgroup2Functi_0005 1;
BA_ "SystemSignalLongSymbol" SG_ 1425 PASdevelpsignalgroup2Functi_0005 "PASdevelpsignalgroup2Functiondevpsignalgroup7";
BA_ "GenSigSendType" SG_ 1425 PASdevelpsignalgroup2Functi_0006 1;
BA_ "SystemSignalLongSymbol" SG_ 1425 PASdevelpsignalgroup2Functi_0006 "PASdevelpsignalgroup2Functiondevpsignalgroup8";
BA_ "GenSigSendType" SG_ 1426 PASdevelpsignalgroup3Functiondev 1;
BA_ "SystemSignalLongSymbol" SG_ 1426 PASdevelpsignalgroup3Functiondev "PASdevelpsignalgroup3Functiondevpsignalgroup1";
BA_ "GenSigSendType" SG_ 1426 PASdevelpsignalgroup3Functi_0000 1;
BA_ "SystemSignalLongSymbol" SG_ 1426 PASdevelpsignalgroup3Functi_0000 "PASdevelpsignalgroup3Functiondevpsignalgroup2";
BA_ "GenSigSendType" SG_ 1426 PASdevelpsignalgroup3Functi_0001 1;
BA_ "SystemSignalLongSymbol" SG_ 1426 PASdevelpsignalgroup3Functi_0001 "PASdevelpsignalgroup3Functiondevpsignalgroup3";
BA_ "GenSigSendType" SG_ 1426 PASdevelpsignalgroup3Functi_0002 1;
BA_ "SystemSignalLongSymbol" SG_ 1426 PASdevelpsignalgroup3Functi_0002 "PASdevelpsignalgroup3Functiondevpsignalgroup4";
BA_ "GenSigSendType" SG_ 1426 PASdevelpsignalgroup3Functi_0003 1;
BA_ "SystemSignalLongSymbol" SG_ 1426 PASdevelpsignalgroup3Functi_0003 "PASdevelpsignalgroup3Functiondevpsignalgroup5";
BA_ "GenSigSendType" SG_ 1426 PASdevelpsignalgroup3Functi_0004 1;
BA_ "SystemSignalLongSymbol" SG_ 1426 PASdevelpsignalgroup3Functi_0004 "PASdevelpsignalgroup3Functiondevpsignalgroup6";
BA_ "GenSigSendType" SG_ 1426 PASdevelpsignalgroup3Functi_0005 1;
BA_ "SystemSignalLongSymbol" SG_ 1426 PASdevelpsignalgroup3Functi_0005 "PASdevelpsignalgroup3Functiondevpsignalgroup7";
BA_ "GenSigSendType" SG_ 1426 PASdevelpsignalgroup3Functi_0006 1;
BA_ "SystemSignalLongSymbol" SG_ 1426 PASdevelpsignalgroup3Functi_0006 "PASdevelpsignalgroup3Functiondevpsignalgroup8";
BA_ "GenSigSendType" SG_ 96 EngRunngReqByParkAssi1 0;
BA_ "GenSigSendType" SG_ 96 EngRunngReqByParkAssiChks 0;
BA_ "GenSigFuncType" SG_ 96 EngRunngReqByParkAssiChks 15;
BA_ "GenSigDataID" SG_ 96 EngRunngReqByParkAssiChks "0x0F";
BA_ "GenSigSendType" SG_ 96 EngRunngReqByParkAssiCntr 0;
BA_ "GenSigFuncType" SG_ 96 EngRunngReqByParkAssiCntr 16;
BA_ "GenSigSendType" SG_ 96 FctStDisp 0;
BA_ "GenSigSendType" SG_ 96 FctStRemPrkgWarn 0;
BA_ "GenSigSendType" SG_ 96 GearPrkgAssiReqGroupChks 0;
BA_ "GenSigFuncType" SG_ 96 GearPrkgAssiReqGroupChks 15;
BA_ "GenSigDataID" SG_ 96 GearPrkgAssiReqGroupChks "0x02";
BA_ "GenSigSendType" SG_ 96 GearPrkgAssiReqGroupCntr 0;
BA_ "GenSigFuncType" SG_ 96 GearPrkgAssiReqGroupCntr 16;
BA_ "GenSigSendType" SG_ 96 GearPrkgAssiReqGroupGearPrkgAssi 0;
BA_ "SystemSignalLongSymbol" SG_ 96 GearPrkgAssiReqGroupGearPrkgAssi "GearPrkgAssiReqGroupGearPrkgAssiReq1";
BA_ "GenSigSendType" SG_ 96 ImgSnsrFrntWrg 0;
BA_ "GenSigStartValue" SG_ 96 MobDevRPAAuthentReqAuthentSts 2;
BA_ "GenSigSendType" SG_ 96 MobDevRPAAuthentReqAuthentSts 0;
BA_ "GenSigSendType" SG_ 96 MobDevRPAAuthentReqChks 0;
BA_ "GenSigFuncType" SG_ 96 MobDevRPAAuthentReqChks 15;
BA_ "GenSigDataID" SG_ 96 MobDevRPAAuthentReqChks "0x13EC";
BA_ "GenSigSendType" SG_ 96 MobDevRPAAuthentReqCntr 0;
BA_ "GenSigFuncType" SG_ 96 MobDevRPAAuthentReqCntr 16;
BA_ "GenSigSendType" SG_ 96 MobDevRPAAuthentReqRndX 0;
BA_ "GenSigSendType" SG_ 96 MobDevRPAAuthentReqRndY 0;
BA_ "GenSigSendType" SG_ 96 NetPASActvtPrio 0;
BA_ "GenSigSendType" SG_ 96 NetPASActvtResourceGroup 0;
BA_ "GenSigSendType" SG_ 96 PrkgAsscSysEcuTyp 0;
BA_ "SystemSignalLongSymbol" SG_ 96 PrkgAssiElectcStabyProgCtrlModRe "PrkgAssiElectcStabyProgCtrlModReqGroup_UB";
BA_ "GenSigSendType" SG_ 96 PrkgAssiElectcStabyProgCtrl_0000 0;
BA_ "SigGroup" SG_ 96 PrkgAssiElectcStabyProgCtrl_0000 "PrkgAssiElectcStabyProgCtrlModReqGroup";
BA_ "GenSigFuncType" SG_ 96 PrkgAssiElectcStabyProgCtrl_0000 15;
BA_ "GenSigDataID" SG_ 96 PrkgAssiElectcStabyProgCtrl_0000 "0x1C7";
BA_ "SystemSignalLongSymbol" SG_ 96 PrkgAssiElectcStabyProgCtrl_0000 "PrkgAssiElectcStabyProgCtrlModReqGroupChks";
BA_ "GenSigSendType" SG_ 96 PrkgAssiElectcStabyProgCtrl_0001 0;
BA_ "SigGroup" SG_ 96 PrkgAssiElectcStabyProgCtrl_0001 "PrkgAssiElectcStabyProgCtrlModReqGroup";
BA_ "GenSigFuncType" SG_ 96 PrkgAssiElectcStabyProgCtrl_0001 16;
BA_ "SystemSignalLongSymbol" SG_ 96 PrkgAssiElectcStabyProgCtrl_0001 "PrkgAssiElectcStabyProgCtrlModReqGroupCntr";
BA_ "GenSigSendType" SG_ 96 PrkgAssiElectcStabyProgCtrl_0002 0;
BA_ "SigGroup" SG_ 96 PrkgAssiElectcStabyProgCtrl_0002 "PrkgAssiElectcStabyProgCtrlModReqGroup";
BA_ "SystemSignalLongSymbol" SG_ 96 PrkgAssiElectcStabyProgCtrl_0002 "PrkgAssiElectcStabyProgCtrlModReqGroupPASElectcStabyProgCtrlModReq";
BA_ "GenSigSendType" SG_ 96 PrkgAssiSysRemPrkgSts 0;
BA_ "GenSigSendType" SG_ 96 PrkgBrkElectcCtrlReqChks 0;
BA_ "GenSigFuncType" SG_ 96 PrkgBrkElectcCtrlReqChks 15;
BA_ "GenSigDataID" SG_ 96 PrkgBrkElectcCtrlReqChks "0x22B";
BA_ "GenSigSendType" SG_ 96 PrkgBrkElectcCtrlReqCntr 0;
BA_ "GenSigFuncType" SG_ 96 PrkgBrkElectcCtrlReqCntr 16;
BA_ "GenSigSendType" SG_ 96 PrkgBrkElectcCtrlReqReq 0;
BA_ "GenSigSendType" SG_ 96 PrkgEmgyBrkEmgyBrkReq 0;
BA_ "GenSigStartValue" SG_ 96 PrkgEmgyBrkEmgyBrkReq_UB 1;
BA_ "GenSigSendType" SG_ 96 PrkgEmgyBrkEpbApplyReq 0;
BA_ "GenSigStartValue" SG_ 96 PrkgEmgyBrkEpbApplyReq_UB 1;
BA_ "GenSigSendType" SG_ 96 PrkgEmgyBrkStandStillReq 0;
BA_ "GenSigStartValue" SG_ 96 PrkgEmgyBrkStandStillReq_UB 1;
BA_ "GenSigSendType" SG_ 96 PrkgSpdCtrlSafeGroupChks 0;
BA_ "GenSigFuncType" SG_ 96 PrkgSpdCtrlSafeGroupChks 15;
BA_ "GenSigDataID" SG_ 96 PrkgSpdCtrlSafeGroupChks "0x3C";
BA_ "GenSigSendType" SG_ 96 PrkgSpdCtrlSafeGroupCntr 0;
BA_ "GenSigFuncType" SG_ 96 PrkgSpdCtrlSafeGroupCntr 16;
BA_ "GenSigSendType" SG_ 96 PrkgSpdCtrlSafeGroupDrvrAsscSysB 0;
BA_ "SystemSignalLongSymbol" SG_ 96 PrkgSpdCtrlSafeGroupDrvrAsscSysB "PrkgSpdCtrlSafeGroupDrvrAsscSysBrkFctMod";
BA_ "GenSigStartValue" SG_ 96 PrkgSpdCtrlSafeGroupPrkgAssiALow 128;
BA_ "GenSigSendType" SG_ 96 PrkgSpdCtrlSafeGroupPrkgAssiALow 0;
BA_ "SystemSignalLongSymbol" SG_ 96 PrkgSpdCtrlSafeGroupPrkgAssiALow "PrkgSpdCtrlSafeGroupPrkgAssiALowrLim";
BA_ "GenSigStartValue" SG_ 96 PrkgSpdCtrlSafeGroupPrkgAss_0000 124;
BA_ "GenSigSendType" SG_ 96 PrkgSpdCtrlSafeGroupPrkgAss_0000 0;
BA_ "SystemSignalLongSymbol" SG_ 96 PrkgSpdCtrlSafeGroupPrkgAss_0000 "PrkgSpdCtrlSafeGroupPrkgAssiALowrSlop";
BA_ "GenSigStartValue" SG_ 96 PrkgSpdCtrlSafeGroupPrkgAssiAReq 128;
BA_ "GenSigSendType" SG_ 96 PrkgSpdCtrlSafeGroupPrkgAssiAReq 0;
BA_ "SystemSignalLongSymbol" SG_ 96 PrkgSpdCtrlSafeGroupPrkgAssiAReq "PrkgSpdCtrlSafeGroupPrkgAssiAReq1";
BA_ "GenSigStartValue" SG_ 96 PrkgSpdCtrlSafeGroupPrkgAssiAUpp 128;
BA_ "GenSigSendType" SG_ 96 PrkgSpdCtrlSafeGroupPrkgAssiAUpp 0;
BA_ "SystemSignalLongSymbol" SG_ 96 PrkgSpdCtrlSafeGroupPrkgAssiAUpp "PrkgSpdCtrlSafeGroupPrkgAssiAUpprLim";
BA_ "GenSigStartValue" SG_ 96 PrkgSpdCtrlSafeGroupPrkgAss_0001 3;
BA_ "GenSigSendType" SG_ 96 PrkgSpdCtrlSafeGroupPrkgAss_0001 0;
BA_ "SystemSignalLongSymbol" SG_ 96 PrkgSpdCtrlSafeGroupPrkgAss_0001 "PrkgSpdCtrlSafeGroupPrkgAssiAUpprSlop";
BA_ "GenSigSendType" SG_ 96 PrkgStandstillReqChks 0;
BA_ "GenSigFuncType" SG_ 96 PrkgStandstillReqChks 15;
BA_ "GenSigDataID" SG_ 96 PrkgStandstillReqChks "0x1C3";
BA_ "GenSigSendType" SG_ 96 PrkgStandstillReqCntr 0;
BA_ "GenSigFuncType" SG_ 96 PrkgStandstillReqCntr 16;
BA_ "GenSigSendType" SG_ 96 PrkgStandstillReqReqSts1 0;
BA_ "GenSigSendType" SG_ 96 PrkgUsgDrvModTranReq 0;
BA_ "GenSigSendType" SG_ 96 VehBeamLoModReq 0;
BA_ "GenSigSendType" SG_ 96 VehPrkgToHorn 0;
BA_ "GenSigSendType" SG_ 528 AudWarnOfSnsrParkAssiFrnt 0;
BA_ "GenSigSendType" SG_ 528 AudWarnOfSnsrParkAssiRe 0;
BA_ "GenSigSendType" SG_ 528 DispAndSwtOfPrkgMod 0;
BA_ "GenSigStartValue" SG_ 528 DispAndSwtOfPrkgMod_UB 1;
BA_ "GenSigSendType" SG_ 528 DispPrkgStallBtn 0;
BA_ "GenSigSendType" SG_ 528 FrntLeOfSnsrOfPrkgAssiSide 0;
BA_ "GenSigSendType" SG_ 528 FrntRiOfSnsrOfPrkgAssiSide 0;
BA_ "GenSigSendType" SG_ 528 ImgSnsrLeWrg 0;
BA_ "GenSigSendType" SG_ 528 InsdLeOfSnsrPrkgAssiFrnt 0;
BA_ "GenSigSendType" SG_ 528 InsdLeOfSnsrPrkgAssiRe 0;
BA_ "GenSigSendType" SG_ 528 InsdRiOfSnsrPrkgAssiFrnt 0;
BA_ "GenSigSendType" SG_ 528 InsdRiOfSnsrPrkgAssiRe 0;
BA_ "GenSigSendType" SG_ 528 OutdLeOfSnsrPrkgAssiFrnt 0;
BA_ "GenSigSendType" SG_ 528 OutdLeOfSnsrPrkgAssiRe 0;
BA_ "GenSigSendType" SG_ 528 OutdRiOfSnsrPrkgAssiFrnt 0;
BA_ "GenSigSendType" SG_ 528 OutdRiOfSnsrPrkgAssiRe 0;
BA_ "GenSigSendType" SG_ 528 PrkgBackDisp 0;
BA_ "GenSigSendType" SG_ 528 PrkgEmgyBrkFltDisp 0;
BA_ "GenSigStartValue" SG_ 528 PrkgEmgyBrkFltDisp_UB 1;
BA_ "GenSigSendType" SG_ 528 PrkgProgsDisp 0;
BA_ "GenSigSendType" SG_ 528 ReLeOfSnsrOfPrkgAssiSide 0;
BA_ "GenSigSendType" SG_ 528 ReRiOfSnsrOfPrkgAssiSide 0;
BA_ "GenSigSendType" SG_ 528 ValtPrkgFailrNotif 0;
BA_ "GenSigSendType" SG_ 528 ValtSysSts 0;
BA_ "GenSigSendType" SG_ 528 VehHomePrkgSysSts 0;
BA_ "GenSigSendType" SG_ 528 VehPrkgLockTheftReq 0;
BA_ "GenSigSendType" SG_ 528 VehWinSunRoofClsReq 0;
BA_ "GenSigSendType" SG_ 821 DstToCllsnOfPrkgEmgyBrk 1;
BA_ "GenSigSendType" SG_ 821 ImgSnsrClrReqFrnt 1;
BA_ "GenSigSendType" SG_ 821 ImgSnsrClrReqLe 1;
BA_ "GenSigSendType" SG_ 821 ImgSnsrClrReqRe 1;
BA_ "GenSigSendType" SG_ 821 ImgSnsrClrReqRi 1;
BA_ "GenSigSendType" SG_ 821 MirrOpenClsReq 1;
BA_ "GenSigSendType" SG_ 821 MobDevRPAStsOnOff1 1;
BA_ "GenSigSendType" SG_ 821 MobDevRPAStsUInt8 1;
BA_ "GenSigSendType" SG_ 821 PrkgFctDiDisp 1;
BA_ "GenSigSendType" SG_ 529 InsdSnsrDstFrntShoLe 0;
BA_ "GenSigSendType" SG_ 529 InsdSnsrDstFrntShoRi 0;
BA_ "GenSigSendType" SG_ 529 InsdSnsrDstReShoLe 0;
BA_ "GenSigSendType" SG_ 529 InsdSnsrDstReShoRi 0;
BA_ "GenSigSendType" SG_ 529 InsdSnsrFltFrntShoLe 0;
BA_ "GenSigSendType" SG_ 529 InsdSnsrFltFrntShoRi 0;
BA_ "GenSigSendType" SG_ 529 InsdSnsrFltReShoLe 0;
BA_ "GenSigSendType" SG_ 529 InsdSnsrFltReShoRi 0;
BA_ "GenSigSendType" SG_ 529 ObjOnIfOfSnsr 0;
BA_ "GenSigSendType" SG_ 529 OutdSnsrDstFrntShoLe 0;
BA_ "GenSigSendType" SG_ 529 OutdSnsrDstFrntShoRi 0;
BA_ "GenSigSendType" SG_ 529 OutdSnsrDstReShoLe 0;
BA_ "GenSigSendType" SG_ 529 OutdSnsrDstReShoRi 0;
BA_ "GenSigSendType" SG_ 529 OutdSnsrFltFrntShoLe 0;
BA_ "GenSigSendType" SG_ 529 OutdSnsrFltFrntShoRi 0;
BA_ "GenSigSendType" SG_ 529 OutdSnsrFltReShoLe 0;
BA_ "GenSigSendType" SG_ 529 OutdSnsrFltReShoRi 0;
BA_ "GenSigSendType" SG_ 529 PrkgDstCtrlWarn 0;
BA_ "GenSigSendType" SG_ 529 SnsrDstFrntShoSideLe 0;
BA_ "GenSigSendType" SG_ 529 SnsrDstFrntShoSideRi 0;
BA_ "GenSigSendType" SG_ 529 SnsrDstReShoSideLe 0;
BA_ "GenSigSendType" SG_ 529 SnsrDstReShoSideRi 0;
BA_ "GenSigSendType" SG_ 529 SnsrFltFrntShoSideLe 0;
BA_ "GenSigSendType" SG_ 529 SnsrFltFrntShoSideRi 0;
BA_ "GenSigSendType" SG_ 529 SnsrFltOfPrkgDstCtrl 0;
BA_ "GenSigSendType" SG_ 529 SnsrFltReShoSideLe 0;
BA_ "GenSigSendType" SG_ 529 SnsrFltReShoSideRi 0;
BA_ "GenSigSendType" SG_ 587 DrvrAsscSysDisp 0;
BA_ "GenSigSendType" SG_ 587 MobDevFctStTip 0;
BA_ "GenSigSendType" SG_ 587 PdcMuteBtnSts 0;
BA_ "GenSigSendType" SG_ 587 PlaModStsResp 0;
BA_ "GenSigSendType" SG_ 587 PrkgAuxInfoDisp 0;
BA_ "GenSigStartValue" SG_ 587 PrkgDispGroupLeCornrCoornx 20;
BA_ "GenSigSendType" SG_ 587 PrkgDispGroupLeCornrCoornx 0;
BA_ "GenSigStartValue" SG_ 587 PrkgDispGroupLeCornrCoorny 5;
BA_ "GenSigSendType" SG_ 587 PrkgDispGroupLeCornrCoorny 0;
BA_ "GenSigSendType" SG_ 587 PrkgDispGroupLeCornrLocn 0;
BA_ "GenSigSendType" SG_ 587 PrkgDispGroupPrkgTyp 0;
BA_ "GenSigStartValue" SG_ 587 PrkgDispGroupRiCornrCoornx 20;
BA_ "GenSigSendType" SG_ 587 PrkgDispGroupRiCornrCoornx 0;
BA_ "GenSigStartValue" SG_ 587 PrkgDispGroupRiCornrCoorny 5;
BA_ "GenSigSendType" SG_ 587 PrkgDispGroupRiCornrCoorny 0;
BA_ "GenSigSendType" SG_ 587 PrkgDispGroupStallNr 0;
BA_ "GenSigSendType" SG_ 587 PrkgDstCtrlSts 0;
BA_ "GenSigSendType" SG_ 587 PrkgEmgyBrkWarn 0;
BA_ "GenSigSendType" SG_ 587 PrkgImgDispReq 0;
BA_ "GenSigStartValue" SG_ 587 PrkgIndcrLineResp 1;
BA_ "GenSigSendType" SG_ 587 PrkgIndcrLineResp 0;
BA_ "GenSigStartValue" SG_ 587 PrkgIndcrLineResp_UB 1;
BA_ "GenSigSendType" SG_ 587 PrkgOutModBtnSts1 0;
BA_ "GenSigSendType" SG_ 587 PrkgOutModBtnSts2 0;
BA_ "GenSigSendType" SG_ 587 PrkgOutModBtnSts3 0;
BA_ "GenSigSendType" SG_ 587 PrkgOutModBtnSts4 0;
BA_ "GenSigSendType" SG_ 587 PrkgOutModBtnSts5 0;
BA_ "GenSigSendType" SG_ 587 PrkgOutModBtnSts6 0;
BA_ "GenSigSendType" SG_ 587 PrkgOutModBtnStsToAPPPrkgOutModB 0;
BA_ "SystemSignalLongSymbol" SG_ 587 PrkgOutModBtnStsToAPPPrkgOutModB "PrkgOutModBtnStsToAPPPrkgOutModBtnSts1";
BA_ "GenSigSendType" SG_ 587 PrkgOutModBtnStsToAPPPrkgOu_0000 0;
BA_ "SystemSignalLongSymbol" SG_ 587 PrkgOutModBtnStsToAPPPrkgOu_0000 "PrkgOutModBtnStsToAPPPrkgOutModBtnSts2";
BA_ "GenSigSendType" SG_ 587 PrkgOutModBtnStsToAPPPrkgOu_0001 0;
BA_ "SystemSignalLongSymbol" SG_ 587 PrkgOutModBtnStsToAPPPrkgOu_0001 "PrkgOutModBtnStsToAPPPrkgOutModBtnSts3";
BA_ "GenSigSendType" SG_ 587 PrkgOutModBtnStsToAPPPrkgOu_0002 0;
BA_ "SystemSignalLongSymbol" SG_ 587 PrkgOutModBtnStsToAPPPrkgOu_0002 "PrkgOutModBtnStsToAPPPrkgOutModBtnSts4";
BA_ "GenSigSendType" SG_ 587 PrkgOutModBtnStsToAPPPrkgOu_0003 0;
BA_ "SystemSignalLongSymbol" SG_ 587 PrkgOutModBtnStsToAPPPrkgOu_0003 "PrkgOutModBtnStsToAPPPrkgOutModBtnSts5";
BA_ "GenSigSendType" SG_ 587 PrkgOutModBtnStsToAPPPrkgOu_0004 0;
BA_ "SystemSignalLongSymbol" SG_ 587 PrkgOutModBtnStsToAPPPrkgOu_0004 "PrkgOutModBtnStsToAPPPrkgOutModBtnSts6";
BA_ "GenSigSendType" SG_ 587 PrkgStopAudWarnReq 1;
BA_ "GenSigStartValue" SG_ 587 PrkgTypAutBtnCfmd 1;
BA_ "GenSigSendType" SG_ 587 PrkgTypAutBtnCfmd 0;
BA_ "GenSigStartValue" SG_ 587 RemPrkgEnaSts 1;
BA_ "GenSigSendType" SG_ 587 RemPrkgEnaSts 0;
BA_ "GenSigStartValue" SG_ 587 SurrndgsObjDetnResp 1;
BA_ "GenSigSendType" SG_ 587 SurrndgsObjDetnResp 0;
BA_ "GenSigStartValue" SG_ 587 SurrndgsObjDetnResp_UB 1;
BA_ "GenSigSendType" SG_ 587 SwtDispOnAndOffStsResp 0;
BA_ "GenSigStartValue" SG_ 587 ThrDTouringViewResp 1;
BA_ "GenSigSendType" SG_ 587 ThrDTouringViewResp 0;
BA_ "GenSigStartValue" SG_ 587 TopVisnDispExtnResp 1;
BA_ "GenSigSendType" SG_ 587 TopVisnDispExtnResp 0;
BA_ "GenSigStartValue" SG_ 587 TopVisnDispExtnResp_UB 1;
BA_ "GenSigStartValue" SG_ 587 TurnEntryAgWideVisResp 1;
BA_ "GenSigSendType" SG_ 587 TurnEntryAgWideVisResp 0;
BA_ "GenSigSendType" SG_ 587 VehMdlClrResp 0;
BA_ "GenSigStartValue" SG_ 587 VehMdlClrResp_UB 1;
BA_ "GenSigSendType" SG_ 587 VisnAgExtnResp 0;
BA_ "GenSigStartValue" SG_ 587 VisnAgExtnResp_UB 1;
BA_ "GenSigSendType" SG_ 587 VisnImgDispModResp 0;
BA_ "GenSigStartValue" SG_ 587 VisnImgDispModResp_UB 1;
BA_ "GenSigSendType" SG_ 784 MonrSysSts 0;
BA_ "GenSigSendType" SG_ 1105 InhbCdnOfPrkgEmgyBrk 0;
BA_ "GenSigSendType" SG_ 274 DrvrAsscSysIndcrReq 0;
BA_ "GenSigSendType" SG_ 274 DrvrAsscSysSts 0;
BA_ "GenSigSendType" SG_ 274 ImgSnsrReWrg 0;
BA_ "GenSigSendType" SG_ 274 ImgSnsrRiWrg 0;
BA_ "GenSigStartValue" SG_ 274 LineDetnPptyLeAgOffCenAndLine 200;
BA_ "GenSigSendType" SG_ 274 LineDetnPptyLeAgOffCenAndLine 0;
BA_ "GenSigSendType" SG_ 274 LineDetnPptyLeChks 0;
BA_ "GenSigSendType" SG_ 274 LineDetnPptyLeCntr 0;
BA_ "GenSigSendType" SG_ 274 LineDetnPptyLeDstVertCenAndLine 0;
BA_ "GenSigStartValue" SG_ 274 LineDetnPptyLeLineCrvt 32;
BA_ "GenSigSendType" SG_ 274 LineDetnPptyLeLineCrvt 0;
BA_ "GenSigSendType" SG_ 274 LineDetnPptyLeLineDetdDe 0;
BA_ "GenSigSendType" SG_ 274 LineDetnPptyLeLineDetdEfc 0;
BA_ "GenSigSendType" SG_ 274 LineDetnPptyLeLineTintg 0;
BA_ "GenSigSendType" SG_ 274 LineDetnPptyLeLineTyp 0;
BA_ "GenSigSendType" SG_ 274 LineDetnPptyLeLineWidth 0;
BA_ "GenSigSendType" SG_ 274 LineDetnPptyLeTiStamp 0;
BA_ "GenSigStartValue" SG_ 274 LineDetnPptyRiAgOffCenAndLine 200;
BA_ "GenSigSendType" SG_ 274 LineDetnPptyRiAgOffCenAndLine 0;
BA_ "GenSigSendType" SG_ 274 LineDetnPptyRiChks 0;
BA_ "GenSigSendType" SG_ 274 LineDetnPptyRiCntr 0;
BA_ "GenSigSendType" SG_ 274 LineDetnPptyRiDstVertCenAndLine 0;
BA_ "GenSigStartValue" SG_ 274 LineDetnPptyRiLineCrvt 32;
BA_ "GenSigSendType" SG_ 274 LineDetnPptyRiLineCrvt 0;
BA_ "GenSigSendType" SG_ 274 LineDetnPptyRiLineDetdDe 0;
BA_ "GenSigSendType" SG_ 274 LineDetnPptyRiLineDetdEfc 0;
BA_ "GenSigSendType" SG_ 274 LineDetnPptyRiLineTintg 0;
BA_ "GenSigSendType" SG_ 274 LineDetnPptyRiLineTyp 0;
BA_ "GenSigSendType" SG_ 274 LineDetnPptyRiLineWidth 0;
BA_ "GenSigSendType" SG_ 274 LineDetnPptyRiTiStamp 0;
BA_ "GenSigSendType" SG_ 274 PrkgEmgyBrkSysSts 0;
BA_ "GenSigStartValue" SG_ 274 PrkgEmgyBrkSysSts_UB 1;
BA_ "GenSigSendType" SG_ 274 PrkgLockReq 0;
VAL_ 384 DoorDrvrLockSts 0 "LockSts2_LockStsUkwn" 1 "LockSts2_Unlckd" 2 "LockSts2_Lockd" 3 "LockSts2_SafeLockd" ;
VAL_ 384 DoorLeReLockSts 0 "LockSts2_LockStsUkwn" 1 "LockSts2_Unlckd" 2 "LockSts2_Lockd" 3 "LockSts2_SafeLockd" ;
VAL_ 384 DoorPassLockSts 0 "LockSts2_LockStsUkwn" 1 "LockSts2_Unlckd" 2 "LockSts2_Lockd" 3 "LockSts2_SafeLockd" ;
VAL_ 384 DoorRiReLockSts 0 "LockSts2_LockStsUkwn" 1 "LockSts2_Unlckd" 2 "LockSts2_Lockd" 3 "LockSts2_SafeLockd" ;
VAL_ 384 DrvrPrsntStsDrvrPrsnt 0 "NoYesCrit1_NotVld1" 1 "NoYesCrit1_No" 2 "NoYesCrit1_Yes" 3 "NoYesCrit1_NotVld2" ;
VAL_ 384 DrvrPrsntStsDrvrPrsntQf 0 "Qf1_DevOfDataUndefd" 1 "Qf1_DataTmpUndefdAndEvlnInProgs" 2 "Qf1_DevOfDataNotWithinRngAllwd" 3 "Qf1_DataCalcdWithDevDefd" ;
VAL_ 384 ExtrLtgStsAFS 0 "DevSts4_Off" 1 "DevSts4_On" 2 "DevSts4_Err" 3 "DevSts4_Resd" ;
VAL_ 384 ExtrLtgStsAHBC 0 "DevSts4_Off" 1 "DevSts4_On" 2 "DevSts4_Err" 3 "DevSts4_Resd" ;
VAL_ 384 ExtrLtgStsAHL 0 "DevSts4_Off" 1 "DevSts4_On" 2 "DevSts4_Err" 3 "DevSts4_Resd" ;
VAL_ 384 ExtrLtgStsAllWL 0 "DevSts4_Off" 1 "DevSts4_On" 2 "DevSts4_Err" 3 "DevSts4_Resd" ;
VAL_ 384 ExtrLtgStsApproach 0 "DevSts4_Off" 1 "DevSts4_On" 2 "DevSts4_Err" 3 "DevSts4_Resd" ;
VAL_ 384 ExtrLtgStsCornrgLi 0 "DevSts4_Off" 1 "DevSts4_On" 2 "DevSts4_Err" 3 "DevSts4_Resd" ;
VAL_ 384 ExtrLtgStsDBL 0 "DevSts4_Off" 1 "DevSts4_On" 2 "DevSts4_Err" 3 "DevSts4_Resd" ;
VAL_ 384 ExtrLtgStsDRL 0 "DevSts4_Off" 1 "DevSts4_On" 2 "DevSts4_Err" 3 "DevSts4_Resd" ;
VAL_ 384 ExtrLtgStsFlash 0 "DevSts4_Off" 1 "DevSts4_On" 2 "DevSts4_Err" 3 "DevSts4_Resd" ;
VAL_ 384 ExtrLtgStsFrntFog 0 "DevSts4_Off" 1 "DevSts4_On" 2 "DevSts4_Err" 3 "DevSts4_Resd" ;
VAL_ 384 ExtrLtgStsGoodbye 0 "DevSts4_Off" 1 "DevSts4_On" 2 "DevSts4_Err" 3 "DevSts4_Resd" ;
VAL_ 384 ExtrLtgStsHiBeam 0 "DevSts4_Off" 1 "DevSts4_On" 2 "DevSts4_Err" 3 "DevSts4_Resd" ;
VAL_ 384 ExtrLtgStsHomeSafe 0 "DevSts4_Off" 1 "DevSts4_On" 2 "DevSts4_Err" 3 "DevSts4_Resd" ;
VAL_ 384 ExtrLtgStsHWL 0 "DevSts4_Off" 1 "DevSts4_On" 2 "DevSts4_Err" 3 "DevSts4_Resd" ;
VAL_ 384 ExtrLtgStsLoBeam 0 "DevSts4_Off" 1 "DevSts4_On" 2 "DevSts4_Err" 3 "DevSts4_Resd" ;
VAL_ 384 ExtrLtgStsLtgShow 0 "DevSts4_Off" 1 "DevSts4_On" 2 "DevSts4_Err" 3 "DevSts4_Resd" ;
VAL_ 384 ExtrLtgStsPosLiFrnt 0 "DevSts4_Off" 1 "DevSts4_On" 2 "DevSts4_Err" 3 "DevSts4_Resd" ;
VAL_ 384 ExtrLtgStsPosLiRe 0 "DevSts4_Off" 1 "DevSts4_On" 2 "DevSts4_Err" 3 "DevSts4_Resd" ;
VAL_ 384 ExtrLtgStsReFog 0 "DevSts4_Off" 1 "DevSts4_On" 2 "DevSts4_Err" 3 "DevSts4_Resd" ;
VAL_ 384 ExtrLtgStsReverseLi 0 "DevSts4_Off" 1 "DevSts4_On" 2 "DevSts4_Err" 3 "DevSts4_Resd" ;
VAL_ 384 ExtrLtgStsStopLi 0 "DevSts4_Off" 1 "DevSts4_On" 2 "DevSts4_Err" 3 "DevSts4_Resd" ;
VAL_ 384 ExtrLtgStsTurnIndrLe 0 "DevSts4_Off" 1 "DevSts4_On" 2 "DevSts4_Err" 3 "DevSts4_Resd" ;
VAL_ 384 ExtrLtgStsTurnIndrRi 0 "DevSts4_Off" 1 "DevSts4_On" 2 "DevSts4_Err" 3 "DevSts4_Resd" ;
VAL_ 384 ExtrLtgStsWelcome 0 "DevSts4_Off" 1 "DevSts4_On" 2 "DevSts4_Err" 3 "DevSts4_Resd" ;
VAL_ 384 IndcrSts 0 "IndcrSts1_Off" 1 "IndcrSts1_LeOn" 2 "IndcrSts1_RiOn" 3 "IndcrSts1_LeAndRiOn" ;
VAL_ 384 TrLockSts 0 "LockSts2_LockStsUkwn" 1 "LockSts2_Unlckd" 2 "LockSts2_Lockd" 3 "LockSts2_SafeLockd" ;
VAL_ 384 TrlrPrsnt 0 "TrlrPrsntSts_TrlrNotPrsnt" 1 "TrlrPrsntSts_TrlrPrsnt" ;
VAL_ 781 PrkgDstCtrlSysSwt 0 "OnOff1_Off" 1 "OnOff1_On" ;
VAL_ 781 PrkgIntrptReldBtn 0 "ActvnAvl3_Idle" 1 "ActvnAvl3_Actvn" 2 "ActvnAvl3_Deactvn" ;
VAL_ 781 PrkgTypAutBtn 0 "OnOff1_Off" 1 "OnOff1_On" ;
VAL_ 89 VehBattUSysUQf 0 "GenQf1_UndefindDataAccur" 1 "GenQf1_TmpUndefdData" 2 "GenQf1_DataAccurNotWithinSpcn" 3 "GenQf1_AccurData" ;
VAL_ 69 DrvrAsscSysParkMod 0 "DrvrFbOfPrkgMod2_Default" 1 "DrvrFbOfPrkgMod2_Cancel" 2 "DrvrFbOfPrkgMod2_HorizontalParkingIn" 3 "DrvrFbOfPrkgMod2_PerpendicularParkingIn" 4 "DrvrFbOfPrkgMod2_PerpendicularParkingInForward" 5 "DrvrFbOfPrkgMod2_PerpendicularParkingInBackward" 6 "DrvrFbOfPrkgMod2_Reserved1" 7 "DrvrFbOfPrkgMod2_Reserved2" 8 "DrvrFbOfPrkgMod2_Reserved3" 9 "DrvrFbOfPrkgMod2_HorizontalLeftParkingOut" 10 "DrvrFbOfPrkgMod2_HorizontalRightParkingOut" 11 "DrvrFbOfPrkgMod2_PerpendicularLeftParkingOutForward" 12 "DrvrFbOfPrkgMod2_PerpendicularRightParkingOutForward" 13 "DrvrFbOfPrkgMod2_PerpendicularLeftParkingOutBackward" 14 "DrvrFbOfPrkgMod2_PerpendicularRightParkingOutBackward" 15 "DrvrFbOfPrkgMod2_Reserved6" ;
VAL_ 69 PlaModReq 0 "Normal_Mode" 1 "Factory_Mode" ;
VAL_ 69 PrkgEmgBrkSysSwt 0 "OnOff1_Off" 1 "OnOff1_On" ;
VAL_ 69 PrkgIndcrLineReqIdPen 0 "IdPen_ProfUkwn" 1 "IdPen_Prof1" 2 "IdPen_Prof2" 3 "IdPen_Prof3" 4 "IdPen_Prof4" 5 "IdPen_Prof5" 6 "IdPen_Prof6" 7 "IdPen_Prof7" 8 "IdPen_Prof8" 9 "IdPen_Prof9" 10 "IdPen_Prof10" 11 "IdPen_Prof11" 12 "IdPen_Prof12" 13 "IdPen_Prof13" 14 "IdPen_Resd14" 15 "IdPen_ProfAll" ;
VAL_ 69 PrkgIndcrLineReqOnOff1 0 "OnOff1_Off" 1 "OnOff1_On" ;
VAL_ 69 PrkgInOrOutAndCncl 0 "PrkgInOrOutAndCncl1_Default" 1 "PrkgInOrOutAndCncl1_ParkingIn" 2 "PrkgInOrOutAndCncl1_ParkingOut" 3 "PrkgInOrOutAndCncl1_Cancel" ;
VAL_ 69 RemPrkgEnaReq 0 "OnOff1_Off" 1 "OnOff1_On" ;
VAL_ 69 SurrndgsObjDetnReqIdPen 0 "IdPen_ProfUkwn" 1 "IdPen_Prof1" 2 "IdPen_Prof2" 3 "IdPen_Prof3" 4 "IdPen_Prof4" 5 "IdPen_Prof5" 6 "IdPen_Prof6" 7 "IdPen_Prof7" 8 "IdPen_Prof8" 9 "IdPen_Prof9" 10 "IdPen_Prof10" 11 "IdPen_Prof11" 12 "IdPen_Prof12" 13 "IdPen_Prof13" 14 "IdPen_Resd14" 15 "IdPen_ProfAll" ;
VAL_ 69 SurrndgsObjDetnReqOnOff1 0 "OnOff1_Off" 1 "OnOff1_On" ;
VAL_ 69 SwtDispOnAndOffReq 0 "OnOff1_Off" 1 "OnOff1_On" ;
VAL_ 69 ThrDTouringViewReqIdPen 0 "IdPen_ProfUkwn" 1 "IdPen_Prof1" 2 "IdPen_Prof2" 3 "IdPen_Prof3" 4 "IdPen_Prof4" 5 "IdPen_Prof5" 6 "IdPen_Prof6" 7 "IdPen_Prof7" 8 "IdPen_Prof8" 9 "IdPen_Prof9" 10 "IdPen_Prof10" 11 "IdPen_Prof11" 12 "IdPen_Prof12" 13 "IdPen_Prof13" 14 "IdPen_Resd14" 15 "IdPen_ProfAll" ;
VAL_ 69 ThrDTouringViewReqOnOff1 0 "OnOff1_Off" 1 "OnOff1_On" ;
VAL_ 69 TopVisnDispExtnReqIdPen 0 "IdPen_ProfUkwn" 1 "IdPen_Prof1" 2 "IdPen_Prof2" 3 "IdPen_Prof3" 4 "IdPen_Prof4" 5 "IdPen_Prof5" 6 "IdPen_Prof6" 7 "IdPen_Prof7" 8 "IdPen_Prof8" 9 "IdPen_Prof9" 10 "IdPen_Prof10" 11 "IdPen_Prof11" 12 "IdPen_Prof12" 13 "IdPen_Prof13" 14 "IdPen_Resd14" 15 "IdPen_ProfAll" ;
VAL_ 69 TopVisnDispExtnReqOnOff1 0 "OnOff1_Off" 1 "OnOff1_On" ;
VAL_ 69 TurnEntryAgWideVisReqIdPen 0 "IdPen_ProfUkwn" 1 "IdPen_Prof1" 2 "IdPen_Prof2" 3 "IdPen_Prof3" 4 "IdPen_Prof4" 5 "IdPen_Prof5" 6 "IdPen_Prof6" 7 "IdPen_Prof7" 8 "IdPen_Prof8" 9 "IdPen_Prof9" 10 "IdPen_Prof10" 11 "IdPen_Prof11" 12 "IdPen_Prof12" 13 "IdPen_Prof13" 14 "IdPen_Resd14" 15 "IdPen_ProfAll" ;
VAL_ 69 TurnEntryAgWideVisReqOnOff1 0 "OnOff1_Off" 1 "OnOff1_On" ;
VAL_ 69 VehMdlClrReqIdPen 0 "IdPen_ProfUkwn" 1 "IdPen_Prof1" 2 "IdPen_Prof2" 3 "IdPen_Prof3" 4 "IdPen_Prof4" 5 "IdPen_Prof5" 6 "IdPen_Prof6" 7 "IdPen_Prof7" 8 "IdPen_Prof8" 9 "IdPen_Prof9" 10 "IdPen_Prof10" 11 "IdPen_Prof11" 12 "IdPen_Prof12" 13 "IdPen_Prof13" 14 "IdPen_Resd14" 15 "IdPen_ProfAll" ;
VAL_ 69 VehMdlClrReqOnOff1 0 "OnOff1_Off" 1 "OnOff1_On" ;
VAL_ 69 VisnAgExtnReq 0 "OnOff1_Off" 1 "OnOff1_On" ;
VAL_ 112 DvrErrSts 0 "DvrErrSts_NoError" 1 "DvrErrSts_NoCameraConnected" 2 "DvrErrSts_RecordingError" 3 "DvrErrSts_EthernetError" 4 "DvrErrSts_GSensorError" 5 "DvrErrSts_NandFlashReadingError" 6 "DvrErrSts_NandFlashWritingError" 7 "DvrErrSts_SystemCrashOrWatchDogTimeout" 8 "DvrErrSts_PASErrorHappened" 9 "DvrErrSts_Reserved1" 10 "DvrErrSts_OverHeatProtectionMode" 11 "DvrErrSts_DVROccupied" 12 "DvrErrSts_TFcardSlow" 13 "DvrErrSts_TFcardFragment" 14 "DvrErrSts_AbnormalVolt" 15 "DvrErrSts_UnknownError" ;
VAL_ 112 DVRSysSts 0 "DVRSysSts_Off" 1 "DVRSysSts_Normal" 2 "DVRSysSts_Overheat" 3 "DVRSysSts_ParkingRecord" 4 "DVRSysSts_ParkingMonitor" 5 "DVRSysSts_Reserved1" 6 "DVRSysSts_Reserved2" 7 "DVRSysSts_Reserved3" ;
VAL_ 112 PrkgTouchCoornReqFingerIndex 0 "Index_NoReq" 1 "Index_1" 2 "Index_2" 3 "Index_Reserved" ;
VAL_ 112 PrkgTouchCoornReqTouchEveTyp 0 "NotTouch" 1 "PenDown" 2 "PenUp" 3 "PenMove" ;
VAL_ 96 EngRunngReqByParkAssi1 0 "EngRunngReqByParkAssi1_Default" 1 "EngRunngReqByParkAssi1_StopInhibited" 2 "EngRunngReqByParkAssi1_RequestToKeepTheEngineRunning" 3 "EngRunngReqByParkAssi1_Reserved" ;
VAL_ 96 FctStDisp 0 "FctStDisp_Default" 1 "FctStDisp_DisplayControlOpetatingTip" 2 "FctStDisp_DisplayControlActiveTip" 3 "FctStDisp_DisplayFunctionQuit" ;
VAL_ 96 FctStRemPrkgWarn 0 "RemPrkgWarn_Default" 1 "RemPrkgWarn_ExternalECUFailure" 2 "RemPrkgWarn_PASECUFailure" 3 "RemPrkgWarn_OtherFunctionActive" 4 "RemPrkgWarn_EngineOffOrHVDown" 5 "RemPrkgWarn_BluetoochFailure" 6 "RemPrkgWarn_SpeedGreaterThan3kmh" 7 "RemPrkgWarn_HeavyRain" 8 "RemPrkgWarn_Suspend8Times_MobileDevicePushMoveButton20Times" 9 "RemPrkgWarn_CallDialBeyond2Min" 10 "RemPrkgWarn_GradientOfTheGroundExceed8OrTheSuspendFaultIsNotRemovedExceed30s" 11 "RemPrkgWarn_LateralEvadibleBrake" 12 "RemPrkgWarn_MobileApp" 13 "RemPrkgWarn_VMMIsFail" 14 "RemPrkgWarn_ParkingSpaceLimit" 15 "RemPrkgWarn_Reserved1" 16 "RemPrkgWarn_Reserved2" 17 "RemPrkgWarn_Reserved3" 18 "RemPrkgWarn_Reserved4" 19 "RemPrkgWarn_Reserved5" 20 "RemPrkgWarn_Reserved6" 21 "RemPrkgWarn_Reserved7" 22 "RemPrkgWarn_Reserved8" 23 "RemPrkgWarn_Reserved9" 24 "RemPrkgWarn_Reserved10" 25 "RemPrkgWarn_Reserved11" 26 "RemPrkgWarn_Reserved12" 27 "RemPrkgWarn_Reserved13" 28 "RemPrkgWarn_Reserved14" 29 "RemPrkgWarn_Reserved15" 30 "RemPrkgWarn_Reserved16" 31 "RemPrkgWarn_Reserved17" 32 "RemPrkgWarn_BTConnectionMissing3Cycle" 33 "RemPrkgWarn_EPBTrigger" 34 "RemPrkgWarn_SteeringWheelIntervention" 35 "RemPrkgWarn_GearIntervention" 36 "RemPrkgWarn_GasPedalPressed" 37 "RemPrkgWarn_BrakePedalPressed" 38 "RemPrkgWarn_OutsideRearMirrorFold" 39 "RemPrkgWarn_DoorOpen" 40 "RemPrkgWarn_TrunkOpen" 41 "RemPrkgWarn_HoodOpen" 42 "RemPrkgWarn_ObjectsDetectedIncludeTrajectory" 43 "RemPrkgWarn_AVMCameraSmudginess" 44 "RemPrkgWarn_FrontUSSSmudginessAndRearUSSSmudginess" 45 "RemPrkgWarn_FrontUSSSmudginess" 46 "RemPrkgWarn_RearUSSSmudginess" 47 "RemPrkgWarn_FCTAWarning" 48 "RemPrkgWarn_RCTAWarning" 49 "RemPrkgWarn_RemoteArangeOverflow6m" 50 "RemPrkgWarn_UserNoPushButton" 51 "RemPrkgWarn_CallDialLessThan2Min" 52 "RemPrkgWarn_OneMoveLengthGreaterThan0m" 53 "RemPrkgWarn_KeyInVehicle" 54 "RemPrkgWarn_DoorUnlockOrTrailIsConnected" ;
VAL_ 96 GearPrkgAssiReqGroupGearPrkgAssi 0 "GearPrkgAssiReq1_NoRequest" 1 "GearPrkgAssiReq1_TargetgearP" 2 "GearPrkgAssiReq1_TargetgearR" 3 "GearPrkgAssiReq1_TargetgearD" ;
VAL_ 96 ImgSnsrFrntWrg 0 "Flt_NoFault" 1 "Flt_Fault" ;
VAL_ 96 MobDevRPAAuthentReqAuthentSts 0 "Auth_Success" 1 "Auth_Failed" 2 "Auth_None" 3 "Auth_Reserved1" ;
VAL_ 96 NetPASActvtPrio 0 "PrioHighNormal_PrioNormal" 1 "PrioHighNormal_PrioHigh" ;
VAL_ 96 PrkgAsscSysEcuTyp 0 "PrkgAsscSysEcuTyp_PAS1" 1 "PrkgAsscSysEcuTyp_PAS2" 2 "PrkgAsscSysEcuTyp_PAS3" ;
VAL_ 96 PrkgAssiElectcStabyProgCtrl_0002 0 "PASElectcStabyProgCtrlMod_NoRequest" 1 "PASElectcStabyProgCtrlMod_APARequest" 2 "PASElectcStabyProgCtrlMod_RPArequest" 3 "PASElectcStabyProgCtrlMod_HPArequest" 4 "PASElectcStabyProgCtrlMod_APAcontrolactive" 5 "PASElectcStabyProgCtrlMod_RPAcontrolactive" 6 "PASElectcStabyProgCtrlMod_HPAcontrolactive" 7 "PASElectcStabyProgCtrlMod_Reserved2" ;
VAL_ 96 PrkgAssiSysRemPrkgSts 0 "PrkgAssiSysRemPrkgSts_OFF" 1 "PrkgAssiSysRemPrkgSts_Remoteparkinstandby" 2 "PrkgAssiSysRemPrkgSts_Remoteparkoutstandby" 3 "PrkgAssiSysRemPrkgSts_Searching" 4 "PrkgAssiSysRemPrkgSts_Remoteparkinpreactive" 5 "PrkgAssiSysRemPrkgSts_Remoteparkactive" 6 "PrkgAssiSysRemPrkgSts_Parkprocessactive" 7 "PrkgAssiSysRemPrkgSts_Suspend" 8 "PrkgAssiSysRemPrkgSts_Abort" 9 "PrkgAssiSysRemPrkgSts_Remoteparkprocesscompleted" 10 "PrkgAssiSysRemPrkgSts_Remoteparkoutprocscompleted" 11 "PrkgAssiSysRemPrkgSts_Remoteparkcompleted" 12 "PrkgAssiSysRemPrkgSts_Quit" 13 "PrkgAssiSysRemPrkgSts_Failure" 14 "PrkgAssiSysRemPrkgSts_Cancel" ;
VAL_ 96 PrkgBrkElectcCtrlReqReq 0 "PrkgBrkElectcCtrlReq_NoRequest" 1 "PrkgBrkElectcCtrlReq_ReleaseRequest" 2 "PrkgBrkElectcCtrlReq_ApplyRequest" 3 "PrkgBrkElectcCtrlReq_Reserved" ;
VAL_ 96 PrkgEmgyBrkEmgyBrkReq 0 "ReqSts1_NotReqd" 1 "ReqSts1_Reqd" ;
VAL_ 96 PrkgEmgyBrkEpbApplyReq 0 "ReqSts1_NotReqd" 1 "ReqSts1_Reqd" ;
VAL_ 96 PrkgEmgyBrkStandStillReq 0 "ReqSts1_NotReqd" 1 "ReqSts1_Reqd" ;
VAL_ 96 PrkgSpdCtrlSafeGroupDrvrAsscSysB 0 "DrvrAsscSysBrkFctMod_Default" 1 "DrvrAsscSysBrkFctMod_Comfortable" 2 "DrvrAsscSysBrkFctMod_Emergency" ;
VAL_ 96 PrkgStandstillReqReqSts1 0 "ReqSts1_NotReqd" 1 "ReqSts1_Reqd" ;
VAL_ 96 PrkgUsgDrvModTranReq 0 "Inact_Inactive" 1 "Inact_Active" ;
VAL_ 96 VehBeamLoModReq 0 "OnOffNoReq_NoReq" 1 "OnOffNoReq_On" 2 "OnOffNoReq_Off" ;
VAL_ 96 VehPrkgToHorn 0 "OnOff1_Off" 1 "OnOff1_On" ;
VAL_ 528 AudWarnOfSnsrParkAssiFrnt 0 "BuzzerReq_BuzzerOFF" 1 "BuzzerReq_BuzzerON" 2 "BuzzerReq_BuzzerONat4Hz" 3 "BuzzerReq_BuzzerONat2Hz" 4 "BuzzerReq_LeftON" 5 "BuzzerReq_LeftONat4Hz" 6 "BuzzerReq_LeftONat2Hz" 7 "BuzzerReq_RightON" 8 "BuzzerReq_RightONat4Hz" 9 "BuzzerReq_RightONat2Hz" ;
VAL_ 528 AudWarnOfSnsrParkAssiRe 0 "BuzzerReq_BuzzerOFF" 1 "BuzzerReq_BuzzerON" 2 "BuzzerReq_BuzzerONat4Hz" 3 "BuzzerReq_BuzzerONat2Hz" 4 "BuzzerReq_LeftON" 5 "BuzzerReq_LeftONat4Hz" 6 "BuzzerReq_LeftONat2Hz" 7 "BuzzerReq_RightON" 8 "BuzzerReq_RightONat4Hz" 9 "BuzzerReq_RightONat2Hz" ;
VAL_ 528 DispAndSwtOfPrkgMod 0 "DispAndSwtOfPrkgMod_NoRequest" 1 "DispAndSwtOfPrkgMod_Parkin_Outselect" 2 "DispAndSwtOfPrkgMod_OnlyHorizontalParkingIn" 3 "DispAndSwtOfPrkgMod_OnlyPerpendicularParkingIn_forward" 4 "DispAndSwtOfPrkgMod_OnlyPerpendicularParkingIn_backward" 5 "DispAndSwtOfPrkgMod_HorizontalParkingIn_PerpendicularParkingIn_Forward" 6 "DispAndSwtOfPrkgMod_HorizontalParkingIn_PerpendicularParkingIn_Backward" 7 "DispAndSwtOfPrkgMod_PerpendicularParkingIn_ForwardOrBackward" 8 "DispAndSwtOfPrkgMod_HorizontalParkingInOrPerpendicularParkingIn_ForwardOrBackward" 9 "DispAndSwtOfPrkgMod_OnlyHorizontalParkingOut" 10 "DispAndSwtOfPrkgMod_OnlyPerpendicularParkingOut_Forward" 11 "DispAndSwtOfPrkgMod_OnlyPerpendicularParkingOut_Backward" 12 "DispAndSwtOfPrkgMod_HorizontalParkingOutOrPerpendicularParkingOut_Forward" 13 "DispAndSwtOfPrkgMod_HorizontalParkingOutOrPerpendicularParkingOut_Backward" 14 "DispAndSwtOfPrkgMod_PerpendicularParkingOut_ForwardOrBacward" 15 "DispAndSwtOfPrkgMod_HorizontalParkingOutOrPerpendicularParkingOut_ForwardOrBacward" ;
VAL_ 528 DispPrkgStallBtn 0 "OnOff1_Off" 1 "OnOff1_On" ;
VAL_ 528 FrntLeOfSnsrOfPrkgAssiSide 0 "SnsrPrkgAssiFrntSnsrDstInsd_NoDistance" 1 "SnsrPrkgAssiFrntSnsrDstInsd_Range1" 2 "SnsrPrkgAssiFrntSnsrDstInsd_Range2" 3 "SnsrPrkgAssiFrntSnsrDstInsd_Range3" 4 "SnsrPrkgAssiFrntSnsrDstInsd_Range4" 5 "SnsrPrkgAssiFrntSnsrDstInsd_Range5" 6 "SnsrPrkgAssiFrntSnsrDstInsd_Range6" 7 "SnsrPrkgAssiFrntSnsrDstInsd_Range7" ;
VAL_ 528 FrntRiOfSnsrOfPrkgAssiSide 0 "SnsrPrkgAssiFrntSnsrDstInsd_NoDistance" 1 "SnsrPrkgAssiFrntSnsrDstInsd_Range1" 2 "SnsrPrkgAssiFrntSnsrDstInsd_Range2" 3 "SnsrPrkgAssiFrntSnsrDstInsd_Range3" 4 "SnsrPrkgAssiFrntSnsrDstInsd_Range4" 5 "SnsrPrkgAssiFrntSnsrDstInsd_Range5" 6 "SnsrPrkgAssiFrntSnsrDstInsd_Range6" 7 "SnsrPrkgAssiFrntSnsrDstInsd_Range7" ;
VAL_ 528 ImgSnsrLeWrg 0 "Flt_NoFault" 1 "Flt_Fault" ;
VAL_ 528 InsdLeOfSnsrPrkgAssiFrnt 0 "SnsrPrkgAssiFrntSnsrDstInsd_NoDistance" 1 "SnsrPrkgAssiFrntSnsrDstInsd_Range1" 2 "SnsrPrkgAssiFrntSnsrDstInsd_Range2" 3 "SnsrPrkgAssiFrntSnsrDstInsd_Range3" 4 "SnsrPrkgAssiFrntSnsrDstInsd_Range4" 5 "SnsrPrkgAssiFrntSnsrDstInsd_Range5" 6 "SnsrPrkgAssiFrntSnsrDstInsd_Range6" 7 "SnsrPrkgAssiFrntSnsrDstInsd_Range7" ;
VAL_ 528 InsdLeOfSnsrPrkgAssiRe 0 "SnsrPrkgAssiFrntSnsrDstInsd_NoDistance" 1 "SnsrPrkgAssiFrntSnsrDstInsd_Range1" 2 "SnsrPrkgAssiFrntSnsrDstInsd_Range2" 3 "SnsrPrkgAssiFrntSnsrDstInsd_Range3" 4 "SnsrPrkgAssiFrntSnsrDstInsd_Range4" 5 "SnsrPrkgAssiFrntSnsrDstInsd_Range5" 6 "SnsrPrkgAssiFrntSnsrDstInsd_Range6" 7 "SnsrPrkgAssiFrntSnsrDstInsd_Range7" ;
VAL_ 528 InsdRiOfSnsrPrkgAssiFrnt 0 "SnsrPrkgAssiFrntSnsrDstInsd_NoDistance" 1 "SnsrPrkgAssiFrntSnsrDstInsd_Range1" 2 "SnsrPrkgAssiFrntSnsrDstInsd_Range2" 3 "SnsrPrkgAssiFrntSnsrDstInsd_Range3" 4 "SnsrPrkgAssiFrntSnsrDstInsd_Range4" 5 "SnsrPrkgAssiFrntSnsrDstInsd_Range5" 6 "SnsrPrkgAssiFrntSnsrDstInsd_Range6" 7 "SnsrPrkgAssiFrntSnsrDstInsd_Range7" ;
VAL_ 528 InsdRiOfSnsrPrkgAssiRe 0 "SnsrPrkgAssiFrntSnsrDstInsd_NoDistance" 1 "SnsrPrkgAssiFrntSnsrDstInsd_Range1" 2 "SnsrPrkgAssiFrntSnsrDstInsd_Range2" 3 "SnsrPrkgAssiFrntSnsrDstInsd_Range3" 4 "SnsrPrkgAssiFrntSnsrDstInsd_Range4" 5 "SnsrPrkgAssiFrntSnsrDstInsd_Range5" 6 "SnsrPrkgAssiFrntSnsrDstInsd_Range6" 7 "SnsrPrkgAssiFrntSnsrDstInsd_Range7" ;
VAL_ 528 OutdLeOfSnsrPrkgAssiFrnt 0 "SnsrPrkgAssiFrntSnsrDstInsd_NoDistance" 1 "SnsrPrkgAssiFrntSnsrDstInsd_Range1" 2 "SnsrPrkgAssiFrntSnsrDstInsd_Range2" 3 "SnsrPrkgAssiFrntSnsrDstInsd_Range3" 4 "SnsrPrkgAssiFrntSnsrDstInsd_Range4" 5 "SnsrPrkgAssiFrntSnsrDstInsd_Range5" 6 "SnsrPrkgAssiFrntSnsrDstInsd_Range6" 7 "SnsrPrkgAssiFrntSnsrDstInsd_Range7" ;
VAL_ 528 OutdLeOfSnsrPrkgAssiRe 0 "SnsrPrkgAssiFrntSnsrDstInsd_NoDistance" 1 "SnsrPrkgAssiFrntSnsrDstInsd_Range1" 2 "SnsrPrkgAssiFrntSnsrDstInsd_Range2" 3 "SnsrPrkgAssiFrntSnsrDstInsd_Range3" 4 "SnsrPrkgAssiFrntSnsrDstInsd_Range4" 5 "SnsrPrkgAssiFrntSnsrDstInsd_Range5" 6 "SnsrPrkgAssiFrntSnsrDstInsd_Range6" 7 "SnsrPrkgAssiFrntSnsrDstInsd_Range7" ;
VAL_ 528 OutdRiOfSnsrPrkgAssiFrnt 0 "SnsrPrkgAssiFrntSnsrDstInsd_NoDistance" 1 "SnsrPrkgAssiFrntSnsrDstInsd_Range1" 2 "SnsrPrkgAssiFrntSnsrDstInsd_Range2" 3 "SnsrPrkgAssiFrntSnsrDstInsd_Range3" 4 "SnsrPrkgAssiFrntSnsrDstInsd_Range4" 5 "SnsrPrkgAssiFrntSnsrDstInsd_Range5" 6 "SnsrPrkgAssiFrntSnsrDstInsd_Range6" 7 "SnsrPrkgAssiFrntSnsrDstInsd_Range7" ;
VAL_ 528 OutdRiOfSnsrPrkgAssiRe 0 "SnsrPrkgAssiFrntSnsrDstInsd_NoDistance" 1 "SnsrPrkgAssiFrntSnsrDstInsd_Range1" 2 "SnsrPrkgAssiFrntSnsrDstInsd_Range2" 3 "SnsrPrkgAssiFrntSnsrDstInsd_Range3" 4 "SnsrPrkgAssiFrntSnsrDstInsd_Range4" 5 "SnsrPrkgAssiFrntSnsrDstInsd_Range5" 6 "SnsrPrkgAssiFrntSnsrDstInsd_Range6" 7 "SnsrPrkgAssiFrntSnsrDstInsd_Range7" ;
VAL_ 528 PrkgBackDisp 0 "NoYes1_No" 1 "NoYes1_Yes" ;
VAL_ 528 PrkgEmgyBrkFltDisp 0 "TypeOfPosiDisp_NoDisplay" 1 "TypeOfPosiDisp_FrontFault" 2 "TypeOfPosiDisp_RearFault" ;
VAL_ 528 ReLeOfSnsrOfPrkgAssiSide 0 "SnsrPrkgAssiFrntSnsrDstInsd_NoDistance" 1 "SnsrPrkgAssiFrntSnsrDstInsd_Range1" 2 "SnsrPrkgAssiFrntSnsrDstInsd_Range2" 3 "SnsrPrkgAssiFrntSnsrDstInsd_Range3" 4 "SnsrPrkgAssiFrntSnsrDstInsd_Range4" 5 "SnsrPrkgAssiFrntSnsrDstInsd_Range5" 6 "SnsrPrkgAssiFrntSnsrDstInsd_Range6" 7 "SnsrPrkgAssiFrntSnsrDstInsd_Range7" ;
VAL_ 528 ReRiOfSnsrOfPrkgAssiSide 0 "SnsrPrkgAssiFrntSnsrDstInsd_NoDistance" 1 "SnsrPrkgAssiFrntSnsrDstInsd_Range1" 2 "SnsrPrkgAssiFrntSnsrDstInsd_Range2" 3 "SnsrPrkgAssiFrntSnsrDstInsd_Range3" 4 "SnsrPrkgAssiFrntSnsrDstInsd_Range4" 5 "SnsrPrkgAssiFrntSnsrDstInsd_Range5" 6 "SnsrPrkgAssiFrntSnsrDstInsd_Range6" 7 "SnsrPrkgAssiFrntSnsrDstInsd_Range7" ;
VAL_ 528 ValtPrkgFailrNotif 0 "ValtPrkgFailrNotif_Invalid" 1 "ValtPrkgFailrNotif_FunctionUnavailable" ;
VAL_ 528 ValtSysSts 0 "ValtSysSts_Off" 1 "ValtSysSts_MapListLoading" 2 "ValtSysSts_MapDownloading" 3 "ValtSysSts_Localization" 4 "ValtSysSts_Abort" 5 "ValtSysSts_Failure" 6 "ValtSysSts_Reserved1" 7 "ValtSysSts_Reserved2" 8 "ValtSysSts_ParkingInStandby" 9 "ValtSysSts_ParkingInPreactive" 10 "ValtSysSts_ParkingInCruse" 11 "ValtSysSts_ParkingInProcess" 12 "ValtSysSts_ParkingInComplete" 13 "ValtSysSts_Reserved3" 14 "ValtSysSts_Reserved4" 15 "ValtSysSts_Reserved5" 16 "ValtSysSts_ParkingOutStandby" 17 "ValtSysSts_ParkingOutPreactive" 18 "ValtSysSts_ParkingOutCruse" 19 "ValtSysSts_ParkingOutProcess" 20 "ValtSysSts_ParkingOutComplete" ;
VAL_ 528 VehHomePrkgSysSts 0 "HomePrkgSysSts_Off" 1 "HomePrkgSysSts_Standby" 2 "HomePrkgSysSts_MapBuilding" 3 "HomePrkgSysSts_Localization" 4 "HomePrkgSysSts_Cruse" 5 "HomePrkgSysSts_Reserved1" 6 "HomePrkgSysSts_Reserved2" 7 "HomePrkgSysSts_Reserved3" 8 "HomePrkgSysSts_ParkingInPreactive" 9 "HomePrkgSysSts_ParkingInProcess" 10 "HomePrkgSysSts_Reserved4" 11 "HomePrkgSysSts_Reserved5" 12 "HomePrkgSysSts_ParkingOutPreactive" 13 "HomePrkgSysSts_ParkingOutProcess" 14 "HomePrkgSysSts_Reserved6" 15 "HomePrkgSysSts_Reserved7" 16 "HomePrkgSysSts_FunctionCompleted" 17 "HomePrkgSysSts_Abort" 18 "HomePrkgSysSts_Suspend" ;
VAL_ 528 VehPrkgLockTheftReq 0 "VehPrkgLockTheftProtnReq_NoRequest" 1 "VehPrkgLockTheftProtnReq_InsideLockAndIncompleteArmRequest" 2 "VehPrkgLockTheftProtnReq_OutsideLockAndCompleteArmRequest" 3 "VehPrkgLockTheftProtnReq_UnlockAndDisarmRequest" ;
VAL_ 528 VehWinSunRoofClsReq 0 "OpenCls3_NoRequest" 1 "OpenCls3_Close" 2 "OpenCls3_Reserved1" 3 "OpenCls3_Reserved2" ;
VAL_ 821 ImgSnsrClrReqFrnt 0 "OnOff1_Off" 1 "OnOff1_On" ;
VAL_ 821 ImgSnsrClrReqLe 0 "OnOff1_Off" 1 "OnOff1_On" ;
VAL_ 821 ImgSnsrClrReqRe 0 "OnOff1_Off" 1 "OnOff1_On" ;
VAL_ 821 ImgSnsrClrReqRi 0 "OnOff1_Off" 1 "OnOff1_On" ;
VAL_ 821 MirrOpenClsReq 0 "MirrFoldCmdTyp_Idle" 1 "MirrFoldCmdTyp_FoldIn" 2 "MirrFoldCmdTyp_FoldOut" ;
VAL_ 821 MobDevRPAStsOnOff1 0 "OnOff1_Off" 1 "OnOff1_On" ;
VAL_ 821 PrkgFctDiDisp 0 "PrkgFctDiDisp_SystemIsNormal" 1 "PrkgFctDiDisp_SystemFaultParkingDisable" 2 "PrkgFctDiDisp_FunctionConflictParkingDisable" 3 "PrkgFctDiDisp_SpeedOver20kmhParkingDisable" 4 "PrkgFctDiDisp_HeavyRainParkingDisable" 5 "PrkgFctDiDisp_GradientOverRangeParkingDisable" 6 "PrkgFctDiDisp_RVCMsystemFailureParkingDisable" ;
VAL_ 529 InsdSnsrFltFrntShoLe 0 "FltAddCover_NoFault" 1 "FltAddCover_Fault" 2 "FltAddCover_Cover" ;
VAL_ 529 InsdSnsrFltFrntShoRi 0 "FltAddCover_NoFault" 1 "FltAddCover_Fault" 2 "FltAddCover_Cover" ;
VAL_ 529 InsdSnsrFltReShoLe 0 "FltAddCover_NoFault" 1 "FltAddCover_Fault" 2 "FltAddCover_Cover" ;
VAL_ 529 InsdSnsrFltReShoRi 0 "FltAddCover_NoFault" 1 "FltAddCover_Fault" 2 "FltAddCover_Cover" ;
VAL_ 529 ObjOnIfOfSnsr 0 "ObjOnIfOfSnsr_Normal" 1 "ObjOnIfOfSnsr_FrontUSSCoverd" 2 "ObjOnIfOfSnsr_RearUSSCoverd" 3 "ObjOnIfOfSnsr_FrontAndRearUSSCoverd" ;
VAL_ 529 OutdSnsrFltFrntShoLe 0 "FltAddCover_NoFault" 1 "FltAddCover_Fault" 2 "FltAddCover_Cover" ;
VAL_ 529 OutdSnsrFltFrntShoRi 0 "FltAddCover_NoFault" 1 "FltAddCover_Fault" 2 "FltAddCover_Cover" ;
VAL_ 529 OutdSnsrFltReShoLe 0 "FltAddCover_NoFault" 1 "FltAddCover_Fault" 2 "FltAddCover_Cover" ;
VAL_ 529 OutdSnsrFltReShoRi 0 "FltAddCover_NoFault" 1 "FltAddCover_Fault" 2 "FltAddCover_Cover" ;
VAL_ 529 PrkgDstCtrlWarn 0 "WarningInd_NoWarning" 1 "WarningInd_Warning" ;
VAL_ 529 SnsrFltFrntShoSideLe 0 "FltAddCover_NoFault" 1 "FltAddCover_Fault" 2 "FltAddCover_Cover" ;
VAL_ 529 SnsrFltFrntShoSideRi 0 "FltAddCover_NoFault" 1 "FltAddCover_Fault" 2 "FltAddCover_Cover" ;
VAL_ 529 SnsrFltOfPrkgDstCtrl 0 "SnsrFltOfPrkgDstCtrl_Normal" 1 "SnsrFltOfPrkgDstCtrl_FrontUSSFault" 2 "SnsrFltOfPrkgDstCtrl_RearUSSFault" 3 "SnsrFltOfPrkgDstCtrl_FrontAndRearUSSFault" ;
VAL_ 529 SnsrFltReShoSideLe 0 "FltAddCover_NoFault" 1 "FltAddCover_Fault" 2 "FltAddCover_Cover" ;
VAL_ 529 SnsrFltReShoSideRi 0 "FltAddCover_NoFault" 1 "FltAddCover_Fault" 2 "FltAddCover_Cover" ;
VAL_ 587 DrvrAsscSysDisp 0 "DrvrAsscSysDisp_Off" 1 "DrvrAsscSysDisp_ParkingInParkingOutSelect" 2 "DrvrAsscSysDisp_Reserve1" 3 "DrvrAsscSysDisp_VehicleSpeedIsTooFastPleaseSlowDown" 4 "DrvrAsscSysDisp_SearchedParkingSlotPressTheBrakePedalAndSelectParkingSlot_APA" 5 "DrvrAsscSysDisp_SelectRecommendParkingSpaceAndHangD_Or_ClickAnotherParkingSpace" 6 "DrvrAsscSysDisp_SelectRecommendParkingSpaceAndHangR_Or_ClickAnotherParkingSpace" 7 "DrvrAsscSysDisp_SpeedNotZeroAndCanNotParkingOut" 8 "DrvrAsscSysDisp_SeatBeltReleased_BeforeActive" 9 "DrvrAsscSysDisp_SearchedParkingSlotPressTheBrakePedalAndSelectParkingSlot_APARPA" 10 "DrvrAsscSysDisp_DoorOpen_BeforeActive" 11 "DrvrAsscSysDisp_SearchedParkingSlotPressTheBrakePedalAndSelectParkingSlot_RPA" 12 "DrvrAsscSysDisp_TrunkOpen_BeforeActive" 13 "DrvrAsscSysDisp_GradientOverRange_Searching" 14 "DrvrAsscSysDisp_TrailerActive_BeforeActive" 15 "DrvrAsscSysDisp_GradientOverRange_BeforeActive" 16 "DrvrAsscSysDisp_TowbarActive_BeforeActive" 17 "DrvrAsscSysDisp_CameraSmugled_BeforeActive" 18 "DrvrAsscSysDisp_MirrorFold_BeforeActive" 19 "DrvrAsscSysDisp_UssCovered_BeforeActive" 20 "DrvrAsscSysDisp_HoldOpen_BeforeActive" 21 "DrvrAsscSysDisp_SeatBeltReleased_Active" 22 "DrvrAsscSysDisp_DoorOpen_Active" 23 "DrvrAsscSysDisp_TrunkOpen_Active" 24 "DrvrAsscSysDisp_TrailerActive_Active" 25 "DrvrAsscSysDisp_TowbarActive_Active" 26 "DrvrAsscSysDisp_MirrorFold_Active" 27 "DrvrAsscSysDisp_HoldOpen_Active" 28 "DrvrAsscSysDisp_ObstacleOccur_Active" 29 "DrvrAsscSysDisp_EpbActivated_Active" 30 "DrvrAsscSysDisp_VehicleSpeedOverranging_UndoInvalid" 31 "DrvrAsscSysDisp_MoveTimesOverflow_UndoInvalid" 32 "DrvrAsscSysDisp_InterruptTimesOverflow_UndoInvalid" 33 "DrvrAsscSysDisp_GradientOverranging_UndoInvalid" 34 "DrvrAsscSysDisp_RelatedSystemFail_UndoInvalid" 35 "DrvrAsscSysDisp_InterveneSystemActive_UndoInvalid" 36 "DrvrAsscSysDisp_OutOfTrajectory_UndoInvalid" 37 "DrvrAsscSysDisp_SystemFault_BeforeActive" 38 "DrvrAsscSysDisp_FunctionConflict_BeforeActive" 39 "DrvrAsscSysDisp_HeavyRain_BeforeActive" 40 "DrvrAsscSysDisp_ParkingTimeout_UndoInvalid" 41 "DrvrAsscSysDisp_SpaceLimit_UndoInvalid" 42 "DrvrAsscSysDisp_EngOff_UndoInvalid" 43 "DrvrAsscSysDisp_TheUserResponseTimeout_UndoInvalid" 44 "DrvrAsscSysDisp_PasFail_UndoInvalid" 45 "DrvrAsscSysDisp_AvmFailOrNoCalibration_UndoInvalid" 46 "DrvrAsscSysDisp_OverrideByGearShift_Active" 47 "DrvrAsscSysDisp_GradeOfRainOverflow_UndoInvalid" 48 "DrvrAsscSysDisp_GradientOverranging_UndoValid" 49 "DrvrAsscSysDisp_CameraSmugled_Active" 50 "DrvrAsscSysDisp_FrontAndRearUssCovered_Active" 51 "DrvrAsscSysDisp_OverrideByGasPedal_Active" 52 "DrvrAsscSysDisp_TheUserResponseTimeout_UndoValid" 53 "DrvrAsscSysDisp_APASelectRRpaSelectP" 54 "DrvrAsscSysDisp_ReleaseTheBrakePedal" 55 "DrvrAsscSysDisp_SysTimeoutParkingFunctionQuitPleaseTakeOverTheCar" 56 "DrvrAsscSysDisp_ParkingFinished" 57 "DrvrAsscSysDisp_OverrideBySteeringWheel_Active" 58 "DrvrAsscSysDisp_Reserve2" 59 "DrvrAsscSysDisp_SelectDGear" 60 "DrvrAsscSysDisp_Reserve3" 61 "DrvrAsscSysDisp_SelectRGear" 62 "DrvrAsscSysDisp_Reserve4" 63 "DrvrAsscSysDisp_Reserve5" 64 "DrvrAsscSysDisp_APASelectRRpaSelectPSmallSlotRecommendRPA" 65 "DrvrAsscSysDisp_Reserve6" 66 "DrvrAsscSysDisp_Reserve7" 67 "DrvrAsscSysDisp_Reserve8" 68 "DrvrAsscSysDisp_FrontUssCovered_Active" 69 "DrvrAsscSysDisp_RearUssCovered_Active" 70 "DrvrAsscSysDisp_FctaActive_Active" 71 "DrvrAsscSysDisp_RctaActive_Active" 72 "DrvrAsscSysDisp_FrontUssCovered_BeforeActive" 73 "DrvrAsscSysDisp_RearUSSCovered_And_BeforeActive" 74 "DrvrAsscSysDisp_ParkingQuit" 75 "DrvrAsscSysDisp_ParkingInterruptRecoverPleaseSelectContinueOrNot" 76 "DrvrAsscSysDisp_EPBActivePleaseUseMobileAPPToConnectVehicle" 77 "DrvrAsscSysDisp_SearchingParkingSlot" 78 "DrvrAsscSysDisp_FoundParkingSlot" 79 "DrvrAsscSysDisp_PleaseConnectTheAppAndTakeOutKey" 80 "DrvrAsscSysDisp_RemoteParkAssistIsWorking" 81 "DrvrAsscSysDisp_RemoteParkAssistIsQuit" 82 "DrvrAsscSysDisp_RemoteParkAssistIsFinished" ;
VAL_ 587 MobDevFctStTip 0 "MobDevFctStTip_Default" 1 "MobDevFctStTip_PushButtonStartSearchParkingSlot" 2 "MobDevFctStTip_Searching" 3 "MobDevFctStTip_StartParkingIn" 4 "MobDevFctStTip_StartParkingOut" 5 "MobDevFctStTip_Parking" 6 "MobDevFctStTip_NotToSearch" 7 "MobDevFctStTip_Continue" 8 "MobDevFctStTip_OutToRange" 9 "MobDevFctStTip_TheftProtection" ;
VAL_ 587 PdcMuteBtnSts 0 "OnOff1_Off" 1 "OnOff1_On" ;
VAL_ 587 PlaModStsResp 0 "Normal_Mode" 1 "Factory_Mode" ;
VAL_ 587 PrkgAuxInfoDisp 0 "PrkgAuxInfoDisp_NoReq" 1 "PrkgAuxInfoDisp_PleasePayAttentionToSurrounding" 2 "PrkgAuxInfoDisp_PleaseForward" 3 "PrkgAuxInfoDisp_PressTtheBrakePedal" 4 "PrkgAuxInfoDisp_SelectParkingSlot" 5 "PrkgAuxInfoDisp_ParkingSlotSelected" 6 "PrkgAuxInfoDisp_ParkingTypeRecommandButtonOff" 7 "PrkgAuxInfoDisp_ChooseParkingMode_Or_ChangeOtherParkingSpaces" 8 "PrkgAuxInfoDisp_ChooseParkingMode" ;
VAL_ 587 PrkgDispGroupLeCornrLocn 0 "CornrLocn_TopLeftX" 1 "CornrLocn_TopRightY" 2 "CornrLocn_LowLeftX" 3 "CornrLocn_LowRightY" ;
VAL_ 587 PrkgDispGroupPrkgTyp 0 "PrkgTyp_Default" 1 "PrkgTyp_LeftPerpendicular" 2 "PrkgTyp_LeftParallel" 3 "PrkgTyp_RightPerpendicular" 4 "PrkgTyp_RightParallel" 5 "PrkgTyp_Reserved2" 6 "PrkgTyp_Reserved3" 7 "PrkgTyp_Reserved4" ;
VAL_ 587 PrkgDstCtrlSts 0 "PrkgDstCtrlSysSts_Off" 1 "PrkgDstCtrlSysSts_Standby" 2 "PrkgDstCtrlSysSts_FrontRearActive" 3 "PrkgDstCtrlSysSts_FrontActive" 4 "PrkgDstCtrlSysSts_RearActive" 5 "PrkgDstCtrlSysSts_SystemFailure" 6 "PrkgDstCtrlSysSts_Inhibited" 7 "PrkgDstCtrlSysSts_Initialize" 8 "PrkgDstCtrlSysSts_Covered" 9 "PrkgDstCtrlSysSts_FrontActiveTrailerMode" 10 "PrkgDstCtrlSysSts_Reserved1" 11 "PrkgDstCtrlSysSts_Reserved2" 12 "PrkgDstCtrlSysSts_Reserved3" 13 "PrkgDstCtrlSysSts_Reserved4" 14 "PrkgDstCtrlSysSts_Reserved5" 15 "PrkgDstCtrlSysSts_Reserved6" ;
VAL_ 587 PrkgEmgyBrkWarn 0 "PrkgEmgyBrkWarn_OFF" 1 "PrkgEmgyBrkWarn_ONNotActive" 2 "PrkgEmgyBrkWarn_Fault" 3 "PrkgEmgyBrkWarn_PEBActivate" 4 "PrkgEmgyBrkWarn_MSPActivate" 5 "PrkgEmgyBrkWarn_Largerainwarning" ;
VAL_ 587 PrkgImgDispReq 0 "PrkgImgDispReq_NotDisplay" 1 "PrkgImgDispReq_DisplayRSPA" 2 "PrkgImgDispReq_DisplayAPA" 3 "PrkgImgDispReq_DisplayRPA" 4 "PrkgImgDispReq_DisplayRPAPlus" 5 "PrkgImgDispReq_DisplayHPP" 6 "PrkgImgDispReq_DisplayAVP" 7 "PrkgImgDispReq_Reserved1" ;
VAL_ 587 PrkgIndcrLineResp 0 "OnOff1_Off" 1 "OnOff1_On" ;
VAL_ 587 PrkgOutModBtnSts1 0 "ActvnAvl4_Idle" 1 "ActvnAvl4_Actvn" 2 "ActvnAvl4_Deactvn" 3 "ActvnAvl4_Recommand" ;
VAL_ 587 PrkgOutModBtnSts2 0 "ActvnAvl4_Idle" 1 "ActvnAvl4_Actvn" 2 "ActvnAvl4_Deactvn" 3 "ActvnAvl4_Recommand" ;
VAL_ 587 PrkgOutModBtnSts3 0 "ActvnAvl4_Idle" 1 "ActvnAvl4_Actvn" 2 "ActvnAvl4_Deactvn" 3 "ActvnAvl4_Recommand" ;
VAL_ 587 PrkgOutModBtnSts4 0 "ActvnAvl4_Idle" 1 "ActvnAvl4_Actvn" 2 "ActvnAvl4_Deactvn" 3 "ActvnAvl4_Recommand" ;
VAL_ 587 PrkgOutModBtnSts5 0 "ActvnAvl4_Idle" 1 "ActvnAvl4_Actvn" 2 "ActvnAvl4_Deactvn" 3 "ActvnAvl4_Recommand" ;
VAL_ 587 PrkgOutModBtnSts6 0 "ActvnAvl4_Idle" 1 "ActvnAvl4_Actvn" 2 "ActvnAvl4_Deactvn" 3 "ActvnAvl4_Recommand" ;
VAL_ 587 PrkgOutModBtnStsToAPPPrkgOutModB 0 "ActvnAvl4_Idle" 1 "ActvnAvl4_Actvn" 2 "ActvnAvl4_Deactvn" 3 "ActvnAvl4_Recommand" ;
VAL_ 587 PrkgOutModBtnStsToAPPPrkgOu_0000 0 "ActvnAvl4_Idle" 1 "ActvnAvl4_Actvn" 2 "ActvnAvl4_Deactvn" 3 "ActvnAvl4_Recommand" ;
VAL_ 587 PrkgOutModBtnStsToAPPPrkgOu_0001 0 "ActvnAvl4_Idle" 1 "ActvnAvl4_Actvn" 2 "ActvnAvl4_Deactvn" 3 "ActvnAvl4_Recommand" ;
VAL_ 587 PrkgOutModBtnStsToAPPPrkgOu_0002 0 "ActvnAvl4_Idle" 1 "ActvnAvl4_Actvn" 2 "ActvnAvl4_Deactvn" 3 "ActvnAvl4_Recommand" ;
VAL_ 587 PrkgOutModBtnStsToAPPPrkgOu_0003 0 "ActvnAvl4_Idle" 1 "ActvnAvl4_Actvn" 2 "ActvnAvl4_Deactvn" 3 "ActvnAvl4_Recommand" ;
VAL_ 587 PrkgOutModBtnStsToAPPPrkgOu_0004 0 "ActvnAvl4_Idle" 1 "ActvnAvl4_Actvn" 2 "ActvnAvl4_Deactvn" 3 "ActvnAvl4_Recommand" ;
VAL_ 587 PrkgStopAudWarnReq 0 "OnOff1_Off" 1 "OnOff1_On" ;
VAL_ 587 PrkgTypAutBtnCfmd 0 "OnOff1_Off" 1 "OnOff1_On" ;
VAL_ 587 RemPrkgEnaSts 0 "OnOff1_Off" 1 "OnOff1_On" ;
VAL_ 587 SurrndgsObjDetnResp 0 "OnOff1_Off" 1 "OnOff1_On" ;
VAL_ 587 SwtDispOnAndOffStsResp 0 "SwtDispOnAndOffStsResp_InValid" 1 "SwtDispOnAndOffStsResp_EnterBySoftSwitch" 2 "SwtDispOnAndOffStsResp_EnterByHardSwitch" 3 "SwtDispOnAndOffStsResp_EnterByRGear" 8 "SwtDispOnAndOffStsResp_ExitBySoftSwitch" 9 "SwtDispOnAndOffStsResp_ExitByHardSwitch" 10 "SwtDispOnAndOffStsResp_ExitByOverSpeed" 11 "SwtDispOnAndOffStsResp_ExitByPGearAfter5s" 12 "SwtDispOnAndOffStsResp_ExitBySystemFault" ;
VAL_ 587 ThrDTouringViewResp 0 "OnOff1_Off" 1 "OnOff1_On" ;
VAL_ 587 TopVisnDispExtnResp 0 "OnOff1_Off" 1 "OnOff1_On" ;
VAL_ 587 TurnEntryAgWideVisResp 0 "OnOff1_Off" 1 "OnOff1_On" ;
VAL_ 587 VehMdlClrResp 0 "OnOff1_Off" 1 "OnOff1_On" ;
VAL_ 587 VisnAgExtnResp 0 "OnOff1_Off" 1 "OnOff1_On" ;
VAL_ 587 VisnImgDispModResp 0 "VisnImgDispModResp_NotActive" 1 "VisnImgDispModResp_2D_FrontView" 2 "VisnImgDispModResp_2D_RearView" 3 "VisnImgDispModResp_2D_LeftView" 4 "VisnImgDispModResp_2D_RightView" 5 "VisnImgDispModResp_2D_LeftFrontAndRightFrontView" 6 "VisnImgDispModResp_2D_LeftRearAndRightRearView" 7 "VisnImgDispModResp_2D_FrontWideView" 8 "VisnImgDispModResp_2D_RearWideView" 13 "VisnImgDispModResp_3D_FrontView" 14 "VisnImgDispModResp_3D_RearView" 15 "VisnImgDispModResp_3D_LeftView" 16 "VisnImgDispModResp_3D_RightView" 17 "VisnImgDispModResp_3D_LeftFrontView" 18 "VisnImgDispModResp_3D_RightFrontView" 19 "VisnImgDispModResp_3D_LeftRearView" 20 "VisnImgDispModResp_3D_RightRearView" 21 "VisnImgDispModResp_3D_TourView" 22 "VisnImgDispModResp_3D_FreeSlideView" 23 "VisnImgDispModResp_3D_FrontZoomView" 24 "VisnImgDispModResp_3D_RearZoomView" 25 "VisnImgDispModResp_3D_LeftZoomView" 26 "VisnImgDispModResp_3D_RightZoomView" ;
VAL_ 784 MonrSysSts 0 "SysSts3_Invalid" 1 "SysSts3_Sleep" 2 "SysSts3_Standby" 3 "SysSts3_Active" 4 "SysSts3_Failure" 5 "SysSts3_SelfInspection" 6 "SysSts3_Reserved1" 7 "SysSts3_Reserved2" ;
VAL_ 1105 InhbCdnOfPrkgEmgyBrk 0 "InhbCdnOfPrkgEmgyBrk_NoInhibitedConditions" 1 "InhbCdnOfPrkgEmgyBrk_TailgateNotClose" 2 "InhbCdnOfPrkgEmgyBrk_HoodNotClose" 3 "InhbCdnOfPrkgEmgyBrk_DriverDoorNotClose" 4 "InhbCdnOfPrkgEmgyBrk_PassengerDoorNotClose" 5 "InhbCdnOfPrkgEmgyBrk_DriverSideRearDoorNoClose" 6 "InhbCdnOfPrkgEmgyBrk_PassengerSideRearDoorNoClose" 7 "InhbCdnOfPrkgEmgyBrk_ESCError" 8 "InhbCdnOfPrkgEmgyBrk_SafetyBeltUnlock" 9 "InhbCdnOfPrkgEmgyBrk_TrailerMode" 10 "InhbCdnOfPrkgEmgyBrk_VehicleSpeedIsInvalid" 11 "InhbCdnOfPrkgEmgyBrk_TheLateralAndLongitudinalAccelerationSignalIsInvalid" 12 "InhbCdnOfPrkgEmgyBrk_GearSignalIsInvalid" 13 "InhbCdnOfPrkgEmgyBrk_MissCommunicateWithGearSignal" 14 "InhbCdnOfPrkgEmgyBrk_MissCommunicateWithVehicleSpeedSignal" 15 "InhbCdnOfPrkgEmgyBrk_Reserved1" 16 "InhbCdnOfPrkgEmgyBrk_MissCommunicateWithWheelSpeedDirection" 17 "InhbCdnOfPrkgEmgyBrk_MissCommunicateWithESCSignal" 18 "InhbCdnOfPrkgEmgyBrk_MissCommunicateWithTailgate" 19 "InhbCdnOfPrkgEmgyBrk_MissCommunicateWithHood" 20 "InhbCdnOfPrkgEmgyBrk_MissCommunicateWithDriverDoor" 21 "InhbCdnOfPrkgEmgyBrk_MissCommunicateWithPassengerDoor" 22 "InhbCdnOfPrkgEmgyBrk_MissCommunicateWithDriverSideRearDoor" 23 "InhbCdnOfPrkgEmgyBrk_MissCommunicateWithPassengerSideRearDoor" 24 "InhbCdnOfPrkgEmgyBrk_MissCommunicateWithsafetyBeltSignal" 25 "InhbCdnOfPrkgEmgyBrk_MissCommunicateWithTrailerModeSignal" 26 "InhbCdnOfPrkgEmgyBrk_MissCommunicateWithAcceleratePedalSignal" 27 "InhbCdnOfPrkgEmgyBrk_MissCommunicateWithTheLateralAndLongitudinalAccelerationSignal" 28 "InhbCdnOfPrkgEmgyBrk_MissCommunicateWithBrakePedalSignal" 29 "InhbCdnOfPrkgEmgyBrk_MissCommunicateWithEPBSignal" 30 "InhbCdnOfPrkgEmgyBrk_MissCommunicateWithSteeringAngle" 31 "InhbCdnOfPrkgEmgyBrk_MissCommunicateWithVehicleStandstillStatus" 32 "InhbCdnOfPrkgEmgyBrk_RearviewMirrorFold" 33 "InhbCdnOfPrkgEmgyBrk_RainIsTooLarge" ;
VAL_ 274 DrvrAsscSysIndcrReq 0 "PASTurnIndcrReq_NoRequest" 1 "PASTurnIndcrReq_LeftRequest" 2 "PASTurnIndcrReq_RightRequest" 3 "PASTurnIndcrReq_HWLReq" ;
VAL_ 274 DrvrAsscSysSts 0 "DrvrAsscSysSts_Off" 1 "DrvrAsscSysSts_Standby" 2 "DrvrAsscSysSts_Failure" 3 "DrvrAsscSysSts_Searching" 4 "DrvrAsscSysSts_ParkingProcessActive" 5 "DrvrAsscSysSts_ParkingProcessCompleted" 6 "DrvrAsscSysSts_Quit" 7 "DrvrAsscSysSts_Suspend" 8 "DrvrAsscSysSts_Abort" 9 "DrvrAsscSysSts_PreParkingprocessactive" ;
VAL_ 274 ImgSnsrReWrg 0 "Flt_NoFault" 1 "Flt_Fault" ;
VAL_ 274 ImgSnsrRiWrg 0 "Flt_NoFault" 1 "Flt_Fault" ;
VAL_ 274 LineDetnPptyLeLineDetdEfc 0 "Validity_NotValid" 1 "Validity_Valid" ;
VAL_ 274 LineDetnPptyLeLineTintg 0 "LineTintg_Unknown" 1 "LineTintg_White" 2 "LineTintg_Yellow" 3 "LineTintg_Red" 4 "LineTintg_Blue" 5 "LineTintg_Reserved1" 6 "LineTintg_Reserved2" 7 "LineTintg_Reserved3" ;
VAL_ 274 LineDetnPptyLeLineTyp 0 "LineTyp_Unknown" 1 "LineTyp_Solid" 2 "LineTyp_Dashed" 3 "LineTyp_BottsDots" 4 "LineTyp_VirtualTrackedlanemarker" 5 "LineTyp_Double" 6 "LineTyp_Reserved1" 7 "LineTyp_Reserved2" ;
VAL_ 274 LineDetnPptyRiLineDetdEfc 0 "Validity_NotValid" 1 "Validity_Valid" ;
VAL_ 274 LineDetnPptyRiLineTintg 0 "LineTintg_Unknown" 1 "LineTintg_White" 2 "LineTintg_Yellow" 3 "LineTintg_Red" 4 "LineTintg_Blue" 5 "LineTintg_Reserved1" 6 "LineTintg_Reserved2" 7 "LineTintg_Reserved3" ;
VAL_ 274 LineDetnPptyRiLineTyp 0 "LineTyp_Unknown" 1 "LineTyp_Solid" 2 "LineTyp_Dashed" 3 "LineTyp_BottsDots" 4 "LineTyp_VirtualTrackedlanemarker" 5 "LineTyp_Double" 6 "LineTyp_Reserved1" 7 "LineTyp_Reserved2" ;
VAL_ 274 PrkgEmgyBrkSysSts 0 "PEBSysSts_Off" 1 "PEBSysSts_Standby" 2 "PEBSysSts_Inactivate" 3 "PEBSysSts_PEBactivate" 4 "PEBSysSts_MSPactivate" 5 "PEBSysSts_Failure" 6 "PEBSysSts_Inhibited" 7 "PEBSysSts_Initialze" 8 "PEBSysSts_Reserved1" 9 "PEBSysSts_Reserved2" 10 "PEBSysSts_Reserved3" 11 "PEBSysSts_Reserved4" 12 "PEBSysSts_Reserved5" 13 "PEBSysSts_Reserved6" 14 "PEBSysSts_Reserved7" 15 "PEBSysSts_Reserved8" ;
VAL_ 274 PrkgLockReq 0 "LockgCenReq2_Idle" 1 "LockgCenReq2_Unlck" 2 "LockgCenReq2_Lock" ;
SIG_GROUP_ 384 DrvrPrsntSts 1 : DrvrPrsntStsDrvrPrsnt DrvrPrsntStsDrvrPrsntChks DrvrPrsntStsDrvrPrsntCntr DrvrPrsntStsDrvrPrsntQf;
SIG_GROUP_ 384 ExtrLtgSts 1 : ExtrLtgStsAFS ExtrLtgStsAHBC ExtrLtgStsAHL ExtrLtgStsAllWL ExtrLtgStsApproach ExtrLtgStsChks ExtrLtgStsCntr ExtrLtgStsCornrgLi ExtrLtgStsDBL ExtrLtgStsDRL ExtrLtgStsFlash ExtrLtgStsFrntFog ExtrLtgStsGoodbye ExtrLtgStsHiBeam ExtrLtgStsHomeSafe ExtrLtgStsHWL ExtrLtgStsLoBeam ExtrLtgStsLtgShow ExtrLtgStsPosLiFrnt ExtrLtgStsPosLiRe ExtrLtgStsReFog ExtrLtgStsReverseLi ExtrLtgStsStopLi ExtrLtgStsTurnIndrLe ExtrLtgStsTurnIndrRi ExtrLtgStsWelcome;
SIG_GROUP_ 781 VehCfgPrm 1 : VehCfgPrmBlkIDBytePosn1 VehCfgPrmCCPBytePosn2 VehCfgPrmCCPBytePosn3 VehCfgPrmCCPBytePosn4 VehCfgPrmCCPBytePosn5 VehCfgPrmCCPBytePosn6 VehCfgPrmCCPBytePosn7 VehCfgPrmCCPBytePosn8;
SIG_GROUP_ 781 VehCfgPrmExt 1 : VehCfgPrmExtBlkIDBytePosn1 VehCfgPrmExtCCPBytePosn2 VehCfgPrmExtCCPBytePosn3 VehCfgPrmExtCCPBytePosn4 VehCfgPrmExtCCPBytePosn5 VehCfgPrmExtCCPBytePosn6 VehCfgPrmExtCCPBytePosn7 VehCfgPrmExtCCPBytePosn8;
SIG_GROUP_ 89 VehBattU 1 : VehBattUSysU VehBattUSysUQf;
SIG_GROUP_ 69 PrkgIndcrLineReq 1 : PrkgIndcrLineReqIdPen PrkgIndcrLineReqOnOff1;
SIG_GROUP_ 69 SurrndgsObjDetnReq 1 : SurrndgsObjDetnReqIdPen SurrndgsObjDetnReqOnOff1;
SIG_GROUP_ 69 ThrDTouringViewReq 1 : ThrDTouringViewReqIdPen ThrDTouringViewReqOnOff1;
SIG_GROUP_ 69 TopVisnDispExtnReq 1 : TopVisnDispExtnReqIdPen TopVisnDispExtnReqOnOff1;
SIG_GROUP_ 69 TurnEntryAgWideVisReq 1 : TurnEntryAgWideVisReqIdPen TurnEntryAgWideVisReqOnOff1;
SIG_GROUP_ 69 VehMdlClrReq 1 : VehMdlClrReqIdPen VehMdlClrReqOnOff1;
SIG_GROUP_ 112 PrkgTouchCoornReq 1 : PrkgTouchCoornReqCoordinateX PrkgTouchCoornReqCoordinateY PrkgTouchCoornReqFingerIndex PrkgTouchCoornReqTouchEveTyp;
SIG_GROUP_ 1424 PASdevelpsignalgroup1 1 : PASdevelpsignalgroup1Functiondev PASdevelpsignalgroup1Functi_0000 PASdevelpsignalgroup1Functi_0001 PASdevelpsignalgroup1Functi_0002 PASdevelpsignalgroup1Functi_0003 PASdevelpsignalgroup1Functi_0004 PASdevelpsignalgroup1Functi_0005 PASdevelpsignalgroup1Functi_0006;
SIG_GROUP_ 1425 PASdevelpsignalgroup2 1 : PASdevelpsignalgroup2Functiondev PASdevelpsignalgroup2Functi_0000 PASdevelpsignalgroup2Functi_0001 PASdevelpsignalgroup2Functi_0002 PASdevelpsignalgroup2Functi_0003 PASdevelpsignalgroup2Functi_0004 PASdevelpsignalgroup2Functi_0005 PASdevelpsignalgroup2Functi_0006;
SIG_GROUP_ 1426 PASdevelpsignalgroup3 1 : PASdevelpsignalgroup3Functiondev PASdevelpsignalgroup3Functi_0000 PASdevelpsignalgroup3Functi_0001 PASdevelpsignalgroup3Functi_0002 PASdevelpsignalgroup3Functi_0003 PASdevelpsignalgroup3Functi_0004 PASdevelpsignalgroup3Functi_0005 PASdevelpsignalgroup3Functi_0006;
SIG_GROUP_ 96 EngRunngReqByParkAssi 1 : EngRunngReqByParkAssi1 EngRunngReqByParkAssiChks EngRunngReqByParkAssiCntr;
SIG_GROUP_ 96 FctSt 1 : FctStDisp FctStRemPrkgWarn;
SIG_GROUP_ 96 GearPrkgAssiReqGroup 1 : GearPrkgAssiReqGroupChks GearPrkgAssiReqGroupCntr GearPrkgAssiReqGroupGearPrkgAssi;
SIG_GROUP_ 96 MobDevRPAAuthentReq 1 : MobDevRPAAuthentReqAuthentSts MobDevRPAAuthentReqChks MobDevRPAAuthentReqCntr MobDevRPAAuthentReqRndX MobDevRPAAuthentReqRndY;
SIG_GROUP_ 96 NetPASActvt 1 : NetPASActvtPrio NetPASActvtResourceGroup;
SIG_GROUP_ 96 PrkgAssiElectcStabyProgCtrlModRe 1 : PrkgAssiElectcStabyProgCtrl_0000 PrkgAssiElectcStabyProgCtrl_0001 PrkgAssiElectcStabyProgCtrl_0002;
SIG_GROUP_ 96 PrkgBrkElectcCtrlReq 1 : PrkgBrkElectcCtrlReqChks PrkgBrkElectcCtrlReqCntr PrkgBrkElectcCtrlReqReq;
SIG_GROUP_ 96 PrkgSpdCtrlSafeGroup 1 : PrkgSpdCtrlSafeGroupChks PrkgSpdCtrlSafeGroupCntr PrkgSpdCtrlSafeGroupDrvrAsscSysB PrkgSpdCtrlSafeGroupPrkgAssiALow PrkgSpdCtrlSafeGroupPrkgAss_0000 PrkgSpdCtrlSafeGroupPrkgAssiAReq PrkgSpdCtrlSafeGroupPrkgAssiAUpp PrkgSpdCtrlSafeGroupPrkgAss_0001;
SIG_GROUP_ 96 PrkgStandstillReq 1 : PrkgStandstillReqChks PrkgStandstillReqCntr PrkgStandstillReqReqSts1;
SIG_GROUP_ 821 ImgSnsrClrReq 1 : ImgSnsrClrReqFrnt ImgSnsrClrReqLe ImgSnsrClrReqRe ImgSnsrClrReqRi;
SIG_GROUP_ 821 MobDevRPASts 1 : MobDevRPAStsOnOff1 MobDevRPAStsUInt8;
SIG_GROUP_ 587 PrkgDispGroup 1 : PrkgDispGroupLeCornrCoornx PrkgDispGroupLeCornrCoorny PrkgDispGroupLeCornrLocn PrkgDispGroupPrkgTyp PrkgDispGroupRiCornrCoornx PrkgDispGroupRiCornrCoorny PrkgDispGroupStallNr;
SIG_GROUP_ 587 PrkgOutModBtnSts 1 : PrkgOutModBtnSts1 PrkgOutModBtnSts2 PrkgOutModBtnSts3 PrkgOutModBtnSts4 PrkgOutModBtnSts5 PrkgOutModBtnSts6;
SIG_GROUP_ 587 PrkgOutModBtnStsToAPP 1 : PrkgOutModBtnStsToAPPPrkgOutModB PrkgOutModBtnStsToAPPPrkgOu_0000 PrkgOutModBtnStsToAPPPrkgOu_0001 PrkgOutModBtnStsToAPPPrkgOu_0002 PrkgOutModBtnStsToAPPPrkgOu_0003 PrkgOutModBtnStsToAPPPrkgOu_0004;
SIG_GROUP_ 274 LineDetnPptyLe 1 : LineDetnPptyLeAgOffCenAndLine LineDetnPptyLeChks LineDetnPptyLeCntr LineDetnPptyLeDstVertCenAndLine LineDetnPptyLeLineCrvt LineDetnPptyLeLineDetdDe LineDetnPptyLeLineDetdEfc LineDetnPptyLeLineTintg LineDetnPptyLeLineTyp LineDetnPptyLeLineWidth LineDetnPptyLeTiStamp;
SIG_GROUP_ 274 LineDetnPptyRi 1 : LineDetnPptyRiAgOffCenAndLine LineDetnPptyRiChks LineDetnPptyRiCntr LineDetnPptyRiDstVertCenAndLine LineDetnPptyRiLineCrvt LineDetnPptyRiLineDetdDe LineDetnPptyRiLineDetdEfc LineDetnPptyRiLineTintg LineDetnPptyRiLineTyp LineDetnPptyRiLineWidth LineDetnPptyRiTiStamp;
