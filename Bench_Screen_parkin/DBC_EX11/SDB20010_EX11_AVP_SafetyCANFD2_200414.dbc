// *************************************************************************** *
// *                                                                           *
// *                      Mentor Graphics Corporation                          *
// *                          All rights reserved                              *
// *                                                                           *
// *************************************************************************** *
// *                                                                           *
// * Description:         CANDB File                                           *
// * Generated at:        2020-04-14 13:13:01                                  *
// * System:              SDB20010                                             *
// * Variant:             EX11_AVP                                             *
// * Network:             SafetyCANFD2                                         *
// *                                                                           *
// *************************************************************************** *
// *                                                                           *
// *             THIS CONFIGURATION MIGHT CONTAIN SOME ERRORS                  *
// *              IF THE INPUT MODEL WAS NOT PROPERLY FORMED!                  *
// *                    Do Not Use this File directly!                         *
// *                                                                           *
// *************************************************************************** *
VERSION "SafetyCANFD2"

NS_ :

BS_:

BU_:  ASDM ETC FLC FLR PAS

BO_ 33 ASDMCanFD2TimeSynchFr: 8 ASDM

BO_ 24 ASDMSafetyCANFD2Frame1: 64 ASDM
 SG_ PrimADataComp_UB : 141|1@0+ (1,0) [0|1] "" FLC
 SG_ PrimADataCompALat : 95|15@0- (0.0085,0.0) [-138.99200000000002|139.00050000000002] "m/s^2" FLC
 SG_ PrimADataCompALat1Qf : 9|2@0+ (1,0) [0|3] "" FLC
 SG_ PrimADataCompALgt : 127|15@0- (0.0085,0.0) [-138.99200000000002|139.00050000000002] "m/s^2" FLC
 SG_ PrimADataCompALgt1Qf : 11|2@0+ (1,0) [0|3] "" FLC
 SG_ PrimADataCompAVert : 111|15@0- (0.0085,0.0) [-138.99200000000002|139.00050000000002] "m/s^2" FLC
 SG_ PrimADataCompAVertQf : 143|2@0+ (1,0) [0|3] "" FLC
 SG_ PrimADataCompChks : 7|8@0+ (1.0,0.0) [0.0|255.0] "Unitless" FLC
 SG_ PrimADataCompCntr : 15|4@0+ (1.0,0.0) [0.0|15.0] "Unitless" FLC
 SG_ PrimADataComptimeStampNanoSec : 23|32@0+ (1.0,0.0) [0.0|4294967295.0] "Unitless" FLC
 SG_ PrimADataComptimeStampSec : 55|32@0+ (1.0,0.0) [0.0|4294967295.0] "Unitless" FLC
 SG_ PrimADataComptimeStampTiBasSts : 87|8@0+ (1.0,0.0) [0.0|255.0] "Unitless" FLC
 SG_ PrimAgDataComp_UB : 271|1@0+ (1,0) [0|1] "" FLC
 SG_ PrimAgDataCompChks : 151|8@0+ (1.0,0.0) [0.0|255.0] "Unitless" FLC
 SG_ PrimAgDataCompCntr : 159|4@0+ (1.0,0.0) [0.0|15.0] "Unitless" FLC
 SG_ PrimAgDataCompRollRate : 167|16@0- (0.000244140625,0.0) [-6.0|6.0] "rad/s" FLC
 SG_ PrimAgDataCompRollRateQf : 155|2@0+ (1,0) [0|3] "" FLC
 SG_ PrimAgDataComptimeStampNanoSec : 191|32@0+ (1.0,0.0) [0.0|4294967295.0] "Unitless" FLC
 SG_ PrimAgDataComptimeStampSec : 223|32@0+ (1.0,0.0) [0.0|4294967295.0] "Unitless" FLC
 SG_ PrimAgDataComptimeStampTiBasSts : 183|8@0+ (1.0,0.0) [0.0|255.0] "Unitless" FLC
 SG_ PrimAgDataCompYawRate : 255|16@0- (0.000244140625,0.0) [-6.0|6.0] "rad/s" FLC
 SG_ PrimAgDataCompYawRateQf : 153|2@0+ (1,0) [0|3] "" FLC
 SG_ PrimAsyALgtReqForCmft_UB : 322|1@0+ (1,0) [0|1] "" FLC
 SG_ PrimAsyALgtReqForCmftAsyCmftLgtNegLimForJerk : 279|13@0+ (0.01,-30.0) [-30.0|30.0] "m/s^3" FLC
 SG_ PrimAsyALgtReqForCmftAsyCmftLgtPosLimForJerk : 319|13@0+ (0.01,-30.0) [-30.0|30.0] "m/s^3" FLC
 SG_ PrimAsyALgtReqForCmftMax : 295|12@0+ (0.01,-12.0) [-12.0|12.0] "m/s^2" FLC
 SG_ PrimAsyALgtReqForCmftMin : 299|12@0+ (0.01,-12.0) [-12.0|12.0] "m/s^2" FLC
 SG_ PrimAsyALgtReqRngForSafe_UB : 363|1@0+ (1,0) [0|1] "" FLC
 SG_ PrimAsyALgtReqRngForSafeMax : 339|12@0+ (0.01,-15.0) [-15.0|15.0] "m/s^2" FLC
 SG_ PrimAsyALgtReqRngForSafeMin : 359|12@0+ (0.01,-15.0) [-15.0|15.0] "m/s^2" FLC
 SG_ PrimAsyPinionAgReqSafe : 391|15@0+ (0.0009765625,-14.5) [-14.5|17.4990234375] "rad" FLC
 SG_ PrimAsyPinionAgReqSafe_UB : 392|1@0+ (1,0) [0|1] "" FLC
 SG_ PrimChSts_UB : 360|1@0+ (1,0) [0|1] "" FLC
 SG_ PrimChStsADModeAvtn : 375|1@0+ (1,0) [0|1] "" FLC
 SG_ PrimChStsADModeAvtnCfm : 374|1@0+ (1,0) [0|1] "" FLC
 SG_ PrimChStsADModeDeavtn : 373|1@0+ (1,0) [0|1] "" FLC
 SG_ PrimChStsADModeDeavtnCfm : 372|1@0+ (1,0) [0|1] "" FLC
 SG_ PrimChStsChanlSts : 371|1@0+ (1,0) [0|1] "" FLC
 SG_ PrimChStsCtrlrSts : 370|1@0+ (1,0) [0|1] "" FLC
 SG_ PrimChStsLatADAvtn : 369|1@0+ (1,0) [0|1] "" FLC
 SG_ PrimChStsLatADAvtnCfm : 368|1@0+ (1,0) [0|1] "" FLC
 SG_ PrimChStsLatSts : 383|1@0+ (1,0) [0|1] "" FLC
 SG_ PrimChStsLgtADAvtn : 382|1@0+ (1,0) [0|1] "" FLC
 SG_ PrimChStsLgtADAvtnCfm : 381|1@0+ (1,0) [0|1] "" FLC
 SG_ PrimChStsLgtSts : 380|1@0+ (1,0) [0|1] "" FLC
 SG_ PrimChStsReserved1 : 379|1@0+ (1,0) [0|1] "" FLC
 SG_ PrimChStsReserved2 : 378|1@0+ (1,0) [0|1] "" FLC
 SG_ PrimChStsReserved3 : 377|1@0+ (1,0) [0|1] "" FLC
 SG_ PrimChStsSafeStop : 376|1@0+ (1,0) [0|1] "" FLC
 SG_ PrimVehVComp_UB : 441|1@0+ (1,0) [0|1] "" FLC
 SG_ PrimVehVCompChks : 407|8@0+ (1.0,0.0) [0.0|255.0] "Unitless" FLC
 SG_ PrimVehVCompCntr : 415|4@0+ (1.0,0.0) [0.0|15.0] "Unitless" FLC
 SG_ PrimVehVCompVehVLat : 439|14@0- (0.003906369,0.0) [-29.997007551|30.00091392] "m/s" FLC
 SG_ PrimVehVCompVehVLatQf : 411|2@0+ (1,0) [0|3] "" FLC
 SG_ PrimVehVCompVehVLgt : 423|16@0- (0.00391,0.0) [-127.99776000000001|128.00167000000002] "m/s" FLC
 SG_ PrimVehVCompVehVLgtQf : 409|2@0+ (1,0) [0|3] "" FLC
 SG_ WhlSpdCmpFac : 511|5@0+ (0.005,0.92) [0.92|1.075] "Unitless" FLC
 SG_ WhlSpdCmpFac_UB : 506|1@0+ (1,0) [0|1] "" FLC

BO_ 17 ASDMSafetyCANFD2Frame2: 64 ASDM
 SG_ PrimAdPSSGroupSafe0_UB : 311|1@0+ (1,0) [0|1] "" FLC
 SG_ PrimAdPSSGroupSafe0DataID : 23|16@0+ (1.0,0.0) [0.0|65535.0] "Unitless" FLC
 SG_ PrimAdPSSGroupSafe0DeltaTPos1 : 39|16@0+ (0.000023,0.0) [0.0|1.507305] "s" FLC
 SG_ PrimAdPSSGroupSafe0DeltaTPos2 : 55|16@0+ (0.000023,0.0) [0.0|1.507305] "s" FLC
 SG_ PrimAdPSSGroupSafe0DeltaXPos1 : 71|16@0+ (0.0004,-13.107) [-13.107|13.107000000000003] "m" FLC
 SG_ PrimAdPSSGroupSafe0DeltaXPos2 : 87|16@0+ (0.0004,-13.107) [-13.107|13.107000000000003] "m" FLC
 SG_ PrimAdPSSGroupSafe0DeltaYPos1 : 103|16@0+ (0.0004,-13.107) [-13.107|13.107000000000003] "m" FLC
 SG_ PrimAdPSSGroupSafe0DeltaYPos2 : 119|16@0+ (0.0004,-13.107) [-13.107|13.107000000000003] "m" FLC
 SG_ PrimAdPSSGroupSafe0HeadingPos1 : 135|16@0+ (0.0001,-3.27675) [-3.27675|3.2767500000000007] "rad" FLC
 SG_ PrimAdPSSGroupSafe0HeadingPos2 : 151|16@0+ (0.0001,-3.27675) [-3.27675|3.2767500000000007] "rad" FLC
 SG_ PrimAdPSSGroupSafe0InitHeading : 167|16@0+ (0.0001,-3.27675) [-3.27675|3.2767500000000007] "rad" FLC
 SG_ PrimAdPSSGroupSafe0InitPosX : 183|32@0+ (0.0005,-1073741.824) [-1073741.824|1073741.8235] "m" FLC
 SG_ PrimAdPSSGroupSafe0InitPosY : 215|32@0+ (0.0005,-1073741.824) [-1073741.824|1073741.8235] "m" FLC
 SG_ PrimAdPSSGroupSafe0TiStampNanoSec : 247|32@0+ (1.0,0.0) [0.0|4294967295.0] "Unitless" FLC
 SG_ PrimAdPSSGroupSafe0TiStampSec : 279|32@0+ (0.0001,0.0) [0.0|429496.7295] "s" FLC
 SG_ PrimAdPSSGroupSafe0TrajectID : 11|4@0+ (1.0,0.0) [0.0|15.0] "Unitless" FLC

BO_ 18 ASDMSafetyCANFD2Frame3: 64 ASDM
 SG_ PrimAdPSSGroupSafe1_UB : 423|1@0+ (1,0) [0|1] "" FLC
 SG_ PrimAdPSSGroupSafe1DataID : 23|16@0+ (1.0,0.0) [0.0|65535.0] "Unitless" FLC
 SG_ PrimAdPSSGroupSafe1DeltaTPos1 : 39|16@0+ (0.000023,0.0) [0.0|1.507305] "s" FLC
 SG_ PrimAdPSSGroupSafe1DeltaTPos2 : 55|16@0+ (0.000023,0.0) [0.0|1.507305] "s" FLC
 SG_ PrimAdPSSGroupSafe1DeltaTPos3 : 71|16@0+ (0.000023,0.0) [0.0|1.507305] "s" FLC
 SG_ PrimAdPSSGroupSafe1DeltaTPos4 : 87|16@0+ (0.000023,0.0) [0.0|1.507305] "s" FLC
 SG_ PrimAdPSSGroupSafe1DeltaTPos5 : 103|16@0+ (0.000023,0.0) [0.0|1.507305] "s" FLC
 SG_ PrimAdPSSGroupSafe1DeltaTPos6 : 119|16@0+ (0.000023,0.0) [0.0|1.507305] "s" FLC
 SG_ PrimAdPSSGroupSafe1DeltaXPos1 : 135|16@0+ (0.0004,-13.107) [-13.107|13.107000000000003] "m" FLC
 SG_ PrimAdPSSGroupSafe1DeltaXPos2 : 151|16@0+ (0.0004,-13.107) [-13.107|13.107000000000003] "m" FLC
 SG_ PrimAdPSSGroupSafe1DeltaXPos3 : 167|16@0+ (0.0004,-13.107) [-13.107|13.107000000000003] "m" FLC
 SG_ PrimAdPSSGroupSafe1DeltaXPos4 : 183|16@0+ (0.0004,-13.107) [-13.107|13.107000000000003] "m" FLC
 SG_ PrimAdPSSGroupSafe1DeltaXPos5 : 199|16@0+ (0.0004,-13.107) [-13.107|13.107000000000003] "m" FLC
 SG_ PrimAdPSSGroupSafe1DeltaXPos6 : 215|16@0+ (0.0004,-13.107) [-13.107|13.107000000000003] "m" FLC
 SG_ PrimAdPSSGroupSafe1DeltaYPos1 : 231|16@0+ (0.0004,-13.107) [-13.107|13.107000000000003] "m" FLC
 SG_ PrimAdPSSGroupSafe1DeltaYPos2 : 247|16@0+ (0.0004,-13.107) [-13.107|13.107000000000003] "m" FLC
 SG_ PrimAdPSSGroupSafe1DeltaYPos3 : 263|16@0+ (0.0004,-13.107) [-13.107|13.107000000000003] "m" FLC
 SG_ PrimAdPSSGroupSafe1DeltaYPos4 : 279|16@0+ (0.0004,-13.107) [-13.107|13.107000000000003] "m" FLC
 SG_ PrimAdPSSGroupSafe1DeltaYPos5 : 295|16@0+ (0.0004,-13.107) [-13.107|13.107000000000003] "m" FLC
 SG_ PrimAdPSSGroupSafe1DeltaYPos6 : 311|16@0+ (0.0004,-13.107) [-13.107|13.107000000000003] "m" FLC
 SG_ PrimAdPSSGroupSafe1HeadingPos1 : 327|16@0+ (0.0001,-3.27675) [-3.27675|3.2767500000000007] "rad" FLC
 SG_ PrimAdPSSGroupSafe1HeadingPos2 : 343|16@0+ (0.0001,-3.27675) [-3.27675|3.2767500000000007] "rad" FLC
 SG_ PrimAdPSSGroupSafe1HeadingPos3 : 359|16@0+ (0.0001,-3.27675) [-3.27675|3.2767500000000007] "rad" FLC
 SG_ PrimAdPSSGroupSafe1HeadingPos4 : 375|16@0+ (0.0001,-3.27675) [-3.27675|3.2767500000000007] "rad" FLC
 SG_ PrimAdPSSGroupSafe1HeadingPos5 : 391|16@0+ (0.0001,-3.27675) [-3.27675|3.2767500000000007] "rad" FLC
 SG_ PrimAdPSSGroupSafe1HeadingPos6 : 407|16@0+ (0.0001,-3.27675) [-3.27675|3.2767500000000007] "rad" FLC
 SG_ PrimAdPSSGroupSafe1TrajectID : 11|4@0+ (1.0,0.0) [0.0|15.0] "Unitless" FLC

BO_ 288 ASDMSafetyCANFD2Frame4: 64 ASDM
 SG_ ADataRawSafe_UB : 56|1@0+ (1,0) [0|1] "" FLR
 SG_ ADataRawSafeALat : 23|15@0- (0.0085,0.0) [-138.99200000000002|139.00050000000002] "m/s^2" FLR
 SG_ ADataRawSafeALat1Qf : 11|2@0+ (1,0) [0|3] "" FLR
 SG_ ADataRawSafeALgt : 38|15@0- (0.0085,0.0) [-138.99200000000002|139.00050000000002] "m/s^2" FLR
 SG_ ADataRawSafeALgt1Qf : 9|2@0+ (1,0) [0|3] "" FLR
 SG_ ADataRawSafeAVert : 55|15@0- (0.0085,0.0) [-138.99200000000002|139.00050000000002] "m/s^2" FLR
 SG_ ADataRawSafeAVertQf : 24|2@0+ (1,0) [0|3] "" FLR
 SG_ ADataRawSafeChks : 7|8@0+ (1.0,0.0) [0.0|255.0] "Unitless" FLR
 SG_ ADataRawSafeCntr : 15|4@0+ (1.0,0.0) [0.0|15.0] "Unitless" FLR
 SG_ ALgtStdFromWhlSpd_UB : 318|1@0+ (1,0) [0|1] "" FLR
 SG_ ALgtStdFromWhlSpdALgtStdFromWhlSpd : 335|16@0- (0.0009765625,0.0) [-18.0|18.0] "m/s^2" FLR
 SG_ ALgtStdFromWhlSpdChks : 327|8@0+ (1.0,0.0) [0.0|255.0] "Unitless" FLR
 SG_ ALgtStdFromWhlSpdCntr : 315|4@0+ (1.0,0.0) [0.0|15.0] "Unitless" FLR
 SG_ ALgtStdFromWhlSpdQf : 317|2@0+ (1,0) [0|3] "" FLR
 SG_ AmbTRaw_UB : 106|1@0+ (1,0) [0|1] "" FLR
 SG_ AmbTRawAmbTVal : 234|11@0+ (0.1,-70.0) [-70.0|134.70000000000002] "degC" FLR
 SG_ AmbTRawQly : 236|2@0+ (1,0) [0|3] "" FLR
 SG_ AsyDataWithCmpSafe_UB : 168|1@0+ (1,0) [0|1] "" FLR
 SG_ AsyDataWithCmpSafeALat1Qf : 153|2@0+ (1,0) [0|3] "" FLR
 SG_ AsyDataWithCmpSafeALatWithCmp : 167|15@0- (0.0085,0.0) [-138.99200000000002|139.00050000000002] "m/s^2" FLR
 SG_ AsyDataWithCmpSafeALgt1Qf : 155|2@0+ (1,0) [0|3] "" FLR
 SG_ AsyDataWithCmpSafeChks : 135|8@0+ (1.0,0.0) [0.0|255.0] "Unitless" FLR
 SG_ AsyDataWithCmpSafeCntr : 159|4@0+ (1.0,0.0) [0.0|15.0] "Unitless" FLR
 SG_ AsyDataWithCmpSafeGrdtOfALgt : 143|14@0- (0.00390625,0.0) [-30.0|30.0] "m/s^3" FLR
 SG_ AsyDataWithCmpSafeYawRateQf : 145|2@0+ (1,0) [0|3] "" FLR
 SG_ AsyDataWithCmpSafeYawRateWithCmp : 119|16@0- (0.000244140625,0.0) [-6.0|6.0] "rad/s" FLR
 SG_ BkpOfDstTrvld : 416|21@0+ (1.0,0.0) [0.0|2000000.0] "km" FLR
 SG_ BkpOfDstTrvld_UB : 319|1@0+ (1,0) [0|1] "" FLR
 SG_ CarTiGlb : 391|32@0+ (0.1,0.0) [0.0|429496729.5] "s" FLR
 SG_ CarTiGlb_UB : 107|1@0+ (1,0) [0|1] "" FLR
 SG_ DrvModReq : 227|4@0+ (1,0) [0|15] "" FLR
 SG_ DrvModReq_UB : 105|1@0+ (1,0) [0|1] "" FLR
 SG_ PinionSteerAgGroup_UB : 305|1@0+ (1,0) [0|1] "" FLR
 SG_ PinionSteerAgGroupChks : 255|8@0+ (1.0,0.0) [0.0|255.0] "Unitless" FLR
 SG_ PinionSteerAgGroupCntr : 311|4@0+ (1.0,0.0) [0.0|15.0] "Unitless" FLR
 SG_ PinionSteerAgGroupPinionSteerAg1 : 294|15@0- (0.0009765625,0.0) [-14.5|14.5] "rad" FLR
 SG_ PinionSteerAgGroupPinionSteerAg1Qf : 263|2@0+ (1,0) [0|3] "" FLR
 SG_ PinionSteerAgGroupPinionSteerAgSpd1 : 261|14@0- (0.0078125,0.0) [-50.0|50.0] "rad/s" FLR
 SG_ PinionSteerAgGroupPinionSteerAgSpd1Qf : 279|2@0+ (1,0) [0|3] "" FLR
 SG_ PinionSteerAgGroupSteerWhlTq : 277|14@0- (0.00390625,0.0) [-30.0|30.0] "NewtonMeter" FLR
 SG_ PinionSteerAgGroupSteerWhlTqQf : 307|2@0+ (1,0) [0|3] "" FLR
 SG_ SteerWhlSnsr_UB : 71|1@0+ (1,0) [0|1] "" FLR
 SG_ SteerWhlSnsrAg : 70|15@0- (0.0009765625,0.0) [-14.5|14.5] "rad" FLR
 SG_ SteerWhlSnsrAgSpd : 85|14@0- (0.0078125,0.0) [-50.0|50.0] "rad/s" FLR
 SG_ SteerWhlSnsrChks : 103|8@0+ (1.0,0.0) [0.0|255.0] "Unitless" FLR
 SG_ SteerWhlSnsrCntr : 111|4@0+ (1.0,0.0) [0.0|15.0] "Unitless" FLR
 SG_ SteerWhlSnsrQf : 87|2@0+ (1,0) [0|3] "" FLR
 SG_ VehBattU_UB : 442|1@0+ (1,0) [0|1] "" FLR
 SG_ VehBattUSysU : 455|8@0+ (0.1,0.0) [0.0|25.0] "Volt" FLR
 SG_ VehBattUSysUQf : 441|2@0+ (1,0) [0|3] "" FLR
 SG_ VehModMngtGlbSafe1_UB : 376|1@0+ (1,0) [0|1] "" FLR
 SG_ VehModMngtGlbSafe1CarModSts1 : 383|3@0+ (1,0) [0|7] "" FLR
 SG_ VehModMngtGlbSafe1CarModSubtypWdCarModSubtyp : 380|3@0+ (1.0,0.0) [0.0|7.0] "Unitless" FLR
 SG_ VehModMngtGlbSafe1Chks : 351|8@0+ (1.0,0.0) [0.0|255.0] "Unitless" FLR
 SG_ VehModMngtGlbSafe1Cntr : 359|4@0+ (1.0,0.0) [0.0|15.0] "Unitless" FLR
 SG_ VehModMngtGlbSafe1EgyLvlElecMai : 355|4@0+ (1.0,0.0) [0.0|15.0] "Unitless" FLR
 SG_ VehModMngtGlbSafe1EgyLvlElecSubtyp : 367|4@0+ (1.0,0.0) [0.0|15.0] "Unitless" FLR
 SG_ VehModMngtGlbSafe1FltEgyCnsWdSts : 377|1@0+ (1,0) [0|1] "" FLR
 SG_ VehModMngtGlbSafe1PwrLvlElecMai : 363|4@0+ (1.0,0.0) [0.0|15.0] "Unitless" FLR
 SG_ VehModMngtGlbSafe1PwrLvlElecSubtyp : 375|4@0+ (1.0,0.0) [0.0|15.0] "Unitless" FLR
 SG_ VehModMngtGlbSafe1UsgModSts : 371|4@0+ (1,0) [0|15] "" FLR
 SG_ VehMtnSt_UB : 183|1@0+ (1,0) [0|1] "" FLR
 SG_ VehMtnStChks : 191|8@0+ (1.0,0.0) [0.0|255.0] "Unitless" FLR
 SG_ VehMtnStCntr : 182|4@0+ (1.0,0.0) [0.0|15.0] "Unitless" FLR
 SG_ VehMtnStVehMtnSt : 178|3@0+ (1,0) [0|7] "" FLR
 SG_ VehSpdLgt_UB : 199|1@0+ (1,0) [0|1] "" FLR
 SG_ VehSpdLgtA : 198|15@0+ (0.00391,0.0) [0.0|125.0027] "m/s" FLR
 SG_ VehSpdLgtChks : 215|8@0+ (1.0,0.0) [0.0|255.0] "Unitless" FLR
 SG_ VehSpdLgtCntr : 223|4@0+ (1.0,0.0) [0.0|15.0] "Unitless" FLR
 SG_ VehSpdLgtQf : 219|2@0+ (1,0) [0|3] "" FLR
 SG_ WipgInfo_UB : 461|1@0+ (1,0) [0|1] "" FLR
 SG_ WipgInfoWipgSpdInfo : 458|3@0+ (1,0) [0|7] "" FLR
 SG_ WipgInfoWiprActv : 459|1@0+ (1,0) [0|1] "" FLR
 SG_ WipgInfoWiprInWipgAr : 460|1@0+ (1,0) [0|1] "" FLR

BO_ 1007 ASDMSafetyCANFD2Frame7: 64 ASDM
 SG_ FrntRdrVehPrm_UB : 147|1@0+ (1,0) [0|1] "" FLR
 SG_ FrntRdrVehPrmRdrVehPrmChks : 7|8@0+ (1.0,0.0) [0.0|255.0] "Unitless" FLR
 SG_ FrntRdrVehPrmRdrVehPrmCntr : 15|4@0+ (1.0,0.0) [0.0|15.0] "Unitless" FLR
 SG_ FrntRdrVehPrmRdrVehPrmRdrDynCalPrmForAgOffs : 71|8@0+ (0.1,-12.8) [-12.8|12.7] "Deg" FLR
 SG_ FrntRdrVehPrmRdrVehPrmRdrDynCalPrmForAxleDstReToVehFrnt : 109|9@0+ (0.01,1.0) [1.0|6.0] "m" FLR
 SG_ FrntRdrVehPrmRdrVehPrmRdrDynCalPrmForPinoinAgRat : 95|8@0+ (0.05,8.0) [8.0|20.75] "Unitless" FLR
 SG_ FrntRdrVehPrmRdrVehPrmRdrDynCalPrmForRollAgGain : 79|14@0+ (0.0001,0.0) [0.0|1.0] "Unitless" FLR
 SG_ FrntRdrVehPrmRdrVehPrmRdrDynCalPrmForSnsrDir : 81|1@0+ (1,0) [0|1] "" FLR
 SG_ FrntRdrVehPrmRdrVehPrmRdrDynCalPrmForSnsrOrntn : 80|1@0+ (1,0) [0|1] "" FLR
 SG_ FrntRdrVehPrmRdrVehPrmRdrDynCalPrmForSnsrPosnLat : 11|12@0+ (0.001,-2.0) [-2.0|2.0] "m" FLR
 SG_ FrntRdrVehPrmRdrVehPrmRdrDynCalPrmForSnsrPosnLgt : 135|14@0+ (0.001,-5.0) [-5.0|5.0] "m" FLR
 SG_ FrntRdrVehPrmRdrVehPrmRdrDynCalPrmForSnsrPosnVert : 31|11@0+ (0.001,0.0) [0.0|2.0] "m" FLR
 SG_ FrntRdrVehPrmRdrVehPrmRdrDynCalPrmForSnsrRot1 : 36|11@0+ (0.1,-90.0) [-90.0|90.0] "Deg" FLR
 SG_ FrntRdrVehPrmRdrVehPrmRdrDynCalPrmForVehLen : 41|10@0+ (0.01,0.0) [0.0|10.0] "m" FLR
 SG_ FrntRdrVehPrmRdrVehPrmRdrDynCalPrmForVehTyp : 63|8@0+ (1.0,0.0) [0.0|255.0] "Unitless" FLR
 SG_ FrntRdrVehPrmRdrVehPrmRdrDynCalPrmForVehWidth : 116|9@0+ (0.01,0.0) [0.0|5.0] "m" FLR
 SG_ FrntRdrVehPrmRdrVehPrmRdrDynCalPrmForVersMajor : 123|4@0+ (1.0,0.0) [0.0|15.0] "Unitless" FLR
 SG_ FrntRdrVehPrmRdrVehPrmRdrDynCalPrmForVersMinor : 151|4@0+ (1.0,0.0) [0.0|15.0] "Unitless" FLR
 SG_ FrntRdrVehPrmRdrVehPrmRdrDynCalPrmForWhlBas : 103|10@0+ (0.01,0.0) [0.0|10.0] "m" FLR
 SG_ FrntRdrVehPrmRdrVehPrmVld : 137|1@0+ (1,0) [0|1] "" FLR

BO_ 1281 AsdmSafetyCanFD2NmFr: 8 ASDM
 SG_ PNC16_ASDM : 16|1@0+ (1,0) [0|0] "" FLR
 SG_ PNC17_ASDM : 17|1@0+ (1,0) [0|0] "" FLR
 SG_ PNC18_ASDM : 18|1@0+ (1,0) [0|0] "" FLR
 SG_ PNC19_ASDM : 19|1@0+ (1,0) [0|0] "" FLR
 SG_ PNC20_ASDM : 20|1@0+ (1,0) [0|0] "" FLR
 SG_ PNC21_ASDM : 21|1@0+ (1,0) [0|0] "" FLR
 SG_ PNC22_ASDM : 22|1@0+ (1,0) [0|0] "" FLR
 SG_ PNC23_ASDM : 23|1@0+ (1,0) [0|0] "" FLR
 SG_ PNC24_ASDM : 24|1@0+ (1,0) [0|0] "" FLR
 SG_ PNC25_ASDM : 25|1@0+ (1,0) [0|0] "" FLR
 SG_ PNC26_ASDM : 26|1@0+ (1,0) [0|0] "" FLR
 SG_ PNC27_ASDM : 27|1@0+ (1,0) [0|0] "" FLR
 SG_ PNC28_ASDM : 28|1@0+ (1,0) [0|0] "" FLR
 SG_ PNC29_ASDM : 29|1@0+ (1,0) [0|0] "" FLR
 SG_ PNC30_ASDM : 30|1@0+ (1,0) [0|0] "" FLR
 SG_ PNC31_ASDM : 31|1@0+ (1,0) [0|0] "" FLR
 SG_ PNC32_ASDM : 32|1@0+ (1,0) [0|0] "" FLR
 SG_ PNC33_ASDM : 33|1@0+ (1,0) [0|0] "" FLR
 SG_ PNC34_ASDM : 34|1@0+ (1,0) [0|0] "" FLR
 SG_ PNC35_ASDM : 35|1@0+ (1,0) [0|0] "" FLR
 SG_ PNC36_ASDM : 36|1@0+ (1,0) [0|0] "" FLR
 SG_ PNC37_ASDM : 37|1@0+ (1,0) [0|0] "" FLR
 SG_ PNC38_ASDM : 38|1@0+ (1,0) [0|0] "" FLR
 SG_ PNC39_ASDM : 39|1@0+ (1,0) [0|0] "" FLR
 SG_ NM_PNI_ASDM : 14|1@0+ (1,0) [0|0] "" FLR
 SG_ NM_AW_ASDM : 12|1@0+ (1,0) [0|0] "" FLR
 SG_ NM_CS_ASDM : 11|1@0+ (1,0) [0|0] "" FLR
 SG_ NM_RMR_ASDM : 8|1@0+ (1,0) [0|0] "" FLR
 SG_ NM_NodeID_ASDM : 7|8@0+ (1,0) [0|0] "" FLR

BO_ 2047 AsdmToAllFuncSafetyCanFD2DiagReqFrame1: 8 ASDM
 SG_ AsdmToAllFuncSafetyCanFD2DiagReqNpdu : 7|64@0+ (1,0) [0|0] "" FLR

BO_ 1860 AsdmToFlrSafetyCanFD2DiagReqFrame1: 64 ASDM
 SG_ AsdmToFlrSafetyCanFD2DiagReqNpdu : 7|512@0+ (1,0) [0|0] "" FLR

BO_ 1410 EtctoFlrXcpFr01: 8 ETC

BO_ 16 FlcSafetyCANFD2Fr01: 64 FLC
 SG_ BrkPedlTrvl_UB : 42|1@0+ (1,0) [0|1] "" ASDM
 SG_ BrkPedlTrvlAct : 39|13@0+ (0.01,-5.0) [-5.0|47.0] "mm" ASDM
 SG_ BrkPedlTrvlChks : 7|8@0+ (1.0,0.0) [0.0|255.0] "Unitless" ASDM
 SG_ BrkPedlTrvlCntr : 15|4@0+ (1.0,0.0) [0.0|15.0] "Unitless" ASDM
 SG_ BrkPedlTrvlQf : 11|2@0+ (1,0) [0|3] "" ASDM
 SG_ BrkPedlTrvlSt : 26|1@0+ (1,0) [0|1] "" ASDM
 SG_ BrkPedlTrvlStQf : 9|2@0+ (1,0) [0|3] "" ASDM
 SG_ BrkPedlTrvlTar : 23|13@0+ (0.01,-5.0) [-5.0|47.0] "mm" ASDM
 SG_ DrvBrkReqDmat : 495|1@0+ (1,0) [0|1] "" ASDM
 SG_ DrvBrkReqDmat_UB : 494|1@0+ (1,0) [0|1] "" ASDM
 SG_ PinionSteerAgGroupForBkp_UB : 104|1@0+ (1,0) [0|1] "" ASDM
 SG_ PinionSteerAgGroupForBkpChks : 55|8@0+ (1.0,0.0) [0.0|255.0] "Unitless" ASDM
 SG_ PinionSteerAgGroupForBkpCntr : 63|4@0+ (1.0,0.0) [0.0|15.0] "Unitless" ASDM
 SG_ PinionSteerAgGroupForBkpPinionSteerAgForBkp : 103|15@0- (0.0009765625,0.0) [-14.5|14.5] "rad" ASDM
 SG_ PinionSteerAgGroupForBkpPinionSteerAgQfForBkp : 59|2@0+ (1,0) [0|3] "" ASDM
 SG_ PinionSteerAgGroupForBkpPinionSteerAgSpdForBkp : 87|14@0- (0.0078125,0.0) [-50.0|50.0] "rad/s" ASDM
 SG_ PinionSteerAgGroupForBkpPinionSteerAgSpdQfForBkp : 57|2@0+ (1,0) [0|3] "" ASDM
 SG_ PinionSteerAgGroupForBkpSteerWhlTqForBkp : 71|14@0- (0.00390625,0.0) [-30.0|30.0] "NewtonMeter" ASDM
 SG_ PinionSteerAgGroupForBkpSteerWhlTqQfForBkp : 73|2@0+ (1,0) [0|3] "" ASDM
 SG_ SecChSts_UB : 488|1@0+ (1,0) [0|1] "" ASDM
 SG_ SecChStsADModeAvtn : 503|1@0+ (1,0) [0|1] "" ASDM
 SG_ SecChStsADModeAvtnCfm : 502|1@0+ (1,0) [0|1] "" ASDM
 SG_ SecChStsADModeDeavtn : 501|1@0+ (1,0) [0|1] "" ASDM
 SG_ SecChStsADModeDeavtnCfm : 500|1@0+ (1,0) [0|1] "" ASDM
 SG_ SecChStsChanlSts : 499|1@0+ (1,0) [0|1] "" ASDM
 SG_ SecChStsCtrlrSts : 498|1@0+ (1,0) [0|1] "" ASDM
 SG_ SecChStsLatADAvtn : 497|1@0+ (1,0) [0|1] "" ASDM
 SG_ SecChStsLatADAvtnCfm : 496|1@0+ (1,0) [0|1] "" ASDM
 SG_ SecChStsLatSts : 511|1@0+ (1,0) [0|1] "" ASDM
 SG_ SecChStsLgtADAvtn : 510|1@0+ (1,0) [0|1] "" ASDM
 SG_ SecChStsLgtADAvtnCfm : 509|1@0+ (1,0) [0|1] "" ASDM
 SG_ SecChStsLgtSts : 508|1@0+ (1,0) [0|1] "" ASDM
 SG_ SecChStsReserved1 : 507|1@0+ (1,0) [0|1] "" ASDM
 SG_ SecChStsReserved2 : 506|1@0+ (1,0) [0|1] "" ASDM
 SG_ SecChStsReserved3 : 505|1@0+ (1,0) [0|1] "" ASDM
 SG_ SecChStsSafeStop : 504|1@0+ (1,0) [0|1] "" ASDM
 SG_ VehMtnStForBkp_UB : 152|1@0+ (1,0) [0|1] "" ASDM
 SG_ VehMtnStForBkpVehMtnSt : 155|3@0+ (1,0) [0|7] "" ASDM
 SG_ VehMtnStForBkpVehMtnStChks : 151|8@0+ (1.0,0.0) [0.0|255.0] "Unitless" ASDM
 SG_ VehMtnStForBkpVehMtnStCntr : 159|4@0+ (1.0,0.0) [0.0|15.0] "Unitless" ASDM
 SG_ VehSpdLgtForBkp_UB : 166|1@0+ (1,0) [0|1] "" ASDM
 SG_ VehSpdLgtForBkpVehSpdLgtA : 174|15@0+ (0.00391,0.0) [0.0|125.0027] "m/s" ASDM
 SG_ VehSpdLgtForBkpVehSpdLgtChks : 191|8@0+ (1.0,0.0) [0.0|255.0] "Unitless" ASDM
 SG_ VehSpdLgtForBkpVehSpdLgtCntr : 165|4@0+ (1.0,0.0) [0.0|15.0] "Unitless" ASDM
 SG_ VehSpdLgtForBkpVehSpdLgtQf : 161|2@0+ (1,0) [0|3] "" ASDM
 SG_ WhlDirRotlFrntForBkp_UB : 215|1@0+ (1,0) [0|1] "" ASDM
 SG_ WhlDirRotlFrntForBkpChks : 199|8@0+ (1.0,0.0) [0.0|255.0] "Unitless" ASDM
 SG_ WhlDirRotlFrntForBkpCntr : 207|4@0+ (1.0,0.0) [0.0|15.0] "Unitless" ASDM
 SG_ WhlDirRotlFrntForBkpLe : 203|2@0+ (1,0) [0|3] "" ASDM
 SG_ WhlDirRotlFrntForBkpRi : 201|2@0+ (1,0) [0|3] "" ASDM
 SG_ WhlDirRotlReForBkp_UB : 279|1@0+ (1,0) [0|1] "" ASDM
 SG_ WhlDirRotlReForBkpChks : 271|8@0+ (1.0,0.0) [0.0|255.0] "Unitless" ASDM
 SG_ WhlDirRotlReForBkpCntr : 259|4@0+ (1.0,0.0) [0.0|15.0] "Unitless" ASDM
 SG_ WhlDirRotlReForBkpLe : 261|2@0+ (1,0) [0|3] "" ASDM
 SG_ WhlDirRotlReForBkpRi : 263|2@0+ (1,0) [0|3] "" ASDM
 SG_ WhlRotToothCntrForBkp_UB : 212|1@0+ (1,0) [0|1] "" ASDM
 SG_ WhlRotToothCntrForBkpChks : 223|8@0+ (1.0,0.0) [0.0|255.0] "Unitless" ASDM
 SG_ WhlRotToothCntrForBkpCntr : 211|4@0+ (1.0,0.0) [0.0|15.0] "Unitless" ASDM
 SG_ WhlRotToothCntrForBkpWhlRotToothCntrFrntLe : 231|8@0+ (1.0,0.0) [0.0|255.0] "Unitless" ASDM
 SG_ WhlRotToothCntrForBkpWhlRotToothCntrFrntRi : 239|8@0+ (1.0,0.0) [0.0|255.0] "Unitless" ASDM
 SG_ WhlRotToothCntrForBkpWhlRotToothCntrReLe : 247|8@0+ (1.0,0.0) [0.0|255.0] "Unitless" ASDM
 SG_ WhlRotToothCntrForBkpWhlRotToothCntrReRi : 255|8@0+ (1.0,0.0) [0.0|255.0] "Unitless" ASDM
 SG_ WhlSpdCircumlFrntForBkp_UB : 480|1@0+ (1,0) [0|1] "" ASDM
 SG_ WhlSpdCircumlFrntForBkpWhlSpdCircumlFrntChks : 447|8@0+ (1.0,0.0) [0.0|255.0] "Unitless" ASDM
 SG_ WhlSpdCircumlFrntForBkpWhlSpdCircumlFrntCntr : 455|4@0+ (1.0,0.0) [0.0|15.0] "Unitless" ASDM
 SG_ WhlSpdCircumlFrntForBkpWhlSpdCircumlFrntLe : 463|15@0+ (0.00391,0.0) [0.0|125.0027] "m/s" ASDM
 SG_ WhlSpdCircumlFrntForBkpWhlSpdCircumlFrntLeQf : 451|2@0+ (1,0) [0|3] "" ASDM
 SG_ WhlSpdCircumlFrntForBkpWhlSpdCircumlFrntRiQf : 449|2@0+ (1,0) [0|3] "" ASDM
 SG_ WhlSpdCircumlFrntForBkpWhlSpdCircumlFrntWhlSpdCircumlFrntRi : 479|15@0+ (0.00391,0.0) [0.0|125.0027] "m/s" ASDM
 SG_ WhlSpdCircumlReForBkp_UB : 432|1@0+ (1,0) [0|1] "" ASDM
 SG_ WhlSpdCircumlReForBkpWhlSpdCircumlReChks : 399|8@0+ (1.0,0.0) [0.0|255.0] "Unitless" ASDM
 SG_ WhlSpdCircumlReForBkpWhlSpdCircumlReCntr : 407|4@0+ (1.0,0.0) [0.0|15.0] "Unitless" ASDM
 SG_ WhlSpdCircumlReForBkpWhlSpdCircumlReLe : 415|15@0+ (0.00391,0.0) [0.0|125.0027] "m/s" ASDM
 SG_ WhlSpdCircumlReForBkpWhlSpdCircumlReLeQf : 403|2@0+ (1,0) [0|3] "" ASDM
 SG_ WhlSpdCircumlReForBkpWhlSpdCircumlReRi : 431|15@0+ (0.00391,0.0) [0.0|125.0027] "m/s" ASDM
 SG_ WhlSpdCircumlReForBkpWhlSpdCircumlReRiQf : 401|2@0+ (1,0) [0|3] "" ASDM
 SG_ WhlVAgrFrntForBkp_UB : 391|1@0+ (1,0) [0|1] "" ASDM
 SG_ WhlVAgrFrntForBkpWhlVAgrFrntLe : 375|16@0- (0.0078125,0.0) [-255.0|255.0] "rad/s" ASDM
 SG_ WhlVAgrFrntForBkpWhlVAgrFrntLeQf : 347|2@0+ (1,0) [0|3] "" ASDM
 SG_ WhlVAgrFrntForBkpWhlVAgrFrntRi : 359|16@0- (0.0078125,0.0) [-255.0|255.0] "rad/s" ASDM
 SG_ WhlVAgrFrntForBkpWhlVAgrFrntRiQf : 345|2@0+ (1,0) [0|3] "" ASDM
 SG_ WhlVAgrReForBkp_UB : 335|1@0+ (1,0) [0|1] "" ASDM
 SG_ WhlVAgrReForBkpWhlVAgrReLe : 303|16@0- (0.0078125,0.0) [-255.0|255.0] "rad/s" ASDM
 SG_ WhlVAgrReForBkpWhlVAgrReLeQf : 291|2@0+ (1,0) [0|3] "" ASDM
 SG_ WhlVAgrReForBkpWhlVAgrReRi : 319|16@0- (0.0078125,0.0) [-255.0|255.0] "rad/s" ASDM
 SG_ WhlVAgrReForBkpWhlVAgrReRiQf : 289|2@0+ (1,0) [0|3] "" ASDM

BO_ 1283 FlcSafetyCanFD2NmFr: 8 FLC
 SG_ PNC16_FLC : 16|1@0+ (1,0) [0|0] "" ASDM
 SG_ PNC17_FLC : 17|1@0+ (1,0) [0|0] "" ASDM
 SG_ PNC18_FLC : 18|1@0+ (1,0) [0|0] "" ASDM
 SG_ PNC19_FLC : 19|1@0+ (1,0) [0|0] "" ASDM
 SG_ PNC20_FLC : 20|1@0+ (1,0) [0|0] "" ASDM
 SG_ PNC21_FLC : 21|1@0+ (1,0) [0|0] "" ASDM
 SG_ PNC22_FLC : 22|1@0+ (1,0) [0|0] "" ASDM
 SG_ PNC23_FLC : 23|1@0+ (1,0) [0|0] "" ASDM
 SG_ PNC24_FLC : 24|1@0+ (1,0) [0|0] "" ASDM
 SG_ PNC25_FLC : 25|1@0+ (1,0) [0|0] "" ASDM
 SG_ PNC26_FLC : 26|1@0+ (1,0) [0|0] "" ASDM
 SG_ PNC27_FLC : 27|1@0+ (1,0) [0|0] "" ASDM
 SG_ PNC28_FLC : 28|1@0+ (1,0) [0|0] "" ASDM
 SG_ PNC29_FLC : 29|1@0+ (1,0) [0|0] "" ASDM
 SG_ PNC30_FLC : 30|1@0+ (1,0) [0|0] "" ASDM
 SG_ PNC31_FLC : 31|1@0+ (1,0) [0|0] "" ASDM
 SG_ PNC32_FLC : 32|1@0+ (1,0) [0|0] "" ASDM
 SG_ PNC33_FLC : 33|1@0+ (1,0) [0|0] "" ASDM
 SG_ PNC34_FLC : 34|1@0+ (1,0) [0|0] "" ASDM
 SG_ PNC35_FLC : 35|1@0+ (1,0) [0|0] "" ASDM
 SG_ PNC36_FLC : 36|1@0+ (1,0) [0|0] "" ASDM
 SG_ PNC37_FLC : 37|1@0+ (1,0) [0|0] "" ASDM
 SG_ PNC38_FLC : 38|1@0+ (1,0) [0|0] "" ASDM
 SG_ PNC39_FLC : 39|1@0+ (1,0) [0|0] "" ASDM
 SG_ NM_PNI_FLC : 14|1@0+ (1,0) [0|0] "" ASDM
 SG_ NM_AW_FLC : 12|1@0+ (1,0) [0|0] "" ASDM
 SG_ NM_CS_FLC : 11|1@0+ (1,0) [0|0] "" ASDM
 SG_ NM_RMR_FLC : 8|1@0+ (1,0) [0|0] "" ASDM
 SG_ NM_NodeID_FLC : 7|8@0+ (1,0) [0|0] "" ASDM

BO_ 297 FLRSafetyCANFD2Frame00: 64 FLR
 SG_ FrntRdrSts_UB : 243|1@0+ (1,0) [0|1] "" ASDM,PAS
 SG_ FrntRdrStsForDim : 127|3@0+ (1,0) [0|7] "" ASDM,PAS
 SG_ FrntRdrStsForDim_UB : 116|1@0+ (1,0) [0|1] "" ASDM,PAS
 SG_ FrntRdrStsRdrNrDetn : 207|8@0+ (1.0,0.0) [0.0|255.0] "Unitless" ASDM,PAS
 SG_ FrntRdrStsRdrNrObj : 215|8@0+ (1.0,0.0) [0.0|255.0] "Unitless" ASDM,PAS
 SG_ FrntRdrStsRdrStsBlkd0bin : 216|1@0+ (1,0) [0|1] "" ASDM,PAS
 SG_ FrntRdrStsRdrStsBlkdConf : 223|7@0+ (1.0,0.0) [0.0|100.0] "%" ASDM,PAS
 SG_ FrntRdrStsRdrStsChks : 135|8@0+ (1.0,0.0) [0.0|255.0] "Unitless" ASDM,PAS
 SG_ FrntRdrStsRdrStsCntr : 143|4@0+ (1.0,0.0) [0.0|15.0] "Unitless" ASDM,PAS
 SG_ FrntRdrStsRdrStsDstbc : 239|7@0+ (1.0,0.0) [0.0|100.0] "%" ASDM,PAS
 SG_ FrntRdrStsRdrStsEna : 232|1@0+ (1,0) [0|1] "" ASDM,PAS
 SG_ FrntRdrStsRdrStsFaulty : 247|1@0+ (1,0) [0|1] "" ASDM,PAS
 SG_ FrntRdrStsRdrStsIfVersMajor : 139|4@0+ (1.0,0.0) [0.0|15.0] "Unitless" ASDM,PAS
 SG_ FrntRdrStsRdrStsIfVersMinor : 151|4@0+ (1.0,0.0) [0.0|15.0] "Unitless" ASDM,PAS
 SG_ FrntRdrStsRdrStsLatency : 191|16@0+ (1.0,0.0) [0.0|65535.0] "Unitless" ASDM,PAS
 SG_ FrntRdrStsRdrStsMisAlign : 147|3@0+ (1,0) [0|7] "" ASDM,PAS
 SG_ FrntRdrStsRdrStsMissCom : 144|1@0+ (1,0) [0|1] "" ASDM,PAS
 SG_ FrntRdrStsRdrStsSftyFlt : 246|2@0+ (1,0) [0|3] "" ASDM,PAS
 SG_ FrntRdrStsRdrStsTiStamp : 159|32@0+ (0.0001,0.0) [0.0|429496.7295] "s" ASDM,PAS
 SG_ FrntRdrStsRdrStsTiStampStsGlbTiBas : 244|1@0+ (1,0) [0|1] "" ASDM,PAS
 SG_ FrntRdrStsRdrStsTiStampStsSyncToGatewy : 224|1@0+ (1,0) [0|1] "" ASDM,PAS
 SG_ FrntRdrStsRdrStsTiStampStsTiLeap : 225|1@0+ (1,0) [0|1] "" ASDM,PAS
 SG_ FrntRdrStsRdrStsTiStampStsTiOut : 226|1@0+ (1,0) [0|1] "" ASDM,PAS
 SG_ FrntRdrStsRdrStsWhlSpdCmpFac : 231|5@0+ (0.005,0.92) [0.92|1.075] "Unitless" ASDM,PAS

BO_ 304 FLRSafetyCANFD2Frame01: 64 FLR
 SG_ FrntRdrDetn1_UB : 74|1@0+ (1,0) [0|1] "" ASDM,PAS
 SG_ FrntRdrDetn1RdrDetnAzi : 31|11@0+ (0.1,-90.0) [-90.0|90.0] "Deg" ASDM,PAS
 SG_ FrntRdrDetn1RdrDetnChks : 7|8@0+ (1.0,0.0) [0.0|255.0] "Unitless" ASDM,PAS
 SG_ FrntRdrDetn1RdrDetnCntr : 15|4@0+ (1.0,0.0) [0.0|15.0] "Unitless" ASDM,PAS
 SG_ FrntRdrDetn1RdrDetnConf : 71|7@0+ (1.0,0.0) [0.0|100.0] "%" ASDM,PAS
 SG_ FrntRdrDetn1RdrDetnElevn : 79|5@0+ (1.0,-15.0) [-15.0|15.0] "Deg" ASDM,PAS
 SG_ FrntRdrDetn1RdrDetnPwr : 8|9@0+ (0.1,0.0) [0.0|51.1] "dB" ASDM,PAS
 SG_ FrntRdrDetn1RdrDetnRng : 55|14@0+ (0.02,-1.0) [-1.0|200.0] "m" ASDM,PAS
 SG_ FrntRdrDetn1RdrDetnRngV : 36|13@0+ (0.02,-80.0) [-80.0|80.0] "m/s" ASDM,PAS
 SG_ FrntRdrDetn1RdrDetnSts : 11|2@0+ (1,0) [0|3] "" ASDM,PAS
 SG_ FrntRdrDetn2_UB : 154|1@0+ (1,0) [0|1] "" ASDM,PAS
 SG_ FrntRdrDetn2RdrDetnAzi : 119|11@0+ (0.1,-90.0) [-90.0|90.0] "Deg" ASDM,PAS
 SG_ FrntRdrDetn2RdrDetnChks : 87|8@0+ (1.0,0.0) [0.0|255.0] "Unitless" ASDM,PAS
 SG_ FrntRdrDetn2RdrDetnCntr : 95|4@0+ (1.0,0.0) [0.0|15.0] "Unitless" ASDM,PAS
 SG_ FrntRdrDetn2RdrDetnConf : 111|7@0+ (1.0,0.0) [0.0|100.0] "%" ASDM,PAS
 SG_ FrntRdrDetn2RdrDetnElevn : 159|5@0+ (1.0,-15.0) [-15.0|15.0] "Deg" ASDM,PAS
 SG_ FrntRdrDetn2RdrDetnPwr : 89|9@0+ (0.1,0.0) [0.0|51.1] "dB" ASDM,PAS
 SG_ FrntRdrDetn2RdrDetnRng : 143|14@0+ (0.02,-1.0) [-1.0|200.0] "m" ASDM,PAS
 SG_ FrntRdrDetn2RdrDetnRngV : 124|13@0+ (0.02,-80.0) [-80.0|80.0] "m/s" ASDM,PAS
 SG_ FrntRdrDetn2RdrDetnSts : 91|2@0+ (1,0) [0|3] "" ASDM,PAS
 SG_ FrntRdrDetn3_UB : 234|1@0+ (1,0) [0|1] "" ASDM,PAS
 SG_ FrntRdrDetn3RdrDetnAzi : 199|11@0+ (0.1,-90.0) [-90.0|90.0] "Deg" ASDM,PAS
 SG_ FrntRdrDetn3RdrDetnChks : 167|8@0+ (1.0,0.0) [0.0|255.0] "Unitless" ASDM,PAS
 SG_ FrntRdrDetn3RdrDetnCntr : 175|4@0+ (1.0,0.0) [0.0|15.0] "Unitless" ASDM,PAS
 SG_ FrntRdrDetn3RdrDetnConf : 191|7@0+ (1.0,0.0) [0.0|100.0] "%" ASDM,PAS
 SG_ FrntRdrDetn3RdrDetnElevn : 239|5@0+ (1.0,-15.0) [-15.0|15.0] "Deg" ASDM,PAS
 SG_ FrntRdrDetn3RdrDetnPwr : 169|9@0+ (0.1,0.0) [0.0|51.1] "dB" ASDM,PAS
 SG_ FrntRdrDetn3RdrDetnRng : 223|14@0+ (0.02,-1.0) [-1.0|200.0] "m" ASDM,PAS
 SG_ FrntRdrDetn3RdrDetnRngV : 204|13@0+ (0.02,-80.0) [-80.0|80.0] "m/s" ASDM,PAS
 SG_ FrntRdrDetn3RdrDetnSts : 171|2@0+ (1,0) [0|3] "" ASDM,PAS
 SG_ FrntRdrDetn4_UB : 314|1@0+ (1,0) [0|1] "" ASDM,PAS
 SG_ FrntRdrDetn4RdrDetnAzi : 287|11@0+ (0.1,-90.0) [-90.0|90.0] "Deg" ASDM,PAS
 SG_ FrntRdrDetn4RdrDetnChks : 247|8@0+ (1.0,0.0) [0.0|255.0] "Unitless" ASDM,PAS
 SG_ FrntRdrDetn4RdrDetnCntr : 255|4@0+ (1.0,0.0) [0.0|15.0] "Unitless" ASDM,PAS
 SG_ FrntRdrDetn4RdrDetnConf : 311|7@0+ (1.0,0.0) [0.0|100.0] "%" ASDM,PAS
 SG_ FrntRdrDetn4RdrDetnElevn : 319|5@0+ (1.0,-15.0) [-15.0|15.0] "Deg" ASDM,PAS
 SG_ FrntRdrDetn4RdrDetnPwr : 249|9@0+ (0.1,0.0) [0.0|51.1] "dB" ASDM,PAS
 SG_ FrntRdrDetn4RdrDetnRng : 271|14@0+ (0.02,-1.0) [-1.0|200.0] "m" ASDM,PAS
 SG_ FrntRdrDetn4RdrDetnRngV : 292|13@0+ (0.02,-80.0) [-80.0|80.0] "m/s" ASDM,PAS
 SG_ FrntRdrDetn4RdrDetnSts : 251|2@0+ (1,0) [0|3] "" ASDM,PAS
 SG_ FrntRdrDetn5_UB : 394|1@0+ (1,0) [0|1] "" ASDM,PAS
 SG_ FrntRdrDetn5RdrDetnAzi : 351|11@0+ (0.1,-90.0) [-90.0|90.0] "Deg" ASDM,PAS
 SG_ FrntRdrDetn5RdrDetnChks : 327|8@0+ (1.0,0.0) [0.0|255.0] "Unitless" ASDM,PAS
 SG_ FrntRdrDetn5RdrDetnCntr : 335|4@0+ (1.0,0.0) [0.0|15.0] "Unitless" ASDM,PAS
 SG_ FrntRdrDetn5RdrDetnConf : 391|7@0+ (1.0,0.0) [0.0|100.0] "%" ASDM,PAS
 SG_ FrntRdrDetn5RdrDetnElevn : 399|5@0+ (1.0,-15.0) [-15.0|15.0] "Deg" ASDM,PAS
 SG_ FrntRdrDetn5RdrDetnPwr : 329|9@0+ (0.1,0.0) [0.0|51.1] "dB" ASDM,PAS
 SG_ FrntRdrDetn5RdrDetnRng : 375|14@0+ (0.02,-1.0) [-1.0|200.0] "m" ASDM,PAS
 SG_ FrntRdrDetn5RdrDetnRngV : 356|13@0+ (0.02,-80.0) [-80.0|80.0] "m/s" ASDM,PAS
 SG_ FrntRdrDetn5RdrDetnSts : 331|2@0+ (1,0) [0|3] "" ASDM,PAS
 SG_ FrntRdrDetn6_UB : 474|1@0+ (1,0) [0|1] "" ASDM,PAS
 SG_ FrntRdrDetn6RdrDetnAzi : 447|11@0+ (0.1,-90.0) [-90.0|90.0] "Deg" ASDM,PAS
 SG_ FrntRdrDetn6RdrDetnChks : 407|8@0+ (1.0,0.0) [0.0|255.0] "Unitless" ASDM,PAS
 SG_ FrntRdrDetn6RdrDetnCntr : 415|4@0+ (1.0,0.0) [0.0|15.0] "Unitless" ASDM,PAS
 SG_ FrntRdrDetn6RdrDetnConf : 471|7@0+ (1.0,0.0) [0.0|100.0] "%" ASDM,PAS
 SG_ FrntRdrDetn6RdrDetnElevn : 479|5@0+ (1.0,-15.0) [-15.0|15.0] "Deg" ASDM,PAS
 SG_ FrntRdrDetn6RdrDetnPwr : 409|9@0+ (0.1,0.0) [0.0|51.1] "dB" ASDM,PAS
 SG_ FrntRdrDetn6RdrDetnRng : 431|14@0+ (0.02,-1.0) [-1.0|200.0] "m" ASDM,PAS
 SG_ FrntRdrDetn6RdrDetnRngV : 452|13@0+ (0.02,-80.0) [-80.0|80.0] "m/s" ASDM,PAS
 SG_ FrntRdrDetn6RdrDetnSts : 411|2@0+ (1,0) [0|3] "" ASDM,PAS

BO_ 306 FLRSafetyCANFD2Frame02: 64 FLR
 SG_ FrntRdrDetn10_UB : 74|1@0+ (1,0) [0|1] "" ASDM,PAS
 SG_ FrntRdrDetn10RdrDetnAzi : 31|11@0+ (0.1,-90.0) [-90.0|90.0] "Deg" ASDM,PAS
 SG_ FrntRdrDetn10RdrDetnChks : 7|8@0+ (1.0,0.0) [0.0|255.0] "Unitless" ASDM,PAS
 SG_ FrntRdrDetn10RdrDetnCntr : 15|4@0+ (1.0,0.0) [0.0|15.0] "Unitless" ASDM,PAS
 SG_ FrntRdrDetn10RdrDetnConf : 71|7@0+ (1.0,0.0) [0.0|100.0] "%" ASDM,PAS
 SG_ FrntRdrDetn10RdrDetnElevn : 79|5@0+ (1.0,-15.0) [-15.0|15.0] "Deg" ASDM,PAS
 SG_ FrntRdrDetn10RdrDetnPwr : 8|9@0+ (0.1,0.0) [0.0|51.1] "dB" ASDM,PAS
 SG_ FrntRdrDetn10RdrDetnRng : 55|14@0+ (0.02,-1.0) [-1.0|200.0] "m" ASDM,PAS
 SG_ FrntRdrDetn10RdrDetnRngV : 36|13@0+ (0.02,-80.0) [-80.0|80.0] "m/s" ASDM,PAS
 SG_ FrntRdrDetn10RdrDetnSts : 11|2@0+ (1,0) [0|3] "" ASDM,PAS
 SG_ FrntRdrDetn11_UB : 154|1@0+ (1,0) [0|1] "" ASDM,PAS
 SG_ FrntRdrDetn11RdrDetnAzi : 119|11@0+ (0.1,-90.0) [-90.0|90.0] "Deg" ASDM,PAS
 SG_ FrntRdrDetn11RdrDetnChks : 87|8@0+ (1.0,0.0) [0.0|255.0] "Unitless" ASDM,PAS
 SG_ FrntRdrDetn11RdrDetnCntr : 95|4@0+ (1.0,0.0) [0.0|15.0] "Unitless" ASDM,PAS
 SG_ FrntRdrDetn11RdrDetnConf : 111|7@0+ (1.0,0.0) [0.0|100.0] "%" ASDM,PAS
 SG_ FrntRdrDetn11RdrDetnElevn : 159|5@0+ (1.0,-15.0) [-15.0|15.0] "Deg" ASDM,PAS
 SG_ FrntRdrDetn11RdrDetnPwr : 89|9@0+ (0.1,0.0) [0.0|51.1] "dB" ASDM,PAS
 SG_ FrntRdrDetn11RdrDetnRng : 143|14@0+ (0.02,-1.0) [-1.0|200.0] "m" ASDM,PAS
 SG_ FrntRdrDetn11RdrDetnRngV : 124|13@0+ (0.02,-80.0) [-80.0|80.0] "m/s" ASDM,PAS
 SG_ FrntRdrDetn11RdrDetnSts : 91|2@0+ (1,0) [0|3] "" ASDM,PAS
 SG_ FrntRdrDetn12_UB : 234|1@0+ (1,0) [0|1] "" ASDM,PAS
 SG_ FrntRdrDetn12RdrDetnAzi : 199|11@0+ (0.1,-90.0) [-90.0|90.0] "Deg" ASDM,PAS
 SG_ FrntRdrDetn12RdrDetnChks : 167|8@0+ (1.0,0.0) [0.0|255.0] "Unitless" ASDM,PAS
 SG_ FrntRdrDetn12RdrDetnCntr : 175|4@0+ (1.0,0.0) [0.0|15.0] "Unitless" ASDM,PAS
 SG_ FrntRdrDetn12RdrDetnConf : 191|7@0+ (1.0,0.0) [0.0|100.0] "%" ASDM,PAS
 SG_ FrntRdrDetn12RdrDetnElevn : 239|5@0+ (1.0,-15.0) [-15.0|15.0] "Deg" ASDM,PAS
 SG_ FrntRdrDetn12RdrDetnPwr : 169|9@0+ (0.1,0.0) [0.0|51.1] "dB" ASDM,PAS
 SG_ FrntRdrDetn12RdrDetnRng : 223|14@0+ (0.02,-1.0) [-1.0|200.0] "m" ASDM,PAS
 SG_ FrntRdrDetn12RdrDetnRngV : 204|13@0+ (0.02,-80.0) [-80.0|80.0] "m/s" ASDM,PAS
 SG_ FrntRdrDetn12RdrDetnSts : 171|2@0+ (1,0) [0|3] "" ASDM,PAS
 SG_ FrntRdrDetn7_UB : 314|1@0+ (1,0) [0|1] "" ASDM,PAS
 SG_ FrntRdrDetn7RdrDetnAzi : 287|11@0+ (0.1,-90.0) [-90.0|90.0] "Deg" ASDM,PAS
 SG_ FrntRdrDetn7RdrDetnChks : 247|8@0+ (1.0,0.0) [0.0|255.0] "Unitless" ASDM,PAS
 SG_ FrntRdrDetn7RdrDetnCntr : 255|4@0+ (1.0,0.0) [0.0|15.0] "Unitless" ASDM,PAS
 SG_ FrntRdrDetn7RdrDetnConf : 311|7@0+ (1.0,0.0) [0.0|100.0] "%" ASDM,PAS
 SG_ FrntRdrDetn7RdrDetnElevn : 319|5@0+ (1.0,-15.0) [-15.0|15.0] "Deg" ASDM,PAS
 SG_ FrntRdrDetn7RdrDetnPwr : 249|9@0+ (0.1,0.0) [0.0|51.1] "dB" ASDM,PAS
 SG_ FrntRdrDetn7RdrDetnRng : 271|14@0+ (0.02,-1.0) [-1.0|200.0] "m" ASDM,PAS
 SG_ FrntRdrDetn7RdrDetnRngV : 292|13@0+ (0.02,-80.0) [-80.0|80.0] "m/s" ASDM,PAS
 SG_ FrntRdrDetn7RdrDetnSts : 251|2@0+ (1,0) [0|3] "" ASDM,PAS
 SG_ FrntRdrDetn8_UB : 394|1@0+ (1,0) [0|1] "" ASDM,PAS
 SG_ FrntRdrDetn8RdrDetnAzi : 351|11@0+ (0.1,-90.0) [-90.0|90.0] "Deg" ASDM,PAS
 SG_ FrntRdrDetn8RdrDetnChks : 327|8@0+ (1.0,0.0) [0.0|255.0] "Unitless" ASDM,PAS
 SG_ FrntRdrDetn8RdrDetnCntr : 335|4@0+ (1.0,0.0) [0.0|15.0] "Unitless" ASDM,PAS
 SG_ FrntRdrDetn8RdrDetnConf : 391|7@0+ (1.0,0.0) [0.0|100.0] "%" ASDM,PAS
 SG_ FrntRdrDetn8RdrDetnElevn : 399|5@0+ (1.0,-15.0) [-15.0|15.0] "Deg" ASDM,PAS
 SG_ FrntRdrDetn8RdrDetnPwr : 329|9@0+ (0.1,0.0) [0.0|51.1] "dB" ASDM,PAS
 SG_ FrntRdrDetn8RdrDetnRng : 375|14@0+ (0.02,-1.0) [-1.0|200.0] "m" ASDM,PAS
 SG_ FrntRdrDetn8RdrDetnRngV : 356|13@0+ (0.02,-80.0) [-80.0|80.0] "m/s" ASDM,PAS
 SG_ FrntRdrDetn8RdrDetnSts : 331|2@0+ (1,0) [0|3] "" ASDM,PAS
 SG_ FrntRdrDetn9_UB : 474|1@0+ (1,0) [0|1] "" ASDM,PAS
 SG_ FrntRdrDetn9RdrDetnAzi : 447|11@0+ (0.1,-90.0) [-90.0|90.0] "Deg" ASDM,PAS
 SG_ FrntRdrDetn9RdrDetnChks : 407|8@0+ (1.0,0.0) [0.0|255.0] "Unitless" ASDM,PAS
 SG_ FrntRdrDetn9RdrDetnCntr : 415|4@0+ (1.0,0.0) [0.0|15.0] "Unitless" ASDM,PAS
 SG_ FrntRdrDetn9RdrDetnConf : 471|7@0+ (1.0,0.0) [0.0|100.0] "%" ASDM,PAS
 SG_ FrntRdrDetn9RdrDetnElevn : 479|5@0+ (1.0,-15.0) [-15.0|15.0] "Deg" ASDM,PAS
 SG_ FrntRdrDetn9RdrDetnPwr : 409|9@0+ (0.1,0.0) [0.0|51.1] "dB" ASDM,PAS
 SG_ FrntRdrDetn9RdrDetnRng : 431|14@0+ (0.02,-1.0) [-1.0|200.0] "m" ASDM,PAS
 SG_ FrntRdrDetn9RdrDetnRngV : 452|13@0+ (0.02,-80.0) [-80.0|80.0] "m/s" ASDM,PAS
 SG_ FrntRdrDetn9RdrDetnSts : 411|2@0+ (1,0) [0|3] "" ASDM,PAS

BO_ 308 FLRSafetyCANFD2Frame03: 64 FLR
 SG_ FrntRdrDetn13_UB : 74|1@0+ (1,0) [0|1] "" ASDM,PAS
 SG_ FrntRdrDetn13RdrDetnAzi : 31|11@0+ (0.1,-90.0) [-90.0|90.0] "Deg" ASDM,PAS
 SG_ FrntRdrDetn13RdrDetnChks : 7|8@0+ (1.0,0.0) [0.0|255.0] "Unitless" ASDM,PAS
 SG_ FrntRdrDetn13RdrDetnCntr : 15|4@0+ (1.0,0.0) [0.0|15.0] "Unitless" ASDM,PAS
 SG_ FrntRdrDetn13RdrDetnConf : 71|7@0+ (1.0,0.0) [0.0|100.0] "%" ASDM,PAS
 SG_ FrntRdrDetn13RdrDetnElevn : 79|5@0+ (1.0,-15.0) [-15.0|15.0] "Deg" ASDM,PAS
 SG_ FrntRdrDetn13RdrDetnPwr : 8|9@0+ (0.1,0.0) [0.0|51.1] "dB" ASDM,PAS
 SG_ FrntRdrDetn13RdrDetnRng : 55|14@0+ (0.02,-1.0) [-1.0|200.0] "m" ASDM,PAS
 SG_ FrntRdrDetn13RdrDetnRngV : 36|13@0+ (0.02,-80.0) [-80.0|80.0] "m/s" ASDM,PAS
 SG_ FrntRdrDetn13RdrDetnSts : 11|2@0+ (1,0) [0|3] "" ASDM,PAS
 SG_ FrntRdrDetn14_UB : 154|1@0+ (1,0) [0|1] "" ASDM,PAS
 SG_ FrntRdrDetn14RdrDetnAzi : 119|11@0+ (0.1,-90.0) [-90.0|90.0] "Deg" ASDM,PAS
 SG_ FrntRdrDetn14RdrDetnChks : 87|8@0+ (1.0,0.0) [0.0|255.0] "Unitless" ASDM,PAS
 SG_ FrntRdrDetn14RdrDetnCntr : 95|4@0+ (1.0,0.0) [0.0|15.0] "Unitless" ASDM,PAS
 SG_ FrntRdrDetn14RdrDetnConf : 111|7@0+ (1.0,0.0) [0.0|100.0] "%" ASDM,PAS
 SG_ FrntRdrDetn14RdrDetnElevn : 159|5@0+ (1.0,-15.0) [-15.0|15.0] "Deg" ASDM,PAS
 SG_ FrntRdrDetn14RdrDetnPwr : 89|9@0+ (0.1,0.0) [0.0|51.1] "dB" ASDM,PAS
 SG_ FrntRdrDetn14RdrDetnRng : 143|14@0+ (0.02,-1.0) [-1.0|200.0] "m" ASDM,PAS
 SG_ FrntRdrDetn14RdrDetnRngV : 124|13@0+ (0.02,-80.0) [-80.0|80.0] "m/s" ASDM,PAS
 SG_ FrntRdrDetn14RdrDetnSts : 91|2@0+ (1,0) [0|3] "" ASDM,PAS
 SG_ FrntRdrDetn15_UB : 234|1@0+ (1,0) [0|1] "" ASDM,PAS
 SG_ FrntRdrDetn15RdrDetnAzi : 199|11@0+ (0.1,-90.0) [-90.0|90.0] "Deg" ASDM,PAS
 SG_ FrntRdrDetn15RdrDetnChks : 167|8@0+ (1.0,0.0) [0.0|255.0] "Unitless" ASDM,PAS
 SG_ FrntRdrDetn15RdrDetnCntr : 175|4@0+ (1.0,0.0) [0.0|15.0] "Unitless" ASDM,PAS
 SG_ FrntRdrDetn15RdrDetnConf : 191|7@0+ (1.0,0.0) [0.0|100.0] "%" ASDM,PAS
 SG_ FrntRdrDetn15RdrDetnElevn : 239|5@0+ (1.0,-15.0) [-15.0|15.0] "Deg" ASDM,PAS
 SG_ FrntRdrDetn15RdrDetnPwr : 169|9@0+ (0.1,0.0) [0.0|51.1] "dB" ASDM,PAS
 SG_ FrntRdrDetn15RdrDetnRng : 223|14@0+ (0.02,-1.0) [-1.0|200.0] "m" ASDM,PAS
 SG_ FrntRdrDetn15RdrDetnRngV : 204|13@0+ (0.02,-80.0) [-80.0|80.0] "m/s" ASDM,PAS
 SG_ FrntRdrDetn15RdrDetnSts : 171|2@0+ (1,0) [0|3] "" ASDM,PAS
 SG_ FrntRdrDetn16_UB : 314|1@0+ (1,0) [0|1] "" ASDM,PAS
 SG_ FrntRdrDetn16RdrDetnAzi : 287|11@0+ (0.1,-90.0) [-90.0|90.0] "Deg" ASDM,PAS
 SG_ FrntRdrDetn16RdrDetnChks : 247|8@0+ (1.0,0.0) [0.0|255.0] "Unitless" ASDM,PAS
 SG_ FrntRdrDetn16RdrDetnCntr : 255|4@0+ (1.0,0.0) [0.0|15.0] "Unitless" ASDM,PAS
 SG_ FrntRdrDetn16RdrDetnConf : 311|7@0+ (1.0,0.0) [0.0|100.0] "%" ASDM,PAS
 SG_ FrntRdrDetn16RdrDetnElevn : 319|5@0+ (1.0,-15.0) [-15.0|15.0] "Deg" ASDM,PAS
 SG_ FrntRdrDetn16RdrDetnPwr : 249|9@0+ (0.1,0.0) [0.0|51.1] "dB" ASDM,PAS
 SG_ FrntRdrDetn16RdrDetnRng : 271|14@0+ (0.02,-1.0) [-1.0|200.0] "m" ASDM,PAS
 SG_ FrntRdrDetn16RdrDetnRngV : 292|13@0+ (0.02,-80.0) [-80.0|80.0] "m/s" ASDM,PAS
 SG_ FrntRdrDetn16RdrDetnSts : 251|2@0+ (1,0) [0|3] "" ASDM,PAS
 SG_ FrntRdrDetn17_UB : 394|1@0+ (1,0) [0|1] "" ASDM,PAS
 SG_ FrntRdrDetn17RdrDetnAzi : 351|11@0+ (0.1,-90.0) [-90.0|90.0] "Deg" ASDM,PAS
 SG_ FrntRdrDetn17RdrDetnChks : 327|8@0+ (1.0,0.0) [0.0|255.0] "Unitless" ASDM,PAS
 SG_ FrntRdrDetn17RdrDetnCntr : 335|4@0+ (1.0,0.0) [0.0|15.0] "Unitless" ASDM,PAS
 SG_ FrntRdrDetn17RdrDetnConf : 391|7@0+ (1.0,0.0) [0.0|100.0] "%" ASDM,PAS
 SG_ FrntRdrDetn17RdrDetnElevn : 399|5@0+ (1.0,-15.0) [-15.0|15.0] "Deg" ASDM,PAS
 SG_ FrntRdrDetn17RdrDetnPwr : 329|9@0+ (0.1,0.0) [0.0|51.1] "dB" ASDM,PAS
 SG_ FrntRdrDetn17RdrDetnRng : 375|14@0+ (0.02,-1.0) [-1.0|200.0] "m" ASDM,PAS
 SG_ FrntRdrDetn17RdrDetnRngV : 356|13@0+ (0.02,-80.0) [-80.0|80.0] "m/s" ASDM,PAS
 SG_ FrntRdrDetn17RdrDetnSts : 331|2@0+ (1,0) [0|3] "" ASDM,PAS
 SG_ FrntRdrDetn18_UB : 474|1@0+ (1,0) [0|1] "" ASDM,PAS
 SG_ FrntRdrDetn18RdrDetnAzi : 447|11@0+ (0.1,-90.0) [-90.0|90.0] "Deg" ASDM,PAS
 SG_ FrntRdrDetn18RdrDetnChks : 407|8@0+ (1.0,0.0) [0.0|255.0] "Unitless" ASDM,PAS
 SG_ FrntRdrDetn18RdrDetnCntr : 415|4@0+ (1.0,0.0) [0.0|15.0] "Unitless" ASDM,PAS
 SG_ FrntRdrDetn18RdrDetnConf : 471|7@0+ (1.0,0.0) [0.0|100.0] "%" ASDM,PAS
 SG_ FrntRdrDetn18RdrDetnElevn : 479|5@0+ (1.0,-15.0) [-15.0|15.0] "Deg" ASDM,PAS
 SG_ FrntRdrDetn18RdrDetnPwr : 409|9@0+ (0.1,0.0) [0.0|51.1] "dB" ASDM,PAS
 SG_ FrntRdrDetn18RdrDetnRng : 431|14@0+ (0.02,-1.0) [-1.0|200.0] "m" ASDM,PAS
 SG_ FrntRdrDetn18RdrDetnRngV : 452|13@0+ (0.02,-80.0) [-80.0|80.0] "m/s" ASDM,PAS
 SG_ FrntRdrDetn18RdrDetnSts : 411|2@0+ (1,0) [0|3] "" ASDM,PAS

// Node Comments
CM_ BU_ ETC "External Tester Connector";

// Signal Comments
CM_ SG_ 24 PrimADataCompALat "lateral accelerate";
CM_ SG_ 24 PrimADataCompALat1Qf "Quality factor for Lateral acceleration signal";
CM_ SG_ 24 PrimADataCompALgt "longitute accelerate";
CM_ SG_ 24 PrimADataCompALgt1Qf "Quality factor for longitudinal acceleration";
CM_ SG_ 24 PrimADataCompAVert "Vertical acceleration.";
CM_ SG_ 24 PrimADataCompAVertQf "Quality factor for Vertical acceleration";
CM_ SG_ 24 PrimADataCompChks "Checksum";
CM_ SG_ 24 PrimADataCompCntr "counter";
CM_ SG_ 24 PrimADataComptimeStampNanoSec "Nanoseconds part of the time.";
CM_ SG_ 24 PrimADataComptimeStampSec "Seconds part of the time.";
CM_ SG_ 24 PrimADataComptimeStampTiBasSts "Time Base Status";
CM_ SG_ 24 PrimAgDataCompChks "Checksum";
CM_ SG_ 24 PrimAgDataCompCntr "counter";
CM_ SG_ 24 PrimAgDataCompRollRate "Vehicle roll rate.";
CM_ SG_ 24 PrimAgDataCompRollRateQf "Quality factor for Roll Rate";
CM_ SG_ 24 PrimAgDataComptimeStampNanoSec "Nanoseconds part of the time.";
CM_ SG_ 24 PrimAgDataComptimeStampSec "Seconds part of the time.";
CM_ SG_ 24 PrimAgDataComptimeStampTiBasSts "Time Base Status ";
CM_ SG_ 24 PrimAgDataCompYawRate "Vehicle yaw rate.";
CM_ SG_ 24 PrimAgDataCompYawRateQf "Quality Factor for Yaw Rate";
CM_ SG_ 24 PrimAsyALgtReqForCmftAsyCmftLgtNegLimForJerk "Neg jerk";
CM_ SG_ 24 PrimAsyALgtReqForCmftAsyCmftLgtPosLimForJerk "Pos jerk";
CM_ SG_ 24 PrimAsyALgtReqForCmftMax "max";
CM_ SG_ 24 PrimAsyALgtReqForCmftMin "min";
CM_ SG_ 24 PrimAsyALgtReqRngForSafeMax "Lgt cmd for safe Max";
CM_ SG_ 24 PrimAsyALgtReqRngForSafeMin "Lgt cmd for safe Min";
CM_ SG_ 24 PrimAsyPinionAgReqSafe "prim Ag";
CM_ SG_ 24 PrimChStsADModeAvtn "indicate AD mode active request from primary AD controller";
CM_ SG_ 24 PrimChStsADModeAvtnCfm "indicate all system into AD mode, this status mean AD function START or not";
CM_ SG_ 24 PrimChStsADModeDeavtn "dicate AD mode deactive request from primary AD controller";
CM_ SG_ 24 PrimChStsADModeDeavtnCfm "indicate all system quits AD mode, this status means AD function ends or not";
CM_ SG_ 24 PrimChStsChanlSts "indicate primary channel status is OK or not";
CM_ SG_ 24 PrimChStsCtrlrSts "indicate primary AD controller status is OK or not";
CM_ SG_ 24 PrimChStsLatADAvtn "indicate primary AD controller send AD Mode active request to primary lateral controller";
CM_ SG_ 24 PrimChStsLatADAvtnCfm "indicate lateral system confirm AD mode from primary lateral controller";
CM_ SG_ 24 PrimChStsLatSts "indicate primary lateral controller status is OK or not";
CM_ SG_ 24 PrimChStsLgtADAvtn "indicate primary AD controller send AD Mode active request to primary longitudinal controller";
CM_ SG_ 24 PrimChStsLgtADAvtnCfm "indicate longitudinal system confirm AD mode from primary longitudinal controller";
CM_ SG_ 24 PrimChStsLgtSts "indicate primary longitudinal controller status is OK or not";
CM_ SG_ 24 PrimChStsReserved1 "Reserved";
CM_ SG_ 24 PrimChStsReserved2 "Reserved";
CM_ SG_ 24 PrimChStsReserved3 "Reserved";
CM_ SG_ 24 PrimChStsSafeStop "indicate primary AD controller start execute safe stop or not";
CM_ SG_ 24 PrimVehVCompChks "Checksum";
CM_ SG_ 24 PrimVehVCompCntr "counter";
CM_ SG_ 24 PrimVehVCompVehVLat "Lateral velocity.";
CM_ SG_ 24 PrimVehVCompVehVLatQf "Quality factor for lateral velocity.";
CM_ SG_ 24 PrimVehVCompVehVLgt "Longitudinal velocity.";
CM_ SG_ 24 PrimVehVCompVehVLgtQf "Quality factor for longitudinal velocity.";
CM_ SG_ 24 WhlSpdCmpFac "Estimated compensation factor for host speed.";
CM_ SG_ 17 PrimAdPSSGroupSafe0DataID "ID";
CM_ SG_ 17 PrimAdPSSGroupSafe0DeltaTPos1 "T Pos1";
CM_ SG_ 17 PrimAdPSSGroupSafe0DeltaTPos2 "T Pos2";
CM_ SG_ 17 PrimAdPSSGroupSafe0DeltaXPos1 "X Pos1";
CM_ SG_ 17 PrimAdPSSGroupSafe0DeltaXPos2 "X Pos2
";
CM_ SG_ 17 PrimAdPSSGroupSafe0DeltaYPos1 "Y Pos1";
CM_ SG_ 17 PrimAdPSSGroupSafe0DeltaYPos2 "Y Pos2
";
CM_ SG_ 17 PrimAdPSSGroupSafe0HeadingPos1 "heading pos1
";
CM_ SG_ 17 PrimAdPSSGroupSafe0HeadingPos2 "heading pos2
";
CM_ SG_ 17 PrimAdPSSGroupSafe0InitHeading "init heading";
CM_ SG_ 17 PrimAdPSSGroupSafe0InitPosX "init pos X
";
CM_ SG_ 17 PrimAdPSSGroupSafe0InitPosY "init Pos Y";
CM_ SG_ 17 PrimAdPSSGroupSafe0TiStampNanoSec "Ti n sec";
CM_ SG_ 17 PrimAdPSSGroupSafe0TiStampSec "Ti sec";
CM_ SG_ 17 PrimAdPSSGroupSafe0TrajectID "traject ID";
CM_ SG_ 18 PrimAdPSSGroupSafe1DataID "ID";
CM_ SG_ 18 PrimAdPSSGroupSafe1DeltaTPos1 "T Pos1
";
CM_ SG_ 18 PrimAdPSSGroupSafe1DeltaTPos2 "T Pos2
";
CM_ SG_ 18 PrimAdPSSGroupSafe1DeltaTPos3 "T Pos3";
CM_ SG_ 18 PrimAdPSSGroupSafe1DeltaTPos4 "T Pos 4";
CM_ SG_ 18 PrimAdPSSGroupSafe1DeltaTPos5 "T Pos 5";
CM_ SG_ 18 PrimAdPSSGroupSafe1DeltaTPos6 "T Pos 6";
CM_ SG_ 18 PrimAdPSSGroupSafe1DeltaXPos1 "X pos 1";
CM_ SG_ 18 PrimAdPSSGroupSafe1DeltaXPos2 "X Pos 2";
CM_ SG_ 18 PrimAdPSSGroupSafe1DeltaXPos3 "X Pos 3";
CM_ SG_ 18 PrimAdPSSGroupSafe1DeltaXPos4 "X Pos 4";
CM_ SG_ 18 PrimAdPSSGroupSafe1DeltaXPos5 "X Pos 5";
CM_ SG_ 18 PrimAdPSSGroupSafe1DeltaXPos6 "X Pos 6";
CM_ SG_ 18 PrimAdPSSGroupSafe1DeltaYPos1 "Y Pos1";
CM_ SG_ 18 PrimAdPSSGroupSafe1DeltaYPos2 "Y Pos2";
CM_ SG_ 18 PrimAdPSSGroupSafe1DeltaYPos3 "Y Pos 3
";
CM_ SG_ 18 PrimAdPSSGroupSafe1DeltaYPos4 "Y Pos 4";
CM_ SG_ 18 PrimAdPSSGroupSafe1DeltaYPos5 "Y Pos 5";
CM_ SG_ 18 PrimAdPSSGroupSafe1DeltaYPos6 "Y Pos 6";
CM_ SG_ 18 PrimAdPSSGroupSafe1HeadingPos1 "heading Pos 1
";
CM_ SG_ 18 PrimAdPSSGroupSafe1HeadingPos2 "Heading Pos 2";
CM_ SG_ 18 PrimAdPSSGroupSafe1HeadingPos3 "Heading Pos 3";
CM_ SG_ 18 PrimAdPSSGroupSafe1HeadingPos4 "Heading Pos 4";
CM_ SG_ 18 PrimAdPSSGroupSafe1HeadingPos5 "Heading Pos 5";
CM_ SG_ 18 PrimAdPSSGroupSafe1HeadingPos6 "Heading Pos 6";
CM_ SG_ 18 PrimAdPSSGroupSafe1TrajectID "tragect id
";
CM_ SG_ 288 ADataRawSafeALat "IMU acceleration data Lateral acceleration";
CM_ SG_ 288 ADataRawSafeALat1Qf "IMU acceleration data Quality factor for Lateral acceleration signal";
CM_ SG_ 288 ADataRawSafeALgt "IMU acceleration data Longitudinal acceleration";
CM_ SG_ 288 ADataRawSafeALgt1Qf "IMU acceleration data Quality factor for Longitudinal acceleration";
CM_ SG_ 288 ADataRawSafeAVert "IMU acceleration data Vertical acceleration";
CM_ SG_ 288 ADataRawSafeAVertQf "IMU acceleration data Quality factor for Vertical acceleration";
CM_ SG_ 288 ADataRawSafeChks "IMU acceleration data Check sum";
CM_ SG_ 288 ADataRawSafeCntr "IMU acceleration data Counter";
CM_ SG_ 288 ALgtStdFromWhlSpdALgtStdFromWhlSpd "Longitudinal acceleration over ground.
end2endprotection=profile1A dataid= 12345 Longitudinal acceleration over ground";
CM_ SG_ 288 ALgtStdFromWhlSpdChks "Longitudinal acceleration over ground.
end2endprotection=profile1A dataid=12345 Checksum for longitudinal acceleration over ground";
CM_ SG_ 288 ALgtStdFromWhlSpdCntr "Longitudinal acceleration over ground.
end2endprotection=profile1A dataid=12345 Counter for longitudinal acceleration over ground";
CM_ SG_ 288 ALgtStdFromWhlSpdQf "Longitudinal acceleration over ground.
end2endprotection=profile1A dataid=12345 Qf for longitudinal acceleration over ground";
CM_ SG_ 288 AmbTRawAmbTVal "Unfiltered ambient temp raw data in deg C. Ambient temp value";
CM_ SG_ 288 AmbTRawQly "Unfiltered ambient temp raw data in deg C. Quality Factor of the ambient temp";
CM_ SG_ 288 AsyDataWithCmpSafeALat1Qf "IMU processed special data. Quality factor for Lateral acceleration signal";
CM_ SG_ 288 AsyDataWithCmpSafeALatWithCmp "IMU processed special data.  Compensated Lateral acceleration";
CM_ SG_ 288 AsyDataWithCmpSafeALgt1Qf "IMU processed special data. Quality factor for Longitudinal acceleration";
CM_ SG_ 288 AsyDataWithCmpSafeChks "IMU processed special data. Check sum";
CM_ SG_ 288 AsyDataWithCmpSafeCntr "IMU processed special data. Counter";
CM_ SG_ 288 AsyDataWithCmpSafeGrdtOfALgt "IMU processed special data. Derivative of Longitudinal acceleration";
CM_ SG_ 288 AsyDataWithCmpSafeYawRateQf "IMU processed special data. Quality Factor for Yaw Rate";
CM_ SG_ 288 AsyDataWithCmpSafeYawRateWithCmp "IMU processed special data. Compensated Yaw rate";
CM_ SG_ 288 BkpOfDstTrvld "total traveled distance.";
CM_ SG_ 288 CarTiGlb "Presents a tiime value that shall be used by all ECUs to time-stamp diagnsotic trouble codes (DTC) according to the requirements for Global DTC snapshot data.";
CM_ SG_ 288 DrvModReq "drive mode";
CM_ SG_ 288 PinionSteerAgGroupChks "Checksum for PinionSteerAgGroup";
CM_ SG_ 288 PinionSteerAgGroupCntr "Counter for PinionSteerAgGroup";
CM_ SG_ 288 PinionSteerAgGroupPinionSteerAg1 "Calculated pinion steer angle at the front steering device";
CM_ SG_ 288 PinionSteerAgGroupPinionSteerAg1Qf "Quality factor for PinionSteerAg1";
CM_ SG_ 288 PinionSteerAgGroupPinionSteerAgSpd1 "Calculated pinion steer angle speed at the front steering device ";
CM_ SG_ 288 PinionSteerAgGroupPinionSteerAgSpd1Qf "Quality factor for PinionSteerAgSpd1";
CM_ SG_ 288 PinionSteerAgGroupSteerWhlTq "Torque on steering wheel";
CM_ SG_ 288 PinionSteerAgGroupSteerWhlTqQf "Quality factor for SteerWhlTq";
CM_ SG_ 288 SteerWhlSnsrAg "Actual steering wheel angle from the actual centre position of the steering wheel. ";
CM_ SG_ 288 SteerWhlSnsrAgSpd "Actual steering wheel angle from the actual centre position of the steering wheel. Steering angle speed with steering wheel rotation direction.  ";
CM_ SG_ 288 SteerWhlSnsrChks "Checksum for steering wheel sensor data.";
CM_ SG_ 288 SteerWhlSnsrCntr "Counter value for steering wheel sensor data.";
CM_ SG_ 288 SteerWhlSnsrQf "Qf for steering wheel sensor information";
CM_ SG_ 288 VehBattUSysU "Vehicle System Voltage At 12V side";
CM_ SG_ 288 VehBattUSysUQf "Present vehicle voltage measured by CEM with QF";
CM_ SG_ 288 VehModMngtGlbSafe1CarModSts1 "CarMode Status";
CM_ SG_ 288 VehModMngtGlbSafe1CarModSubtypWdCarModSubtyp "CarMode substate status";
CM_ SG_ 288 VehModMngtGlbSafe1Chks "Checksum";
CM_ SG_ 288 VehModMngtGlbSafe1Cntr "Counter";
CM_ SG_ 288 VehModMngtGlbSafe1EgyLvlElecMai "Main energy level in the vehicle.";
CM_ SG_ 288 VehModMngtGlbSafe1EgyLvlElecSubtyp "Substate of the energy level in the vehicle.";
CM_ SG_ 288 VehModMngtGlbSafe1FltEgyCnsWdSts "High quiescent current detected by CEM via BMS.";
CM_ SG_ 288 VehModMngtGlbSafe1PwrLvlElecMai "Main Power level in the vehicle.";
CM_ SG_ 288 VehModMngtGlbSafe1PwrLvlElecSubtyp "Substate of the power level in the vehicle.";
CM_ SG_ 288 VehModMngtGlbSafe1UsgModSts "UsageMode Status";
CM_ SG_ 288 VehMtnStChks "Vehicle motion state information based on wheel speed sensors. Provides information about vehicle stand still and vehicle rolling direction. Checksum for vehicle motion state";
CM_ SG_ 288 VehMtnStCntr "Vehicle motion state information based on wheel speed sensors. Provides information about vehicle stand still and vehicle rolling direction. Counter for vehicle motion state";
CM_ SG_ 288 VehMtnStVehMtnSt "Vehicle motion state information based on wheel speed sensors. Provides information about vehicle stand still and vehicle rolling direction. Vehicle motion state";
CM_ SG_ 288 VehSpdLgtA "Vehicle speed longitudinal based on wheel speed sensors and longitudinal acceleration.";
CM_ SG_ 288 VehSpdLgtChks "Checksum";
CM_ SG_ 288 VehSpdLgtCntr "Counter";
CM_ SG_ 288 VehSpdLgtQf "Quality factor for vehicle speed as measured by wheel speed sensors and longitudinal acceleration.";
CM_ SG_ 288 WipgInfoWipgSpdInfo "Information regarding how the wipers are run";
CM_ SG_ 288 WipgInfoWiprActv " 0 No wiping, 1 Wiping";
CM_ SG_ 288 WipgInfoWiprInWipgAr " 0 Wiper in lower reversing area or parked, 1 Wiper in wiping area";
CM_ SG_ 1007 FrntRdrVehPrmRdrVehPrmChks "CRC";
CM_ SG_ 1007 FrntRdrVehPrmRdrVehPrmCntr "Counter";
CM_ SG_ 1007 FrntRdrVehPrmRdrVehPrmRdrDynCalPrmForAgOffs "Angle offset due to facia effects";
CM_ SG_ 1007 FrntRdrVehPrmRdrVehPrmRdrDynCalPrmForAxleDstReToVehFrnt "Distance from rear axel to vehicle front";
CM_ SG_ 1007 FrntRdrVehPrmRdrVehPrmRdrDynCalPrmForPinoinAgRat "Ration between pinion angle and wheel angle";
CM_ SG_ 1007 FrntRdrVehPrmRdrVehPrmRdrDynCalPrmForRollAgGain "the compliance of the rear corner suspension";
CM_ SG_ 1007 FrntRdrVehPrmRdrVehPrmRdrDynCalPrmForSnsrDir "Sensor direction in relation to the vehicle driving direction";
CM_ SG_ 1007 FrntRdrVehPrmRdrVehPrmRdrDynCalPrmForSnsrOrntn "Direction of Sensor connector points.";
CM_ SG_ 1007 FrntRdrVehPrmRdrVehPrmRdrDynCalPrmForSnsrPosnLat "Sensor lateral position in relation to the vehicle reference point";
CM_ SG_ 1007 FrntRdrVehPrmRdrVehPrmRdrDynCalPrmForSnsrPosnLgt "Sensor longitudinal position in relation to the vehicle reference point";
CM_ SG_ 1007 FrntRdrVehPrmRdrVehPrmRdrDynCalPrmForSnsrPosnVert "Sensor vertical position in relation to ground";
CM_ SG_ 1007 FrntRdrVehPrmRdrVehPrmRdrDynCalPrmForSnsrRot1 "Sensor rotation";
CM_ SG_ 1007 FrntRdrVehPrmRdrVehPrmRdrDynCalPrmForVehLen "Vehicle length";
CM_ SG_ 1007 FrntRdrVehPrmRdrVehPrmRdrDynCalPrmForVehTyp "Vehicle type";
CM_ SG_ 1007 FrntRdrVehPrmRdrVehPrmRdrDynCalPrmForVehWidth "Vehicle width";
CM_ SG_ 1007 FrntRdrVehPrmRdrVehPrmRdrDynCalPrmForVersMajor "Major version for dynamic calibration parameters.";
CM_ SG_ 1007 FrntRdrVehPrmRdrVehPrmRdrDynCalPrmForVersMinor "Minor version for dynamic calibration parameters";
CM_ SG_ 1007 FrntRdrVehPrmRdrVehPrmRdrDynCalPrmForWhlBas "Vehicle wheel base";
CM_ SG_ 1007 FrntRdrVehPrmRdrVehPrmVld "Validity of data, if it is not valid, then set to 0";
CM_ SG_ 16 BrkPedlTrvlAct "Information about driver brake request derived from the travel sensor in the brake booster. Actual value for the output rod";
CM_ SG_ 16 BrkPedlTrvlChks "Information about driver brake request derived from the travel sensor in the brake booster. Checksum";
CM_ SG_ 16 BrkPedlTrvlCntr "Information about driver brake request derived from the travel sensor in the brake booster. Counter";
CM_ SG_ 16 BrkPedlTrvlQf "Information about driver brake request derived from the travel sensor in the brake booster. Travel sensor quality factor";
CM_ SG_ 16 BrkPedlTrvlSt "Information about driver brake request derived from the travel sensor in the brake booster. Brake pedal applied information";
CM_ SG_ 16 BrkPedlTrvlStQf "Information about driver brake request derived from the travel sensor in the brake booster. Brake pedal applied information quality factor";
CM_ SG_ 16 BrkPedlTrvlTar "Information about driver brake request derived from the travel sensor in the brake booster. Target value for the output rod";
CM_ SG_ 16 DrvBrkReqDmat "Driver brake dominant";
CM_ SG_ 16 PinionSteerAgGroupForBkpChks "Checksum for PinionSteerAgGroupForBkp";
CM_ SG_ 16 PinionSteerAgGroupForBkpCntr "Counter for PinionSteerAgGroupForBkp";
CM_ SG_ 16 PinionSteerAgGroupForBkpPinionSteerAgForBkp "Calculated pinion steer angle at the front steering device";
CM_ SG_ 16 PinionSteerAgGroupForBkpPinionSteerAgQfForBkp "Quality factor for PinionSteerAgForBkp";
CM_ SG_ 16 PinionSteerAgGroupForBkpPinionSteerAgSpdForBkp "Calculated pinion steer angle speed at the front steering device ";
CM_ SG_ 16 PinionSteerAgGroupForBkpPinionSteerAgSpdQfForBkp "Quality factor for PinionSteerAgSpdForBkp";
CM_ SG_ 16 PinionSteerAgGroupForBkpSteerWhlTqForBkp "Torque on steering wheel";
CM_ SG_ 16 PinionSteerAgGroupForBkpSteerWhlTqQfForBkp "Quality factor for SteerWhlTqForBkp";
CM_ SG_ 16 SecChStsADModeAvtn "indicate AD mode active request from secondary AD controller";
CM_ SG_ 16 SecChStsADModeAvtnCfm "indicate secondary AD controller into AD Mode";
CM_ SG_ 16 SecChStsADModeDeavtn "indicate AD mode deactive request from secondary AD controller";
CM_ SG_ 16 SecChStsADModeDeavtnCfm "indicate secondary AD controller";
CM_ SG_ 16 SecChStsChanlSts "indicate secondary channel status is OK or not";
CM_ SG_ 16 SecChStsCtrlrSts "indicate secondary AD controller status is OK or not";
CM_ SG_ 16 SecChStsLatADAvtn "indicate secondary AD controller send AD Mode active request";
CM_ SG_ 16 SecChStsLatADAvtnCfm "indicate lateral system confirm AD mode from secondary lateral controller";
CM_ SG_ 16 SecChStsLatSts "indicate secondary lateral controller status is OK or not";
CM_ SG_ 16 SecChStsLgtADAvtn "indicate secondary AD controller send AD Mode active request";
CM_ SG_ 16 SecChStsLgtADAvtnCfm "indicate longitudinal system confirm AD mode from secondary longitudinal controller";
CM_ SG_ 16 SecChStsLgtSts "indicate secondary longitudinal controller status is OK or not";
CM_ SG_ 16 SecChStsReserved1 "Reserved";
CM_ SG_ 16 SecChStsReserved2 "Reserved";
CM_ SG_ 16 SecChStsReserved3 "Reserved";
CM_ SG_ 16 SecChStsSafeStop "indicate secondary AD controller start execute safe stop or not";
CM_ SG_ 16 VehMtnStForBkpVehMtnSt "Vehicle motion state information based on wheel speed sensors. Provides information about vehicle stand still and vehicle rolling direction. Vehicle motion state for backup";
CM_ SG_ 16 VehMtnStForBkpVehMtnStChks "Vehicle motion state information based on wheel speed sensors. Provides information about vehicle stand still and vehicle rolling direction. Checksum for vehicle motion state";
CM_ SG_ 16 VehMtnStForBkpVehMtnStCntr "Vehicle motion state information based on wheel speed sensors. Provides information about vehicle stand still and vehicle rolling direction. Counter for vehicle motion state";
CM_ SG_ 16 VehSpdLgtForBkpVehSpdLgtA "vehicle speed for backup";
CM_ SG_ 16 VehSpdLgtForBkpVehSpdLgtChks "checksum";
CM_ SG_ 16 VehSpdLgtForBkpVehSpdLgtCntr "counter";
CM_ SG_ 16 VehSpdLgtForBkpVehSpdLgtQf "vehicle speed quality factor for backup";
CM_ SG_ 16 WhlDirRotlFrntForBkpChks "check sum";
CM_ SG_ 16 WhlDirRotlFrntForBkpCntr "counter";
CM_ SG_ 16 WhlDirRotlFrntForBkpLe "Rotational direction for the front individual wheels. Wheel rotation direction of front left wheel.";
CM_ SG_ 16 WhlDirRotlFrntForBkpRi "Rotational direction for the front individual wheels. Wheel rotation direction of front right wheel.";
CM_ SG_ 16 WhlDirRotlReForBkpChks "checksum";
CM_ SG_ 16 WhlDirRotlReForBkpCntr "counter";
CM_ SG_ 16 WhlDirRotlReForBkpLe "Rotational direction for the rear individual wheels. Wheel rotation direction of rear left wheel.";
CM_ SG_ 16 WhlDirRotlReForBkpRi "Rotational direction for the rear individual wheels. Wheel rotation direction of rear right wheel.";
CM_ SG_ 16 WhlRotToothCntrForBkpChks "check sum";
CM_ SG_ 16 WhlRotToothCntrForBkpCntr "counter";
CM_ SG_ 16 WhlRotToothCntrForBkpWhlRotToothCntrFrntLe "Wheel rotation ticks for each individual wheel. Wheel rotation impuls counter front left. For one complete wheel revolution the counter will increase by 96 (with 48 magnetic pole-pairs).";
CM_ SG_ 16 WhlRotToothCntrForBkpWhlRotToothCntrFrntRi "Wheel rotation ticks for each individual wheel. Wheel rotation impuls counter front right. For one complete wheel revolution the counter will increase by 96 (with 48 magnetic pole-pairs).";
CM_ SG_ 16 WhlRotToothCntrForBkpWhlRotToothCntrReLe "Wheel rotation ticks for each individual wheel. Wheel rotation impuls counter rear left. For one complete wheel revolution the counter will increase by 96 (with 48 magnetic pole-pairs).";
CM_ SG_ 16 WhlRotToothCntrForBkpWhlRotToothCntrReRi "Wheel rotation ticks for each individual wheel. Wheel rotation impuls counter rear right. For one complete wheel revolution the counter will increase by 96 (with 48 magnetic pole-pairs).";
CM_ SG_ 16 WhlSpdCircumlFrntForBkpWhlSpdCircumlFrntChks "Individual wheel speed from front wheel speed sensors. Checksum";
CM_ SG_ 16 WhlSpdCircumlFrntForBkpWhlSpdCircumlFrntCntr "Individual wheel speed from front wheel speed sensors. Counter";
CM_ SG_ 16 WhlSpdCircumlFrntForBkpWhlSpdCircumlFrntLe "Individual wheel speed from front wheel speed sensors. Wheel speed from front left wheel speed sensor using nominal value of wheel radius.";
CM_ SG_ 16 WhlSpdCircumlFrntForBkpWhlSpdCircumlFrntLeQf "Individual wheel speed from front wheel speed sensors. Qf for wheel speed sensor";
CM_ SG_ 16 WhlSpdCircumlFrntForBkpWhlSpdCircumlFrntRiQf "Individual wheel speed from front wheel speed sensors. Qf for wheel speed sensor";
CM_ SG_ 16 WhlSpdCircumlFrntForBkpWhlSpdCircumlFrntWhlSpdCircumlFrntRi "Individual wheel speed from front wheel speed sensors. Wheel speed from front right wheel speed sensor using nominal value of wheel radius
";
CM_ SG_ 16 WhlSpdCircumlReForBkpWhlSpdCircumlReChks "Individual wheel speed from rear wheel speed sensors. Checksum";
CM_ SG_ 16 WhlSpdCircumlReForBkpWhlSpdCircumlReCntr "Individual wheel speed from rear wheel speed sensors. Counter";
CM_ SG_ 16 WhlSpdCircumlReForBkpWhlSpdCircumlReLe "Individual wheel speed from rear wheel speed sensors. Wheel speed from rear left wheel speed sensor using nominal value of wheel radius.";
CM_ SG_ 16 WhlSpdCircumlReForBkpWhlSpdCircumlReLeQf "Individual wheel speed from rear wheel speed sensors. Qf for wheel speed sensor";
CM_ SG_ 16 WhlSpdCircumlReForBkpWhlSpdCircumlReRi "Individual wheel speed from rear wheel speed sensors. Wheel speed from rear right wheel speed sensor using nominal value of wheel radius.";
CM_ SG_ 16 WhlSpdCircumlReForBkpWhlSpdCircumlReRiQf "Individual wheel speed from rear wheel speed sensors. Qf for wheel speed sensor";
CM_ SG_ 16 WhlVAgrFrntForBkpWhlVAgrFrntLe "Unfiltered angular velocity of individual front left wheel for backup.";
CM_ SG_ 16 WhlVAgrFrntForBkpWhlVAgrFrntLeQf "qf";
CM_ SG_ 16 WhlVAgrFrntForBkpWhlVAgrFrntRi "Unfiltered angular velocity of individual front right wheel fo backup.";
CM_ SG_ 16 WhlVAgrFrntForBkpWhlVAgrFrntRiQf "qf";
CM_ SG_ 16 WhlVAgrReForBkpWhlVAgrReLe "Unfiltered angular velocity of individual rear left wheel for backup.";
CM_ SG_ 16 WhlVAgrReForBkpWhlVAgrReLeQf "qf";
CM_ SG_ 16 WhlVAgrReForBkpWhlVAgrReRi "Unfiltered angular velocity of individual rear right wheel for backup.";
CM_ SG_ 16 WhlVAgrReForBkpWhlVAgrReRiQf "qf";
CM_ SG_ 297 FrntRdrStsForDim "FLR state information which will be shown on DIM or IHU";
CM_ SG_ 297 FrntRdrStsRdrNrDetn "Number of detections";
CM_ SG_ 297 FrntRdrStsRdrNrObj "Number of objects";
CM_ SG_ 297 FrntRdrStsRdrStsBlkd0bin "Blockage flag for 0bin";
CM_ SG_ 297 FrntRdrStsRdrStsBlkdConf "Confidence of radar blockage";
CM_ SG_ 297 FrntRdrStsRdrStsChks "Checksum";
CM_ SG_ 297 FrntRdrStsRdrStsCntr "Counter";
CM_ SG_ 297 FrntRdrStsRdrStsDstbc "Indication of radar interference, 0 means no interference, 100 means the radar fully saturated from interference";
CM_ SG_ 297 FrntRdrStsRdrStsEna "Indication whether radar functionality is enabled";
CM_ SG_ 297 FrntRdrStsRdrStsFaulty "Indication whether radar is faulty";
CM_ SG_ 297 FrntRdrStsRdrStsIfVersMajor "Reserve";
CM_ SG_ 297 FrntRdrStsRdrStsIfVersMinor "Reserve";
CM_ SG_ 297 FrntRdrStsRdrStsLatency "The time instance starting from the end of the last measurement acquisition per cycle to the CAN-FD frames being outputted on the CAN-FD bus";
CM_ SG_ 297 FrntRdrStsRdrStsMisAlign "Indication whether 0, calibration not start. 1, calibration in progress. 2, successfully calibrated. 3, misalignment degree is larger than threshold, static calibration fail. 4, can not be calibrated statically cause other reason. 5, auto-calibrate fail (cause misalignment degree is larger than threshold or other reason). 6, misalignment degree is larger than threshold, dynamic calibration fail in factory or after-sales. 7, can not be calibrated dynamically cause other reason.";
CM_ SG_ 297 FrntRdrStsRdrStsMissCom "Signal used to detect missing communication from radar";
CM_ SG_ 297 FrntRdrStsRdrStsSftyFlt "Safety faulty status";
CM_ SG_ 297 FrntRdrStsRdrStsTiStamp "Timestamp";
CM_ SG_ 297 FrntRdrStsRdrStsTiStampStsGlbTiBas "Timestamp";
CM_ SG_ 297 FrntRdrStsRdrStsTiStampStsSyncToGatewy "Time synchronization status - synchronized to gateway";
CM_ SG_ 297 FrntRdrStsRdrStsTiStampStsTiLeap "Time synchronization status - time leap";
CM_ SG_ 297 FrntRdrStsRdrStsTiStampStsTiOut "Time synchronization status - time out";
CM_ SG_ 297 FrntRdrStsRdrStsWhlSpdCmpFac "Estimated compensation factor for host speed.";
CM_ SG_ 304 FrntRdrDetn1RdrDetnAzi "Azimuth Angle";
CM_ SG_ 304 FrntRdrDetn1RdrDetnChks "CRC";
CM_ SG_ 304 FrntRdrDetn1RdrDetnCntr "Counter";
CM_ SG_ 304 FrntRdrDetn1RdrDetnConf "Quality";
CM_ SG_ 304 FrntRdrDetn1RdrDetnElevn "Elevation Angle";
CM_ SG_ 304 FrntRdrDetn1RdrDetnPwr "Magnitude, 0dB is the detection threshold";
CM_ SG_ 304 FrntRdrDetn1RdrDetnRng "Range";
CM_ SG_ 304 FrntRdrDetn1RdrDetnRngV "Range velocity";
CM_ SG_ 304 FrntRdrDetn1RdrDetnSts "Detection type and validity";
CM_ SG_ 304 FrntRdrDetn2RdrDetnAzi "Refer to the data element description in FrntRdrDetn1 with the same data element name.";
CM_ SG_ 304 FrntRdrDetn2RdrDetnChks "Refer to the data element description in FrntRdrDetn1 with the same data element name.";
CM_ SG_ 304 FrntRdrDetn2RdrDetnCntr "Refer to the data element description in FrntRdrDetn1 with the same data element name.";
CM_ SG_ 304 FrntRdrDetn2RdrDetnConf "Refer to the data element description in FrntRdrDetn1 with the same data element name.";
CM_ SG_ 304 FrntRdrDetn2RdrDetnElevn "Refer to the data element description in FrntRdrDetn1 with the same data element name.";
CM_ SG_ 304 FrntRdrDetn2RdrDetnPwr "Refer to the data element description in FrntRdrDetn1 with the same data element name.";
CM_ SG_ 304 FrntRdrDetn2RdrDetnRng "Refer to the data element description in FrntRdrDetn1 with the same data element name.";
CM_ SG_ 304 FrntRdrDetn2RdrDetnRngV "Refer to the data element description in FrntRdrDetn1 with the same data element name.";
CM_ SG_ 304 FrntRdrDetn2RdrDetnSts "Refer to the data element description in FrntRdrDetn1 with the same data element name.";
CM_ SG_ 304 FrntRdrDetn3RdrDetnAzi "Refer to the data element description in FrntRdrDetn1 with the same data element name.";
CM_ SG_ 304 FrntRdrDetn3RdrDetnChks "Refer to the data element description in FrntRdrDetn1 with the same data element name.";
CM_ SG_ 304 FrntRdrDetn3RdrDetnCntr "Refer to the data element description in FrntRdrDetn1 with the same data element name.";
CM_ SG_ 304 FrntRdrDetn3RdrDetnConf "Refer to the data element description in FrntRdrDetn1 with the same data element name.";
CM_ SG_ 304 FrntRdrDetn3RdrDetnElevn "Refer to the data element description in FrntRdrDetn1 with the same data element name.";
CM_ SG_ 304 FrntRdrDetn3RdrDetnPwr "Refer to the data element description in FrntRdrDetn1 with the same data element name.";
CM_ SG_ 304 FrntRdrDetn3RdrDetnRng "Refer to the data element description in FrntRdrDetn1 with the same data element name.";
CM_ SG_ 304 FrntRdrDetn3RdrDetnRngV "Refer to the data element description in FrntRdrDetn1 with the same data element name.";
CM_ SG_ 304 FrntRdrDetn3RdrDetnSts "Refer to the data element description in FrntRdrDetn1 with the same data element name.";
CM_ SG_ 304 FrntRdrDetn4RdrDetnAzi "Refer to the data element description in FrntRdrDetn1 with the same data element name.";
CM_ SG_ 304 FrntRdrDetn4RdrDetnChks "Refer to the data element description in FrntRdrDetn1 with the same data element name.";
CM_ SG_ 304 FrntRdrDetn4RdrDetnCntr "Refer to the data element description in FrntRdrDetn1 with the same data element name.";
CM_ SG_ 304 FrntRdrDetn4RdrDetnConf "Refer to the data element description in FrntRdrDetn1 with the same data element name.";
CM_ SG_ 304 FrntRdrDetn4RdrDetnElevn "Refer to the data element description in FrntRdrDetn1 with the same data element name.";
CM_ SG_ 304 FrntRdrDetn4RdrDetnPwr "Refer to the data element description in FrntRdrDetn1 with the same data element name.";
CM_ SG_ 304 FrntRdrDetn4RdrDetnRng "Refer to the data element description in FrntRdrDetn1 with the same data element name.";
CM_ SG_ 304 FrntRdrDetn4RdrDetnRngV "Refer to the data element description in FrntRdrDetn1 with the same data element name.";
CM_ SG_ 304 FrntRdrDetn4RdrDetnSts "Refer to the data element description in FrntRdrDetn1 with the same data element name.";
CM_ SG_ 304 FrntRdrDetn5RdrDetnAzi "Refer to the data element description in FrntRdrDetn1 with the same data element name.";
CM_ SG_ 304 FrntRdrDetn5RdrDetnChks "Refer to the data element description in FrntRdrDetn1 with the same data element name.";
CM_ SG_ 304 FrntRdrDetn5RdrDetnCntr "Refer to the data element description in FrntRdrDetn1 with the same data element name.";
CM_ SG_ 304 FrntRdrDetn5RdrDetnConf "Refer to the data element description in FrntRdrDetn1 with the same data element name.";
CM_ SG_ 304 FrntRdrDetn5RdrDetnElevn "Refer to the data element description in FrntRdrDetn1 with the same data element name.";
CM_ SG_ 304 FrntRdrDetn5RdrDetnPwr "Refer to the data element description in FrntRdrDetn1 with the same data element name.";
CM_ SG_ 304 FrntRdrDetn5RdrDetnRng "Refer to the data element description in FrntRdrDetn1 with the same data element name.";
CM_ SG_ 304 FrntRdrDetn5RdrDetnRngV "Refer to the data element description in FrntRdrDetn1 with the same data element name.";
CM_ SG_ 304 FrntRdrDetn5RdrDetnSts "Refer to the data element description in FrntRdrDetn1 with the same data element name.";
CM_ SG_ 304 FrntRdrDetn6RdrDetnAzi "Refer to the data element description in FrntRdrDetn1 with the same data element name.";
CM_ SG_ 304 FrntRdrDetn6RdrDetnChks "Refer to the data element description in FrntRdrDetn1 with the same data element name.";
CM_ SG_ 304 FrntRdrDetn6RdrDetnCntr "Refer to the data element description in FrntRdrDetn1 with the same data element name.";
CM_ SG_ 304 FrntRdrDetn6RdrDetnConf "Refer to the data element description in FrntRdrDetn1 with the same data element name.";
CM_ SG_ 304 FrntRdrDetn6RdrDetnElevn "Refer to the data element description in FrntRdrDetn1 with the same data element name.";
CM_ SG_ 304 FrntRdrDetn6RdrDetnPwr "Refer to the data element description in FrntRdrDetn1 with the same data element name.";
CM_ SG_ 304 FrntRdrDetn6RdrDetnRng "Refer to the data element description in FrntRdrDetn1 with the same data element name.";
CM_ SG_ 304 FrntRdrDetn6RdrDetnRngV "Refer to the data element description in FrntRdrDetn1 with the same data element name.";
CM_ SG_ 304 FrntRdrDetn6RdrDetnSts "Refer to the data element description in FrntRdrDetn1 with the same data element name.";
CM_ SG_ 306 FrntRdrDetn10RdrDetnAzi "Refer to the data element description in FrntRdrDetn1 with the same data element name.";
CM_ SG_ 306 FrntRdrDetn10RdrDetnChks "Refer to the data element description in FrntRdrDetn1 with the same data element name.";
CM_ SG_ 306 FrntRdrDetn10RdrDetnCntr "Refer to the data element description in FrntRdrDetn1 with the same data element name.";
CM_ SG_ 306 FrntRdrDetn10RdrDetnConf "Refer to the data element description in FrntRdrDetn1 with the same data element name.";
CM_ SG_ 306 FrntRdrDetn10RdrDetnElevn "Refer to the data element description in FrntRdrDetn1 with the same data element name.";
CM_ SG_ 306 FrntRdrDetn10RdrDetnPwr "Refer to the data element description in FrntRdrDetn1 with the same data element name.";
CM_ SG_ 306 FrntRdrDetn10RdrDetnRng "Refer to the data element description in FrntRdrDetn1 with the same data element name.";
CM_ SG_ 306 FrntRdrDetn10RdrDetnRngV "Refer to the data element description in FrntRdrDetn1 with the same data element name.";
CM_ SG_ 306 FrntRdrDetn10RdrDetnSts "Refer to the data element description in FrntRdrDetn1 with the same data element name.";
CM_ SG_ 306 FrntRdrDetn11RdrDetnAzi "Refer to the data element description in FrntRdrDetn1 with the same data element name.";
CM_ SG_ 306 FrntRdrDetn11RdrDetnChks "Refer to the data element description in FrntRdrDetn1 with the same data element name.";
CM_ SG_ 306 FrntRdrDetn11RdrDetnCntr "Refer to the data element description in FrntRdrDetn1 with the same data element name.";
CM_ SG_ 306 FrntRdrDetn11RdrDetnConf "Refer to the data element description in FrntRdrDetn1 with the same data element name.";
CM_ SG_ 306 FrntRdrDetn11RdrDetnElevn "Refer to the data element description in FrntRdrDetn1 with the same data element name.";
CM_ SG_ 306 FrntRdrDetn11RdrDetnPwr "Refer to the data element description in FrntRdrDetn1 with the same data element name.";
CM_ SG_ 306 FrntRdrDetn11RdrDetnRng "Refer to the data element description in FrntRdrDetn1 with the same data element name.";
CM_ SG_ 306 FrntRdrDetn11RdrDetnRngV "Refer to the data element description in FrntRdrDetn1 with the same data element name.";
CM_ SG_ 306 FrntRdrDetn11RdrDetnSts "Refer to the data element description in FrntRdrDetn1 with the same data element name.";
CM_ SG_ 306 FrntRdrDetn12RdrDetnAzi "Refer to the data element description in FrntRdrDetn1 with the same data element name.";
CM_ SG_ 306 FrntRdrDetn12RdrDetnChks "Refer to the data element description in FrntRdrDetn1 with the same data element name.";
CM_ SG_ 306 FrntRdrDetn12RdrDetnCntr "Refer to the data element description in FrntRdrDetn1 with the same data element name.";
CM_ SG_ 306 FrntRdrDetn12RdrDetnConf "Refer to the data element description in FrntRdrDetn1 with the same data element name.";
CM_ SG_ 306 FrntRdrDetn12RdrDetnElevn "Refer to the data element description in FrntRdrDetn1 with the same data element name.";
CM_ SG_ 306 FrntRdrDetn12RdrDetnPwr "Refer to the data element description in FrntRdrDetn1 with the same data element name.";
CM_ SG_ 306 FrntRdrDetn12RdrDetnRng "Refer to the data element description in FrntRdrDetn1 with the same data element name.";
CM_ SG_ 306 FrntRdrDetn12RdrDetnRngV "Refer to the data element description in FrntRdrDetn1 with the same data element name.";
CM_ SG_ 306 FrntRdrDetn12RdrDetnSts "Refer to the data element description in FrntRdrDetn1 with the same data element name.";
CM_ SG_ 306 FrntRdrDetn7RdrDetnAzi "Refer to the data element description in FrntRdrDetn1 with the same data element name.";
CM_ SG_ 306 FrntRdrDetn7RdrDetnChks "Refer to the data element description in FrntRdrDetn1 with the same data element name.";
CM_ SG_ 306 FrntRdrDetn7RdrDetnCntr "Refer to the data element description in FrntRdrDetn1 with the same data element name.";
CM_ SG_ 306 FrntRdrDetn7RdrDetnConf "Refer to the data element description in FrntRdrDetn1 with the same data element name.";
CM_ SG_ 306 FrntRdrDetn7RdrDetnElevn "Refer to the data element description in FrntRdrDetn1 with the same data element name.";
CM_ SG_ 306 FrntRdrDetn7RdrDetnPwr "Refer to the data element description in FrntRdrDetn1 with the same data element name.";
CM_ SG_ 306 FrntRdrDetn7RdrDetnRng "Refer to the data element description in FrntRdrDetn1 with the same data element name.";
CM_ SG_ 306 FrntRdrDetn7RdrDetnRngV "Refer to the data element description in FrntRdrDetn1 with the same data element name.";
CM_ SG_ 306 FrntRdrDetn7RdrDetnSts "Refer to the data element description in FrntRdrDetn1 with the same data element name.";
CM_ SG_ 306 FrntRdrDetn8RdrDetnAzi "Refer to the data element description in FrntRdrDetn1 with the same data element name.";
CM_ SG_ 306 FrntRdrDetn8RdrDetnChks "Refer to the data element description in FrntRdrDetn1 with the same data element name.";
CM_ SG_ 306 FrntRdrDetn8RdrDetnCntr "Refer to the data element description in FrntRdrDetn1 with the same data element name.";
CM_ SG_ 306 FrntRdrDetn8RdrDetnConf "Refer to the data element description in FrntRdrDetn1 with the same data element name.";
CM_ SG_ 306 FrntRdrDetn8RdrDetnElevn "Refer to the data element description in FrntRdrDetn1 with the same data element name.";
CM_ SG_ 306 FrntRdrDetn8RdrDetnPwr "Refer to the data element description in FrntRdrDetn1 with the same data element name.";
CM_ SG_ 306 FrntRdrDetn8RdrDetnRng "Refer to the data element description in FrntRdrDetn1 with the same data element name.";
CM_ SG_ 306 FrntRdrDetn8RdrDetnRngV "Refer to the data element description in FrntRdrDetn1 with the same data element name.";
CM_ SG_ 306 FrntRdrDetn8RdrDetnSts "Refer to the data element description in FrntRdrDetn1 with the same data element name.";
CM_ SG_ 306 FrntRdrDetn9RdrDetnAzi "Refer to the data element description in FrntRdrDetn1 with the same data element name.";
CM_ SG_ 306 FrntRdrDetn9RdrDetnChks "Refer to the data element description in FrntRdrDetn1 with the same data element name.";
CM_ SG_ 306 FrntRdrDetn9RdrDetnCntr "Refer to the data element description in FrntRdrDetn1 with the same data element name.";
CM_ SG_ 306 FrntRdrDetn9RdrDetnConf "Refer to the data element description in FrntRdrDetn1 with the same data element name.";
CM_ SG_ 306 FrntRdrDetn9RdrDetnElevn "Refer to the data element description in FrntRdrDetn1 with the same data element name.";
CM_ SG_ 306 FrntRdrDetn9RdrDetnPwr "Refer to the data element description in FrntRdrDetn1 with the same data element name.";
CM_ SG_ 306 FrntRdrDetn9RdrDetnRng "Refer to the data element description in FrntRdrDetn1 with the same data element name.";
CM_ SG_ 306 FrntRdrDetn9RdrDetnRngV "Refer to the data element description in FrntRdrDetn1 with the same data element name.";
CM_ SG_ 306 FrntRdrDetn9RdrDetnSts "Refer to the data element description in FrntRdrDetn1 with the same data element name.";
CM_ SG_ 308 FrntRdrDetn13RdrDetnAzi "Refer to the data element description in FrntRdrDetn1 with the same data element name.";
CM_ SG_ 308 FrntRdrDetn13RdrDetnChks "Refer to the data element description in FrntRdrDetn1 with the same data element name.";
CM_ SG_ 308 FrntRdrDetn13RdrDetnCntr "Refer to the data element description in FrntRdrDetn1 with the same data element name.";
CM_ SG_ 308 FrntRdrDetn13RdrDetnConf "Refer to the data element description in FrntRdrDetn1 with the same data element name.";
CM_ SG_ 308 FrntRdrDetn13RdrDetnElevn "Refer to the data element description in FrntRdrDetn1 with the same data element name.";
CM_ SG_ 308 FrntRdrDetn13RdrDetnPwr "Refer to the data element description in FrntRdrDetn1 with the same data element name.";
CM_ SG_ 308 FrntRdrDetn13RdrDetnRng "Refer to the data element description in FrntRdrDetn1 with the same data element name.";
CM_ SG_ 308 FrntRdrDetn13RdrDetnRngV "Refer to the data element description in FrntRdrDetn1 with the same data element name.";
CM_ SG_ 308 FrntRdrDetn13RdrDetnSts "Refer to the data element description in FrntRdrDetn1 with the same data element name.";
CM_ SG_ 308 FrntRdrDetn14RdrDetnAzi "Refer to the data element description in FrntRdrDetn1 with the same data element name.";
CM_ SG_ 308 FrntRdrDetn14RdrDetnChks "Refer to the data element description in FrntRdrDetn1 with the same data element name.";
CM_ SG_ 308 FrntRdrDetn14RdrDetnCntr "Refer to the data element description in FrntRdrDetn1 with the same data element name.";
CM_ SG_ 308 FrntRdrDetn14RdrDetnConf "Refer to the data element description in FrntRdrDetn1 with the same data element name.";
CM_ SG_ 308 FrntRdrDetn14RdrDetnElevn "Refer to the data element description in FrntRdrDetn1 with the same data element name.";
CM_ SG_ 308 FrntRdrDetn14RdrDetnPwr "Refer to the data element description in FrntRdrDetn1 with the same data element name.";
CM_ SG_ 308 FrntRdrDetn14RdrDetnRng "Refer to the data element description in FrntRdrDetn1 with the same data element name.";
CM_ SG_ 308 FrntRdrDetn14RdrDetnRngV "Refer to the data element description in FrntRdrDetn1 with the same data element name.";
CM_ SG_ 308 FrntRdrDetn14RdrDetnSts "Refer to the data element description in FrntRdrDetn1 with the same data element name.";
CM_ SG_ 308 FrntRdrDetn15RdrDetnAzi "Refer to the data element description in FrntRdrDetn1 with the same data element name.";
CM_ SG_ 308 FrntRdrDetn15RdrDetnChks "Refer to the data element description in FrntRdrDetn1 with the same data element name.";
CM_ SG_ 308 FrntRdrDetn15RdrDetnCntr "Refer to the data element description in FrntRdrDetn1 with the same data element name.";
CM_ SG_ 308 FrntRdrDetn15RdrDetnConf "Refer to the data element description in FrntRdrDetn1 with the same data element name.";
CM_ SG_ 308 FrntRdrDetn15RdrDetnElevn "Refer to the data element description in FrntRdrDetn1 with the same data element name.";
CM_ SG_ 308 FrntRdrDetn15RdrDetnPwr "Refer to the data element description in FrntRdrDetn1 with the same data element name.";
CM_ SG_ 308 FrntRdrDetn15RdrDetnRng "Refer to the data element description in FrntRdrDetn1 with the same data element name.";
CM_ SG_ 308 FrntRdrDetn15RdrDetnRngV "Refer to the data element description in FrntRdrDetn1 with the same data element name.";
CM_ SG_ 308 FrntRdrDetn15RdrDetnSts "Refer to the data element description in FrntRdrDetn1 with the same data element name.";
CM_ SG_ 308 FrntRdrDetn16RdrDetnAzi "Refer to the data element description in FrntRdrDetn1 with the same data element name.";
CM_ SG_ 308 FrntRdrDetn16RdrDetnChks "Refer to the data element description in FrntRdrDetn1 with the same data element name.";
CM_ SG_ 308 FrntRdrDetn16RdrDetnCntr "Refer to the data element description in FrntRdrDetn1 with the same data element name.";
CM_ SG_ 308 FrntRdrDetn16RdrDetnConf "Refer to the data element description in FrntRdrDetn1 with the same data element name.";
CM_ SG_ 308 FrntRdrDetn16RdrDetnElevn "Refer to the data element description in FrntRdrDetn1 with the same data element name.";
CM_ SG_ 308 FrntRdrDetn16RdrDetnPwr "Refer to the data element description in FrntRdrDetn1 with the same data element name.";
CM_ SG_ 308 FrntRdrDetn16RdrDetnRng "Refer to the data element description in FrntRdrDetn1 with the same data element name.";
CM_ SG_ 308 FrntRdrDetn16RdrDetnRngV "Refer to the data element description in FrntRdrDetn1 with the same data element name.";
CM_ SG_ 308 FrntRdrDetn16RdrDetnSts "Refer to the data element description in FrntRdrDetn1 with the same data element name.";
CM_ SG_ 308 FrntRdrDetn17RdrDetnAzi "Refer to the data element description in FrntRdrDetn1 with the same data element name.";
CM_ SG_ 308 FrntRdrDetn17RdrDetnChks "Refer to the data element description in FrntRdrDetn1 with the same data element name.";
CM_ SG_ 308 FrntRdrDetn17RdrDetnCntr "Refer to the data element description in FrntRdrDetn1 with the same data element name.";
CM_ SG_ 308 FrntRdrDetn17RdrDetnConf "Refer to the data element description in FrntRdrDetn1 with the same data element name.";
CM_ SG_ 308 FrntRdrDetn17RdrDetnElevn "Refer to the data element description in FrntRdrDetn1 with the same data element name.";
CM_ SG_ 308 FrntRdrDetn17RdrDetnPwr "Refer to the data element description in FrntRdrDetn1 with the same data element name.";
CM_ SG_ 308 FrntRdrDetn17RdrDetnRng "Refer to the data element description in FrntRdrDetn1 with the same data element name.";
CM_ SG_ 308 FrntRdrDetn17RdrDetnRngV "Refer to the data element description in FrntRdrDetn1 with the same data element name.";
CM_ SG_ 308 FrntRdrDetn17RdrDetnSts "Refer to the data element description in FrntRdrDetn1 with the same data element name.";
CM_ SG_ 308 FrntRdrDetn18RdrDetnAzi "Refer to the data element description in FrntRdrDetn1 with the same data element name.";
CM_ SG_ 308 FrntRdrDetn18RdrDetnChks "Refer to the data element description in FrntRdrDetn1 with the same data element name.";
CM_ SG_ 308 FrntRdrDetn18RdrDetnCntr "Refer to the data element description in FrntRdrDetn1 with the same data element name.";
CM_ SG_ 308 FrntRdrDetn18RdrDetnConf "Refer to the data element description in FrntRdrDetn1 with the same data element name.";
CM_ SG_ 308 FrntRdrDetn18RdrDetnElevn "Refer to the data element description in FrntRdrDetn1 with the same data element name.";
CM_ SG_ 308 FrntRdrDetn18RdrDetnPwr "Refer to the data element description in FrntRdrDetn1 with the same data element name.";
CM_ SG_ 308 FrntRdrDetn18RdrDetnRng "Refer to the data element description in FrntRdrDetn1 with the same data element name.";
CM_ SG_ 308 FrntRdrDetn18RdrDetnRngV "Refer to the data element description in FrntRdrDetn1 with the same data element name.";
CM_ SG_ 308 FrntRdrDetn18RdrDetnSts "Refer to the data element description in FrntRdrDetn1 with the same data element name.";

// Attribute definitions
BA_DEF_  "Baudrate" INT 1000 1000000; // [bps]
BA_DEF_  "BaudRateCANFD" FLOAT 1000 10000000; // [bps]
BA_DEF_ BO_ "VFrameFormat" ENUM "StandardCAN","ExtendedCAN","reserved","J1939PG","reserved","reserved","reserved","reserved","reserved","reserved","reserved","reserved","reserved","reserved","StandardCAN_FD","ExtendedCAN_FD";
BA_DEF_ BO_ "CANFD_BRS" ENUM "0","1";
BA_DEF_ BO_ "GenMsgSendType" ENUM "cyclic", "spontaneous", "not-used", "not-used", "not-used", "cyclicAndSpontaneous", "not-used", "cyclicIfActive", "NoMsgSendType"; // [us]
BA_DEF_ BO_ "GenMsgCycleTime" INT 0 65536; // [ms]
BA_DEF_ BO_ "GenMsgStartDelayTime" INT 0 65536; // [ms]
BA_DEF_ BO_ "GenMsgDelayTime" INT 0 65536; // [ms]
BA_DEF_ SG_ "GenSigSendType" ENUM "Cyclic","OnWrite","OnWriteWithRepetition","OnChange","OnChangeWithRepetition","IfActive","IfActiveWithRepetition","NoSigSendType";
BA_DEF_ SG_ "GenSigStartValue" HEX 0 80000000;
BA_DEF_ BU_ "NmAsrNodeIdentifier" INT 0 255;
BA_DEF_  "DBName" STRING;
BA_DEF_  "BusType" STRING;
BA_DEF_  "ProtocolType" STRING;
BA_DEF_ BO_ "GenMsgILSupport" ENUM "No","Yes";
BA_DEF_ BO_ "NmAsrMessage" ENUM "No","Yes";
BA_DEF_  "NmAsrBaseAddress" HEX 0 536870911;
BA_DEF_  "NmAsrMessageCount" INT 0 255;
BA_DEF_ BU_ "NodeLayerModules" STRING;
BA_DEF_ BU_ "NmAsrNode" ENUM "No","Yes";
BA_DEF_ BU_ "ILused" ENUM "No","Yes";
BA_DEF_ SG_ "GenSigFuncType" ENUM "NoFunction","n/a","n/a","n/a","n/a","n/a","n/a","n/a","n/a","n/a","n/a","n/a","n/a","n/a","n/a","CHK","CNTR","n/a","n/a","n/a","CNTR_AR_01","CRC_AR_01_BOTH","CRC_AR_01_ALT","CRC_AR_01_LOW","CRC_AR_01_NIBBLE","CNTR_AR_04","CRC_AR_04A","CNTR_AR_05","CRC_AR_05";
BA_DEF_ SG_ "GenSigDataID" STRING;

BA_DEF_DEF_ "VFrameFormat" "J1939PG";
BA_DEF_DEF_ "CANFD_BRS" "1";
BA_DEF_DEF_ "GenSigStartValue" 0;
BA_DEF_DEF_ "GenSigSendType" "NoSigSendType";
BA_DEF_DEF_ "DBName" "";
BA_DEF_DEF_ "BusType" "";
BA_DEF_DEF_ "ProtocolType" "";
BA_DEF_DEF_ "GenMsgCycleTime" 0;
BA_DEF_DEF_ "GenMsgDelayTime" 0;
BA_DEF_DEF_ "GenMsgStartDelayTime" 0;
BA_DEF_DEF_ "GenMsgSendType" "NoMsgSendType";
BA_DEF_DEF_ "GenMsgILSupport" "Yes";
BA_DEF_DEF_ "NmAsrMessage" "No";
BA_DEF_DEF_ "NmAsrBaseAddress" 1280;
BA_DEF_DEF_ "NmAsrMessageCount" 64;
BA_DEF_DEF_ "NodeLayerModules" "CANoeILNLSPA.dll";
BA_DEF_DEF_ "NmAsrNode" "No";
BA_DEF_DEF_ "NmAsrNodeIdentifier" 0;
BA_DEF_DEF_ "ILused" "Yes";
BA_DEF_DEF_ "GenSigFuncType" "NoFunction";
BA_DEF_DEF_ "GenSigDataID" "";

// Network
BA_ "DBName" "SafetyCANFD2";
BA_ "BusType" "CAN FD";
BA_ "ProtocolType" "CAN";
BA_ "Baudrate" 500000;
BA_ "BaudRateCANFD" 2000000;
// ECU: ASDM
BA_ "NmAsrNodeIdentifier" BU_ ASDM 1;
BA_ "NmAsrNode" BU_ ASDM 1;
BA_ "NodeLayerModules" BU_ ASDM "CANoeILNLSPA.dll,AsrNM33.dll";
// ECU: ETC
BA_ "ILused" BU_ ETC 0;
// ECU: FLC
BA_ "NmAsrNodeIdentifier" BU_ FLC 3;
BA_ "NmAsrNode" BU_ FLC 1;
BA_ "NodeLayerModules" BU_ FLC "CANoeILNLSPA.dll,AsrNM33.dll";
// ECU: FLR
BA_ "NmAsrNodeIdentifier" BU_ FLR 2;
BA_ "NmAsrNode" BU_ FLR 1;
BA_ "NodeLayerModules" BU_ FLR "CANoeILNLSPA.dll,AsrNM33.dll";
// ECU: PAS
BA_ "ILused" BU_ PAS 0;
// Frame: ASDMCanFD2TimeSynchFr
BA_ "VFrameFormat" BO_ 33 14;
BA_ "GenMsgSendType" BO_ 33 1;
BA_ "GenMsgDelayTime" BO_ 33 50.000;
// Frame: ASDMSafetyCANFD2Frame1
BA_ "VFrameFormat" BO_ 24 14;
BA_ "GenMsgSendType" BO_ 24 0;
BA_ "GenMsgCycleTime" BO_ 24 20.000;
BA_ "GenSigSendType" SG_ 24 PrimADataCompALat 0;
BA_ "GenSigStartValue" SG_ 24 PrimADataCompALat1Qf 1;
BA_ "GenSigSendType" SG_ 24 PrimADataCompALat1Qf 0;
BA_ "GenSigSendType" SG_ 24 PrimADataCompALgt 0;
BA_ "GenSigStartValue" SG_ 24 PrimADataCompALgt1Qf 1;
BA_ "GenSigSendType" SG_ 24 PrimADataCompALgt1Qf 0;
BA_ "GenSigStartValue" SG_ 24 PrimADataCompAVert 1154.118;
BA_ "GenSigSendType" SG_ 24 PrimADataCompAVert 0;
BA_ "GenSigStartValue" SG_ 24 PrimADataCompAVertQf 1;
BA_ "GenSigSendType" SG_ 24 PrimADataCompAVertQf 0;
BA_ "GenSigSendType" SG_ 24 PrimADataCompChks 0;
BA_ "GenSigSendType" SG_ 24 PrimADataCompCntr 0;
BA_ "GenSigSendType" SG_ 24 PrimADataComptimeStampNanoSec 0;
BA_ "GenSigSendType" SG_ 24 PrimADataComptimeStampSec 0;
BA_ "GenSigSendType" SG_ 24 PrimADataComptimeStampTiBasSts 0;
BA_ "GenSigSendType" SG_ 24 PrimAgDataCompChks 0;
BA_ "GenSigSendType" SG_ 24 PrimAgDataCompCntr 0;
BA_ "GenSigSendType" SG_ 24 PrimAgDataCompRollRate 0;
BA_ "GenSigStartValue" SG_ 24 PrimAgDataCompRollRateQf 1;
BA_ "GenSigSendType" SG_ 24 PrimAgDataCompRollRateQf 0;
BA_ "GenSigSendType" SG_ 24 PrimAgDataComptimeStampNanoSec 0;
BA_ "GenSigSendType" SG_ 24 PrimAgDataComptimeStampSec 0;
BA_ "GenSigSendType" SG_ 24 PrimAgDataComptimeStampTiBasSts 0;
BA_ "GenSigSendType" SG_ 24 PrimAgDataCompYawRate 0;
BA_ "GenSigStartValue" SG_ 24 PrimAgDataCompYawRateQf 1;
BA_ "GenSigSendType" SG_ 24 PrimAgDataCompYawRateQf 0;
BA_ "GenSigStartValue" SG_ 24 PrimAsyALgtReqForCmftAsyCmftLgtNegLimForJerk 3000;
BA_ "GenSigSendType" SG_ 24 PrimAsyALgtReqForCmftAsyCmftLgtNegLimForJerk 0;
BA_ "GenSigStartValue" SG_ 24 PrimAsyALgtReqForCmftAsyCmftLgtPosLimForJerk 3000;
BA_ "GenSigSendType" SG_ 24 PrimAsyALgtReqForCmftAsyCmftLgtPosLimForJerk 0;
BA_ "GenSigStartValue" SG_ 24 PrimAsyALgtReqForCmftMax 1200;
BA_ "GenSigSendType" SG_ 24 PrimAsyALgtReqForCmftMax 0;
BA_ "GenSigStartValue" SG_ 24 PrimAsyALgtReqForCmftMin 1200;
BA_ "GenSigSendType" SG_ 24 PrimAsyALgtReqForCmftMin 0;
BA_ "GenSigStartValue" SG_ 24 PrimAsyALgtReqRngForSafeMax 1500;
BA_ "GenSigSendType" SG_ 24 PrimAsyALgtReqRngForSafeMax 0;
BA_ "GenSigStartValue" SG_ 24 PrimAsyALgtReqRngForSafeMin 1500;
BA_ "GenSigSendType" SG_ 24 PrimAsyALgtReqRngForSafeMin 0;
BA_ "GenSigStartValue" SG_ 24 PrimAsyPinionAgReqSafe 14848;
BA_ "GenSigSendType" SG_ 24 PrimAsyPinionAgReqSafe 0;
BA_ "GenSigSendType" SG_ 24 PrimChStsADModeAvtn 0;
BA_ "GenSigSendType" SG_ 24 PrimChStsADModeAvtnCfm 0;
BA_ "GenSigSendType" SG_ 24 PrimChStsADModeDeavtn 0;
BA_ "GenSigSendType" SG_ 24 PrimChStsADModeDeavtnCfm 0;
BA_ "GenSigSendType" SG_ 24 PrimChStsChanlSts 0;
BA_ "GenSigSendType" SG_ 24 PrimChStsCtrlrSts 0;
BA_ "GenSigSendType" SG_ 24 PrimChStsLatADAvtn 0;
BA_ "GenSigSendType" SG_ 24 PrimChStsLatADAvtnCfm 0;
BA_ "GenSigSendType" SG_ 24 PrimChStsLatSts 0;
BA_ "GenSigSendType" SG_ 24 PrimChStsLgtADAvtn 0;
BA_ "GenSigSendType" SG_ 24 PrimChStsLgtADAvtnCfm 0;
BA_ "GenSigSendType" SG_ 24 PrimChStsLgtSts 0;
BA_ "GenSigSendType" SG_ 24 PrimChStsReserved1 0;
BA_ "GenSigSendType" SG_ 24 PrimChStsReserved2 0;
BA_ "GenSigSendType" SG_ 24 PrimChStsReserved3 0;
BA_ "GenSigSendType" SG_ 24 PrimChStsSafeStop 0;
BA_ "GenSigSendType" SG_ 24 PrimVehVCompChks 0;
BA_ "GenSigSendType" SG_ 24 PrimVehVCompCntr 0;
BA_ "GenSigSendType" SG_ 24 PrimVehVCompVehVLat 0;
BA_ "GenSigStartValue" SG_ 24 PrimVehVCompVehVLatQf 1;
BA_ "GenSigSendType" SG_ 24 PrimVehVCompVehVLatQf 0;
BA_ "GenSigSendType" SG_ 24 PrimVehVCompVehVLgt 0;
BA_ "GenSigStartValue" SG_ 24 PrimVehVCompVehVLgtQf 1;
BA_ "GenSigSendType" SG_ 24 PrimVehVCompVehVLgtQf 0;
BA_ "GenSigStartValue" SG_ 24 WhlSpdCmpFac 16;
BA_ "GenSigSendType" SG_ 24 WhlSpdCmpFac 0;
// Frame: ASDMSafetyCANFD2Frame2
BA_ "VFrameFormat" BO_ 17 14;
BA_ "GenMsgSendType" BO_ 17 0;
BA_ "GenMsgCycleTime" BO_ 17 20.000;
BA_ "GenSigSendType" SG_ 17 PrimAdPSSGroupSafe0DataID 0;
BA_ "GenSigSendType" SG_ 17 PrimAdPSSGroupSafe0DeltaTPos1 0;
BA_ "GenSigSendType" SG_ 17 PrimAdPSSGroupSafe0DeltaTPos2 0;
BA_ "GenSigStartValue" SG_ 17 PrimAdPSSGroupSafe0DeltaXPos1 32767.5;
BA_ "GenSigSendType" SG_ 17 PrimAdPSSGroupSafe0DeltaXPos1 0;
BA_ "GenSigStartValue" SG_ 17 PrimAdPSSGroupSafe0DeltaXPos2 32767.5;
BA_ "GenSigSendType" SG_ 17 PrimAdPSSGroupSafe0DeltaXPos2 0;
BA_ "GenSigStartValue" SG_ 17 PrimAdPSSGroupSafe0DeltaYPos1 32767.5;
BA_ "GenSigSendType" SG_ 17 PrimAdPSSGroupSafe0DeltaYPos1 0;
BA_ "GenSigStartValue" SG_ 17 PrimAdPSSGroupSafe0DeltaYPos2 32767.5;
BA_ "GenSigSendType" SG_ 17 PrimAdPSSGroupSafe0DeltaYPos2 0;
BA_ "GenSigStartValue" SG_ 17 PrimAdPSSGroupSafe0HeadingPos1 32767.5;
BA_ "GenSigSendType" SG_ 17 PrimAdPSSGroupSafe0HeadingPos1 0;
BA_ "GenSigStartValue" SG_ 17 PrimAdPSSGroupSafe0HeadingPos2 32767.5;
BA_ "GenSigSendType" SG_ 17 PrimAdPSSGroupSafe0HeadingPos2 0;
BA_ "GenSigStartValue" SG_ 17 PrimAdPSSGroupSafe0InitHeading 32767.5;
BA_ "GenSigSendType" SG_ 17 PrimAdPSSGroupSafe0InitHeading 0;
BA_ "GenSigSendType" SG_ 17 PrimAdPSSGroupSafe0InitPosX 0;
BA_ "GenSigSendType" SG_ 17 PrimAdPSSGroupSafe0InitPosY 0;
BA_ "GenSigSendType" SG_ 17 PrimAdPSSGroupSafe0TiStampNanoSec 0;
BA_ "GenSigSendType" SG_ 17 PrimAdPSSGroupSafe0TiStampSec 0;
BA_ "GenSigSendType" SG_ 17 PrimAdPSSGroupSafe0TrajectID 0;
// Frame: ASDMSafetyCANFD2Frame3
BA_ "VFrameFormat" BO_ 18 14;
BA_ "GenMsgSendType" BO_ 18 0;
BA_ "GenMsgCycleTime" BO_ 18 20.000;
BA_ "GenSigSendType" SG_ 18 PrimAdPSSGroupSafe1DataID 0;
BA_ "GenSigSendType" SG_ 18 PrimAdPSSGroupSafe1DeltaTPos1 0;
BA_ "GenSigSendType" SG_ 18 PrimAdPSSGroupSafe1DeltaTPos2 0;
BA_ "GenSigSendType" SG_ 18 PrimAdPSSGroupSafe1DeltaTPos3 0;
BA_ "GenSigSendType" SG_ 18 PrimAdPSSGroupSafe1DeltaTPos4 0;
BA_ "GenSigSendType" SG_ 18 PrimAdPSSGroupSafe1DeltaTPos5 0;
BA_ "GenSigSendType" SG_ 18 PrimAdPSSGroupSafe1DeltaTPos6 0;
BA_ "GenSigStartValue" SG_ 18 PrimAdPSSGroupSafe1DeltaXPos1 32767.5;
BA_ "GenSigSendType" SG_ 18 PrimAdPSSGroupSafe1DeltaXPos1 0;
BA_ "GenSigStartValue" SG_ 18 PrimAdPSSGroupSafe1DeltaXPos2 32767.5;
BA_ "GenSigSendType" SG_ 18 PrimAdPSSGroupSafe1DeltaXPos2 0;
BA_ "GenSigStartValue" SG_ 18 PrimAdPSSGroupSafe1DeltaXPos3 32767.5;
BA_ "GenSigSendType" SG_ 18 PrimAdPSSGroupSafe1DeltaXPos3 0;
BA_ "GenSigStartValue" SG_ 18 PrimAdPSSGroupSafe1DeltaXPos4 32767.5;
BA_ "GenSigSendType" SG_ 18 PrimAdPSSGroupSafe1DeltaXPos4 0;
BA_ "GenSigStartValue" SG_ 18 PrimAdPSSGroupSafe1DeltaXPos5 32767.5;
BA_ "GenSigSendType" SG_ 18 PrimAdPSSGroupSafe1DeltaXPos5 0;
BA_ "GenSigStartValue" SG_ 18 PrimAdPSSGroupSafe1DeltaXPos6 32767.5;
BA_ "GenSigSendType" SG_ 18 PrimAdPSSGroupSafe1DeltaXPos6 0;
BA_ "GenSigStartValue" SG_ 18 PrimAdPSSGroupSafe1DeltaYPos1 32767.5;
BA_ "GenSigSendType" SG_ 18 PrimAdPSSGroupSafe1DeltaYPos1 0;
BA_ "GenSigStartValue" SG_ 18 PrimAdPSSGroupSafe1DeltaYPos2 32767.5;
BA_ "GenSigSendType" SG_ 18 PrimAdPSSGroupSafe1DeltaYPos2 0;
BA_ "GenSigStartValue" SG_ 18 PrimAdPSSGroupSafe1DeltaYPos3 32767.5;
BA_ "GenSigSendType" SG_ 18 PrimAdPSSGroupSafe1DeltaYPos3 0;
BA_ "GenSigStartValue" SG_ 18 PrimAdPSSGroupSafe1DeltaYPos4 32767.5;
BA_ "GenSigSendType" SG_ 18 PrimAdPSSGroupSafe1DeltaYPos4 0;
BA_ "GenSigStartValue" SG_ 18 PrimAdPSSGroupSafe1DeltaYPos5 32767.5;
BA_ "GenSigSendType" SG_ 18 PrimAdPSSGroupSafe1DeltaYPos5 0;
BA_ "GenSigStartValue" SG_ 18 PrimAdPSSGroupSafe1DeltaYPos6 32767.5;
BA_ "GenSigSendType" SG_ 18 PrimAdPSSGroupSafe1DeltaYPos6 0;
BA_ "GenSigStartValue" SG_ 18 PrimAdPSSGroupSafe1HeadingPos1 32767.5;
BA_ "GenSigSendType" SG_ 18 PrimAdPSSGroupSafe1HeadingPos1 0;
BA_ "GenSigStartValue" SG_ 18 PrimAdPSSGroupSafe1HeadingPos2 32767.5;
BA_ "GenSigSendType" SG_ 18 PrimAdPSSGroupSafe1HeadingPos2 0;
BA_ "GenSigStartValue" SG_ 18 PrimAdPSSGroupSafe1HeadingPos3 32767.5;
BA_ "GenSigSendType" SG_ 18 PrimAdPSSGroupSafe1HeadingPos3 0;
BA_ "GenSigStartValue" SG_ 18 PrimAdPSSGroupSafe1HeadingPos4 32767.5;
BA_ "GenSigSendType" SG_ 18 PrimAdPSSGroupSafe1HeadingPos4 0;
BA_ "GenSigStartValue" SG_ 18 PrimAdPSSGroupSafe1HeadingPos5 32767.5;
BA_ "GenSigSendType" SG_ 18 PrimAdPSSGroupSafe1HeadingPos5 0;
BA_ "GenSigStartValue" SG_ 18 PrimAdPSSGroupSafe1HeadingPos6 32767.5;
BA_ "GenSigSendType" SG_ 18 PrimAdPSSGroupSafe1HeadingPos6 0;
BA_ "GenSigSendType" SG_ 18 PrimAdPSSGroupSafe1TrajectID 0;
// Frame: ASDMSafetyCANFD2Frame4
BA_ "VFrameFormat" BO_ 288 14;
BA_ "GenMsgSendType" BO_ 288 0;
BA_ "GenMsgCycleTime" BO_ 288 50.000;
BA_ "GenSigSendType" SG_ 288 ADataRawSafeALat 0;
BA_ "GenSigStartValue" SG_ 288 ADataRawSafeALat1Qf 1;
BA_ "GenSigSendType" SG_ 288 ADataRawSafeALat1Qf 0;
BA_ "GenSigSendType" SG_ 288 ADataRawSafeALgt 0;
BA_ "GenSigStartValue" SG_ 288 ADataRawSafeALgt1Qf 1;
BA_ "GenSigSendType" SG_ 288 ADataRawSafeALgt1Qf 0;
BA_ "GenSigStartValue" SG_ 288 ADataRawSafeAVert 1155.059;
BA_ "GenSigSendType" SG_ 288 ADataRawSafeAVert 0;
BA_ "GenSigStartValue" SG_ 288 ADataRawSafeAVertQf 1;
BA_ "GenSigSendType" SG_ 288 ADataRawSafeAVertQf 0;
BA_ "GenSigStartValue" SG_ 288 ADataRawSafeChks 255;
BA_ "GenSigSendType" SG_ 288 ADataRawSafeChks 0;
BA_ "GenSigFuncType" SG_ 288 ADataRawSafeChks 15;
BA_ "GenSigDataID" SG_ 288 ADataRawSafeChks "0x22";
BA_ "GenSigSendType" SG_ 288 ADataRawSafeCntr 0;
BA_ "GenSigFuncType" SG_ 288 ADataRawSafeCntr 16;
BA_ "GenSigSendType" SG_ 288 ALgtStdFromWhlSpdALgtStdFromWhlSpd 0;
BA_ "GenSigSendType" SG_ 288 ALgtStdFromWhlSpdChks 0;
BA_ "GenSigFuncType" SG_ 288 ALgtStdFromWhlSpdChks 15;
BA_ "GenSigDataID" SG_ 288 ALgtStdFromWhlSpdChks "0x34";
BA_ "GenSigSendType" SG_ 288 ALgtStdFromWhlSpdCntr 0;
BA_ "GenSigFuncType" SG_ 288 ALgtStdFromWhlSpdCntr 16;
BA_ "GenSigStartValue" SG_ 288 ALgtStdFromWhlSpdQf 1;
BA_ "GenSigSendType" SG_ 288 ALgtStdFromWhlSpdQf 0;
BA_ "GenSigStartValue" SG_ 288 AmbTRawAmbTVal 700;
BA_ "GenSigSendType" SG_ 288 AmbTRawAmbTVal 0;
BA_ "GenSigSendType" SG_ 288 AmbTRawQly 0;
BA_ "GenSigStartValue" SG_ 288 AsyDataWithCmpSafeALat1Qf 1;
BA_ "GenSigSendType" SG_ 288 AsyDataWithCmpSafeALat1Qf 0;
BA_ "GenSigSendType" SG_ 288 AsyDataWithCmpSafeALatWithCmp 0;
BA_ "GenSigStartValue" SG_ 288 AsyDataWithCmpSafeALgt1Qf 1;
BA_ "GenSigSendType" SG_ 288 AsyDataWithCmpSafeALgt1Qf 0;
BA_ "GenSigStartValue" SG_ 288 AsyDataWithCmpSafeChks 255;
BA_ "GenSigSendType" SG_ 288 AsyDataWithCmpSafeChks 0;
BA_ "GenSigFuncType" SG_ 288 AsyDataWithCmpSafeChks 15;
BA_ "GenSigDataID" SG_ 288 AsyDataWithCmpSafeChks "0x24";
BA_ "GenSigSendType" SG_ 288 AsyDataWithCmpSafeCntr 0;
BA_ "GenSigFuncType" SG_ 288 AsyDataWithCmpSafeCntr 16;
BA_ "GenSigSendType" SG_ 288 AsyDataWithCmpSafeGrdtOfALgt 0;
BA_ "GenSigStartValue" SG_ 288 AsyDataWithCmpSafeYawRateQf 1;
BA_ "GenSigSendType" SG_ 288 AsyDataWithCmpSafeYawRateQf 0;
BA_ "GenSigSendType" SG_ 288 AsyDataWithCmpSafeYawRateWithCmp 0;
BA_ "GenSigSendType" SG_ 288 BkpOfDstTrvld 0;
BA_ "GenSigSendType" SG_ 288 CarTiGlb 0;
BA_ "GenSigSendType" SG_ 288 DrvModReq 0;
BA_ "GenSigSendType" SG_ 288 PinionSteerAgGroupChks 0;
BA_ "GenSigFuncType" SG_ 288 PinionSteerAgGroupChks 15;
BA_ "GenSigDataID" SG_ 288 PinionSteerAgGroupChks "0x40D";
BA_ "GenSigSendType" SG_ 288 PinionSteerAgGroupCntr 0;
BA_ "GenSigFuncType" SG_ 288 PinionSteerAgGroupCntr 16;
BA_ "GenSigSendType" SG_ 288 PinionSteerAgGroupPinionSteerAg1 0;
BA_ "GenSigStartValue" SG_ 288 PinionSteerAgGroupPinionSteerAg1Qf 1;
BA_ "GenSigSendType" SG_ 288 PinionSteerAgGroupPinionSteerAg1Qf 0;
BA_ "GenSigSendType" SG_ 288 PinionSteerAgGroupPinionSteerAgSpd1 0;
BA_ "GenSigStartValue" SG_ 288 PinionSteerAgGroupPinionSteerAgSpd1Qf 1;
BA_ "GenSigSendType" SG_ 288 PinionSteerAgGroupPinionSteerAgSpd1Qf 0;
BA_ "GenSigSendType" SG_ 288 PinionSteerAgGroupSteerWhlTq 0;
BA_ "GenSigStartValue" SG_ 288 PinionSteerAgGroupSteerWhlTqQf 1;
BA_ "GenSigSendType" SG_ 288 PinionSteerAgGroupSteerWhlTqQf 0;
BA_ "GenSigSendType" SG_ 288 SteerWhlSnsrAg 0;
BA_ "GenSigSendType" SG_ 288 SteerWhlSnsrAgSpd 0;
BA_ "GenSigSendType" SG_ 288 SteerWhlSnsrChks 0;
BA_ "GenSigFuncType" SG_ 288 SteerWhlSnsrChks 15;
BA_ "GenSigDataID" SG_ 288 SteerWhlSnsrChks "0x33";
BA_ "GenSigSendType" SG_ 288 SteerWhlSnsrCntr 0;
BA_ "GenSigFuncType" SG_ 288 SteerWhlSnsrCntr 16;
BA_ "GenSigStartValue" SG_ 288 SteerWhlSnsrQf 1;
BA_ "GenSigSendType" SG_ 288 SteerWhlSnsrQf 0;
BA_ "GenSigSendType" SG_ 288 VehBattUSysU 0;
BA_ "GenSigStartValue" SG_ 288 VehBattUSysUQf 1;
BA_ "GenSigSendType" SG_ 288 VehBattUSysUQf 0;
BA_ "GenSigSendType" SG_ 288 VehModMngtGlbSafe1CarModSts1 0;
BA_ "GenSigSendType" SG_ 288 VehModMngtGlbSafe1CarModSubtypWdCarModSubtyp 0;
BA_ "GenSigSendType" SG_ 288 VehModMngtGlbSafe1Chks 0;
BA_ "GenSigFuncType" SG_ 288 VehModMngtGlbSafe1Chks 15;
BA_ "GenSigDataID" SG_ 288 VehModMngtGlbSafe1Chks "0x74";
BA_ "GenSigSendType" SG_ 288 VehModMngtGlbSafe1Cntr 0;
BA_ "GenSigFuncType" SG_ 288 VehModMngtGlbSafe1Cntr 16;
BA_ "GenSigSendType" SG_ 288 VehModMngtGlbSafe1EgyLvlElecMai 0;
BA_ "GenSigSendType" SG_ 288 VehModMngtGlbSafe1EgyLvlElecSubtyp 0;
BA_ "GenSigSendType" SG_ 288 VehModMngtGlbSafe1FltEgyCnsWdSts 0;
BA_ "GenSigSendType" SG_ 288 VehModMngtGlbSafe1PwrLvlElecMai 0;
BA_ "GenSigSendType" SG_ 288 VehModMngtGlbSafe1PwrLvlElecSubtyp 0;
BA_ "GenSigStartValue" SG_ 288 VehModMngtGlbSafe1UsgModSts 1;
BA_ "GenSigSendType" SG_ 288 VehModMngtGlbSafe1UsgModSts 0;
BA_ "GenSigSendType" SG_ 288 VehMtnStChks 0;
BA_ "GenSigFuncType" SG_ 288 VehMtnStChks 15;
BA_ "GenSigDataID" SG_ 288 VehMtnStChks "0x36";
BA_ "GenSigSendType" SG_ 288 VehMtnStCntr 0;
BA_ "GenSigFuncType" SG_ 288 VehMtnStCntr 16;
BA_ "GenSigSendType" SG_ 288 VehMtnStVehMtnSt 0;
BA_ "GenSigSendType" SG_ 288 VehSpdLgtA 0;
BA_ "GenSigSendType" SG_ 288 VehSpdLgtChks 0;
BA_ "GenSigFuncType" SG_ 288 VehSpdLgtChks 15;
BA_ "GenSigDataID" SG_ 288 VehSpdLgtChks "0x37";
BA_ "GenSigSendType" SG_ 288 VehSpdLgtCntr 0;
BA_ "GenSigFuncType" SG_ 288 VehSpdLgtCntr 16;
BA_ "GenSigStartValue" SG_ 288 VehSpdLgtQf 1;
BA_ "GenSigSendType" SG_ 288 VehSpdLgtQf 0;
BA_ "GenSigSendType" SG_ 288 WipgInfoWipgSpdInfo 0;
BA_ "GenSigSendType" SG_ 288 WipgInfoWiprActv 0;
BA_ "GenSigSendType" SG_ 288 WipgInfoWiprInWipgAr 0;
// Frame: ASDMSafetyCANFD2Frame7
BA_ "VFrameFormat" BO_ 1007 14;
BA_ "GenMsgSendType" BO_ 1007 0;
BA_ "GenMsgCycleTime" BO_ 1007 500.000;
BA_ "GenSigSendType" SG_ 1007 FrntRdrVehPrmRdrVehPrmChks 0;
BA_ "GenSigFuncType" SG_ 1007 FrntRdrVehPrmRdrVehPrmChks 15;
BA_ "GenSigDataID" SG_ 1007 FrntRdrVehPrmRdrVehPrmChks "0x80E";
BA_ "GenSigSendType" SG_ 1007 FrntRdrVehPrmRdrVehPrmCntr 0;
BA_ "GenSigFuncType" SG_ 1007 FrntRdrVehPrmRdrVehPrmCntr 16;
BA_ "GenSigStartValue" SG_ 1007 FrntRdrVehPrmRdrVehPrmRdrDynCalPrmForAgOffs 128;
BA_ "GenSigSendType" SG_ 1007 FrntRdrVehPrmRdrVehPrmRdrDynCalPrmForAgOffs 0;
BA_ "GenSigStartValue" SG_ 1007 FrntRdrVehPrmRdrVehPrmRdrDynCalPrmForAxleDstReToVehFrnt 250;
BA_ "GenSigSendType" SG_ 1007 FrntRdrVehPrmRdrVehPrmRdrDynCalPrmForAxleDstReToVehFrnt 0;
BA_ "GenSigStartValue" SG_ 1007 FrntRdrVehPrmRdrVehPrmRdrDynCalPrmForPinoinAgRat 140;
BA_ "GenSigSendType" SG_ 1007 FrntRdrVehPrmRdrVehPrmRdrDynCalPrmForPinoinAgRat 0;
BA_ "GenSigStartValue" SG_ 1007 FrntRdrVehPrmRdrVehPrmRdrDynCalPrmForRollAgGain 50;
BA_ "GenSigSendType" SG_ 1007 FrntRdrVehPrmRdrVehPrmRdrDynCalPrmForRollAgGain 0;
BA_ "GenSigSendType" SG_ 1007 FrntRdrVehPrmRdrVehPrmRdrDynCalPrmForSnsrDir 0;
BA_ "GenSigSendType" SG_ 1007 FrntRdrVehPrmRdrVehPrmRdrDynCalPrmForSnsrOrntn 0;
BA_ "GenSigStartValue" SG_ 1007 FrntRdrVehPrmRdrVehPrmRdrDynCalPrmForSnsrPosnLat 2000;
BA_ "GenSigSendType" SG_ 1007 FrntRdrVehPrmRdrVehPrmRdrDynCalPrmForSnsrPosnLat 0;
BA_ "GenSigStartValue" SG_ 1007 FrntRdrVehPrmRdrVehPrmRdrDynCalPrmForSnsrPosnLgt 5000;
BA_ "GenSigSendType" SG_ 1007 FrntRdrVehPrmRdrVehPrmRdrDynCalPrmForSnsrPosnLgt 0;
BA_ "GenSigSendType" SG_ 1007 FrntRdrVehPrmRdrVehPrmRdrDynCalPrmForSnsrPosnVert 0;
BA_ "GenSigStartValue" SG_ 1007 FrntRdrVehPrmRdrVehPrmRdrDynCalPrmForSnsrRot1 900;
BA_ "GenSigSendType" SG_ 1007 FrntRdrVehPrmRdrVehPrmRdrDynCalPrmForSnsrRot1 0;
BA_ "GenSigStartValue" SG_ 1007 FrntRdrVehPrmRdrVehPrmRdrDynCalPrmForVehLen 500;
BA_ "GenSigSendType" SG_ 1007 FrntRdrVehPrmRdrVehPrmRdrDynCalPrmForVehLen 0;
BA_ "GenSigSendType" SG_ 1007 FrntRdrVehPrmRdrVehPrmRdrDynCalPrmForVehTyp 0;
BA_ "GenSigStartValue" SG_ 1007 FrntRdrVehPrmRdrVehPrmRdrDynCalPrmForVehWidth 200;
BA_ "GenSigSendType" SG_ 1007 FrntRdrVehPrmRdrVehPrmRdrDynCalPrmForVehWidth 0;
BA_ "GenSigSendType" SG_ 1007 FrntRdrVehPrmRdrVehPrmRdrDynCalPrmForVersMajor 0;
BA_ "GenSigSendType" SG_ 1007 FrntRdrVehPrmRdrVehPrmRdrDynCalPrmForVersMinor 0;
BA_ "GenSigSendType" SG_ 1007 FrntRdrVehPrmRdrVehPrmRdrDynCalPrmForWhlBas 0;
BA_ "GenSigSendType" SG_ 1007 FrntRdrVehPrmRdrVehPrmVld 0;
// Frame: AsdmSafetyCanFD2NmFr
BA_ "VFrameFormat" BO_ 1281 0;
BA_ "GenMsgSendType" BO_ 1281 1;
BA_ "GenMsgDelayTime" BO_ 1281 20.000;
BA_ "GenMsgILSupport" BO_ 1281 0;
BA_ "NmAsrMessage" BO_ 1281 1;
// Frame: AsdmToAllFuncSafetyCanFD2DiagReqFrame1
BA_ "VFrameFormat" BO_ 2047 14;
BA_ "GenMsgSendType" BO_ 2047 1;
BA_ "GenMsgDelayTime" BO_ 2047 5.000;
// Frame: AsdmToFlrSafetyCanFD2DiagReqFrame1
BA_ "VFrameFormat" BO_ 1860 14;
BA_ "GenMsgSendType" BO_ 1860 1;
BA_ "GenMsgDelayTime" BO_ 1860 5.000;
// Frame: EtctoFlrXcpFr01
BA_ "VFrameFormat" BO_ 1410 0;
BA_ "GenMsgSendType" BO_ 1410 1;
BA_ "GenMsgDelayTime" BO_ 1410 5.000;
// Frame: FlcSafetyCANFD2Fr01
BA_ "VFrameFormat" BO_ 16 14;
BA_ "GenMsgSendType" BO_ 16 0;
BA_ "GenMsgCycleTime" BO_ 16 20.000;
BA_ "GenSigStartValue" SG_ 16 BrkPedlTrvlAct 500;
BA_ "GenSigSendType" SG_ 16 BrkPedlTrvlAct 0;
BA_ "GenSigStartValue" SG_ 16 BrkPedlTrvlChks 255;
BA_ "GenSigSendType" SG_ 16 BrkPedlTrvlChks 0;
BA_ "GenSigFuncType" SG_ 16 BrkPedlTrvlChks 15;
BA_ "GenSigDataID" SG_ 16 BrkPedlTrvlChks "0xB3";
BA_ "GenSigSendType" SG_ 16 BrkPedlTrvlCntr 0;
BA_ "GenSigFuncType" SG_ 16 BrkPedlTrvlCntr 16;
BA_ "GenSigStartValue" SG_ 16 BrkPedlTrvlQf 1;
BA_ "GenSigSendType" SG_ 16 BrkPedlTrvlQf 0;
BA_ "GenSigSendType" SG_ 16 BrkPedlTrvlSt 0;
BA_ "GenSigStartValue" SG_ 16 BrkPedlTrvlStQf 1;
BA_ "GenSigSendType" SG_ 16 BrkPedlTrvlStQf 0;
BA_ "GenSigStartValue" SG_ 16 BrkPedlTrvlTar 500;
BA_ "GenSigSendType" SG_ 16 BrkPedlTrvlTar 0;
BA_ "GenSigSendType" SG_ 16 DrvBrkReqDmat 0;
BA_ "GenSigSendType" SG_ 16 PinionSteerAgGroupForBkpChks 0;
BA_ "GenSigFuncType" SG_ 16 PinionSteerAgGroupForBkpChks 15;
BA_ "GenSigDataID" SG_ 16 PinionSteerAgGroupForBkpChks "0x407";
BA_ "GenSigSendType" SG_ 16 PinionSteerAgGroupForBkpCntr 0;
BA_ "GenSigFuncType" SG_ 16 PinionSteerAgGroupForBkpCntr 16;
BA_ "GenSigSendType" SG_ 16 PinionSteerAgGroupForBkpPinionSteerAgForBkp 0;
BA_ "GenSigStartValue" SG_ 16 PinionSteerAgGroupForBkpPinionSteerAgQfForBkp 1;
BA_ "GenSigSendType" SG_ 16 PinionSteerAgGroupForBkpPinionSteerAgQfForBkp 0;
BA_ "GenSigSendType" SG_ 16 PinionSteerAgGroupForBkpPinionSteerAgSpdForBkp 0;
BA_ "GenSigStartValue" SG_ 16 PinionSteerAgGroupForBkpPinionSteerAgSpdQfForBkp 1;
BA_ "GenSigSendType" SG_ 16 PinionSteerAgGroupForBkpPinionSteerAgSpdQfForBkp 0;
BA_ "GenSigSendType" SG_ 16 PinionSteerAgGroupForBkpSteerWhlTqForBkp 0;
BA_ "GenSigStartValue" SG_ 16 PinionSteerAgGroupForBkpSteerWhlTqQfForBkp 1;
BA_ "GenSigSendType" SG_ 16 PinionSteerAgGroupForBkpSteerWhlTqQfForBkp 0;
BA_ "GenSigSendType" SG_ 16 SecChStsADModeAvtn 0;
BA_ "GenSigSendType" SG_ 16 SecChStsADModeAvtnCfm 0;
BA_ "GenSigSendType" SG_ 16 SecChStsADModeDeavtn 0;
BA_ "GenSigSendType" SG_ 16 SecChStsADModeDeavtnCfm 0;
BA_ "GenSigSendType" SG_ 16 SecChStsChanlSts 0;
BA_ "GenSigSendType" SG_ 16 SecChStsCtrlrSts 0;
BA_ "GenSigSendType" SG_ 16 SecChStsLatADAvtn 0;
BA_ "GenSigSendType" SG_ 16 SecChStsLatADAvtnCfm 0;
BA_ "GenSigSendType" SG_ 16 SecChStsLatSts 0;
BA_ "GenSigSendType" SG_ 16 SecChStsLgtADAvtn 0;
BA_ "GenSigSendType" SG_ 16 SecChStsLgtADAvtnCfm 0;
BA_ "GenSigSendType" SG_ 16 SecChStsLgtSts 0;
BA_ "GenSigSendType" SG_ 16 SecChStsReserved1 0;
BA_ "GenSigSendType" SG_ 16 SecChStsReserved2 0;
BA_ "GenSigSendType" SG_ 16 SecChStsReserved3 0;
BA_ "GenSigSendType" SG_ 16 SecChStsSafeStop 0;
BA_ "GenSigSendType" SG_ 16 VehMtnStForBkpVehMtnSt 0;
BA_ "GenSigSendType" SG_ 16 VehMtnStForBkpVehMtnStChks 0;
BA_ "GenSigSendType" SG_ 16 VehMtnStForBkpVehMtnStCntr 0;
BA_ "GenSigSendType" SG_ 16 VehSpdLgtForBkpVehSpdLgtA 0;
BA_ "GenSigSendType" SG_ 16 VehSpdLgtForBkpVehSpdLgtChks 0;
BA_ "GenSigFuncType" SG_ 16 VehSpdLgtForBkpVehSpdLgtChks 15;
BA_ "GenSigDataID" SG_ 16 VehSpdLgtForBkpVehSpdLgtChks "0x1967";
BA_ "GenSigSendType" SG_ 16 VehSpdLgtForBkpVehSpdLgtCntr 0;
BA_ "GenSigFuncType" SG_ 16 VehSpdLgtForBkpVehSpdLgtCntr 16;
BA_ "GenSigSendType" SG_ 16 VehSpdLgtForBkpVehSpdLgtQf 0;
BA_ "GenSigSendType" SG_ 16 WhlDirRotlFrntForBkpChks 0;
BA_ "GenSigSendType" SG_ 16 WhlDirRotlFrntForBkpCntr 0;
BA_ "GenSigSendType" SG_ 16 WhlDirRotlFrntForBkpLe 0;
BA_ "GenSigSendType" SG_ 16 WhlDirRotlFrntForBkpRi 0;
BA_ "GenSigSendType" SG_ 16 WhlDirRotlReForBkpChks 0;
BA_ "GenSigSendType" SG_ 16 WhlDirRotlReForBkpCntr 0;
BA_ "GenSigSendType" SG_ 16 WhlDirRotlReForBkpLe 0;
BA_ "GenSigSendType" SG_ 16 WhlDirRotlReForBkpRi 0;
BA_ "GenSigSendType" SG_ 16 WhlRotToothCntrForBkpChks 0;
BA_ "GenSigSendType" SG_ 16 WhlRotToothCntrForBkpCntr 0;
BA_ "GenSigSendType" SG_ 16 WhlRotToothCntrForBkpWhlRotToothCntrFrntLe 0;
BA_ "GenSigSendType" SG_ 16 WhlRotToothCntrForBkpWhlRotToothCntrFrntRi 0;
BA_ "GenSigSendType" SG_ 16 WhlRotToothCntrForBkpWhlRotToothCntrReLe 0;
BA_ "GenSigSendType" SG_ 16 WhlRotToothCntrForBkpWhlRotToothCntrReRi 0;
BA_ "GenSigSendType" SG_ 16 WhlSpdCircumlFrntForBkpWhlSpdCircumlFrntChks 0;
BA_ "GenSigSendType" SG_ 16 WhlSpdCircumlFrntForBkpWhlSpdCircumlFrntCntr 0;
BA_ "GenSigSendType" SG_ 16 WhlSpdCircumlFrntForBkpWhlSpdCircumlFrntLe 0;
BA_ "GenSigSendType" SG_ 16 WhlSpdCircumlFrntForBkpWhlSpdCircumlFrntLeQf 0;
BA_ "GenSigSendType" SG_ 16 WhlSpdCircumlFrntForBkpWhlSpdCircumlFrntRiQf 0;
BA_ "GenSigSendType" SG_ 16 WhlSpdCircumlFrntForBkpWhlSpdCircumlFrntWhlSpdCircumlFrntRi 0;
BA_ "GenSigSendType" SG_ 16 WhlSpdCircumlReForBkpWhlSpdCircumlReChks 0;
BA_ "GenSigSendType" SG_ 16 WhlSpdCircumlReForBkpWhlSpdCircumlReCntr 0;
BA_ "GenSigSendType" SG_ 16 WhlSpdCircumlReForBkpWhlSpdCircumlReLe 0;
BA_ "GenSigSendType" SG_ 16 WhlSpdCircumlReForBkpWhlSpdCircumlReLeQf 0;
BA_ "GenSigSendType" SG_ 16 WhlSpdCircumlReForBkpWhlSpdCircumlReRi 0;
BA_ "GenSigSendType" SG_ 16 WhlSpdCircumlReForBkpWhlSpdCircumlReRiQf 0;
BA_ "GenSigSendType" SG_ 16 WhlVAgrFrntForBkpWhlVAgrFrntLe 0;
BA_ "GenSigSendType" SG_ 16 WhlVAgrFrntForBkpWhlVAgrFrntLeQf 0;
BA_ "GenSigSendType" SG_ 16 WhlVAgrFrntForBkpWhlVAgrFrntRi 0;
BA_ "GenSigSendType" SG_ 16 WhlVAgrFrntForBkpWhlVAgrFrntRiQf 0;
BA_ "GenSigSendType" SG_ 16 WhlVAgrReForBkpWhlVAgrReLe 0;
BA_ "GenSigSendType" SG_ 16 WhlVAgrReForBkpWhlVAgrReLeQf 0;
BA_ "GenSigSendType" SG_ 16 WhlVAgrReForBkpWhlVAgrReRi 0;
BA_ "GenSigSendType" SG_ 16 WhlVAgrReForBkpWhlVAgrReRiQf 0;
// Frame: FlcSafetyCanFD2NmFr
BA_ "VFrameFormat" BO_ 1283 0;
BA_ "GenMsgSendType" BO_ 1283 1;
BA_ "GenMsgDelayTime" BO_ 1283 20.000;
BA_ "GenMsgILSupport" BO_ 1283 0;
BA_ "NmAsrMessage" BO_ 1283 1;
// Frame: FLRSafetyCANFD2Frame00
BA_ "VFrameFormat" BO_ 297 14;
BA_ "GenMsgSendType" BO_ 297 0;
BA_ "GenMsgCycleTime" BO_ 297 50.000;
BA_ "GenSigStartValue" SG_ 297 FrntRdrStsForDim 1;
BA_ "GenSigSendType" SG_ 297 FrntRdrStsForDim 0;
BA_ "GenSigSendType" SG_ 297 FrntRdrStsRdrNrDetn 0;
BA_ "GenSigSendType" SG_ 297 FrntRdrStsRdrNrObj 0;
BA_ "GenSigSendType" SG_ 297 FrntRdrStsRdrStsBlkd0bin 0;
BA_ "GenSigSendType" SG_ 297 FrntRdrStsRdrStsBlkdConf 0;
BA_ "GenSigSendType" SG_ 297 FrntRdrStsRdrStsChks 0;
BA_ "GenSigFuncType" SG_ 297 FrntRdrStsRdrStsChks 15;
BA_ "GenSigDataID" SG_ 297 FrntRdrStsRdrStsChks "0x80C";
BA_ "GenSigSendType" SG_ 297 FrntRdrStsRdrStsCntr 0;
BA_ "GenSigFuncType" SG_ 297 FrntRdrStsRdrStsCntr 16;
BA_ "GenSigSendType" SG_ 297 FrntRdrStsRdrStsDstbc 0;
BA_ "GenSigSendType" SG_ 297 FrntRdrStsRdrStsEna 0;
BA_ "GenSigSendType" SG_ 297 FrntRdrStsRdrStsFaulty 0;
BA_ "GenSigSendType" SG_ 297 FrntRdrStsRdrStsIfVersMajor 0;
BA_ "GenSigSendType" SG_ 297 FrntRdrStsRdrStsIfVersMinor 0;
BA_ "GenSigSendType" SG_ 297 FrntRdrStsRdrStsLatency 0;
BA_ "GenSigSendType" SG_ 297 FrntRdrStsRdrStsMisAlign 0;
BA_ "GenSigSendType" SG_ 297 FrntRdrStsRdrStsMissCom 0;
BA_ "GenSigStartValue" SG_ 297 FrntRdrStsRdrStsSftyFlt 1;
BA_ "GenSigSendType" SG_ 297 FrntRdrStsRdrStsSftyFlt 0;
BA_ "GenSigSendType" SG_ 297 FrntRdrStsRdrStsTiStamp 0;
BA_ "GenSigSendType" SG_ 297 FrntRdrStsRdrStsTiStampStsGlbTiBas 0;
BA_ "GenSigSendType" SG_ 297 FrntRdrStsRdrStsTiStampStsSyncToGatewy 0;
BA_ "GenSigSendType" SG_ 297 FrntRdrStsRdrStsTiStampStsTiLeap 0;
BA_ "GenSigSendType" SG_ 297 FrntRdrStsRdrStsTiStampStsTiOut 0;
BA_ "GenSigStartValue" SG_ 297 FrntRdrStsRdrStsWhlSpdCmpFac 16;
BA_ "GenSigSendType" SG_ 297 FrntRdrStsRdrStsWhlSpdCmpFac 0;
// Frame: FLRSafetyCANFD2Frame01
BA_ "VFrameFormat" BO_ 304 14;
BA_ "GenMsgSendType" BO_ 304 0;
BA_ "GenMsgCycleTime" BO_ 304 50.000;
BA_ "GenSigStartValue" SG_ 304 FrntRdrDetn1RdrDetnAzi 900;
BA_ "GenSigSendType" SG_ 304 FrntRdrDetn1RdrDetnAzi 0;
BA_ "GenSigSendType" SG_ 304 FrntRdrDetn1RdrDetnChks 0;
BA_ "GenSigFuncType" SG_ 304 FrntRdrDetn1RdrDetnChks 15;
BA_ "GenSigDataID" SG_ 304 FrntRdrDetn1RdrDetnChks "0x708";
BA_ "GenSigSendType" SG_ 304 FrntRdrDetn1RdrDetnCntr 0;
BA_ "GenSigFuncType" SG_ 304 FrntRdrDetn1RdrDetnCntr 16;
BA_ "GenSigSendType" SG_ 304 FrntRdrDetn1RdrDetnConf 0;
BA_ "GenSigStartValue" SG_ 304 FrntRdrDetn1RdrDetnElevn 15;
BA_ "GenSigSendType" SG_ 304 FrntRdrDetn1RdrDetnElevn 0;
BA_ "GenSigSendType" SG_ 304 FrntRdrDetn1RdrDetnPwr 0;
BA_ "GenSigStartValue" SG_ 304 FrntRdrDetn1RdrDetnRng 10050;
BA_ "GenSigSendType" SG_ 304 FrntRdrDetn1RdrDetnRng 0;
BA_ "GenSigStartValue" SG_ 304 FrntRdrDetn1RdrDetnRngV 4000;
BA_ "GenSigSendType" SG_ 304 FrntRdrDetn1RdrDetnRngV 0;
BA_ "GenSigStartValue" SG_ 304 FrntRdrDetn1RdrDetnSts 3;
BA_ "GenSigSendType" SG_ 304 FrntRdrDetn1RdrDetnSts 0;
BA_ "GenSigStartValue" SG_ 304 FrntRdrDetn2RdrDetnAzi 900;
BA_ "GenSigSendType" SG_ 304 FrntRdrDetn2RdrDetnAzi 0;
BA_ "GenSigSendType" SG_ 304 FrntRdrDetn2RdrDetnChks 0;
BA_ "GenSigFuncType" SG_ 304 FrntRdrDetn2RdrDetnChks 15;
BA_ "GenSigDataID" SG_ 304 FrntRdrDetn2RdrDetnChks "0x709";
BA_ "GenSigSendType" SG_ 304 FrntRdrDetn2RdrDetnCntr 0;
BA_ "GenSigFuncType" SG_ 304 FrntRdrDetn2RdrDetnCntr 16;
BA_ "GenSigSendType" SG_ 304 FrntRdrDetn2RdrDetnConf 0;
BA_ "GenSigStartValue" SG_ 304 FrntRdrDetn2RdrDetnElevn 15;
BA_ "GenSigSendType" SG_ 304 FrntRdrDetn2RdrDetnElevn 0;
BA_ "GenSigSendType" SG_ 304 FrntRdrDetn2RdrDetnPwr 0;
BA_ "GenSigStartValue" SG_ 304 FrntRdrDetn2RdrDetnRng 10050;
BA_ "GenSigSendType" SG_ 304 FrntRdrDetn2RdrDetnRng 0;
BA_ "GenSigStartValue" SG_ 304 FrntRdrDetn2RdrDetnRngV 4000;
BA_ "GenSigSendType" SG_ 304 FrntRdrDetn2RdrDetnRngV 0;
BA_ "GenSigStartValue" SG_ 304 FrntRdrDetn2RdrDetnSts 3;
BA_ "GenSigSendType" SG_ 304 FrntRdrDetn2RdrDetnSts 0;
BA_ "GenSigStartValue" SG_ 304 FrntRdrDetn3RdrDetnAzi 900;
BA_ "GenSigSendType" SG_ 304 FrntRdrDetn3RdrDetnAzi 0;
BA_ "GenSigSendType" SG_ 304 FrntRdrDetn3RdrDetnChks 0;
BA_ "GenSigFuncType" SG_ 304 FrntRdrDetn3RdrDetnChks 15;
BA_ "GenSigDataID" SG_ 304 FrntRdrDetn3RdrDetnChks "0x70A";
BA_ "GenSigSendType" SG_ 304 FrntRdrDetn3RdrDetnCntr 0;
BA_ "GenSigFuncType" SG_ 304 FrntRdrDetn3RdrDetnCntr 16;
BA_ "GenSigSendType" SG_ 304 FrntRdrDetn3RdrDetnConf 0;
BA_ "GenSigStartValue" SG_ 304 FrntRdrDetn3RdrDetnElevn 15;
BA_ "GenSigSendType" SG_ 304 FrntRdrDetn3RdrDetnElevn 0;
BA_ "GenSigSendType" SG_ 304 FrntRdrDetn3RdrDetnPwr 0;
BA_ "GenSigStartValue" SG_ 304 FrntRdrDetn3RdrDetnRng 10050;
BA_ "GenSigSendType" SG_ 304 FrntRdrDetn3RdrDetnRng 0;
BA_ "GenSigStartValue" SG_ 304 FrntRdrDetn3RdrDetnRngV 4000;
BA_ "GenSigSendType" SG_ 304 FrntRdrDetn3RdrDetnRngV 0;
BA_ "GenSigStartValue" SG_ 304 FrntRdrDetn3RdrDetnSts 3;
BA_ "GenSigSendType" SG_ 304 FrntRdrDetn3RdrDetnSts 0;
BA_ "GenSigStartValue" SG_ 304 FrntRdrDetn4RdrDetnAzi 900;
BA_ "GenSigSendType" SG_ 304 FrntRdrDetn4RdrDetnAzi 0;
BA_ "GenSigSendType" SG_ 304 FrntRdrDetn4RdrDetnChks 0;
BA_ "GenSigFuncType" SG_ 304 FrntRdrDetn4RdrDetnChks 15;
BA_ "GenSigDataID" SG_ 304 FrntRdrDetn4RdrDetnChks "0x70B";
BA_ "GenSigSendType" SG_ 304 FrntRdrDetn4RdrDetnCntr 0;
BA_ "GenSigFuncType" SG_ 304 FrntRdrDetn4RdrDetnCntr 16;
BA_ "GenSigSendType" SG_ 304 FrntRdrDetn4RdrDetnConf 0;
BA_ "GenSigStartValue" SG_ 304 FrntRdrDetn4RdrDetnElevn 15;
BA_ "GenSigSendType" SG_ 304 FrntRdrDetn4RdrDetnElevn 0;
BA_ "GenSigSendType" SG_ 304 FrntRdrDetn4RdrDetnPwr 0;
BA_ "GenSigStartValue" SG_ 304 FrntRdrDetn4RdrDetnRng 10050;
BA_ "GenSigSendType" SG_ 304 FrntRdrDetn4RdrDetnRng 0;
BA_ "GenSigStartValue" SG_ 304 FrntRdrDetn4RdrDetnRngV 4000;
BA_ "GenSigSendType" SG_ 304 FrntRdrDetn4RdrDetnRngV 0;
BA_ "GenSigStartValue" SG_ 304 FrntRdrDetn4RdrDetnSts 3;
BA_ "GenSigSendType" SG_ 304 FrntRdrDetn4RdrDetnSts 0;
BA_ "GenSigStartValue" SG_ 304 FrntRdrDetn5RdrDetnAzi 900;
BA_ "GenSigSendType" SG_ 304 FrntRdrDetn5RdrDetnAzi 0;
BA_ "GenSigSendType" SG_ 304 FrntRdrDetn5RdrDetnChks 0;
BA_ "GenSigFuncType" SG_ 304 FrntRdrDetn5RdrDetnChks 15;
BA_ "GenSigDataID" SG_ 304 FrntRdrDetn5RdrDetnChks "0x70C";
BA_ "GenSigSendType" SG_ 304 FrntRdrDetn5RdrDetnCntr 0;
BA_ "GenSigFuncType" SG_ 304 FrntRdrDetn5RdrDetnCntr 16;
BA_ "GenSigSendType" SG_ 304 FrntRdrDetn5RdrDetnConf 0;
BA_ "GenSigStartValue" SG_ 304 FrntRdrDetn5RdrDetnElevn 15;
BA_ "GenSigSendType" SG_ 304 FrntRdrDetn5RdrDetnElevn 0;
BA_ "GenSigSendType" SG_ 304 FrntRdrDetn5RdrDetnPwr 0;
BA_ "GenSigStartValue" SG_ 304 FrntRdrDetn5RdrDetnRng 10050;
BA_ "GenSigSendType" SG_ 304 FrntRdrDetn5RdrDetnRng 0;
BA_ "GenSigStartValue" SG_ 304 FrntRdrDetn5RdrDetnRngV 4000;
BA_ "GenSigSendType" SG_ 304 FrntRdrDetn5RdrDetnRngV 0;
BA_ "GenSigStartValue" SG_ 304 FrntRdrDetn5RdrDetnSts 3;
BA_ "GenSigSendType" SG_ 304 FrntRdrDetn5RdrDetnSts 0;
BA_ "GenSigStartValue" SG_ 304 FrntRdrDetn6RdrDetnAzi 900;
BA_ "GenSigSendType" SG_ 304 FrntRdrDetn6RdrDetnAzi 0;
BA_ "GenSigSendType" SG_ 304 FrntRdrDetn6RdrDetnChks 0;
BA_ "GenSigFuncType" SG_ 304 FrntRdrDetn6RdrDetnChks 15;
BA_ "GenSigDataID" SG_ 304 FrntRdrDetn6RdrDetnChks "0x70D";
BA_ "GenSigSendType" SG_ 304 FrntRdrDetn6RdrDetnCntr 0;
BA_ "GenSigFuncType" SG_ 304 FrntRdrDetn6RdrDetnCntr 16;
BA_ "GenSigSendType" SG_ 304 FrntRdrDetn6RdrDetnConf 0;
BA_ "GenSigStartValue" SG_ 304 FrntRdrDetn6RdrDetnElevn 15;
BA_ "GenSigSendType" SG_ 304 FrntRdrDetn6RdrDetnElevn 0;
BA_ "GenSigSendType" SG_ 304 FrntRdrDetn6RdrDetnPwr 0;
BA_ "GenSigStartValue" SG_ 304 FrntRdrDetn6RdrDetnRng 10050;
BA_ "GenSigSendType" SG_ 304 FrntRdrDetn6RdrDetnRng 0;
BA_ "GenSigStartValue" SG_ 304 FrntRdrDetn6RdrDetnRngV 4000;
BA_ "GenSigSendType" SG_ 304 FrntRdrDetn6RdrDetnRngV 0;
BA_ "GenSigStartValue" SG_ 304 FrntRdrDetn6RdrDetnSts 3;
BA_ "GenSigSendType" SG_ 304 FrntRdrDetn6RdrDetnSts 0;
// Frame: FLRSafetyCANFD2Frame02
BA_ "VFrameFormat" BO_ 306 14;
BA_ "GenMsgSendType" BO_ 306 0;
BA_ "GenMsgCycleTime" BO_ 306 50.000;
BA_ "GenSigStartValue" SG_ 306 FrntRdrDetn10RdrDetnAzi 900;
BA_ "GenSigSendType" SG_ 306 FrntRdrDetn10RdrDetnAzi 0;
BA_ "GenSigSendType" SG_ 306 FrntRdrDetn10RdrDetnChks 0;
BA_ "GenSigFuncType" SG_ 306 FrntRdrDetn10RdrDetnChks 15;
BA_ "GenSigDataID" SG_ 306 FrntRdrDetn10RdrDetnChks "0x711";
BA_ "GenSigSendType" SG_ 306 FrntRdrDetn10RdrDetnCntr 0;
BA_ "GenSigFuncType" SG_ 306 FrntRdrDetn10RdrDetnCntr 16;
BA_ "GenSigSendType" SG_ 306 FrntRdrDetn10RdrDetnConf 0;
BA_ "GenSigStartValue" SG_ 306 FrntRdrDetn10RdrDetnElevn 15;
BA_ "GenSigSendType" SG_ 306 FrntRdrDetn10RdrDetnElevn 0;
BA_ "GenSigSendType" SG_ 306 FrntRdrDetn10RdrDetnPwr 0;
BA_ "GenSigStartValue" SG_ 306 FrntRdrDetn10RdrDetnRng 10050;
BA_ "GenSigSendType" SG_ 306 FrntRdrDetn10RdrDetnRng 0;
BA_ "GenSigStartValue" SG_ 306 FrntRdrDetn10RdrDetnRngV 4000;
BA_ "GenSigSendType" SG_ 306 FrntRdrDetn10RdrDetnRngV 0;
BA_ "GenSigStartValue" SG_ 306 FrntRdrDetn10RdrDetnSts 3;
BA_ "GenSigSendType" SG_ 306 FrntRdrDetn10RdrDetnSts 0;
BA_ "GenSigStartValue" SG_ 306 FrntRdrDetn11RdrDetnAzi 900;
BA_ "GenSigSendType" SG_ 306 FrntRdrDetn11RdrDetnAzi 0;
BA_ "GenSigSendType" SG_ 306 FrntRdrDetn11RdrDetnChks 0;
BA_ "GenSigFuncType" SG_ 306 FrntRdrDetn11RdrDetnChks 15;
BA_ "GenSigDataID" SG_ 306 FrntRdrDetn11RdrDetnChks "0x712";
BA_ "GenSigSendType" SG_ 306 FrntRdrDetn11RdrDetnCntr 0;
BA_ "GenSigFuncType" SG_ 306 FrntRdrDetn11RdrDetnCntr 16;
BA_ "GenSigSendType" SG_ 306 FrntRdrDetn11RdrDetnConf 0;
BA_ "GenSigStartValue" SG_ 306 FrntRdrDetn11RdrDetnElevn 15;
BA_ "GenSigSendType" SG_ 306 FrntRdrDetn11RdrDetnElevn 0;
BA_ "GenSigSendType" SG_ 306 FrntRdrDetn11RdrDetnPwr 0;
BA_ "GenSigStartValue" SG_ 306 FrntRdrDetn11RdrDetnRng 10050;
BA_ "GenSigSendType" SG_ 306 FrntRdrDetn11RdrDetnRng 0;
BA_ "GenSigStartValue" SG_ 306 FrntRdrDetn11RdrDetnRngV 4000;
BA_ "GenSigSendType" SG_ 306 FrntRdrDetn11RdrDetnRngV 0;
BA_ "GenSigStartValue" SG_ 306 FrntRdrDetn11RdrDetnSts 3;
BA_ "GenSigSendType" SG_ 306 FrntRdrDetn11RdrDetnSts 0;
BA_ "GenSigStartValue" SG_ 306 FrntRdrDetn12RdrDetnAzi 900;
BA_ "GenSigSendType" SG_ 306 FrntRdrDetn12RdrDetnAzi 0;
BA_ "GenSigSendType" SG_ 306 FrntRdrDetn12RdrDetnChks 0;
BA_ "GenSigFuncType" SG_ 306 FrntRdrDetn12RdrDetnChks 15;
BA_ "GenSigDataID" SG_ 306 FrntRdrDetn12RdrDetnChks "0x713";
BA_ "GenSigSendType" SG_ 306 FrntRdrDetn12RdrDetnCntr 0;
BA_ "GenSigFuncType" SG_ 306 FrntRdrDetn12RdrDetnCntr 16;
BA_ "GenSigSendType" SG_ 306 FrntRdrDetn12RdrDetnConf 0;
BA_ "GenSigStartValue" SG_ 306 FrntRdrDetn12RdrDetnElevn 15;
BA_ "GenSigSendType" SG_ 306 FrntRdrDetn12RdrDetnElevn 0;
BA_ "GenSigSendType" SG_ 306 FrntRdrDetn12RdrDetnPwr 0;
BA_ "GenSigStartValue" SG_ 306 FrntRdrDetn12RdrDetnRng 10050;
BA_ "GenSigSendType" SG_ 306 FrntRdrDetn12RdrDetnRng 0;
BA_ "GenSigStartValue" SG_ 306 FrntRdrDetn12RdrDetnRngV 4000;
BA_ "GenSigSendType" SG_ 306 FrntRdrDetn12RdrDetnRngV 0;
BA_ "GenSigStartValue" SG_ 306 FrntRdrDetn12RdrDetnSts 3;
BA_ "GenSigSendType" SG_ 306 FrntRdrDetn12RdrDetnSts 0;
BA_ "GenSigStartValue" SG_ 306 FrntRdrDetn7RdrDetnAzi 900;
BA_ "GenSigSendType" SG_ 306 FrntRdrDetn7RdrDetnAzi 0;
BA_ "GenSigSendType" SG_ 306 FrntRdrDetn7RdrDetnChks 0;
BA_ "GenSigFuncType" SG_ 306 FrntRdrDetn7RdrDetnChks 15;
BA_ "GenSigDataID" SG_ 306 FrntRdrDetn7RdrDetnChks "0x70E";
BA_ "GenSigSendType" SG_ 306 FrntRdrDetn7RdrDetnCntr 0;
BA_ "GenSigFuncType" SG_ 306 FrntRdrDetn7RdrDetnCntr 16;
BA_ "GenSigSendType" SG_ 306 FrntRdrDetn7RdrDetnConf 0;
BA_ "GenSigStartValue" SG_ 306 FrntRdrDetn7RdrDetnElevn 15;
BA_ "GenSigSendType" SG_ 306 FrntRdrDetn7RdrDetnElevn 0;
BA_ "GenSigSendType" SG_ 306 FrntRdrDetn7RdrDetnPwr 0;
BA_ "GenSigStartValue" SG_ 306 FrntRdrDetn7RdrDetnRng 10050;
BA_ "GenSigSendType" SG_ 306 FrntRdrDetn7RdrDetnRng 0;
BA_ "GenSigStartValue" SG_ 306 FrntRdrDetn7RdrDetnRngV 4000;
BA_ "GenSigSendType" SG_ 306 FrntRdrDetn7RdrDetnRngV 0;
BA_ "GenSigStartValue" SG_ 306 FrntRdrDetn7RdrDetnSts 3;
BA_ "GenSigSendType" SG_ 306 FrntRdrDetn7RdrDetnSts 0;
BA_ "GenSigStartValue" SG_ 306 FrntRdrDetn8RdrDetnAzi 900;
BA_ "GenSigSendType" SG_ 306 FrntRdrDetn8RdrDetnAzi 0;
BA_ "GenSigSendType" SG_ 306 FrntRdrDetn8RdrDetnChks 0;
BA_ "GenSigFuncType" SG_ 306 FrntRdrDetn8RdrDetnChks 15;
BA_ "GenSigDataID" SG_ 306 FrntRdrDetn8RdrDetnChks "0x70F";
BA_ "GenSigSendType" SG_ 306 FrntRdrDetn8RdrDetnCntr 0;
BA_ "GenSigFuncType" SG_ 306 FrntRdrDetn8RdrDetnCntr 16;
BA_ "GenSigSendType" SG_ 306 FrntRdrDetn8RdrDetnConf 0;
BA_ "GenSigStartValue" SG_ 306 FrntRdrDetn8RdrDetnElevn 15;
BA_ "GenSigSendType" SG_ 306 FrntRdrDetn8RdrDetnElevn 0;
BA_ "GenSigSendType" SG_ 306 FrntRdrDetn8RdrDetnPwr 0;
BA_ "GenSigStartValue" SG_ 306 FrntRdrDetn8RdrDetnRng 10050;
BA_ "GenSigSendType" SG_ 306 FrntRdrDetn8RdrDetnRng 0;
BA_ "GenSigStartValue" SG_ 306 FrntRdrDetn8RdrDetnRngV 4000;
BA_ "GenSigSendType" SG_ 306 FrntRdrDetn8RdrDetnRngV 0;
BA_ "GenSigStartValue" SG_ 306 FrntRdrDetn8RdrDetnSts 3;
BA_ "GenSigSendType" SG_ 306 FrntRdrDetn8RdrDetnSts 0;
BA_ "GenSigStartValue" SG_ 306 FrntRdrDetn9RdrDetnAzi 900;
BA_ "GenSigSendType" SG_ 306 FrntRdrDetn9RdrDetnAzi 0;
BA_ "GenSigSendType" SG_ 306 FrntRdrDetn9RdrDetnChks 0;
BA_ "GenSigFuncType" SG_ 306 FrntRdrDetn9RdrDetnChks 15;
BA_ "GenSigDataID" SG_ 306 FrntRdrDetn9RdrDetnChks "0x710";
BA_ "GenSigSendType" SG_ 306 FrntRdrDetn9RdrDetnCntr 0;
BA_ "GenSigFuncType" SG_ 306 FrntRdrDetn9RdrDetnCntr 16;
BA_ "GenSigSendType" SG_ 306 FrntRdrDetn9RdrDetnConf 0;
BA_ "GenSigStartValue" SG_ 306 FrntRdrDetn9RdrDetnElevn 15;
BA_ "GenSigSendType" SG_ 306 FrntRdrDetn9RdrDetnElevn 0;
BA_ "GenSigSendType" SG_ 306 FrntRdrDetn9RdrDetnPwr 0;
BA_ "GenSigStartValue" SG_ 306 FrntRdrDetn9RdrDetnRng 10050;
BA_ "GenSigSendType" SG_ 306 FrntRdrDetn9RdrDetnRng 0;
BA_ "GenSigStartValue" SG_ 306 FrntRdrDetn9RdrDetnRngV 4000;
BA_ "GenSigSendType" SG_ 306 FrntRdrDetn9RdrDetnRngV 0;
BA_ "GenSigStartValue" SG_ 306 FrntRdrDetn9RdrDetnSts 3;
BA_ "GenSigSendType" SG_ 306 FrntRdrDetn9RdrDetnSts 0;
// Frame: FLRSafetyCANFD2Frame03
BA_ "VFrameFormat" BO_ 308 14;
BA_ "GenMsgSendType" BO_ 308 0;
BA_ "GenMsgCycleTime" BO_ 308 50.000;
BA_ "GenSigStartValue" SG_ 308 FrntRdrDetn13RdrDetnAzi 900;
BA_ "GenSigSendType" SG_ 308 FrntRdrDetn13RdrDetnAzi 0;
BA_ "GenSigSendType" SG_ 308 FrntRdrDetn13RdrDetnChks 0;
BA_ "GenSigFuncType" SG_ 308 FrntRdrDetn13RdrDetnChks 15;
BA_ "GenSigDataID" SG_ 308 FrntRdrDetn13RdrDetnChks "0x714";
BA_ "GenSigSendType" SG_ 308 FrntRdrDetn13RdrDetnCntr 0;
BA_ "GenSigFuncType" SG_ 308 FrntRdrDetn13RdrDetnCntr 16;
BA_ "GenSigSendType" SG_ 308 FrntRdrDetn13RdrDetnConf 0;
BA_ "GenSigStartValue" SG_ 308 FrntRdrDetn13RdrDetnElevn 15;
BA_ "GenSigSendType" SG_ 308 FrntRdrDetn13RdrDetnElevn 0;
BA_ "GenSigSendType" SG_ 308 FrntRdrDetn13RdrDetnPwr 0;
BA_ "GenSigStartValue" SG_ 308 FrntRdrDetn13RdrDetnRng 10050;
BA_ "GenSigSendType" SG_ 308 FrntRdrDetn13RdrDetnRng 0;
BA_ "GenSigStartValue" SG_ 308 FrntRdrDetn13RdrDetnRngV 4000;
BA_ "GenSigSendType" SG_ 308 FrntRdrDetn13RdrDetnRngV 0;
BA_ "GenSigStartValue" SG_ 308 FrntRdrDetn13RdrDetnSts 3;
BA_ "GenSigSendType" SG_ 308 FrntRdrDetn13RdrDetnSts 0;
BA_ "GenSigStartValue" SG_ 308 FrntRdrDetn14RdrDetnAzi 900;
BA_ "GenSigSendType" SG_ 308 FrntRdrDetn14RdrDetnAzi 0;
BA_ "GenSigSendType" SG_ 308 FrntRdrDetn14RdrDetnChks 0;
BA_ "GenSigFuncType" SG_ 308 FrntRdrDetn14RdrDetnChks 15;
BA_ "GenSigDataID" SG_ 308 FrntRdrDetn14RdrDetnChks "0x715";
BA_ "GenSigSendType" SG_ 308 FrntRdrDetn14RdrDetnCntr 0;
BA_ "GenSigFuncType" SG_ 308 FrntRdrDetn14RdrDetnCntr 16;
BA_ "GenSigSendType" SG_ 308 FrntRdrDetn14RdrDetnConf 0;
BA_ "GenSigStartValue" SG_ 308 FrntRdrDetn14RdrDetnElevn 15;
BA_ "GenSigSendType" SG_ 308 FrntRdrDetn14RdrDetnElevn 0;
BA_ "GenSigSendType" SG_ 308 FrntRdrDetn14RdrDetnPwr 0;
BA_ "GenSigStartValue" SG_ 308 FrntRdrDetn14RdrDetnRng 10050;
BA_ "GenSigSendType" SG_ 308 FrntRdrDetn14RdrDetnRng 0;
BA_ "GenSigStartValue" SG_ 308 FrntRdrDetn14RdrDetnRngV 4000;
BA_ "GenSigSendType" SG_ 308 FrntRdrDetn14RdrDetnRngV 0;
BA_ "GenSigStartValue" SG_ 308 FrntRdrDetn14RdrDetnSts 3;
BA_ "GenSigSendType" SG_ 308 FrntRdrDetn14RdrDetnSts 0;
BA_ "GenSigStartValue" SG_ 308 FrntRdrDetn15RdrDetnAzi 900;
BA_ "GenSigSendType" SG_ 308 FrntRdrDetn15RdrDetnAzi 0;
BA_ "GenSigSendType" SG_ 308 FrntRdrDetn15RdrDetnChks 0;
BA_ "GenSigFuncType" SG_ 308 FrntRdrDetn15RdrDetnChks 15;
BA_ "GenSigDataID" SG_ 308 FrntRdrDetn15RdrDetnChks "0x716";
BA_ "GenSigSendType" SG_ 308 FrntRdrDetn15RdrDetnCntr 0;
BA_ "GenSigFuncType" SG_ 308 FrntRdrDetn15RdrDetnCntr 16;
BA_ "GenSigSendType" SG_ 308 FrntRdrDetn15RdrDetnConf 0;
BA_ "GenSigStartValue" SG_ 308 FrntRdrDetn15RdrDetnElevn 15;
BA_ "GenSigSendType" SG_ 308 FrntRdrDetn15RdrDetnElevn 0;
BA_ "GenSigSendType" SG_ 308 FrntRdrDetn15RdrDetnPwr 0;
BA_ "GenSigStartValue" SG_ 308 FrntRdrDetn15RdrDetnRng 10050;
BA_ "GenSigSendType" SG_ 308 FrntRdrDetn15RdrDetnRng 0;
BA_ "GenSigStartValue" SG_ 308 FrntRdrDetn15RdrDetnRngV 4000;
BA_ "GenSigSendType" SG_ 308 FrntRdrDetn15RdrDetnRngV 0;
BA_ "GenSigStartValue" SG_ 308 FrntRdrDetn15RdrDetnSts 3;
BA_ "GenSigSendType" SG_ 308 FrntRdrDetn15RdrDetnSts 0;
BA_ "GenSigStartValue" SG_ 308 FrntRdrDetn16RdrDetnAzi 900;
BA_ "GenSigSendType" SG_ 308 FrntRdrDetn16RdrDetnAzi 0;
BA_ "GenSigSendType" SG_ 308 FrntRdrDetn16RdrDetnChks 0;
BA_ "GenSigFuncType" SG_ 308 FrntRdrDetn16RdrDetnChks 15;
BA_ "GenSigDataID" SG_ 308 FrntRdrDetn16RdrDetnChks "0x717";
BA_ "GenSigSendType" SG_ 308 FrntRdrDetn16RdrDetnCntr 0;
BA_ "GenSigFuncType" SG_ 308 FrntRdrDetn16RdrDetnCntr 16;
BA_ "GenSigSendType" SG_ 308 FrntRdrDetn16RdrDetnConf 0;
BA_ "GenSigStartValue" SG_ 308 FrntRdrDetn16RdrDetnElevn 15;
BA_ "GenSigSendType" SG_ 308 FrntRdrDetn16RdrDetnElevn 0;
BA_ "GenSigSendType" SG_ 308 FrntRdrDetn16RdrDetnPwr 0;
BA_ "GenSigStartValue" SG_ 308 FrntRdrDetn16RdrDetnRng 10050;
BA_ "GenSigSendType" SG_ 308 FrntRdrDetn16RdrDetnRng 0;
BA_ "GenSigStartValue" SG_ 308 FrntRdrDetn16RdrDetnRngV 4000;
BA_ "GenSigSendType" SG_ 308 FrntRdrDetn16RdrDetnRngV 0;
BA_ "GenSigStartValue" SG_ 308 FrntRdrDetn16RdrDetnSts 3;
BA_ "GenSigSendType" SG_ 308 FrntRdrDetn16RdrDetnSts 0;
BA_ "GenSigStartValue" SG_ 308 FrntRdrDetn17RdrDetnAzi 900;
BA_ "GenSigSendType" SG_ 308 FrntRdrDetn17RdrDetnAzi 0;
BA_ "GenSigSendType" SG_ 308 FrntRdrDetn17RdrDetnChks 0;
BA_ "GenSigFuncType" SG_ 308 FrntRdrDetn17RdrDetnChks 15;
BA_ "GenSigDataID" SG_ 308 FrntRdrDetn17RdrDetnChks "0x718";
BA_ "GenSigSendType" SG_ 308 FrntRdrDetn17RdrDetnCntr 0;
BA_ "GenSigFuncType" SG_ 308 FrntRdrDetn17RdrDetnCntr 16;
BA_ "GenSigSendType" SG_ 308 FrntRdrDetn17RdrDetnConf 0;
BA_ "GenSigStartValue" SG_ 308 FrntRdrDetn17RdrDetnElevn 15;
BA_ "GenSigSendType" SG_ 308 FrntRdrDetn17RdrDetnElevn 0;
BA_ "GenSigSendType" SG_ 308 FrntRdrDetn17RdrDetnPwr 0;
BA_ "GenSigStartValue" SG_ 308 FrntRdrDetn17RdrDetnRng 10050;
BA_ "GenSigSendType" SG_ 308 FrntRdrDetn17RdrDetnRng 0;
BA_ "GenSigStartValue" SG_ 308 FrntRdrDetn17RdrDetnRngV 4000;
BA_ "GenSigSendType" SG_ 308 FrntRdrDetn17RdrDetnRngV 0;
BA_ "GenSigStartValue" SG_ 308 FrntRdrDetn17RdrDetnSts 3;
BA_ "GenSigSendType" SG_ 308 FrntRdrDetn17RdrDetnSts 0;
BA_ "GenSigStartValue" SG_ 308 FrntRdrDetn18RdrDetnAzi 900;
BA_ "GenSigSendType" SG_ 308 FrntRdrDetn18RdrDetnAzi 0;
BA_ "GenSigSendType" SG_ 308 FrntRdrDetn18RdrDetnChks 0;
BA_ "GenSigFuncType" SG_ 308 FrntRdrDetn18RdrDetnChks 15;
BA_ "GenSigDataID" SG_ 308 FrntRdrDetn18RdrDetnChks "0x719";
BA_ "GenSigSendType" SG_ 308 FrntRdrDetn18RdrDetnCntr 0;
BA_ "GenSigFuncType" SG_ 308 FrntRdrDetn18RdrDetnCntr 16;
BA_ "GenSigSendType" SG_ 308 FrntRdrDetn18RdrDetnConf 0;
BA_ "GenSigStartValue" SG_ 308 FrntRdrDetn18RdrDetnElevn 15;
BA_ "GenSigSendType" SG_ 308 FrntRdrDetn18RdrDetnElevn 0;
BA_ "GenSigSendType" SG_ 308 FrntRdrDetn18RdrDetnPwr 0;
BA_ "GenSigStartValue" SG_ 308 FrntRdrDetn18RdrDetnRng 10050;
BA_ "GenSigSendType" SG_ 308 FrntRdrDetn18RdrDetnRng 0;
BA_ "GenSigStartValue" SG_ 308 FrntRdrDetn18RdrDetnRngV 4000;
BA_ "GenSigSendType" SG_ 308 FrntRdrDetn18RdrDetnRngV 0;
BA_ "GenSigStartValue" SG_ 308 FrntRdrDetn18RdrDetnSts 3;
BA_ "GenSigSendType" SG_ 308 FrntRdrDetn18RdrDetnSts 0;

VAL_ 24 PrimADataCompALat1Qf 0 "Qf1_DevOfDataUndefd" 1 "Qf1_DataTmpUndefdAndEvlnInProgs" 2 "Qf1_DevOfDataNotWithinRngAllwd" 3 "Qf1_DataCalcdWithDevDefd";
VAL_ 24 PrimADataCompALgt1Qf 0 "Qf1_DevOfDataUndefd" 1 "Qf1_DataTmpUndefdAndEvlnInProgs" 2 "Qf1_DevOfDataNotWithinRngAllwd" 3 "Qf1_DataCalcdWithDevDefd";
VAL_ 24 PrimADataCompAVertQf 0 "Qf1_DevOfDataUndefd" 1 "Qf1_DataTmpUndefdAndEvlnInProgs" 2 "Qf1_DevOfDataNotWithinRngAllwd" 3 "Qf1_DataCalcdWithDevDefd";
VAL_ 24 PrimAgDataCompRollRateQf 0 "Qf1_DevOfDataUndefd" 1 "Qf1_DataTmpUndefdAndEvlnInProgs" 2 "Qf1_DevOfDataNotWithinRngAllwd" 3 "Qf1_DataCalcdWithDevDefd";
VAL_ 24 PrimAgDataCompYawRateQf 0 "Qf1_DevOfDataUndefd" 1 "Qf1_DataTmpUndefdAndEvlnInProgs" 2 "Qf1_DevOfDataNotWithinRngAllwd" 3 "Qf1_DataCalcdWithDevDefd";
VAL_ 24 PrimChStsADModeAvtn 0 "ReqSts1_NotReqd" 1 "ReqSts1_Reqd";
VAL_ 24 PrimChStsADModeAvtnCfm 0 "Cfmd1_NotCfmd" 1 "Cfmd1_Cfmd";
VAL_ 24 PrimChStsADModeDeavtn 0 "ReqSts1_NotReqd" 1 "ReqSts1_Reqd";
VAL_ 24 PrimChStsADModeDeavtnCfm 0 "Cfmd1_NotCfmd" 1 "Cfmd1_Cfmd";
VAL_ 24 PrimChStsChanlSts 0 "DataQf_NotOk" 1 "DataQf_Ok";
VAL_ 24 PrimChStsCtrlrSts 0 "DataQf_NotOk" 1 "DataQf_Ok";
VAL_ 24 PrimChStsLatADAvtn 0 "ReqSts1_NotReqd" 1 "ReqSts1_Reqd";
VAL_ 24 PrimChStsLatADAvtnCfm 0 "Cfmd1_NotCfmd" 1 "Cfmd1_Cfmd";
VAL_ 24 PrimChStsLatSts 0 "DataQf_NotOk" 1 "DataQf_Ok";
VAL_ 24 PrimChStsLgtADAvtn 0 "ReqSts1_NotReqd" 1 "ReqSts1_Reqd";
VAL_ 24 PrimChStsLgtADAvtnCfm 0 "Cfmd1_NotCfmd" 1 "Cfmd1_Cfmd";
VAL_ 24 PrimChStsLgtSts 0 "DataQf_NotOk" 1 "DataQf_Ok";
VAL_ 24 PrimChStsReserved1 0 "ReqSts1_NotReqd" 1 "ReqSts1_Reqd";
VAL_ 24 PrimChStsReserved2 0 "ReqSts1_NotReqd" 1 "ReqSts1_Reqd";
VAL_ 24 PrimChStsReserved3 0 "ReqSts1_NotReqd" 1 "ReqSts1_Reqd";
VAL_ 24 PrimChStsSafeStop 0 "Inact_Inactive" 1 "Inact_Active";
VAL_ 24 PrimVehVCompVehVLatQf 0 "GenQf1_UndefindDataAccur" 1 "GenQf1_TmpUndefdData" 2 "GenQf1_DataAccurNotWithinSpcn" 3 "GenQf1_AccurData";
VAL_ 24 PrimVehVCompVehVLgtQf 0 "GenQf1_UndefindDataAccur" 1 "GenQf1_TmpUndefdData" 2 "GenQf1_DataAccurNotWithinSpcn" 3 "GenQf1_AccurData";
VAL_ 288 ADataRawSafeALat1Qf 0 "Qf1_DevOfDataUndefd" 1 "Qf1_DataTmpUndefdAndEvlnInProgs" 2 "Qf1_DevOfDataNotWithinRngAllwd" 3 "Qf1_DataCalcdWithDevDefd";
VAL_ 288 ADataRawSafeALgt1Qf 0 "Qf1_DevOfDataUndefd" 1 "Qf1_DataTmpUndefdAndEvlnInProgs" 2 "Qf1_DevOfDataNotWithinRngAllwd" 3 "Qf1_DataCalcdWithDevDefd";
VAL_ 288 ADataRawSafeAVertQf 0 "Qf1_DevOfDataUndefd" 1 "Qf1_DataTmpUndefdAndEvlnInProgs" 2 "Qf1_DevOfDataNotWithinRngAllwd" 3 "Qf1_DataCalcdWithDevDefd";
VAL_ 288 ALgtStdFromWhlSpdQf 0 "GenQf1_UndefindDataAccur" 1 "GenQf1_TmpUndefdData" 2 "GenQf1_DataAccurNotWithinSpcn" 3 "GenQf1_AccurData";
VAL_ 288 AmbTRawQly 0 "GenQf1_UndefindDataAccur" 1 "GenQf1_TmpUndefdData" 2 "GenQf1_DataAccurNotWithinSpcn" 3 "GenQf1_AccurData";
VAL_ 288 AsyDataWithCmpSafeALat1Qf 0 "Qf1_DevOfDataUndefd" 1 "Qf1_DataTmpUndefdAndEvlnInProgs" 2 "Qf1_DevOfDataNotWithinRngAllwd" 3 "Qf1_DataCalcdWithDevDefd";
VAL_ 288 AsyDataWithCmpSafeALgt1Qf 0 "Qf1_DevOfDataUndefd" 1 "Qf1_DataTmpUndefdAndEvlnInProgs" 2 "Qf1_DevOfDataNotWithinRngAllwd" 3 "Qf1_DataCalcdWithDevDefd";
VAL_ 288 AsyDataWithCmpSafeYawRateQf 0 "Qf1_DevOfDataUndefd" 1 "Qf1_DataTmpUndefdAndEvlnInProgs" 2 "Qf1_DevOfDataNotWithinRngAllwd" 3 "Qf1_DataCalcdWithDevDefd";
VAL_ 288 DrvModReq 0 "DrvModReqType1_Undefd" 1 "DrvModReqType1_ECO" 2 "DrvModReqType1_Comfort_Normal" 3 "DrvModReqType1_Dynamic_Sport" 4 "DrvModReqType1_Individual" 5 "DrvModReqType1_Offroad_CrossTerrain" 6 "DrvModReqType1_AWD" 7 "DrvModReqType1_Race" 8 "DrvModReqType1_Pure_EV" 9 "DrvModReqType1_Hybrid" 10 "DrvModReqType1_Power" 11 "DrvModReqType1_Snow" 12 "DrvModReqType1_Sand" 13 "DrvModReqType1_Mud" 14 "DrvModReqType1_Rock" 15 "DrvModReqType1_Err";
VAL_ 288 PinionSteerAgGroupPinionSteerAg1Qf 0 "GenQf1_UndefindDataAccur" 1 "GenQf1_TmpUndefdData" 2 "GenQf1_DataAccurNotWithinSpcn" 3 "GenQf1_AccurData";
VAL_ 288 PinionSteerAgGroupPinionSteerAgSpd1Qf 0 "GenQf1_UndefindDataAccur" 1 "GenQf1_TmpUndefdData" 2 "GenQf1_DataAccurNotWithinSpcn" 3 "GenQf1_AccurData";
VAL_ 288 PinionSteerAgGroupSteerWhlTqQf 0 "GenQf1_UndefindDataAccur" 1 "GenQf1_TmpUndefdData" 2 "GenQf1_DataAccurNotWithinSpcn" 3 "GenQf1_AccurData";
VAL_ 288 SteerWhlSnsrQf 0 "GenQf1_UndefindDataAccur" 1 "GenQf1_TmpUndefdData" 2 "GenQf1_DataAccurNotWithinSpcn" 3 "GenQf1_AccurData";
VAL_ 288 VehBattUSysUQf 0 "GenQf1_UndefindDataAccur" 1 "GenQf1_TmpUndefdData" 2 "GenQf1_DataAccurNotWithinSpcn" 3 "GenQf1_AccurData";
VAL_ 288 VehModMngtGlbSafe1CarModSts1 0 "CarModSts1_CarModNorm" 1 "CarModSts1_CarModTrnsp" 2 "CarModSts1_CarModFcy" 3 "CarModSts1_CarModCrash" 5 "CarModSts1_CarModDyno";
VAL_ 288 VehModMngtGlbSafe1FltEgyCnsWdSts 0 "FltEgyCns1_NoFlt" 1 "FltEgyCns1_Flt";
VAL_ 288 VehModMngtGlbSafe1UsgModSts 0 "UsgModSts1_UsgModAbdnd" 1 "UsgModSts1_UsgModInActv" 2 "UsgModSts1_UsgModCnvinc" 11 "UsgModSts1_UsgModActv" 13 "UsgModSts1_UsgModDrvg";
VAL_ 288 VehMtnStVehMtnSt 0 "VehMtnSt2_Ukwn" 1 "VehMtnSt2_StandStillVal1" 2 "VehMtnSt2_StandStillVal2" 3 "VehMtnSt2_StandStillVal3" 4 "VehMtnSt2_RollgFwdVal1" 5 "VehMtnSt2_RollgFwdVal2" 6 "VehMtnSt2_RollgBackwVal1" 7 "VehMtnSt2_RollgBackwVal2";
VAL_ 288 VehSpdLgtQf 0 "GenQf1_UndefindDataAccur" 1 "GenQf1_TmpUndefdData" 2 "GenQf1_DataAccurNotWithinSpcn" 3 "GenQf1_AccurData";
VAL_ 288 WipgInfoWipgSpdInfo 0 "WipgSpdInfo_Off" 1 "WipgSpdInfo_IntlLo" 2 "WipgSpdInfo_IntlHi" 3 "WipgSpdInfo_WipgSpd4045" 4 "WipgSpdInfo_WipgSpd4650" 5 "WipgSpdInfo_WipgSpd5155" 6 "WipgSpdInfo_WipgSpd5660" 7 "WipgSpdInfo_WiprErr";
VAL_ 288 WipgInfoWiprActv 0 "OnOff1_Off" 1 "OnOff1_On";
VAL_ 288 WipgInfoWiprInWipgAr 0 "OnOff1_Off" 1 "OnOff1_On";
VAL_ 1007 FrntRdrVehPrmRdrVehPrmRdrDynCalPrmForSnsrDir 0 "YesNo2_No" 1 "YesNo2_Yes";
VAL_ 1007 FrntRdrVehPrmRdrVehPrmRdrDynCalPrmForSnsrOrntn 0 "YesNo2_No" 1 "YesNo2_Yes";
VAL_ 1007 FrntRdrVehPrmRdrVehPrmVld 0 "YesNo2_No" 1 "YesNo2_Yes";
VAL_ 16 BrkPedlTrvlQf 0 "GenQf1_UndefindDataAccur" 1 "GenQf1_TmpUndefdData" 2 "GenQf1_DataAccurNotWithinSpcn" 3 "GenQf1_AccurData";
VAL_ 16 BrkPedlTrvlSt 0 "PsdNotPsd_NotPsd" 1 "PsdNotPsd_Psd";
VAL_ 16 BrkPedlTrvlStQf 0 "GenQf1_UndefindDataAccur" 1 "GenQf1_TmpUndefdData" 2 "GenQf1_DataAccurNotWithinSpcn" 3 "GenQf1_AccurData";
VAL_ 16 DrvBrkReqDmat 0 "Boolean_FALSE" 1 "Boolean_TRUE";
VAL_ 16 PinionSteerAgGroupForBkpPinionSteerAgQfForBkp 0 "GenQf1_UndefindDataAccur" 1 "GenQf1_TmpUndefdData" 2 "GenQf1_DataAccurNotWithinSpcn" 3 "GenQf1_AccurData";
VAL_ 16 PinionSteerAgGroupForBkpPinionSteerAgSpdQfForBkp 0 "GenQf1_UndefindDataAccur" 1 "GenQf1_TmpUndefdData" 2 "GenQf1_DataAccurNotWithinSpcn" 3 "GenQf1_AccurData";
VAL_ 16 PinionSteerAgGroupForBkpSteerWhlTqQfForBkp 0 "GenQf1_UndefindDataAccur" 1 "GenQf1_TmpUndefdData" 2 "GenQf1_DataAccurNotWithinSpcn" 3 "GenQf1_AccurData";
VAL_ 16 SecChStsADModeAvtn 0 "ReqSts1_NotReqd" 1 "ReqSts1_Reqd";
VAL_ 16 SecChStsADModeAvtnCfm 0 "Cfmd1_NotCfmd" 1 "Cfmd1_Cfmd";
VAL_ 16 SecChStsADModeDeavtn 0 "ReqSts1_NotReqd" 1 "ReqSts1_Reqd";
VAL_ 16 SecChStsADModeDeavtnCfm 0 "Cfmd1_NotCfmd" 1 "Cfmd1_Cfmd";
VAL_ 16 SecChStsChanlSts 0 "DataQf_NotOk" 1 "DataQf_Ok";
VAL_ 16 SecChStsCtrlrSts 0 "DataQf_NotOk" 1 "DataQf_Ok";
VAL_ 16 SecChStsLatADAvtn 0 "ReqSts1_NotReqd" 1 "ReqSts1_Reqd";
VAL_ 16 SecChStsLatADAvtnCfm 0 "Cfmd1_NotCfmd" 1 "Cfmd1_Cfmd";
VAL_ 16 SecChStsLatSts 0 "DataQf_NotOk" 1 "DataQf_Ok";
VAL_ 16 SecChStsLgtADAvtn 0 "ReqSts1_NotReqd" 1 "ReqSts1_Reqd";
VAL_ 16 SecChStsLgtADAvtnCfm 0 "Cfmd1_NotCfmd" 1 "Cfmd1_Cfmd";
VAL_ 16 SecChStsLgtSts 0 "DataQf_NotOk" 1 "DataQf_Ok";
VAL_ 16 SecChStsReserved1 0 "ReqSts1_NotReqd" 1 "ReqSts1_Reqd";
VAL_ 16 SecChStsReserved2 0 "ReqSts1_NotReqd" 1 "ReqSts1_Reqd";
VAL_ 16 SecChStsReserved3 0 "ReqSts1_NotReqd" 1 "ReqSts1_Reqd";
VAL_ 16 SecChStsSafeStop 0 "Inact_Inactive" 1 "Inact_Active";
VAL_ 16 VehMtnStForBkpVehMtnSt 0 "VehMtnSt2_Ukwn" 1 "VehMtnSt2_StandStillVal1" 2 "VehMtnSt2_StandStillVal2" 3 "VehMtnSt2_StandStillVal3" 4 "VehMtnSt2_RollgFwdVal1" 5 "VehMtnSt2_RollgFwdVal2" 6 "VehMtnSt2_RollgBackwVal1" 7 "VehMtnSt2_RollgBackwVal2";
VAL_ 16 VehSpdLgtForBkpVehSpdLgtQf 0 "GenQf1_UndefindDataAccur" 1 "GenQf1_TmpUndefdData" 2 "GenQf1_DataAccurNotWithinSpcn" 3 "GenQf1_AccurData";
VAL_ 16 WhlDirRotlFrntForBkpLe 0 "WhlRotlDirStd1_Undefd" 1 "WhlRotlDirStd1_StandStill" 2 "WhlRotlDirStd1_Fwd" 3 "WhlRotlDirStd1_Backw";
VAL_ 16 WhlDirRotlFrntForBkpRi 0 "WhlRotlDirStd1_Undefd" 1 "WhlRotlDirStd1_StandStill" 2 "WhlRotlDirStd1_Fwd" 3 "WhlRotlDirStd1_Backw";
VAL_ 16 WhlDirRotlReForBkpLe 0 "WhlRotlDirStd1_Undefd" 1 "WhlRotlDirStd1_StandStill" 2 "WhlRotlDirStd1_Fwd" 3 "WhlRotlDirStd1_Backw";
VAL_ 16 WhlDirRotlReForBkpRi 0 "WhlRotlDirStd1_Undefd" 1 "WhlRotlDirStd1_StandStill" 2 "WhlRotlDirStd1_Fwd" 3 "WhlRotlDirStd1_Backw";
VAL_ 16 WhlSpdCircumlFrntForBkpWhlSpdCircumlFrntLeQf 0 "GenQf1_UndefindDataAccur" 1 "GenQf1_TmpUndefdData" 2 "GenQf1_DataAccurNotWithinSpcn" 3 "GenQf1_AccurData";
VAL_ 16 WhlSpdCircumlFrntForBkpWhlSpdCircumlFrntRiQf 0 "GenQf1_UndefindDataAccur" 1 "GenQf1_TmpUndefdData" 2 "GenQf1_DataAccurNotWithinSpcn" 3 "GenQf1_AccurData";
VAL_ 16 WhlSpdCircumlReForBkpWhlSpdCircumlReLeQf 0 "GenQf1_UndefindDataAccur" 1 "GenQf1_TmpUndefdData" 2 "GenQf1_DataAccurNotWithinSpcn" 3 "GenQf1_AccurData";
VAL_ 16 WhlSpdCircumlReForBkpWhlSpdCircumlReRiQf 0 "GenQf1_UndefindDataAccur" 1 "GenQf1_TmpUndefdData" 2 "GenQf1_DataAccurNotWithinSpcn" 3 "GenQf1_AccurData";
VAL_ 16 WhlVAgrFrntForBkpWhlVAgrFrntLeQf 0 "GenQf1_UndefindDataAccur" 1 "GenQf1_TmpUndefdData" 2 "GenQf1_DataAccurNotWithinSpcn" 3 "GenQf1_AccurData";
VAL_ 16 WhlVAgrFrntForBkpWhlVAgrFrntRiQf 0 "GenQf1_UndefindDataAccur" 1 "GenQf1_TmpUndefdData" 2 "GenQf1_DataAccurNotWithinSpcn" 3 "GenQf1_AccurData";
VAL_ 16 WhlVAgrReForBkpWhlVAgrReLeQf 0 "GenQf1_UndefindDataAccur" 1 "GenQf1_TmpUndefdData" 2 "GenQf1_DataAccurNotWithinSpcn" 3 "GenQf1_AccurData";
VAL_ 16 WhlVAgrReForBkpWhlVAgrReRiQf 0 "GenQf1_UndefindDataAccur" 1 "GenQf1_TmpUndefdData" 2 "GenQf1_DataAccurNotWithinSpcn" 3 "GenQf1_AccurData";
VAL_ 297 FrntRdrStsForDim 0 "RsdsMstSt_Cfg" 1 "RsdsMstSt_StrtUp" 2 "RsdsMstSt_Runng" 3 "RsdsMstSt_Blkd" 4 "RsdsMstSt_Faulty" 5 "RsdsMstSt_Shutdown" 6 "RsdsMstSt_Hot" 7 "RsdsMstSt_Cal";
VAL_ 297 FrntRdrStsRdrStsBlkd0bin 0 "YesNo2_No" 1 "YesNo2_Yes";
VAL_ 297 FrntRdrStsRdrStsEna 0 "YesNo2_No" 1 "YesNo2_Yes";
VAL_ 297 FrntRdrStsRdrStsFaulty 0 "YesNo2_No" 1 "YesNo2_Yes";
VAL_ 297 FrntRdrStsRdrStsMisAlign 0 "MisAlign_Unknown" 1 "MisAlign_RadarIsFullyCalibrated" 2 "MisAlign_RadarMisalignmentDetected" 3 "MisAlign_RadarCalibrationInProgress" 4 "MisAlign_RadarIsCompletelyMisalignedAndNotPossibleToCalibrateIt" 5 "MisAlign_Reserved1" 6 "MisAlign_Reserved2" 7 "MisAlign_Reserved3";
VAL_ 297 FrntRdrStsRdrStsMissCom 0 "YesNo2_No" 1 "YesNo2_Yes";
VAL_ 297 FrntRdrStsRdrStsSftyFlt 0 "SftyFlt_Undefined" 1 "SftyFlt_NoSafetyFault" 2 "SftyFlt_SafetyFault" 3 "SftyFlt_Reserved";
VAL_ 297 FrntRdrStsRdrStsTiStampStsGlbTiBas 0 "YesNo2_No" 1 "YesNo2_Yes";
VAL_ 297 FrntRdrStsRdrStsTiStampStsSyncToGatewy 0 "YesNo2_No" 1 "YesNo2_Yes";
VAL_ 297 FrntRdrStsRdrStsTiStampStsTiLeap 0 "YesNo2_No" 1 "YesNo2_Yes";
VAL_ 297 FrntRdrStsRdrStsTiStampStsTiOut 0 "YesNo2_No" 1 "YesNo2_Yes";
VAL_ 304 FrntRdrDetn1RdrDetnSts 0 "RdrDetnSts_Ukwn" 1 "RdrDetnSts_Movg" 2 "RdrDetnSts_Staty" 3 "RdrDetnSts_Invalid";
VAL_ 304 FrntRdrDetn2RdrDetnSts 0 "RdrDetnSts_Ukwn" 1 "RdrDetnSts_Movg" 2 "RdrDetnSts_Staty" 3 "RdrDetnSts_Invalid";
VAL_ 304 FrntRdrDetn3RdrDetnSts 0 "RdrDetnSts_Ukwn" 1 "RdrDetnSts_Movg" 2 "RdrDetnSts_Staty" 3 "RdrDetnSts_Invalid";
VAL_ 304 FrntRdrDetn4RdrDetnSts 0 "RdrDetnSts_Ukwn" 1 "RdrDetnSts_Movg" 2 "RdrDetnSts_Staty" 3 "RdrDetnSts_Invalid";
VAL_ 304 FrntRdrDetn5RdrDetnSts 0 "RdrDetnSts_Ukwn" 1 "RdrDetnSts_Movg" 2 "RdrDetnSts_Staty" 3 "RdrDetnSts_Invalid";
VAL_ 304 FrntRdrDetn6RdrDetnSts 0 "RdrDetnSts_Ukwn" 1 "RdrDetnSts_Movg" 2 "RdrDetnSts_Staty" 3 "RdrDetnSts_Invalid";
VAL_ 306 FrntRdrDetn10RdrDetnSts 0 "RdrDetnSts_Ukwn" 1 "RdrDetnSts_Movg" 2 "RdrDetnSts_Staty" 3 "RdrDetnSts_Invalid";
VAL_ 306 FrntRdrDetn11RdrDetnSts 0 "RdrDetnSts_Ukwn" 1 "RdrDetnSts_Movg" 2 "RdrDetnSts_Staty" 3 "RdrDetnSts_Invalid";
VAL_ 306 FrntRdrDetn12RdrDetnSts 0 "RdrDetnSts_Ukwn" 1 "RdrDetnSts_Movg" 2 "RdrDetnSts_Staty" 3 "RdrDetnSts_Invalid";
VAL_ 306 FrntRdrDetn7RdrDetnSts 0 "RdrDetnSts_Ukwn" 1 "RdrDetnSts_Movg" 2 "RdrDetnSts_Staty" 3 "RdrDetnSts_Invalid";
VAL_ 306 FrntRdrDetn8RdrDetnSts 0 "RdrDetnSts_Ukwn" 1 "RdrDetnSts_Movg" 2 "RdrDetnSts_Staty" 3 "RdrDetnSts_Invalid";
VAL_ 306 FrntRdrDetn9RdrDetnSts 0 "RdrDetnSts_Ukwn" 1 "RdrDetnSts_Movg" 2 "RdrDetnSts_Staty" 3 "RdrDetnSts_Invalid";
VAL_ 308 FrntRdrDetn13RdrDetnSts 0 "RdrDetnSts_Ukwn" 1 "RdrDetnSts_Movg" 2 "RdrDetnSts_Staty" 3 "RdrDetnSts_Invalid";
VAL_ 308 FrntRdrDetn14RdrDetnSts 0 "RdrDetnSts_Ukwn" 1 "RdrDetnSts_Movg" 2 "RdrDetnSts_Staty" 3 "RdrDetnSts_Invalid";
VAL_ 308 FrntRdrDetn15RdrDetnSts 0 "RdrDetnSts_Ukwn" 1 "RdrDetnSts_Movg" 2 "RdrDetnSts_Staty" 3 "RdrDetnSts_Invalid";
VAL_ 308 FrntRdrDetn16RdrDetnSts 0 "RdrDetnSts_Ukwn" 1 "RdrDetnSts_Movg" 2 "RdrDetnSts_Staty" 3 "RdrDetnSts_Invalid";
VAL_ 308 FrntRdrDetn17RdrDetnSts 0 "RdrDetnSts_Ukwn" 1 "RdrDetnSts_Movg" 2 "RdrDetnSts_Staty" 3 "RdrDetnSts_Invalid";
VAL_ 308 FrntRdrDetn18RdrDetnSts 0 "RdrDetnSts_Ukwn" 1 "RdrDetnSts_Movg" 2 "RdrDetnSts_Staty" 3 "RdrDetnSts_Invalid";
SIG_GROUP_ 288 ADataRawSafe 1 : ADataRawSafeALat ADataRawSafeALat1Qf ADataRawSafeALgt ADataRawSafeALgt1Qf ADataRawSafeAVert ADataRawSafeAVertQf ADataRawSafeChks ADataRawSafeCntr;
SIG_GROUP_ 288 ALgtStdFromWhlSpd 1 : ALgtStdFromWhlSpdALgtStdFromWhlSpd ALgtStdFromWhlSpdChks ALgtStdFromWhlSpdCntr ALgtStdFromWhlSpdQf;
SIG_GROUP_ 288 AmbTRaw 1 : AmbTRawAmbTVal AmbTRawQly;
SIG_GROUP_ 288 AsyDataWithCmpSafe 1 : AsyDataWithCmpSafeALat1Qf AsyDataWithCmpSafeALatWithCmp AsyDataWithCmpSafeALgt1Qf AsyDataWithCmpSafeChks AsyDataWithCmpSafeCntr AsyDataWithCmpSafeGrdtOfALgt AsyDataWithCmpSafeYawRateQf AsyDataWithCmpSafeYawRateWithCmp;
SIG_GROUP_ 16 BrkPedlTrvl 1 : BrkPedlTrvlAct BrkPedlTrvlChks BrkPedlTrvlCntr BrkPedlTrvlQf BrkPedlTrvlSt BrkPedlTrvlStQf BrkPedlTrvlTar;
SIG_GROUP_ 304 FrntRdrDetn1 1 : FrntRdrDetn1RdrDetnAzi FrntRdrDetn1RdrDetnChks FrntRdrDetn1RdrDetnCntr FrntRdrDetn1RdrDetnConf FrntRdrDetn1RdrDetnElevn FrntRdrDetn1RdrDetnPwr FrntRdrDetn1RdrDetnRng FrntRdrDetn1RdrDetnRngV FrntRdrDetn1RdrDetnSts;
SIG_GROUP_ 306 FrntRdrDetn10 1 : FrntRdrDetn10RdrDetnAzi FrntRdrDetn10RdrDetnChks FrntRdrDetn10RdrDetnCntr FrntRdrDetn10RdrDetnConf FrntRdrDetn10RdrDetnElevn FrntRdrDetn10RdrDetnPwr FrntRdrDetn10RdrDetnRng FrntRdrDetn10RdrDetnRngV FrntRdrDetn10RdrDetnSts;
SIG_GROUP_ 306 FrntRdrDetn11 1 : FrntRdrDetn11RdrDetnAzi FrntRdrDetn11RdrDetnChks FrntRdrDetn11RdrDetnCntr FrntRdrDetn11RdrDetnConf FrntRdrDetn11RdrDetnElevn FrntRdrDetn11RdrDetnPwr FrntRdrDetn11RdrDetnRng FrntRdrDetn11RdrDetnRngV FrntRdrDetn11RdrDetnSts;
SIG_GROUP_ 306 FrntRdrDetn12 1 : FrntRdrDetn12RdrDetnAzi FrntRdrDetn12RdrDetnChks FrntRdrDetn12RdrDetnCntr FrntRdrDetn12RdrDetnConf FrntRdrDetn12RdrDetnElevn FrntRdrDetn12RdrDetnPwr FrntRdrDetn12RdrDetnRng FrntRdrDetn12RdrDetnRngV FrntRdrDetn12RdrDetnSts;
SIG_GROUP_ 308 FrntRdrDetn13 1 : FrntRdrDetn13RdrDetnAzi FrntRdrDetn13RdrDetnChks FrntRdrDetn13RdrDetnCntr FrntRdrDetn13RdrDetnConf FrntRdrDetn13RdrDetnElevn FrntRdrDetn13RdrDetnPwr FrntRdrDetn13RdrDetnRng FrntRdrDetn13RdrDetnRngV FrntRdrDetn13RdrDetnSts;
SIG_GROUP_ 308 FrntRdrDetn14 1 : FrntRdrDetn14RdrDetnAzi FrntRdrDetn14RdrDetnChks FrntRdrDetn14RdrDetnCntr FrntRdrDetn14RdrDetnConf FrntRdrDetn14RdrDetnElevn FrntRdrDetn14RdrDetnPwr FrntRdrDetn14RdrDetnRng FrntRdrDetn14RdrDetnRngV FrntRdrDetn14RdrDetnSts;
SIG_GROUP_ 308 FrntRdrDetn15 1 : FrntRdrDetn15RdrDetnAzi FrntRdrDetn15RdrDetnChks FrntRdrDetn15RdrDetnCntr FrntRdrDetn15RdrDetnConf FrntRdrDetn15RdrDetnElevn FrntRdrDetn15RdrDetnPwr FrntRdrDetn15RdrDetnRng FrntRdrDetn15RdrDetnRngV FrntRdrDetn15RdrDetnSts;
SIG_GROUP_ 308 FrntRdrDetn16 1 : FrntRdrDetn16RdrDetnAzi FrntRdrDetn16RdrDetnChks FrntRdrDetn16RdrDetnCntr FrntRdrDetn16RdrDetnConf FrntRdrDetn16RdrDetnElevn FrntRdrDetn16RdrDetnPwr FrntRdrDetn16RdrDetnRng FrntRdrDetn16RdrDetnRngV FrntRdrDetn16RdrDetnSts;
SIG_GROUP_ 308 FrntRdrDetn17 1 : FrntRdrDetn17RdrDetnAzi FrntRdrDetn17RdrDetnChks FrntRdrDetn17RdrDetnCntr FrntRdrDetn17RdrDetnConf FrntRdrDetn17RdrDetnElevn FrntRdrDetn17RdrDetnPwr FrntRdrDetn17RdrDetnRng FrntRdrDetn17RdrDetnRngV FrntRdrDetn17RdrDetnSts;
SIG_GROUP_ 308 FrntRdrDetn18 1 : FrntRdrDetn18RdrDetnAzi FrntRdrDetn18RdrDetnChks FrntRdrDetn18RdrDetnCntr FrntRdrDetn18RdrDetnConf FrntRdrDetn18RdrDetnElevn FrntRdrDetn18RdrDetnPwr FrntRdrDetn18RdrDetnRng FrntRdrDetn18RdrDetnRngV FrntRdrDetn18RdrDetnSts;
SIG_GROUP_ 304 FrntRdrDetn2 1 : FrntRdrDetn2RdrDetnAzi FrntRdrDetn2RdrDetnChks FrntRdrDetn2RdrDetnCntr FrntRdrDetn2RdrDetnConf FrntRdrDetn2RdrDetnElevn FrntRdrDetn2RdrDetnPwr FrntRdrDetn2RdrDetnRng FrntRdrDetn2RdrDetnRngV FrntRdrDetn2RdrDetnSts;
SIG_GROUP_ 304 FrntRdrDetn3 1 : FrntRdrDetn3RdrDetnAzi FrntRdrDetn3RdrDetnChks FrntRdrDetn3RdrDetnCntr FrntRdrDetn3RdrDetnConf FrntRdrDetn3RdrDetnElevn FrntRdrDetn3RdrDetnPwr FrntRdrDetn3RdrDetnRng FrntRdrDetn3RdrDetnRngV FrntRdrDetn3RdrDetnSts;
SIG_GROUP_ 304 FrntRdrDetn4 1 : FrntRdrDetn4RdrDetnAzi FrntRdrDetn4RdrDetnChks FrntRdrDetn4RdrDetnCntr FrntRdrDetn4RdrDetnConf FrntRdrDetn4RdrDetnElevn FrntRdrDetn4RdrDetnPwr FrntRdrDetn4RdrDetnRng FrntRdrDetn4RdrDetnRngV FrntRdrDetn4RdrDetnSts;
SIG_GROUP_ 304 FrntRdrDetn5 1 : FrntRdrDetn5RdrDetnAzi FrntRdrDetn5RdrDetnChks FrntRdrDetn5RdrDetnCntr FrntRdrDetn5RdrDetnConf FrntRdrDetn5RdrDetnElevn FrntRdrDetn5RdrDetnPwr FrntRdrDetn5RdrDetnRng FrntRdrDetn5RdrDetnRngV FrntRdrDetn5RdrDetnSts;
SIG_GROUP_ 304 FrntRdrDetn6 1 : FrntRdrDetn6RdrDetnAzi FrntRdrDetn6RdrDetnChks FrntRdrDetn6RdrDetnCntr FrntRdrDetn6RdrDetnConf FrntRdrDetn6RdrDetnElevn FrntRdrDetn6RdrDetnPwr FrntRdrDetn6RdrDetnRng FrntRdrDetn6RdrDetnRngV FrntRdrDetn6RdrDetnSts;
SIG_GROUP_ 306 FrntRdrDetn7 1 : FrntRdrDetn7RdrDetnAzi FrntRdrDetn7RdrDetnChks FrntRdrDetn7RdrDetnCntr FrntRdrDetn7RdrDetnConf FrntRdrDetn7RdrDetnElevn FrntRdrDetn7RdrDetnPwr FrntRdrDetn7RdrDetnRng FrntRdrDetn7RdrDetnRngV FrntRdrDetn7RdrDetnSts;
SIG_GROUP_ 306 FrntRdrDetn8 1 : FrntRdrDetn8RdrDetnAzi FrntRdrDetn8RdrDetnChks FrntRdrDetn8RdrDetnCntr FrntRdrDetn8RdrDetnConf FrntRdrDetn8RdrDetnElevn FrntRdrDetn8RdrDetnPwr FrntRdrDetn8RdrDetnRng FrntRdrDetn8RdrDetnRngV FrntRdrDetn8RdrDetnSts;
SIG_GROUP_ 306 FrntRdrDetn9 1 : FrntRdrDetn9RdrDetnAzi FrntRdrDetn9RdrDetnChks FrntRdrDetn9RdrDetnCntr FrntRdrDetn9RdrDetnConf FrntRdrDetn9RdrDetnElevn FrntRdrDetn9RdrDetnPwr FrntRdrDetn9RdrDetnRng FrntRdrDetn9RdrDetnRngV FrntRdrDetn9RdrDetnSts;
SIG_GROUP_ 297 FrntRdrSts 1 : FrntRdrStsRdrNrDetn FrntRdrStsRdrNrObj FrntRdrStsRdrStsBlkd0bin FrntRdrStsRdrStsBlkdConf FrntRdrStsRdrStsChks FrntRdrStsRdrStsCntr FrntRdrStsRdrStsDstbc FrntRdrStsRdrStsEna FrntRdrStsRdrStsFaulty FrntRdrStsRdrStsIfVersMajor FrntRdrStsRdrStsIfVersMinor FrntRdrStsRdrStsLatency FrntRdrStsRdrStsMisAlign FrntRdrStsRdrStsMissCom FrntRdrStsRdrStsSftyFlt FrntRdrStsRdrStsTiStamp FrntRdrStsRdrStsTiStampStsGlbTiBas FrntRdrStsRdrStsTiStampStsSyncToGatewy FrntRdrStsRdrStsTiStampStsTiLeap FrntRdrStsRdrStsTiStampStsTiOut FrntRdrStsRdrStsWhlSpdCmpFac;
SIG_GROUP_ 1007 FrntRdrVehPrm 1 : FrntRdrVehPrmRdrVehPrmChks FrntRdrVehPrmRdrVehPrmCntr FrntRdrVehPrmRdrVehPrmRdrDynCalPrmForAgOffs FrntRdrVehPrmRdrVehPrmRdrDynCalPrmForAxleDstReToVehFrnt FrntRdrVehPrmRdrVehPrmRdrDynCalPrmForPinoinAgRat FrntRdrVehPrmRdrVehPrmRdrDynCalPrmForRollAgGain FrntRdrVehPrmRdrVehPrmRdrDynCalPrmForSnsrDir FrntRdrVehPrmRdrVehPrmRdrDynCalPrmForSnsrOrntn FrntRdrVehPrmRdrVehPrmRdrDynCalPrmForSnsrPosnLat FrntRdrVehPrmRdrVehPrmRdrDynCalPrmForSnsrPosnLgt FrntRdrVehPrmRdrVehPrmRdrDynCalPrmForSnsrPosnVert FrntRdrVehPrmRdrVehPrmRdrDynCalPrmForSnsrRot1 FrntRdrVehPrmRdrVehPrmRdrDynCalPrmForVehLen FrntRdrVehPrmRdrVehPrmRdrDynCalPrmForVehTyp FrntRdrVehPrmRdrVehPrmRdrDynCalPrmForVehWidth FrntRdrVehPrmRdrVehPrmRdrDynCalPrmForVersMajor FrntRdrVehPrmRdrVehPrmRdrDynCalPrmForVersMinor FrntRdrVehPrmRdrVehPrmRdrDynCalPrmForWhlBas FrntRdrVehPrmRdrVehPrmVld;
SIG_GROUP_ 288 PinionSteerAgGroup 1 : PinionSteerAgGroupChks PinionSteerAgGroupCntr PinionSteerAgGroupPinionSteerAg1 PinionSteerAgGroupPinionSteerAg1Qf PinionSteerAgGroupPinionSteerAgSpd1 PinionSteerAgGroupPinionSteerAgSpd1Qf PinionSteerAgGroupSteerWhlTq PinionSteerAgGroupSteerWhlTqQf;
SIG_GROUP_ 16 PinionSteerAgGroupForBkp 1 : PinionSteerAgGroupForBkpChks PinionSteerAgGroupForBkpCntr PinionSteerAgGroupForBkpPinionSteerAgForBkp PinionSteerAgGroupForBkpPinionSteerAgQfForBkp PinionSteerAgGroupForBkpPinionSteerAgSpdForBkp PinionSteerAgGroupForBkpPinionSteerAgSpdQfForBkp PinionSteerAgGroupForBkpSteerWhlTqForBkp PinionSteerAgGroupForBkpSteerWhlTqQfForBkp;
SIG_GROUP_ 24 PrimADataComp 1 : PrimADataCompALat PrimADataCompALat1Qf PrimADataCompALgt PrimADataCompALgt1Qf PrimADataCompAVert PrimADataCompAVertQf PrimADataCompChks PrimADataCompCntr PrimADataComptimeStampNanoSec PrimADataComptimeStampSec PrimADataComptimeStampTiBasSts;
SIG_GROUP_ 17 PrimAdPSSGroupSafe0 1 : PrimAdPSSGroupSafe0DataID PrimAdPSSGroupSafe0DeltaTPos1 PrimAdPSSGroupSafe0DeltaTPos2 PrimAdPSSGroupSafe0DeltaXPos1 PrimAdPSSGroupSafe0DeltaXPos2 PrimAdPSSGroupSafe0DeltaYPos1 PrimAdPSSGroupSafe0DeltaYPos2 PrimAdPSSGroupSafe0HeadingPos1 PrimAdPSSGroupSafe0HeadingPos2 PrimAdPSSGroupSafe0InitHeading PrimAdPSSGroupSafe0InitPosX PrimAdPSSGroupSafe0InitPosY PrimAdPSSGroupSafe0TiStampNanoSec PrimAdPSSGroupSafe0TiStampSec PrimAdPSSGroupSafe0TrajectID;
SIG_GROUP_ 18 PrimAdPSSGroupSafe1 1 : PrimAdPSSGroupSafe1DataID PrimAdPSSGroupSafe1DeltaTPos1 PrimAdPSSGroupSafe1DeltaTPos2 PrimAdPSSGroupSafe1DeltaTPos3 PrimAdPSSGroupSafe1DeltaTPos4 PrimAdPSSGroupSafe1DeltaTPos5 PrimAdPSSGroupSafe1DeltaTPos6 PrimAdPSSGroupSafe1DeltaXPos1 PrimAdPSSGroupSafe1DeltaXPos2 PrimAdPSSGroupSafe1DeltaXPos3 PrimAdPSSGroupSafe1DeltaXPos4 PrimAdPSSGroupSafe1DeltaXPos5 PrimAdPSSGroupSafe1DeltaXPos6 PrimAdPSSGroupSafe1DeltaYPos1 PrimAdPSSGroupSafe1DeltaYPos2 PrimAdPSSGroupSafe1DeltaYPos3 PrimAdPSSGroupSafe1DeltaYPos4 PrimAdPSSGroupSafe1DeltaYPos5 PrimAdPSSGroupSafe1DeltaYPos6 PrimAdPSSGroupSafe1HeadingPos1 PrimAdPSSGroupSafe1HeadingPos2 PrimAdPSSGroupSafe1HeadingPos3 PrimAdPSSGroupSafe1HeadingPos4 PrimAdPSSGroupSafe1HeadingPos5 PrimAdPSSGroupSafe1HeadingPos6 PrimAdPSSGroupSafe1TrajectID;
SIG_GROUP_ 24 PrimAgDataComp 1 : PrimAgDataCompChks PrimAgDataCompCntr PrimAgDataCompRollRate PrimAgDataCompRollRateQf PrimAgDataComptimeStampNanoSec PrimAgDataComptimeStampSec PrimAgDataComptimeStampTiBasSts PrimAgDataCompYawRate PrimAgDataCompYawRateQf;
SIG_GROUP_ 24 PrimAsyALgtReqForCmft 1 : PrimAsyALgtReqForCmftAsyCmftLgtNegLimForJerk PrimAsyALgtReqForCmftAsyCmftLgtPosLimForJerk PrimAsyALgtReqForCmftMax PrimAsyALgtReqForCmftMin;
SIG_GROUP_ 24 PrimAsyALgtReqRngForSafe 1 : PrimAsyALgtReqRngForSafeMax PrimAsyALgtReqRngForSafeMin;
SIG_GROUP_ 24 PrimChSts 1 : PrimChStsADModeAvtn PrimChStsADModeAvtnCfm PrimChStsADModeDeavtn PrimChStsADModeDeavtnCfm PrimChStsChanlSts PrimChStsCtrlrSts PrimChStsLatADAvtn PrimChStsLatADAvtnCfm PrimChStsLatSts PrimChStsLgtADAvtn PrimChStsLgtADAvtnCfm PrimChStsLgtSts PrimChStsReserved1 PrimChStsReserved2 PrimChStsReserved3 PrimChStsSafeStop;
SIG_GROUP_ 24 PrimVehVComp 1 : PrimVehVCompChks PrimVehVCompCntr PrimVehVCompVehVLat PrimVehVCompVehVLatQf PrimVehVCompVehVLgt PrimVehVCompVehVLgtQf;
SIG_GROUP_ 16 SecChSts 1 : SecChStsADModeAvtn SecChStsADModeAvtnCfm SecChStsADModeDeavtn SecChStsADModeDeavtnCfm SecChStsChanlSts SecChStsCtrlrSts SecChStsLatADAvtn SecChStsLatADAvtnCfm SecChStsLatSts SecChStsLgtADAvtn SecChStsLgtADAvtnCfm SecChStsLgtSts SecChStsReserved1 SecChStsReserved2 SecChStsReserved3 SecChStsSafeStop;
SIG_GROUP_ 288 SteerWhlSnsr 1 : SteerWhlSnsrAg SteerWhlSnsrAgSpd SteerWhlSnsrChks SteerWhlSnsrCntr SteerWhlSnsrQf;
SIG_GROUP_ 288 VehBattU 1 : VehBattUSysU VehBattUSysUQf;
SIG_GROUP_ 288 VehModMngtGlbSafe1 1 : VehModMngtGlbSafe1CarModSts1 VehModMngtGlbSafe1CarModSubtypWdCarModSubtyp VehModMngtGlbSafe1Chks VehModMngtGlbSafe1Cntr VehModMngtGlbSafe1EgyLvlElecMai VehModMngtGlbSafe1EgyLvlElecSubtyp VehModMngtGlbSafe1FltEgyCnsWdSts VehModMngtGlbSafe1PwrLvlElecMai VehModMngtGlbSafe1PwrLvlElecSubtyp VehModMngtGlbSafe1UsgModSts;
SIG_GROUP_ 288 VehMtnSt 1 : VehMtnStChks VehMtnStCntr VehMtnStVehMtnSt;
SIG_GROUP_ 16 VehMtnStForBkp 1 : VehMtnStForBkpVehMtnSt VehMtnStForBkpVehMtnStChks VehMtnStForBkpVehMtnStCntr;
SIG_GROUP_ 288 VehSpdLgt 1 : VehSpdLgtA VehSpdLgtChks VehSpdLgtCntr VehSpdLgtQf;
SIG_GROUP_ 16 VehSpdLgtForBkp 1 : VehSpdLgtForBkpVehSpdLgtA VehSpdLgtForBkpVehSpdLgtChks VehSpdLgtForBkpVehSpdLgtCntr VehSpdLgtForBkpVehSpdLgtQf;
SIG_GROUP_ 16 WhlDirRotlFrntForBkp 1 : WhlDirRotlFrntForBkpChks WhlDirRotlFrntForBkpCntr WhlDirRotlFrntForBkpLe WhlDirRotlFrntForBkpRi;
SIG_GROUP_ 16 WhlDirRotlReForBkp 1 : WhlDirRotlReForBkpChks WhlDirRotlReForBkpCntr WhlDirRotlReForBkpLe WhlDirRotlReForBkpRi;
SIG_GROUP_ 16 WhlRotToothCntrForBkp 1 : WhlRotToothCntrForBkpChks WhlRotToothCntrForBkpCntr WhlRotToothCntrForBkpWhlRotToothCntrFrntLe WhlRotToothCntrForBkpWhlRotToothCntrFrntRi WhlRotToothCntrForBkpWhlRotToothCntrReLe WhlRotToothCntrForBkpWhlRotToothCntrReRi;
SIG_GROUP_ 16 WhlSpdCircumlFrntForBkp 1 : WhlSpdCircumlFrntForBkpWhlSpdCircumlFrntChks WhlSpdCircumlFrntForBkpWhlSpdCircumlFrntCntr WhlSpdCircumlFrntForBkpWhlSpdCircumlFrntLe WhlSpdCircumlFrntForBkpWhlSpdCircumlFrntLeQf WhlSpdCircumlFrntForBkpWhlSpdCircumlFrntRiQf WhlSpdCircumlFrntForBkpWhlSpdCircumlFrntWhlSpdCircumlFrntRi;
SIG_GROUP_ 16 WhlSpdCircumlReForBkp 1 : WhlSpdCircumlReForBkpWhlSpdCircumlReChks WhlSpdCircumlReForBkpWhlSpdCircumlReCntr WhlSpdCircumlReForBkpWhlSpdCircumlReLe WhlSpdCircumlReForBkpWhlSpdCircumlReLeQf WhlSpdCircumlReForBkpWhlSpdCircumlReRi WhlSpdCircumlReForBkpWhlSpdCircumlReRiQf;
SIG_GROUP_ 16 WhlVAgrFrntForBkp 1 : WhlVAgrFrntForBkpWhlVAgrFrntLe WhlVAgrFrntForBkpWhlVAgrFrntLeQf WhlVAgrFrntForBkpWhlVAgrFrntRi WhlVAgrFrntForBkpWhlVAgrFrntRiQf;
SIG_GROUP_ 16 WhlVAgrReForBkp 1 : WhlVAgrReForBkpWhlVAgrReLe WhlVAgrReForBkpWhlVAgrReLeQf WhlVAgrReForBkpWhlVAgrReRi WhlVAgrReForBkpWhlVAgrReRiQf;
SIG_GROUP_ 288 WipgInfo 1 : WipgInfoWipgSpdInfo WipgInfoWiprActv WipgInfoWiprInWipgAr;
