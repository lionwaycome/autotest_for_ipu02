// *************************************************************************** *
// *                                                                           *
// *                      Mentor Graphics Corporation                          *
// *                          All rights reserved                              *
// *                                                                           *
// *************************************************************************** *
// *                                                                           *
// * Description:         CANDB File                                           *
// * Generated at:        2020-04-14 13:13:01                                  *
// * System:              SDB20010                                             *
// * Variant:             EX11_AVP                                             *
// * Network:             SafetyCANFD2                                         *
// *                                                                           *
// *************************************************************************** *
// *                                                                           *
// *             THIS CONFIGURATION MIGHT CONTAIN SOME ERRORS                  *
// *              IF THE INPUT MODEL WAS NOT PROPERLY FORMED!                  *
// *                    Do Not Use this File directly!                         *
// *                                                                           *
// *************************************************************************** *
VERSION "SafetyCANFD2"

NS_ :

BS_:

BU_:  ASDM ETC FLC FLR PAS

BO_ 310 FLRSafetyCANFD2Frame04: 64 FLR
 SG_ FrntRdrDetn19_UB : 74|1@0+ (1,0) [0|1] "" ASDM,PAS
 SG_ FrntRdrDetn19RdrDetnAzi : 31|11@0+ (0.1,-90.0) [-90.0|90.0] "Deg" ASDM,PAS
 SG_ FrntRdrDetn19RdrDetnChks : 7|8@0+ (1.0,0.0) [0.0|255.0] "Unitless" ASDM,PAS
 SG_ FrntRdrDetn19RdrDetnCntr : 15|4@0+ (1.0,0.0) [0.0|15.0] "Unitless" ASDM,PAS
 SG_ FrntRdrDetn19RdrDetnConf : 71|7@0+ (1.0,0.0) [0.0|100.0] "%" ASDM,PAS
 SG_ FrntRdrDetn19RdrDetnElevn : 79|5@0+ (1.0,-15.0) [-15.0|15.0] "Deg" ASDM,PAS
 SG_ FrntRdrDetn19RdrDetnPwr : 8|9@0+ (0.1,0.0) [0.0|51.1] "dB" ASDM,PAS
 SG_ FrntRdrDetn19RdrDetnRng : 55|14@0+ (0.02,-1.0) [-1.0|200.0] "m" ASDM,PAS
 SG_ FrntRdrDetn19RdrDetnRngV : 36|13@0+ (0.02,-80.0) [-80.0|80.0] "m/s" ASDM,PAS
 SG_ FrntRdrDetn19RdrDetnSts : 11|2@0+ (1,0) [0|3] "" ASDM,PAS
 SG_ FrntRdrDetn20_UB : 154|1@0+ (1,0) [0|1] "" ASDM,PAS
 SG_ FrntRdrDetn20RdrDetnAzi : 119|11@0+ (0.1,-90.0) [-90.0|90.0] "Deg" ASDM,PAS
 SG_ FrntRdrDetn20RdrDetnChks : 87|8@0+ (1.0,0.0) [0.0|255.0] "Unitless" ASDM,PAS
 SG_ FrntRdrDetn20RdrDetnCntr : 95|4@0+ (1.0,0.0) [0.0|15.0] "Unitless" ASDM,PAS
 SG_ FrntRdrDetn20RdrDetnConf : 111|7@0+ (1.0,0.0) [0.0|100.0] "%" ASDM,PAS
 SG_ FrntRdrDetn20RdrDetnElevn : 159|5@0+ (1.0,-15.0) [-15.0|15.0] "Deg" ASDM,PAS
 SG_ FrntRdrDetn20RdrDetnPwr : 89|9@0+ (0.1,0.0) [0.0|51.1] "dB" ASDM,PAS
 SG_ FrntRdrDetn20RdrDetnRng : 143|14@0+ (0.02,-1.0) [-1.0|200.0] "m" ASDM,PAS
 SG_ FrntRdrDetn20RdrDetnRngV : 124|13@0+ (0.02,-80.0) [-80.0|80.0] "m/s" ASDM,PAS
 SG_ FrntRdrDetn20RdrDetnSts : 91|2@0+ (1,0) [0|3] "" ASDM,PAS
 SG_ FrntRdrDetn21_UB : 234|1@0+ (1,0) [0|1] "" ASDM,PAS
 SG_ FrntRdrDetn21RdrDetnAzi : 199|11@0+ (0.1,-90.0) [-90.0|90.0] "Deg" ASDM,PAS
 SG_ FrntRdrDetn21RdrDetnChks : 167|8@0+ (1.0,0.0) [0.0|255.0] "Unitless" ASDM,PAS
 SG_ FrntRdrDetn21RdrDetnCntr : 175|4@0+ (1.0,0.0) [0.0|15.0] "Unitless" ASDM,PAS
 SG_ FrntRdrDetn21RdrDetnConf : 191|7@0+ (1.0,0.0) [0.0|100.0] "%" ASDM,PAS
 SG_ FrntRdrDetn21RdrDetnElevn : 239|5@0+ (1.0,-15.0) [-15.0|15.0] "Deg" ASDM,PAS
 SG_ FrntRdrDetn21RdrDetnPwr : 169|9@0+ (0.1,0.0) [0.0|51.1] "dB" ASDM,PAS
 SG_ FrntRdrDetn21RdrDetnRng : 223|14@0+ (0.02,-1.0) [-1.0|200.0] "m" ASDM,PAS
 SG_ FrntRdrDetn21RdrDetnRngV : 204|13@0+ (0.02,-80.0) [-80.0|80.0] "m/s" ASDM,PAS
 SG_ FrntRdrDetn21RdrDetnSts : 171|2@0+ (1,0) [0|3] "" ASDM,PAS
 SG_ FrntRdrDetn22_UB : 314|1@0+ (1,0) [0|1] "" ASDM,PAS
 SG_ FrntRdrDetn22RdrDetnAzi : 287|11@0+ (0.1,-90.0) [-90.0|90.0] "Deg" ASDM,PAS
 SG_ FrntRdrDetn22RdrDetnChks : 247|8@0+ (1.0,0.0) [0.0|255.0] "Unitless" ASDM,PAS
 SG_ FrntRdrDetn22RdrDetnCntr : 255|4@0+ (1.0,0.0) [0.0|15.0] "Unitless" ASDM,PAS
 SG_ FrntRdrDetn22RdrDetnConf : 311|7@0+ (1.0,0.0) [0.0|100.0] "%" ASDM,PAS
 SG_ FrntRdrDetn22RdrDetnElevn : 319|5@0+ (1.0,-15.0) [-15.0|15.0] "Deg" ASDM,PAS
 SG_ FrntRdrDetn22RdrDetnPwr : 249|9@0+ (0.1,0.0) [0.0|51.1] "dB" ASDM,PAS
 SG_ FrntRdrDetn22RdrDetnRng : 271|14@0+ (0.02,-1.0) [-1.0|200.0] "m" ASDM,PAS
 SG_ FrntRdrDetn22RdrDetnRngV : 292|13@0+ (0.02,-80.0) [-80.0|80.0] "m/s" ASDM,PAS
 SG_ FrntRdrDetn22RdrDetnSts : 251|2@0+ (1,0) [0|3] "" ASDM,PAS
 SG_ FrntRdrDetn23_UB : 394|1@0+ (1,0) [0|1] "" ASDM,PAS
 SG_ FrntRdrDetn23RdrDetnAzi : 351|11@0+ (0.1,-90.0) [-90.0|90.0] "Deg" ASDM,PAS
 SG_ FrntRdrDetn23RdrDetnChks : 327|8@0+ (1.0,0.0) [0.0|255.0] "Unitless" ASDM,PAS
 SG_ FrntRdrDetn23RdrDetnCntr : 335|4@0+ (1.0,0.0) [0.0|15.0] "Unitless" ASDM,PAS
 SG_ FrntRdrDetn23RdrDetnConf : 391|7@0+ (1.0,0.0) [0.0|100.0] "%" ASDM,PAS
 SG_ FrntRdrDetn23RdrDetnElevn : 399|5@0+ (1.0,-15.0) [-15.0|15.0] "Deg" ASDM,PAS
 SG_ FrntRdrDetn23RdrDetnPwr : 329|9@0+ (0.1,0.0) [0.0|51.1] "dB" ASDM,PAS
 SG_ FrntRdrDetn23RdrDetnRng : 375|14@0+ (0.02,-1.0) [-1.0|200.0] "m" ASDM,PAS
 SG_ FrntRdrDetn23RdrDetnRngV : 356|13@0+ (0.02,-80.0) [-80.0|80.0] "m/s" ASDM,PAS
 SG_ FrntRdrDetn23RdrDetnSts : 331|2@0+ (1,0) [0|3] "" ASDM,PAS
 SG_ FrntRdrDetn24_UB : 474|1@0+ (1,0) [0|1] "" ASDM,PAS
 SG_ FrntRdrDetn24RdrDetnAzi : 447|11@0+ (0.1,-90.0) [-90.0|90.0] "Deg" ASDM,PAS
 SG_ FrntRdrDetn24RdrDetnChks : 407|8@0+ (1.0,0.0) [0.0|255.0] "Unitless" ASDM,PAS
 SG_ FrntRdrDetn24RdrDetnCntr : 415|4@0+ (1.0,0.0) [0.0|15.0] "Unitless" ASDM,PAS
 SG_ FrntRdrDetn24RdrDetnConf : 471|7@0+ (1.0,0.0) [0.0|100.0] "%" ASDM,PAS
 SG_ FrntRdrDetn24RdrDetnElevn : 479|5@0+ (1.0,-15.0) [-15.0|15.0] "Deg" ASDM,PAS
 SG_ FrntRdrDetn24RdrDetnPwr : 409|9@0+ (0.1,0.0) [0.0|51.1] "dB" ASDM,PAS
 SG_ FrntRdrDetn24RdrDetnRng : 431|14@0+ (0.02,-1.0) [-1.0|200.0] "m" ASDM,PAS
 SG_ FrntRdrDetn24RdrDetnRngV : 452|13@0+ (0.02,-80.0) [-80.0|80.0] "m/s" ASDM,PAS
 SG_ FrntRdrDetn24RdrDetnSts : 411|2@0+ (1,0) [0|3] "" ASDM,PAS

BO_ 312 FLRSafetyCANFD2Frame05: 64 FLR
 SG_ FrntRdrDetn25_UB : 74|1@0+ (1,0) [0|1] "" ASDM,PAS
 SG_ FrntRdrDetn25RdrDetnAzi : 31|11@0+ (0.1,-90.0) [-90.0|90.0] "Deg" ASDM,PAS
 SG_ FrntRdrDetn25RdrDetnChks : 7|8@0+ (1.0,0.0) [0.0|255.0] "Unitless" ASDM,PAS
 SG_ FrntRdrDetn25RdrDetnCntr : 15|4@0+ (1.0,0.0) [0.0|15.0] "Unitless" ASDM,PAS
 SG_ FrntRdrDetn25RdrDetnConf : 71|7@0+ (1.0,0.0) [0.0|100.0] "%" ASDM,PAS
 SG_ FrntRdrDetn25RdrDetnElevn : 79|5@0+ (1.0,-15.0) [-15.0|15.0] "Deg" ASDM,PAS
 SG_ FrntRdrDetn25RdrDetnPwr : 8|9@0+ (0.1,0.0) [0.0|51.1] "dB" ASDM,PAS
 SG_ FrntRdrDetn25RdrDetnRng : 55|14@0+ (0.02,-1.0) [-1.0|200.0] "m" ASDM,PAS
 SG_ FrntRdrDetn25RdrDetnRngV : 36|13@0+ (0.02,-80.0) [-80.0|80.0] "m/s" ASDM,PAS
 SG_ FrntRdrDetn25RdrDetnSts : 11|2@0+ (1,0) [0|3] "" ASDM,PAS
 SG_ FrntRdrDetn26_UB : 154|1@0+ (1,0) [0|1] "" ASDM,PAS
 SG_ FrntRdrDetn26RdrDetnAzi : 119|11@0+ (0.1,-90.0) [-90.0|90.0] "Deg" ASDM,PAS
 SG_ FrntRdrDetn26RdrDetnChks : 87|8@0+ (1.0,0.0) [0.0|255.0] "Unitless" ASDM,PAS
 SG_ FrntRdrDetn26RdrDetnCntr : 95|4@0+ (1.0,0.0) [0.0|15.0] "Unitless" ASDM,PAS
 SG_ FrntRdrDetn26RdrDetnConf : 111|7@0+ (1.0,0.0) [0.0|100.0] "%" ASDM,PAS
 SG_ FrntRdrDetn26RdrDetnElevn : 159|5@0+ (1.0,-15.0) [-15.0|15.0] "Deg" ASDM,PAS
 SG_ FrntRdrDetn26RdrDetnPwr : 89|9@0+ (0.1,0.0) [0.0|51.1] "dB" ASDM,PAS
 SG_ FrntRdrDetn26RdrDetnRng : 143|14@0+ (0.02,-1.0) [-1.0|200.0] "m" ASDM,PAS
 SG_ FrntRdrDetn26RdrDetnRngV : 124|13@0+ (0.02,-80.0) [-80.0|80.0] "m/s" ASDM,PAS
 SG_ FrntRdrDetn26RdrDetnSts : 91|2@0+ (1,0) [0|3] "" ASDM,PAS
 SG_ FrntRdrDetn27_UB : 234|1@0+ (1,0) [0|1] "" ASDM,PAS
 SG_ FrntRdrDetn27RdrDetnAzi : 199|11@0+ (0.1,-90.0) [-90.0|90.0] "Deg" ASDM,PAS
 SG_ FrntRdrDetn27RdrDetnChks : 167|8@0+ (1.0,0.0) [0.0|255.0] "Unitless" ASDM,PAS
 SG_ FrntRdrDetn27RdrDetnCntr : 175|4@0+ (1.0,0.0) [0.0|15.0] "Unitless" ASDM,PAS
 SG_ FrntRdrDetn27RdrDetnConf : 191|7@0+ (1.0,0.0) [0.0|100.0] "%" ASDM,PAS
 SG_ FrntRdrDetn27RdrDetnElevn : 239|5@0+ (1.0,-15.0) [-15.0|15.0] "Deg" ASDM,PAS
 SG_ FrntRdrDetn27RdrDetnPwr : 169|9@0+ (0.1,0.0) [0.0|51.1] "dB" ASDM,PAS
 SG_ FrntRdrDetn27RdrDetnRng : 223|14@0+ (0.02,-1.0) [-1.0|200.0] "m" ASDM,PAS
 SG_ FrntRdrDetn27RdrDetnRngV : 204|13@0+ (0.02,-80.0) [-80.0|80.0] "m/s" ASDM,PAS
 SG_ FrntRdrDetn27RdrDetnSts : 171|2@0+ (1,0) [0|3] "" ASDM,PAS
 SG_ FrntRdrDetn28_UB : 314|1@0+ (1,0) [0|1] "" ASDM,PAS
 SG_ FrntRdrDetn28RdrDetnAzi : 287|11@0+ (0.1,-90.0) [-90.0|90.0] "Deg" ASDM,PAS
 SG_ FrntRdrDetn28RdrDetnChks : 247|8@0+ (1.0,0.0) [0.0|255.0] "Unitless" ASDM,PAS
 SG_ FrntRdrDetn28RdrDetnCntr : 255|4@0+ (1.0,0.0) [0.0|15.0] "Unitless" ASDM,PAS
 SG_ FrntRdrDetn28RdrDetnConf : 311|7@0+ (1.0,0.0) [0.0|100.0] "%" ASDM,PAS
 SG_ FrntRdrDetn28RdrDetnElevn : 319|5@0+ (1.0,-15.0) [-15.0|15.0] "Deg" ASDM,PAS
 SG_ FrntRdrDetn28RdrDetnPwr : 249|9@0+ (0.1,0.0) [0.0|51.1] "dB" ASDM,PAS
 SG_ FrntRdrDetn28RdrDetnRng : 271|14@0+ (0.02,-1.0) [-1.0|200.0] "m" ASDM,PAS
 SG_ FrntRdrDetn28RdrDetnRngV : 292|13@0+ (0.02,-80.0) [-80.0|80.0] "m/s" ASDM,PAS
 SG_ FrntRdrDetn28RdrDetnSts : 251|2@0+ (1,0) [0|3] "" ASDM,PAS
 SG_ FrntRdrDetn29_UB : 394|1@0+ (1,0) [0|1] "" ASDM,PAS
 SG_ FrntRdrDetn29RdrDetnAzi : 351|11@0+ (0.1,-90.0) [-90.0|90.0] "Deg" ASDM,PAS
 SG_ FrntRdrDetn29RdrDetnChks : 327|8@0+ (1.0,0.0) [0.0|255.0] "Unitless" ASDM,PAS
 SG_ FrntRdrDetn29RdrDetnCntr : 335|4@0+ (1.0,0.0) [0.0|15.0] "Unitless" ASDM,PAS
 SG_ FrntRdrDetn29RdrDetnConf : 391|7@0+ (1.0,0.0) [0.0|100.0] "%" ASDM,PAS
 SG_ FrntRdrDetn29RdrDetnElevn : 399|5@0+ (1.0,-15.0) [-15.0|15.0] "Deg" ASDM,PAS
 SG_ FrntRdrDetn29RdrDetnPwr : 329|9@0+ (0.1,0.0) [0.0|51.1] "dB" ASDM,PAS
 SG_ FrntRdrDetn29RdrDetnRng : 375|14@0+ (0.02,-1.0) [-1.0|200.0] "m" ASDM,PAS
 SG_ FrntRdrDetn29RdrDetnRngV : 356|13@0+ (0.02,-80.0) [-80.0|80.0] "m/s" ASDM,PAS
 SG_ FrntRdrDetn29RdrDetnSts : 331|2@0+ (1,0) [0|3] "" ASDM,PAS
 SG_ FrntRdrDetn30_UB : 474|1@0+ (1,0) [0|1] "" ASDM,PAS
 SG_ FrntRdrDetn30RdrDetnAzi : 447|11@0+ (0.1,-90.0) [-90.0|90.0] "Deg" ASDM,PAS
 SG_ FrntRdrDetn30RdrDetnChks : 407|8@0+ (1.0,0.0) [0.0|255.0] "Unitless" ASDM,PAS
 SG_ FrntRdrDetn30RdrDetnCntr : 415|4@0+ (1.0,0.0) [0.0|15.0] "Unitless" ASDM,PAS
 SG_ FrntRdrDetn30RdrDetnConf : 471|7@0+ (1.0,0.0) [0.0|100.0] "%" ASDM,PAS
 SG_ FrntRdrDetn30RdrDetnElevn : 479|5@0+ (1.0,-15.0) [-15.0|15.0] "Deg" ASDM,PAS
 SG_ FrntRdrDetn30RdrDetnPwr : 409|9@0+ (0.1,0.0) [0.0|51.1] "dB" ASDM,PAS
 SG_ FrntRdrDetn30RdrDetnRng : 431|14@0+ (0.02,-1.0) [-1.0|200.0] "m" ASDM,PAS
 SG_ FrntRdrDetn30RdrDetnRngV : 452|13@0+ (0.02,-80.0) [-80.0|80.0] "m/s" ASDM,PAS
 SG_ FrntRdrDetn30RdrDetnSts : 411|2@0+ (1,0) [0|3] "" ASDM,PAS

BO_ 314 FLRSafetyCANFD2Frame06: 64 FLR
 SG_ FrntRdrDetn31_UB : 74|1@0+ (1,0) [0|1] "" ASDM,PAS
 SG_ FrntRdrDetn31RdrDetnAzi : 31|11@0+ (0.1,-90.0) [-90.0|90.0] "Deg" ASDM,PAS
 SG_ FrntRdrDetn31RdrDetnChks : 7|8@0+ (1.0,0.0) [0.0|255.0] "Unitless" ASDM,PAS
 SG_ FrntRdrDetn31RdrDetnCntr : 15|4@0+ (1.0,0.0) [0.0|15.0] "Unitless" ASDM,PAS
 SG_ FrntRdrDetn31RdrDetnConf : 71|7@0+ (1.0,0.0) [0.0|100.0] "%" ASDM,PAS
 SG_ FrntRdrDetn31RdrDetnElevn : 79|5@0+ (1.0,-15.0) [-15.0|15.0] "Deg" ASDM,PAS
 SG_ FrntRdrDetn31RdrDetnPwr : 8|9@0+ (0.1,0.0) [0.0|51.1] "dB" ASDM,PAS
 SG_ FrntRdrDetn31RdrDetnRng : 55|14@0+ (0.02,-1.0) [-1.0|200.0] "m" ASDM,PAS
 SG_ FrntRdrDetn31RdrDetnRngV : 36|13@0+ (0.02,-80.0) [-80.0|80.0] "m/s" ASDM,PAS
 SG_ FrntRdrDetn31RdrDetnSts : 11|2@0+ (1,0) [0|3] "" ASDM,PAS
 SG_ FrntRdrDetn32_UB : 154|1@0+ (1,0) [0|1] "" ASDM,PAS
 SG_ FrntRdrDetn32RdrDetnAzi : 119|11@0+ (0.1,-90.0) [-90.0|90.0] "Deg" ASDM,PAS
 SG_ FrntRdrDetn32RdrDetnChks : 87|8@0+ (1.0,0.0) [0.0|255.0] "Unitless" ASDM,PAS
 SG_ FrntRdrDetn32RdrDetnCntr : 95|4@0+ (1.0,0.0) [0.0|15.0] "Unitless" ASDM,PAS
 SG_ FrntRdrDetn32RdrDetnConf : 111|7@0+ (1.0,0.0) [0.0|100.0] "%" ASDM,PAS
 SG_ FrntRdrDetn32RdrDetnElevn : 159|5@0+ (1.0,-15.0) [-15.0|15.0] "Deg" ASDM,PAS
 SG_ FrntRdrDetn32RdrDetnPwr : 89|9@0+ (0.1,0.0) [0.0|51.1] "dB" ASDM,PAS
 SG_ FrntRdrDetn32RdrDetnRng : 143|14@0+ (0.02,-1.0) [-1.0|200.0] "m" ASDM,PAS
 SG_ FrntRdrDetn32RdrDetnRngV : 124|13@0+ (0.02,-80.0) [-80.0|80.0] "m/s" ASDM,PAS
 SG_ FrntRdrDetn32RdrDetnSts : 91|2@0+ (1,0) [0|3] "" ASDM,PAS
 SG_ FrntRdrDetn33_UB : 234|1@0+ (1,0) [0|1] "" ASDM,PAS
 SG_ FrntRdrDetn33RdrDetnAzi : 199|11@0+ (0.1,-90.0) [-90.0|90.0] "Deg" ASDM,PAS
 SG_ FrntRdrDetn33RdrDetnChks : 167|8@0+ (1.0,0.0) [0.0|255.0] "Unitless" ASDM,PAS
 SG_ FrntRdrDetn33RdrDetnCntr : 175|4@0+ (1.0,0.0) [0.0|15.0] "Unitless" ASDM,PAS
 SG_ FrntRdrDetn33RdrDetnConf : 191|7@0+ (1.0,0.0) [0.0|100.0] "%" ASDM,PAS
 SG_ FrntRdrDetn33RdrDetnElevn : 239|5@0+ (1.0,-15.0) [-15.0|15.0] "Deg" ASDM,PAS
 SG_ FrntRdrDetn33RdrDetnPwr : 169|9@0+ (0.1,0.0) [0.0|51.1] "dB" ASDM,PAS
 SG_ FrntRdrDetn33RdrDetnRng : 223|14@0+ (0.02,-1.0) [-1.0|200.0] "m" ASDM,PAS
 SG_ FrntRdrDetn33RdrDetnRngV : 204|13@0+ (0.02,-80.0) [-80.0|80.0] "m/s" ASDM,PAS
 SG_ FrntRdrDetn33RdrDetnSts : 171|2@0+ (1,0) [0|3] "" ASDM,PAS
 SG_ FrntRdrDetn34_UB : 314|1@0+ (1,0) [0|1] "" ASDM,PAS
 SG_ FrntRdrDetn34RdrDetnAzi : 287|11@0+ (0.1,-90.0) [-90.0|90.0] "Deg" ASDM,PAS
 SG_ FrntRdrDetn34RdrDetnChks : 247|8@0+ (1.0,0.0) [0.0|255.0] "Unitless" ASDM,PAS
 SG_ FrntRdrDetn34RdrDetnCntr : 255|4@0+ (1.0,0.0) [0.0|15.0] "Unitless" ASDM,PAS
 SG_ FrntRdrDetn34RdrDetnConf : 311|7@0+ (1.0,0.0) [0.0|100.0] "%" ASDM,PAS
 SG_ FrntRdrDetn34RdrDetnElevn : 319|5@0+ (1.0,-15.0) [-15.0|15.0] "Deg" ASDM,PAS
 SG_ FrntRdrDetn34RdrDetnPwr : 249|9@0+ (0.1,0.0) [0.0|51.1] "dB" ASDM,PAS
 SG_ FrntRdrDetn34RdrDetnRng : 271|14@0+ (0.02,-1.0) [-1.0|200.0] "m" ASDM,PAS
 SG_ FrntRdrDetn34RdrDetnRngV : 292|13@0+ (0.02,-80.0) [-80.0|80.0] "m/s" ASDM,PAS
 SG_ FrntRdrDetn34RdrDetnSts : 251|2@0+ (1,0) [0|3] "" ASDM,PAS
 SG_ FrntRdrDetn35_UB : 394|1@0+ (1,0) [0|1] "" ASDM,PAS
 SG_ FrntRdrDetn35RdrDetnAzi : 351|11@0+ (0.1,-90.0) [-90.0|90.0] "Deg" ASDM,PAS
 SG_ FrntRdrDetn35RdrDetnChks : 327|8@0+ (1.0,0.0) [0.0|255.0] "Unitless" ASDM,PAS
 SG_ FrntRdrDetn35RdrDetnCntr : 335|4@0+ (1.0,0.0) [0.0|15.0] "Unitless" ASDM,PAS
 SG_ FrntRdrDetn35RdrDetnConf : 391|7@0+ (1.0,0.0) [0.0|100.0] "%" ASDM,PAS
 SG_ FrntRdrDetn35RdrDetnElevn : 399|5@0+ (1.0,-15.0) [-15.0|15.0] "Deg" ASDM,PAS
 SG_ FrntRdrDetn35RdrDetnPwr : 329|9@0+ (0.1,0.0) [0.0|51.1] "dB" ASDM,PAS
 SG_ FrntRdrDetn35RdrDetnRng : 375|14@0+ (0.02,-1.0) [-1.0|200.0] "m" ASDM,PAS
 SG_ FrntRdrDetn35RdrDetnRngV : 356|13@0+ (0.02,-80.0) [-80.0|80.0] "m/s" ASDM,PAS
 SG_ FrntRdrDetn35RdrDetnSts : 331|2@0+ (1,0) [0|3] "" ASDM,PAS
 SG_ FrntRdrDetn36_UB : 474|1@0+ (1,0) [0|1] "" ASDM,PAS
 SG_ FrntRdrDetn36RdrDetnAzi : 447|11@0+ (0.1,-90.0) [-90.0|90.0] "Deg" ASDM,PAS
 SG_ FrntRdrDetn36RdrDetnChks : 407|8@0+ (1.0,0.0) [0.0|255.0] "Unitless" ASDM,PAS
 SG_ FrntRdrDetn36RdrDetnCntr : 415|4@0+ (1.0,0.0) [0.0|15.0] "Unitless" ASDM,PAS
 SG_ FrntRdrDetn36RdrDetnConf : 471|7@0+ (1.0,0.0) [0.0|100.0] "%" ASDM,PAS
 SG_ FrntRdrDetn36RdrDetnElevn : 479|5@0+ (1.0,-15.0) [-15.0|15.0] "Deg" ASDM,PAS
 SG_ FrntRdrDetn36RdrDetnPwr : 409|9@0+ (0.1,0.0) [0.0|51.1] "dB" ASDM,PAS
 SG_ FrntRdrDetn36RdrDetnRng : 431|14@0+ (0.02,-1.0) [-1.0|200.0] "m" ASDM,PAS
 SG_ FrntRdrDetn36RdrDetnRngV : 452|13@0+ (0.02,-80.0) [-80.0|80.0] "m/s" ASDM,PAS
 SG_ FrntRdrDetn36RdrDetnSts : 411|2@0+ (1,0) [0|3] "" ASDM,PAS

BO_ 316 FLRSafetyCANFD2Frame07: 64 FLR
 SG_ FrntRdrDetn37_UB : 74|1@0+ (1,0) [0|1] "" ASDM,PAS
 SG_ FrntRdrDetn37RdrDetnAzi : 31|11@0+ (0.1,-90.0) [-90.0|90.0] "Deg" ASDM,PAS
 SG_ FrntRdrDetn37RdrDetnChks : 7|8@0+ (1.0,0.0) [0.0|255.0] "Unitless" ASDM,PAS
 SG_ FrntRdrDetn37RdrDetnCntr : 15|4@0+ (1.0,0.0) [0.0|15.0] "Unitless" ASDM,PAS
 SG_ FrntRdrDetn37RdrDetnConf : 71|7@0+ (1.0,0.0) [0.0|100.0] "%" ASDM,PAS
 SG_ FrntRdrDetn37RdrDetnElevn : 79|5@0+ (1.0,-15.0) [-15.0|15.0] "Deg" ASDM,PAS
 SG_ FrntRdrDetn37RdrDetnPwr : 8|9@0+ (0.1,0.0) [0.0|51.1] "dB" ASDM,PAS
 SG_ FrntRdrDetn37RdrDetnRng : 55|14@0+ (0.02,-1.0) [-1.0|200.0] "m" ASDM,PAS
 SG_ FrntRdrDetn37RdrDetnRngV : 36|13@0+ (0.02,-80.0) [-80.0|80.0] "m/s" ASDM,PAS
 SG_ FrntRdrDetn37RdrDetnSts : 11|2@0+ (1,0) [0|3] "" ASDM,PAS
 SG_ FrntRdrDetn38_UB : 154|1@0+ (1,0) [0|1] "" ASDM,PAS
 SG_ FrntRdrDetn38RdrDetnAzi : 119|11@0+ (0.1,-90.0) [-90.0|90.0] "Deg" ASDM,PAS
 SG_ FrntRdrDetn38RdrDetnChks : 87|8@0+ (1.0,0.0) [0.0|255.0] "Unitless" ASDM,PAS
 SG_ FrntRdrDetn38RdrDetnCntr : 95|4@0+ (1.0,0.0) [0.0|15.0] "Unitless" ASDM,PAS
 SG_ FrntRdrDetn38RdrDetnConf : 111|7@0+ (1.0,0.0) [0.0|100.0] "%" ASDM,PAS
 SG_ FrntRdrDetn38RdrDetnElevn : 159|5@0+ (1.0,-15.0) [-15.0|15.0] "Deg" ASDM,PAS
 SG_ FrntRdrDetn38RdrDetnPwr : 89|9@0+ (0.1,0.0) [0.0|51.1] "dB" ASDM,PAS
 SG_ FrntRdrDetn38RdrDetnRng : 143|14@0+ (0.02,-1.0) [-1.0|200.0] "m" ASDM,PAS
 SG_ FrntRdrDetn38RdrDetnRngV : 124|13@0+ (0.02,-80.0) [-80.0|80.0] "m/s" ASDM,PAS
 SG_ FrntRdrDetn38RdrDetnSts : 91|2@0+ (1,0) [0|3] "" ASDM,PAS
 SG_ FrntRdrDetn39_UB : 234|1@0+ (1,0) [0|1] "" ASDM,PAS
 SG_ FrntRdrDetn39RdrDetnAzi : 199|11@0+ (0.1,-90.0) [-90.0|90.0] "Deg" ASDM,PAS
 SG_ FrntRdrDetn39RdrDetnChks : 167|8@0+ (1.0,0.0) [0.0|255.0] "Unitless" ASDM,PAS
 SG_ FrntRdrDetn39RdrDetnCntr : 175|4@0+ (1.0,0.0) [0.0|15.0] "Unitless" ASDM,PAS
 SG_ FrntRdrDetn39RdrDetnConf : 191|7@0+ (1.0,0.0) [0.0|100.0] "%" ASDM,PAS
 SG_ FrntRdrDetn39RdrDetnElevn : 239|5@0+ (1.0,-15.0) [-15.0|15.0] "Deg" ASDM,PAS
 SG_ FrntRdrDetn39RdrDetnPwr : 169|9@0+ (0.1,0.0) [0.0|51.1] "dB" ASDM,PAS
 SG_ FrntRdrDetn39RdrDetnRng : 223|14@0+ (0.02,-1.0) [-1.0|200.0] "m" ASDM,PAS
 SG_ FrntRdrDetn39RdrDetnRngV : 204|13@0+ (0.02,-80.0) [-80.0|80.0] "m/s" ASDM,PAS
 SG_ FrntRdrDetn39RdrDetnSts : 171|2@0+ (1,0) [0|3] "" ASDM,PAS
 SG_ FrntRdrDetn40_UB : 314|1@0+ (1,0) [0|1] "" ASDM,PAS
 SG_ FrntRdrDetn40RdrDetnAzi : 287|11@0+ (0.1,-90.0) [-90.0|90.0] "Deg" ASDM,PAS
 SG_ FrntRdrDetn40RdrDetnChks : 247|8@0+ (1.0,0.0) [0.0|255.0] "Unitless" ASDM,PAS
 SG_ FrntRdrDetn40RdrDetnCntr : 255|4@0+ (1.0,0.0) [0.0|15.0] "Unitless" ASDM,PAS
 SG_ FrntRdrDetn40RdrDetnConf : 311|7@0+ (1.0,0.0) [0.0|100.0] "%" ASDM,PAS
 SG_ FrntRdrDetn40RdrDetnElevn : 319|5@0+ (1.0,-15.0) [-15.0|15.0] "Deg" ASDM,PAS
 SG_ FrntRdrDetn40RdrDetnPwr : 249|9@0+ (0.1,0.0) [0.0|51.1] "dB" ASDM,PAS
 SG_ FrntRdrDetn40RdrDetnRng : 271|14@0+ (0.02,-1.0) [-1.0|200.0] "m" ASDM,PAS
 SG_ FrntRdrDetn40RdrDetnRngV : 292|13@0+ (0.02,-80.0) [-80.0|80.0] "m/s" ASDM,PAS
 SG_ FrntRdrDetn40RdrDetnSts : 251|2@0+ (1,0) [0|3] "" ASDM,PAS
 SG_ FrntRdrDetn41_UB : 394|1@0+ (1,0) [0|1] "" ASDM,PAS
 SG_ FrntRdrDetn41RdrDetnAzi : 351|11@0+ (0.1,-90.0) [-90.0|90.0] "Deg" ASDM,PAS
 SG_ FrntRdrDetn41RdrDetnChks : 327|8@0+ (1.0,0.0) [0.0|255.0] "Unitless" ASDM,PAS
 SG_ FrntRdrDetn41RdrDetnCntr : 335|4@0+ (1.0,0.0) [0.0|15.0] "Unitless" ASDM,PAS
 SG_ FrntRdrDetn41RdrDetnConf : 391|7@0+ (1.0,0.0) [0.0|100.0] "%" ASDM,PAS
 SG_ FrntRdrDetn41RdrDetnElevn : 399|5@0+ (1.0,-15.0) [-15.0|15.0] "Deg" ASDM,PAS
 SG_ FrntRdrDetn41RdrDetnPwr : 329|9@0+ (0.1,0.0) [0.0|51.1] "dB" ASDM,PAS
 SG_ FrntRdrDetn41RdrDetnRng : 375|14@0+ (0.02,-1.0) [-1.0|200.0] "m" ASDM,PAS
 SG_ FrntRdrDetn41RdrDetnRngV : 356|13@0+ (0.02,-80.0) [-80.0|80.0] "m/s" ASDM,PAS
 SG_ FrntRdrDetn41RdrDetnSts : 331|2@0+ (1,0) [0|3] "" ASDM,PAS
 SG_ FrntRdrDetn42_UB : 474|1@0+ (1,0) [0|1] "" ASDM,PAS
 SG_ FrntRdrDetn42RdrDetnAzi : 447|11@0+ (0.1,-90.0) [-90.0|90.0] "Deg" ASDM,PAS
 SG_ FrntRdrDetn42RdrDetnChks : 407|8@0+ (1.0,0.0) [0.0|255.0] "Unitless" ASDM,PAS
 SG_ FrntRdrDetn42RdrDetnCntr : 415|4@0+ (1.0,0.0) [0.0|15.0] "Unitless" ASDM,PAS
 SG_ FrntRdrDetn42RdrDetnConf : 471|7@0+ (1.0,0.0) [0.0|100.0] "%" ASDM,PAS
 SG_ FrntRdrDetn42RdrDetnElevn : 479|5@0+ (1.0,-15.0) [-15.0|15.0] "Deg" ASDM,PAS
 SG_ FrntRdrDetn42RdrDetnPwr : 409|9@0+ (0.1,0.0) [0.0|51.1] "dB" ASDM,PAS
 SG_ FrntRdrDetn42RdrDetnRng : 431|14@0+ (0.02,-1.0) [-1.0|200.0] "m" ASDM,PAS
 SG_ FrntRdrDetn42RdrDetnRngV : 452|13@0+ (0.02,-80.0) [-80.0|80.0] "m/s" ASDM,PAS
 SG_ FrntRdrDetn42RdrDetnSts : 411|2@0+ (1,0) [0|3] "" ASDM,PAS

BO_ 318 FLRSafetyCANFD2Frame08: 64 FLR
 SG_ FrntRdrDetn43_UB : 74|1@0+ (1,0) [0|1] "" ASDM,PAS
 SG_ FrntRdrDetn43RdrDetnAzi : 31|11@0+ (0.1,-90.0) [-90.0|90.0] "Deg" ASDM,PAS
 SG_ FrntRdrDetn43RdrDetnChks : 7|8@0+ (1.0,0.0) [0.0|255.0] "Unitless" ASDM,PAS
 SG_ FrntRdrDetn43RdrDetnCntr : 15|4@0+ (1.0,0.0) [0.0|15.0] "Unitless" ASDM,PAS
 SG_ FrntRdrDetn43RdrDetnConf : 71|7@0+ (1.0,0.0) [0.0|100.0] "%" ASDM,PAS
 SG_ FrntRdrDetn43RdrDetnElevn : 79|5@0+ (1.0,-15.0) [-15.0|15.0] "Deg" ASDM,PAS
 SG_ FrntRdrDetn43RdrDetnPwr : 8|9@0+ (0.1,0.0) [0.0|51.1] "dB" ASDM,PAS
 SG_ FrntRdrDetn43RdrDetnRng : 55|14@0+ (0.02,-1.0) [-1.0|200.0] "m" ASDM,PAS
 SG_ FrntRdrDetn43RdrDetnRngV : 36|13@0+ (0.02,-80.0) [-80.0|80.0] "m/s" ASDM,PAS
 SG_ FrntRdrDetn43RdrDetnSts : 11|2@0+ (1,0) [0|3] "" ASDM,PAS
 SG_ FrntRdrDetn44_UB : 154|1@0+ (1,0) [0|1] "" ASDM,PAS
 SG_ FrntRdrDetn44RdrDetnAzi : 119|11@0+ (0.1,-90.0) [-90.0|90.0] "Deg" ASDM,PAS
 SG_ FrntRdrDetn44RdrDetnChks : 87|8@0+ (1.0,0.0) [0.0|255.0] "Unitless" ASDM,PAS
 SG_ FrntRdrDetn44RdrDetnCntr : 95|4@0+ (1.0,0.0) [0.0|15.0] "Unitless" ASDM,PAS
 SG_ FrntRdrDetn44RdrDetnConf : 111|7@0+ (1.0,0.0) [0.0|100.0] "%" ASDM,PAS
 SG_ FrntRdrDetn44RdrDetnElevn : 159|5@0+ (1.0,-15.0) [-15.0|15.0] "Deg" ASDM,PAS
 SG_ FrntRdrDetn44RdrDetnPwr : 89|9@0+ (0.1,0.0) [0.0|51.1] "dB" ASDM,PAS
 SG_ FrntRdrDetn44RdrDetnRng : 143|14@0+ (0.02,-1.0) [-1.0|200.0] "m" ASDM,PAS
 SG_ FrntRdrDetn44RdrDetnRngV : 124|13@0+ (0.02,-80.0) [-80.0|80.0] "m/s" ASDM,PAS
 SG_ FrntRdrDetn44RdrDetnSts : 91|2@0+ (1,0) [0|3] "" ASDM,PAS
 SG_ FrntRdrDetn45_UB : 234|1@0+ (1,0) [0|1] "" ASDM,PAS
 SG_ FrntRdrDetn45RdrDetnAzi : 199|11@0+ (0.1,-90.0) [-90.0|90.0] "Deg" ASDM,PAS
 SG_ FrntRdrDetn45RdrDetnChks : 167|8@0+ (1.0,0.0) [0.0|255.0] "Unitless" ASDM,PAS
 SG_ FrntRdrDetn45RdrDetnCntr : 175|4@0+ (1.0,0.0) [0.0|15.0] "Unitless" ASDM,PAS
 SG_ FrntRdrDetn45RdrDetnConf : 191|7@0+ (1.0,0.0) [0.0|100.0] "%" ASDM,PAS
 SG_ FrntRdrDetn45RdrDetnElevn : 239|5@0+ (1.0,-15.0) [-15.0|15.0] "Deg" ASDM,PAS
 SG_ FrntRdrDetn45RdrDetnPwr : 169|9@0+ (0.1,0.0) [0.0|51.1] "dB" ASDM,PAS
 SG_ FrntRdrDetn45RdrDetnRng : 223|14@0+ (0.02,-1.0) [-1.0|200.0] "m" ASDM,PAS
 SG_ FrntRdrDetn45RdrDetnRngV : 204|13@0+ (0.02,-80.0) [-80.0|80.0] "m/s" ASDM,PAS
 SG_ FrntRdrDetn45RdrDetnSts : 171|2@0+ (1,0) [0|3] "" ASDM,PAS
 SG_ FrntRdrDetn46_UB : 314|1@0+ (1,0) [0|1] "" ASDM,PAS
 SG_ FrntRdrDetn46RdrDetnAzi : 287|11@0+ (0.1,-90.0) [-90.0|90.0] "Deg" ASDM,PAS
 SG_ FrntRdrDetn46RdrDetnChks : 247|8@0+ (1.0,0.0) [0.0|255.0] "Unitless" ASDM,PAS
 SG_ FrntRdrDetn46RdrDetnCntr : 255|4@0+ (1.0,0.0) [0.0|15.0] "Unitless" ASDM,PAS
 SG_ FrntRdrDetn46RdrDetnConf : 311|7@0+ (1.0,0.0) [0.0|100.0] "%" ASDM,PAS
 SG_ FrntRdrDetn46RdrDetnElevn : 319|5@0+ (1.0,-15.0) [-15.0|15.0] "Deg" ASDM,PAS
 SG_ FrntRdrDetn46RdrDetnPwr : 249|9@0+ (0.1,0.0) [0.0|51.1] "dB" ASDM,PAS
 SG_ FrntRdrDetn46RdrDetnRng : 271|14@0+ (0.02,-1.0) [-1.0|200.0] "m" ASDM,PAS
 SG_ FrntRdrDetn46RdrDetnRngV : 292|13@0+ (0.02,-80.0) [-80.0|80.0] "m/s" ASDM,PAS
 SG_ FrntRdrDetn46RdrDetnSts : 251|2@0+ (1,0) [0|3] "" ASDM,PAS
 SG_ FrntRdrDetn47_UB : 394|1@0+ (1,0) [0|1] "" ASDM,PAS
 SG_ FrntRdrDetn47RdrDetnAzi : 351|11@0+ (0.1,-90.0) [-90.0|90.0] "Deg" ASDM,PAS
 SG_ FrntRdrDetn47RdrDetnChks : 327|8@0+ (1.0,0.0) [0.0|255.0] "Unitless" ASDM,PAS
 SG_ FrntRdrDetn47RdrDetnCntr : 335|4@0+ (1.0,0.0) [0.0|15.0] "Unitless" ASDM,PAS
 SG_ FrntRdrDetn47RdrDetnConf : 391|7@0+ (1.0,0.0) [0.0|100.0] "%" ASDM,PAS
 SG_ FrntRdrDetn47RdrDetnElevn : 399|5@0+ (1.0,-15.0) [-15.0|15.0] "Deg" ASDM,PAS
 SG_ FrntRdrDetn47RdrDetnPwr : 329|9@0+ (0.1,0.0) [0.0|51.1] "dB" ASDM,PAS
 SG_ FrntRdrDetn47RdrDetnRng : 375|14@0+ (0.02,-1.0) [-1.0|200.0] "m" ASDM,PAS
 SG_ FrntRdrDetn47RdrDetnRngV : 356|13@0+ (0.02,-80.0) [-80.0|80.0] "m/s" ASDM,PAS
 SG_ FrntRdrDetn47RdrDetnSts : 331|2@0+ (1,0) [0|3] "" ASDM,PAS
 SG_ FrntRdrDetn48_UB : 474|1@0+ (1,0) [0|1] "" ASDM,PAS
 SG_ FrntRdrDetn48RdrDetnAzi : 447|11@0+ (0.1,-90.0) [-90.0|90.0] "Deg" ASDM,PAS
 SG_ FrntRdrDetn48RdrDetnChks : 407|8@0+ (1.0,0.0) [0.0|255.0] "Unitless" ASDM,PAS
 SG_ FrntRdrDetn48RdrDetnCntr : 415|4@0+ (1.0,0.0) [0.0|15.0] "Unitless" ASDM,PAS
 SG_ FrntRdrDetn48RdrDetnConf : 471|7@0+ (1.0,0.0) [0.0|100.0] "%" ASDM,PAS
 SG_ FrntRdrDetn48RdrDetnElevn : 479|5@0+ (1.0,-15.0) [-15.0|15.0] "Deg" ASDM,PAS
 SG_ FrntRdrDetn48RdrDetnPwr : 409|9@0+ (0.1,0.0) [0.0|51.1] "dB" ASDM,PAS
 SG_ FrntRdrDetn48RdrDetnRng : 431|14@0+ (0.02,-1.0) [-1.0|200.0] "m" ASDM,PAS
 SG_ FrntRdrDetn48RdrDetnRngV : 452|13@0+ (0.02,-80.0) [-80.0|80.0] "m/s" ASDM,PAS
 SG_ FrntRdrDetn48RdrDetnSts : 411|2@0+ (1,0) [0|3] "" ASDM,PAS

BO_ 320 FLRSafetyCANFD2Frame09: 64 FLR
 SG_ FrntRdrDetn49_UB : 74|1@0+ (1,0) [0|1] "" ASDM,PAS
 SG_ FrntRdrDetn49RdrDetnAzi : 31|11@0+ (0.1,-90.0) [-90.0|90.0] "Deg" ASDM,PAS
 SG_ FrntRdrDetn49RdrDetnChks : 7|8@0+ (1.0,0.0) [0.0|255.0] "Unitless" ASDM,PAS
 SG_ FrntRdrDetn49RdrDetnCntr : 15|4@0+ (1.0,0.0) [0.0|15.0] "Unitless" ASDM,PAS
 SG_ FrntRdrDetn49RdrDetnConf : 71|7@0+ (1.0,0.0) [0.0|100.0] "%" ASDM,PAS
 SG_ FrntRdrDetn49RdrDetnElevn : 79|5@0+ (1.0,-15.0) [-15.0|15.0] "Deg" ASDM,PAS
 SG_ FrntRdrDetn49RdrDetnPwr : 8|9@0+ (0.1,0.0) [0.0|51.1] "dB" ASDM,PAS
 SG_ FrntRdrDetn49RdrDetnRng : 55|14@0+ (0.02,-1.0) [-1.0|200.0] "m" ASDM,PAS
 SG_ FrntRdrDetn49RdrDetnRngV : 36|13@0+ (0.02,-80.0) [-80.0|80.0] "m/s" ASDM,PAS
 SG_ FrntRdrDetn49RdrDetnSts : 11|2@0+ (1,0) [0|3] "" ASDM,PAS
 SG_ FrntRdrDetn50_UB : 154|1@0+ (1,0) [0|1] "" ASDM,PAS
 SG_ FrntRdrDetn50RdrDetnAzi : 119|11@0+ (0.1,-90.0) [-90.0|90.0] "Deg" ASDM,PAS
 SG_ FrntRdrDetn50RdrDetnChks : 87|8@0+ (1.0,0.0) [0.0|255.0] "Unitless" ASDM,PAS
 SG_ FrntRdrDetn50RdrDetnCntr : 95|4@0+ (1.0,0.0) [0.0|15.0] "Unitless" ASDM,PAS
 SG_ FrntRdrDetn50RdrDetnConf : 111|7@0+ (1.0,0.0) [0.0|100.0] "%" ASDM,PAS
 SG_ FrntRdrDetn50RdrDetnElevn : 159|5@0+ (1.0,-15.0) [-15.0|15.0] "Deg" ASDM,PAS
 SG_ FrntRdrDetn50RdrDetnPwr : 89|9@0+ (0.1,0.0) [0.0|51.1] "dB" ASDM,PAS
 SG_ FrntRdrDetn50RdrDetnRng : 143|14@0+ (0.02,-1.0) [-1.0|200.0] "m" ASDM,PAS
 SG_ FrntRdrDetn50RdrDetnRngV : 124|13@0+ (0.02,-80.0) [-80.0|80.0] "m/s" ASDM,PAS
 SG_ FrntRdrDetn50RdrDetnSts : 91|2@0+ (1,0) [0|3] "" ASDM,PAS
 SG_ FrntRdrDetn51_UB : 234|1@0+ (1,0) [0|1] "" ASDM,PAS
 SG_ FrntRdrDetn51RdrDetnAzi : 199|11@0+ (0.1,-90.0) [-90.0|90.0] "Deg" ASDM,PAS
 SG_ FrntRdrDetn51RdrDetnChks : 167|8@0+ (1.0,0.0) [0.0|255.0] "Unitless" ASDM,PAS
 SG_ FrntRdrDetn51RdrDetnCntr : 175|4@0+ (1.0,0.0) [0.0|15.0] "Unitless" ASDM,PAS
 SG_ FrntRdrDetn51RdrDetnConf : 191|7@0+ (1.0,0.0) [0.0|100.0] "%" ASDM,PAS
 SG_ FrntRdrDetn51RdrDetnElevn : 239|5@0+ (1.0,-15.0) [-15.0|15.0] "Deg" ASDM,PAS
 SG_ FrntRdrDetn51RdrDetnPwr : 169|9@0+ (0.1,0.0) [0.0|51.1] "dB" ASDM,PAS
 SG_ FrntRdrDetn51RdrDetnRng : 223|14@0+ (0.02,-1.0) [-1.0|200.0] "m" ASDM,PAS
 SG_ FrntRdrDetn51RdrDetnRngV : 204|13@0+ (0.02,-80.0) [-80.0|80.0] "m/s" ASDM,PAS
 SG_ FrntRdrDetn51RdrDetnSts : 171|2@0+ (1,0) [0|3] "" ASDM,PAS
 SG_ FrntRdrDetn52_UB : 314|1@0+ (1,0) [0|1] "" ASDM,PAS
 SG_ FrntRdrDetn52RdrDetnAzi : 287|11@0+ (0.1,-90.0) [-90.0|90.0] "Deg" ASDM,PAS
 SG_ FrntRdrDetn52RdrDetnChks : 247|8@0+ (1.0,0.0) [0.0|255.0] "Unitless" ASDM,PAS
 SG_ FrntRdrDetn52RdrDetnCntr : 255|4@0+ (1.0,0.0) [0.0|15.0] "Unitless" ASDM,PAS
 SG_ FrntRdrDetn52RdrDetnConf : 311|7@0+ (1.0,0.0) [0.0|100.0] "%" ASDM,PAS
 SG_ FrntRdrDetn52RdrDetnElevn : 319|5@0+ (1.0,-15.0) [-15.0|15.0] "Deg" ASDM,PAS
 SG_ FrntRdrDetn52RdrDetnPwr : 249|9@0+ (0.1,0.0) [0.0|51.1] "dB" ASDM,PAS
 SG_ FrntRdrDetn52RdrDetnRng : 271|14@0+ (0.02,-1.0) [-1.0|200.0] "m" ASDM,PAS
 SG_ FrntRdrDetn52RdrDetnRngV : 292|13@0+ (0.02,-80.0) [-80.0|80.0] "m/s" ASDM,PAS
 SG_ FrntRdrDetn52RdrDetnSts : 251|2@0+ (1,0) [0|3] "" ASDM,PAS
 SG_ FrntRdrDetn53_UB : 394|1@0+ (1,0) [0|1] "" ASDM,PAS
 SG_ FrntRdrDetn53RdrDetnAzi : 351|11@0+ (0.1,-90.0) [-90.0|90.0] "Deg" ASDM,PAS
 SG_ FrntRdrDetn53RdrDetnChks : 327|8@0+ (1.0,0.0) [0.0|255.0] "Unitless" ASDM,PAS
 SG_ FrntRdrDetn53RdrDetnCntr : 335|4@0+ (1.0,0.0) [0.0|15.0] "Unitless" ASDM,PAS
 SG_ FrntRdrDetn53RdrDetnConf : 391|7@0+ (1.0,0.0) [0.0|100.0] "%" ASDM,PAS
 SG_ FrntRdrDetn53RdrDetnElevn : 399|5@0+ (1.0,-15.0) [-15.0|15.0] "Deg" ASDM,PAS
 SG_ FrntRdrDetn53RdrDetnPwr : 329|9@0+ (0.1,0.0) [0.0|51.1] "dB" ASDM,PAS
 SG_ FrntRdrDetn53RdrDetnRng : 375|14@0+ (0.02,-1.0) [-1.0|200.0] "m" ASDM,PAS
 SG_ FrntRdrDetn53RdrDetnRngV : 356|13@0+ (0.02,-80.0) [-80.0|80.0] "m/s" ASDM,PAS
 SG_ FrntRdrDetn53RdrDetnSts : 331|2@0+ (1,0) [0|3] "" ASDM,PAS
 SG_ FrntRdrDetn54_UB : 474|1@0+ (1,0) [0|1] "" ASDM,PAS
 SG_ FrntRdrDetn54RdrDetnAzi : 447|11@0+ (0.1,-90.0) [-90.0|90.0] "Deg" ASDM,PAS
 SG_ FrntRdrDetn54RdrDetnChks : 407|8@0+ (1.0,0.0) [0.0|255.0] "Unitless" ASDM,PAS
 SG_ FrntRdrDetn54RdrDetnCntr : 415|4@0+ (1.0,0.0) [0.0|15.0] "Unitless" ASDM,PAS
 SG_ FrntRdrDetn54RdrDetnConf : 471|7@0+ (1.0,0.0) [0.0|100.0] "%" ASDM,PAS
 SG_ FrntRdrDetn54RdrDetnElevn : 479|5@0+ (1.0,-15.0) [-15.0|15.0] "Deg" ASDM,PAS
 SG_ FrntRdrDetn54RdrDetnPwr : 409|9@0+ (0.1,0.0) [0.0|51.1] "dB" ASDM,PAS
 SG_ FrntRdrDetn54RdrDetnRng : 431|14@0+ (0.02,-1.0) [-1.0|200.0] "m" ASDM,PAS
 SG_ FrntRdrDetn54RdrDetnRngV : 452|13@0+ (0.02,-80.0) [-80.0|80.0] "m/s" ASDM,PAS
 SG_ FrntRdrDetn54RdrDetnSts : 411|2@0+ (1,0) [0|3] "" ASDM,PAS

BO_ 322 FLRSafetyCANFD2Frame10: 64 FLR
 SG_ FrntRdrDetn55_UB : 74|1@0+ (1,0) [0|1] "" ASDM,PAS
 SG_ FrntRdrDetn55RdrDetnAzi : 31|11@0+ (0.1,-90.0) [-90.0|90.0] "Deg" ASDM,PAS
 SG_ FrntRdrDetn55RdrDetnChks : 7|8@0+ (1.0,0.0) [0.0|255.0] "Unitless" ASDM,PAS
 SG_ FrntRdrDetn55RdrDetnCntr : 15|4@0+ (1.0,0.0) [0.0|15.0] "Unitless" ASDM,PAS
 SG_ FrntRdrDetn55RdrDetnConf : 71|7@0+ (1.0,0.0) [0.0|100.0] "%" ASDM,PAS
 SG_ FrntRdrDetn55RdrDetnElevn : 79|5@0+ (1.0,-15.0) [-15.0|15.0] "Deg" ASDM,PAS
 SG_ FrntRdrDetn55RdrDetnPwr : 8|9@0+ (0.1,0.0) [0.0|51.1] "dB" ASDM,PAS
 SG_ FrntRdrDetn55RdrDetnRng : 55|14@0+ (0.02,-1.0) [-1.0|200.0] "m" ASDM,PAS
 SG_ FrntRdrDetn55RdrDetnRngV : 36|13@0+ (0.02,-80.0) [-80.0|80.0] "m/s" ASDM,PAS
 SG_ FrntRdrDetn55RdrDetnSts : 11|2@0+ (1,0) [0|3] "" ASDM,PAS
 SG_ FrntRdrDetn56_UB : 154|1@0+ (1,0) [0|1] "" ASDM,PAS
 SG_ FrntRdrDetn56RdrDetnAzi : 119|11@0+ (0.1,-90.0) [-90.0|90.0] "Deg" ASDM,PAS
 SG_ FrntRdrDetn56RdrDetnChks : 87|8@0+ (1.0,0.0) [0.0|255.0] "Unitless" ASDM,PAS
 SG_ FrntRdrDetn56RdrDetnCntr : 95|4@0+ (1.0,0.0) [0.0|15.0] "Unitless" ASDM,PAS
 SG_ FrntRdrDetn56RdrDetnConf : 111|7@0+ (1.0,0.0) [0.0|100.0] "%" ASDM,PAS
 SG_ FrntRdrDetn56RdrDetnElevn : 159|5@0+ (1.0,-15.0) [-15.0|15.0] "Deg" ASDM,PAS
 SG_ FrntRdrDetn56RdrDetnPwr : 89|9@0+ (0.1,0.0) [0.0|51.1] "dB" ASDM,PAS
 SG_ FrntRdrDetn56RdrDetnRng : 143|14@0+ (0.02,-1.0) [-1.0|200.0] "m" ASDM,PAS
 SG_ FrntRdrDetn56RdrDetnRngV : 124|13@0+ (0.02,-80.0) [-80.0|80.0] "m/s" ASDM,PAS
 SG_ FrntRdrDetn56RdrDetnSts : 91|2@0+ (1,0) [0|3] "" ASDM,PAS
 SG_ FrntRdrDetn57_UB : 234|1@0+ (1,0) [0|1] "" ASDM,PAS
 SG_ FrntRdrDetn57RdrDetnAzi : 199|11@0+ (0.1,-90.0) [-90.0|90.0] "Deg" ASDM,PAS
 SG_ FrntRdrDetn57RdrDetnChks : 167|8@0+ (1.0,0.0) [0.0|255.0] "Unitless" ASDM,PAS
 SG_ FrntRdrDetn57RdrDetnCntr : 175|4@0+ (1.0,0.0) [0.0|15.0] "Unitless" ASDM,PAS
 SG_ FrntRdrDetn57RdrDetnConf : 191|7@0+ (1.0,0.0) [0.0|100.0] "%" ASDM,PAS
 SG_ FrntRdrDetn57RdrDetnElevn : 239|5@0+ (1.0,-15.0) [-15.0|15.0] "Deg" ASDM,PAS
 SG_ FrntRdrDetn57RdrDetnPwr : 169|9@0+ (0.1,0.0) [0.0|51.1] "dB" ASDM,PAS
 SG_ FrntRdrDetn57RdrDetnRng : 223|14@0+ (0.02,-1.0) [-1.0|200.0] "m" ASDM,PAS
 SG_ FrntRdrDetn57RdrDetnRngV : 204|13@0+ (0.02,-80.0) [-80.0|80.0] "m/s" ASDM,PAS
 SG_ FrntRdrDetn57RdrDetnSts : 171|2@0+ (1,0) [0|3] "" ASDM,PAS
 SG_ FrntRdrDetn58_UB : 314|1@0+ (1,0) [0|1] "" ASDM,PAS
 SG_ FrntRdrDetn58RdrDetnAzi : 287|11@0+ (0.1,-90.0) [-90.0|90.0] "Deg" ASDM,PAS
 SG_ FrntRdrDetn58RdrDetnChks : 247|8@0+ (1.0,0.0) [0.0|255.0] "Unitless" ASDM,PAS
 SG_ FrntRdrDetn58RdrDetnCntr : 255|4@0+ (1.0,0.0) [0.0|15.0] "Unitless" ASDM,PAS
 SG_ FrntRdrDetn58RdrDetnConf : 311|7@0+ (1.0,0.0) [0.0|100.0] "%" ASDM,PAS
 SG_ FrntRdrDetn58RdrDetnElevn : 319|5@0+ (1.0,-15.0) [-15.0|15.0] "Deg" ASDM,PAS
 SG_ FrntRdrDetn58RdrDetnPwr : 249|9@0+ (0.1,0.0) [0.0|51.1] "dB" ASDM,PAS
 SG_ FrntRdrDetn58RdrDetnRng : 271|14@0+ (0.02,-1.0) [-1.0|200.0] "m" ASDM,PAS
 SG_ FrntRdrDetn58RdrDetnRngV : 292|13@0+ (0.02,-80.0) [-80.0|80.0] "m/s" ASDM,PAS
 SG_ FrntRdrDetn58RdrDetnSts : 251|2@0+ (1,0) [0|3] "" ASDM,PAS
 SG_ FrntRdrDetn59_UB : 394|1@0+ (1,0) [0|1] "" ASDM,PAS
 SG_ FrntRdrDetn59RdrDetnAzi : 351|11@0+ (0.1,-90.0) [-90.0|90.0] "Deg" ASDM,PAS
 SG_ FrntRdrDetn59RdrDetnChks : 327|8@0+ (1.0,0.0) [0.0|255.0] "Unitless" ASDM,PAS
 SG_ FrntRdrDetn59RdrDetnCntr : 335|4@0+ (1.0,0.0) [0.0|15.0] "Unitless" ASDM,PAS
 SG_ FrntRdrDetn59RdrDetnConf : 391|7@0+ (1.0,0.0) [0.0|100.0] "%" ASDM,PAS
 SG_ FrntRdrDetn59RdrDetnElevn : 399|5@0+ (1.0,-15.0) [-15.0|15.0] "Deg" ASDM,PAS
 SG_ FrntRdrDetn59RdrDetnPwr : 329|9@0+ (0.1,0.0) [0.0|51.1] "dB" ASDM,PAS
 SG_ FrntRdrDetn59RdrDetnRng : 375|14@0+ (0.02,-1.0) [-1.0|200.0] "m" ASDM,PAS
 SG_ FrntRdrDetn59RdrDetnRngV : 356|13@0+ (0.02,-80.0) [-80.0|80.0] "m/s" ASDM,PAS
 SG_ FrntRdrDetn59RdrDetnSts : 331|2@0+ (1,0) [0|3] "" ASDM,PAS
 SG_ FrntRdrDetn60_UB : 474|1@0+ (1,0) [0|1] "" ASDM,PAS
 SG_ FrntRdrDetn60RdrDetnAzi : 447|11@0+ (0.1,-90.0) [-90.0|90.0] "Deg" ASDM,PAS
 SG_ FrntRdrDetn60RdrDetnChks : 407|8@0+ (1.0,0.0) [0.0|255.0] "Unitless" ASDM,PAS
 SG_ FrntRdrDetn60RdrDetnCntr : 415|4@0+ (1.0,0.0) [0.0|15.0] "Unitless" ASDM,PAS
 SG_ FrntRdrDetn60RdrDetnConf : 471|7@0+ (1.0,0.0) [0.0|100.0] "%" ASDM,PAS
 SG_ FrntRdrDetn60RdrDetnElevn : 479|5@0+ (1.0,-15.0) [-15.0|15.0] "Deg" ASDM,PAS
 SG_ FrntRdrDetn60RdrDetnPwr : 409|9@0+ (0.1,0.0) [0.0|51.1] "dB" ASDM,PAS
 SG_ FrntRdrDetn60RdrDetnRng : 431|14@0+ (0.02,-1.0) [-1.0|200.0] "m" ASDM,PAS
 SG_ FrntRdrDetn60RdrDetnRngV : 452|13@0+ (0.02,-80.0) [-80.0|80.0] "m/s" ASDM,PAS
 SG_ FrntRdrDetn60RdrDetnSts : 411|2@0+ (1,0) [0|3] "" ASDM,PAS

BO_ 324 FLRSafetyCANFD2Frame11: 64 FLR
 SG_ FrntRdrDetn61_UB : 74|1@0+ (1,0) [0|1] "" ASDM,PAS
 SG_ FrntRdrDetn61RdrDetnAzi : 31|11@0+ (0.1,-90.0) [-90.0|90.0] "Deg" ASDM,PAS
 SG_ FrntRdrDetn61RdrDetnChks : 7|8@0+ (1.0,0.0) [0.0|255.0] "Unitless" ASDM,PAS
 SG_ FrntRdrDetn61RdrDetnCntr : 15|4@0+ (1.0,0.0) [0.0|15.0] "Unitless" ASDM,PAS
 SG_ FrntRdrDetn61RdrDetnConf : 71|7@0+ (1.0,0.0) [0.0|100.0] "%" ASDM,PAS
 SG_ FrntRdrDetn61RdrDetnElevn : 79|5@0+ (1.0,-15.0) [-15.0|15.0] "Deg" ASDM,PAS
 SG_ FrntRdrDetn61RdrDetnPwr : 8|9@0+ (0.1,0.0) [0.0|51.1] "dB" ASDM,PAS
 SG_ FrntRdrDetn61RdrDetnRng : 55|14@0+ (0.02,-1.0) [-1.0|200.0] "m" ASDM,PAS
 SG_ FrntRdrDetn61RdrDetnRngV : 36|13@0+ (0.02,-80.0) [-80.0|80.0] "m/s" ASDM,PAS
 SG_ FrntRdrDetn61RdrDetnSts : 11|2@0+ (1,0) [0|3] "" ASDM,PAS
 SG_ FrntRdrDetn62_UB : 154|1@0+ (1,0) [0|1] "" ASDM,PAS
 SG_ FrntRdrDetn62RdrDetnAzi : 119|11@0+ (0.1,-90.0) [-90.0|90.0] "Deg" ASDM,PAS
 SG_ FrntRdrDetn62RdrDetnChks : 87|8@0+ (1.0,0.0) [0.0|255.0] "Unitless" ASDM,PAS
 SG_ FrntRdrDetn62RdrDetnCntr : 95|4@0+ (1.0,0.0) [0.0|15.0] "Unitless" ASDM,PAS
 SG_ FrntRdrDetn62RdrDetnConf : 111|7@0+ (1.0,0.0) [0.0|100.0] "%" ASDM,PAS
 SG_ FrntRdrDetn62RdrDetnElevn : 159|5@0+ (1.0,-15.0) [-15.0|15.0] "Deg" ASDM,PAS
 SG_ FrntRdrDetn62RdrDetnPwr : 89|9@0+ (0.1,0.0) [0.0|51.1] "dB" ASDM,PAS
 SG_ FrntRdrDetn62RdrDetnRng : 143|14@0+ (0.02,-1.0) [-1.0|200.0] "m" ASDM,PAS
 SG_ FrntRdrDetn62RdrDetnRngV : 124|13@0+ (0.02,-80.0) [-80.0|80.0] "m/s" ASDM,PAS
 SG_ FrntRdrDetn62RdrDetnSts : 91|2@0+ (1,0) [0|3] "" ASDM,PAS
 SG_ FrntRdrDetn63_UB : 234|1@0+ (1,0) [0|1] "" ASDM,PAS
 SG_ FrntRdrDetn63RdrDetnAzi : 199|11@0+ (0.1,-90.0) [-90.0|90.0] "Deg" ASDM,PAS
 SG_ FrntRdrDetn63RdrDetnChks : 167|8@0+ (1.0,0.0) [0.0|255.0] "Unitless" ASDM,PAS
 SG_ FrntRdrDetn63RdrDetnCntr : 175|4@0+ (1.0,0.0) [0.0|15.0] "Unitless" ASDM,PAS
 SG_ FrntRdrDetn63RdrDetnConf : 191|7@0+ (1.0,0.0) [0.0|100.0] "%" ASDM,PAS
 SG_ FrntRdrDetn63RdrDetnElevn : 239|5@0+ (1.0,-15.0) [-15.0|15.0] "Deg" ASDM,PAS
 SG_ FrntRdrDetn63RdrDetnPwr : 169|9@0+ (0.1,0.0) [0.0|51.1] "dB" ASDM,PAS
 SG_ FrntRdrDetn63RdrDetnRng : 223|14@0+ (0.02,-1.0) [-1.0|200.0] "m" ASDM,PAS
 SG_ FrntRdrDetn63RdrDetnRngV : 204|13@0+ (0.02,-80.0) [-80.0|80.0] "m/s" ASDM,PAS
 SG_ FrntRdrDetn63RdrDetnSts : 171|2@0+ (1,0) [0|3] "" ASDM,PAS
 SG_ FrntRdrDetn64_UB : 314|1@0+ (1,0) [0|1] "" ASDM,PAS
 SG_ FrntRdrDetn64RdrDetnAzi : 287|11@0+ (0.1,-90.0) [-90.0|90.0] "Deg" ASDM,PAS
 SG_ FrntRdrDetn64RdrDetnChks : 247|8@0+ (1.0,0.0) [0.0|255.0] "Unitless" ASDM,PAS
 SG_ FrntRdrDetn64RdrDetnCntr : 255|4@0+ (1.0,0.0) [0.0|15.0] "Unitless" ASDM,PAS
 SG_ FrntRdrDetn64RdrDetnConf : 311|7@0+ (1.0,0.0) [0.0|100.0] "%" ASDM,PAS
 SG_ FrntRdrDetn64RdrDetnElevn : 319|5@0+ (1.0,-15.0) [-15.0|15.0] "Deg" ASDM,PAS
 SG_ FrntRdrDetn64RdrDetnPwr : 249|9@0+ (0.1,0.0) [0.0|51.1] "dB" ASDM,PAS
 SG_ FrntRdrDetn64RdrDetnRng : 271|14@0+ (0.02,-1.0) [-1.0|200.0] "m" ASDM,PAS
 SG_ FrntRdrDetn64RdrDetnRngV : 292|13@0+ (0.02,-80.0) [-80.0|80.0] "m/s" ASDM,PAS
 SG_ FrntRdrDetn64RdrDetnSts : 251|2@0+ (1,0) [0|3] "" ASDM,PAS
 SG_ FrntRdrDetn65_UB : 394|1@0+ (1,0) [0|1] "" ASDM,PAS
 SG_ FrntRdrDetn65RdrDetnAzi : 351|11@0+ (0.1,-90.0) [-90.0|90.0] "Deg" ASDM,PAS
 SG_ FrntRdrDetn65RdrDetnChks : 327|8@0+ (1.0,0.0) [0.0|255.0] "Unitless" ASDM,PAS
 SG_ FrntRdrDetn65RdrDetnCntr : 335|4@0+ (1.0,0.0) [0.0|15.0] "Unitless" ASDM,PAS
 SG_ FrntRdrDetn65RdrDetnConf : 391|7@0+ (1.0,0.0) [0.0|100.0] "%" ASDM,PAS
 SG_ FrntRdrDetn65RdrDetnElevn : 399|5@0+ (1.0,-15.0) [-15.0|15.0] "Deg" ASDM,PAS
 SG_ FrntRdrDetn65RdrDetnPwr : 329|9@0+ (0.1,0.0) [0.0|51.1] "dB" ASDM,PAS
 SG_ FrntRdrDetn65RdrDetnRng : 375|14@0+ (0.02,-1.0) [-1.0|200.0] "m" ASDM,PAS
 SG_ FrntRdrDetn65RdrDetnRngV : 356|13@0+ (0.02,-80.0) [-80.0|80.0] "m/s" ASDM,PAS
 SG_ FrntRdrDetn65RdrDetnSts : 331|2@0+ (1,0) [0|3] "" ASDM,PAS
 SG_ FrntRdrDetn66_UB : 474|1@0+ (1,0) [0|1] "" ASDM,PAS
 SG_ FrntRdrDetn66RdrDetnAzi : 447|11@0+ (0.1,-90.0) [-90.0|90.0] "Deg" ASDM,PAS
 SG_ FrntRdrDetn66RdrDetnChks : 407|8@0+ (1.0,0.0) [0.0|255.0] "Unitless" ASDM,PAS
 SG_ FrntRdrDetn66RdrDetnCntr : 415|4@0+ (1.0,0.0) [0.0|15.0] "Unitless" ASDM,PAS
 SG_ FrntRdrDetn66RdrDetnConf : 471|7@0+ (1.0,0.0) [0.0|100.0] "%" ASDM,PAS
 SG_ FrntRdrDetn66RdrDetnElevn : 479|5@0+ (1.0,-15.0) [-15.0|15.0] "Deg" ASDM,PAS
 SG_ FrntRdrDetn66RdrDetnPwr : 409|9@0+ (0.1,0.0) [0.0|51.1] "dB" ASDM,PAS
 SG_ FrntRdrDetn66RdrDetnRng : 431|14@0+ (0.02,-1.0) [-1.0|200.0] "m" ASDM,PAS
 SG_ FrntRdrDetn66RdrDetnRngV : 452|13@0+ (0.02,-80.0) [-80.0|80.0] "m/s" ASDM,PAS
 SG_ FrntRdrDetn66RdrDetnSts : 411|2@0+ (1,0) [0|3] "" ASDM,PAS

CM_ SG_ 310 FrntRdrDetn19RdrDetnAzi "Refer to the data element description in FrntRdrDetn1 with the same data element name.";
CM_ SG_ 310 FrntRdrDetn19RdrDetnChks "Refer to the data element description in FrntRdrDetn1 with the same data element name.";
CM_ SG_ 310 FrntRdrDetn19RdrDetnCntr "Refer to the data element description in FrntRdrDetn1 with the same data element name.";
CM_ SG_ 310 FrntRdrDetn19RdrDetnConf "Refer to the data element description in FrntRdrDetn1 with the same data element name.";
CM_ SG_ 310 FrntRdrDetn19RdrDetnElevn "Refer to the data element description in FrntRdrDetn1 with the same data element name.";
CM_ SG_ 310 FrntRdrDetn19RdrDetnPwr "Refer to the data element description in FrntRdrDetn1 with the same data element name.";
CM_ SG_ 310 FrntRdrDetn19RdrDetnRng "Refer to the data element description in FrntRdrDetn1 with the same data element name.";
CM_ SG_ 310 FrntRdrDetn19RdrDetnRngV "Refer to the data element description in FrntRdrDetn1 with the same data element name.";
CM_ SG_ 310 FrntRdrDetn19RdrDetnSts "Refer to the data element description in FrntRdrDetn1 with the same data element name.";
CM_ SG_ 310 FrntRdrDetn20RdrDetnAzi "Refer to the data element description in FrntRdrDetn1 with the same data element name.";
CM_ SG_ 310 FrntRdrDetn20RdrDetnChks "Refer to the data element description in FrntRdrDetn1 with the same data element name.";
CM_ SG_ 310 FrntRdrDetn20RdrDetnCntr "Refer to the data element description in FrntRdrDetn1 with the same data element name.";
CM_ SG_ 310 FrntRdrDetn20RdrDetnConf "Refer to the data element description in FrntRdrDetn1 with the same data element name.";
CM_ SG_ 310 FrntRdrDetn20RdrDetnElevn "Refer to the data element description in FrntRdrDetn1 with the same data element name.";
CM_ SG_ 310 FrntRdrDetn20RdrDetnPwr "Refer to the data element description in FrntRdrDetn1 with the same data element name.";
CM_ SG_ 310 FrntRdrDetn20RdrDetnRng "Refer to the data element description in FrntRdrDetn1 with the same data element name.";
CM_ SG_ 310 FrntRdrDetn20RdrDetnRngV "Refer to the data element description in FrntRdrDetn1 with the same data element name.";
CM_ SG_ 310 FrntRdrDetn20RdrDetnSts "Refer to the data element description in FrntRdrDetn1 with the same data element name.";
CM_ SG_ 310 FrntRdrDetn21RdrDetnAzi "Refer to the data element description in FrntRdrDetn1 with the same data element name.";
CM_ SG_ 310 FrntRdrDetn21RdrDetnChks "Refer to the data element description in FrntRdrDetn1 with the same data element name.";
CM_ SG_ 310 FrntRdrDetn21RdrDetnCntr "Refer to the data element description in FrntRdrDetn1 with the same data element name.";
CM_ SG_ 310 FrntRdrDetn21RdrDetnConf "Refer to the data element description in FrntRdrDetn1 with the same data element name.";
CM_ SG_ 310 FrntRdrDetn21RdrDetnElevn "Refer to the data element description in FrntRdrDetn1 with the same data element name.";
CM_ SG_ 310 FrntRdrDetn21RdrDetnPwr "Refer to the data element description in FrntRdrDetn1 with the same data element name.";
CM_ SG_ 310 FrntRdrDetn21RdrDetnRng "Refer to the data element description in FrntRdrDetn1 with the same data element name.";
CM_ SG_ 310 FrntRdrDetn21RdrDetnRngV "Refer to the data element description in FrntRdrDetn1 with the same data element name.";
CM_ SG_ 310 FrntRdrDetn21RdrDetnSts "Refer to the data element description in FrntRdrDetn1 with the same data element name.";
CM_ SG_ 310 FrntRdrDetn22RdrDetnAzi "Refer to the data element description in FrntRdrDetn1 with the same data element name.";
CM_ SG_ 310 FrntRdrDetn22RdrDetnChks "Refer to the data element description in FrntRdrDetn1 with the same data element name.";
CM_ SG_ 310 FrntRdrDetn22RdrDetnCntr "Refer to the data element description in FrntRdrDetn1 with the same data element name.";
CM_ SG_ 310 FrntRdrDetn22RdrDetnConf "Refer to the data element description in FrntRdrDetn1 with the same data element name.";
CM_ SG_ 310 FrntRdrDetn22RdrDetnElevn "Refer to the data element description in FrntRdrDetn1 with the same data element name.";
CM_ SG_ 310 FrntRdrDetn22RdrDetnPwr "Refer to the data element description in FrntRdrDetn1 with the same data element name.";
CM_ SG_ 310 FrntRdrDetn22RdrDetnRng "Refer to the data element description in FrntRdrDetn1 with the same data element name.";
CM_ SG_ 310 FrntRdrDetn22RdrDetnRngV "Refer to the data element description in FrntRdrDetn1 with the same data element name.";
CM_ SG_ 310 FrntRdrDetn22RdrDetnSts "Refer to the data element description in FrntRdrDetn1 with the same data element name.";
CM_ SG_ 310 FrntRdrDetn23RdrDetnAzi "Refer to the data element description in FrntRdrDetn1 with the same data element name.";
CM_ SG_ 310 FrntRdrDetn23RdrDetnChks "Refer to the data element description in FrntRdrDetn1 with the same data element name.";
CM_ SG_ 310 FrntRdrDetn23RdrDetnCntr "Refer to the data element description in FrntRdrDetn1 with the same data element name.";
CM_ SG_ 310 FrntRdrDetn23RdrDetnConf "Refer to the data element description in FrntRdrDetn1 with the same data element name.";
CM_ SG_ 310 FrntRdrDetn23RdrDetnElevn "Refer to the data element description in FrntRdrDetn1 with the same data element name.";
CM_ SG_ 310 FrntRdrDetn23RdrDetnPwr "Refer to the data element description in FrntRdrDetn1 with the same data element name.";
CM_ SG_ 310 FrntRdrDetn23RdrDetnRng "Refer to the data element description in FrntRdrDetn1 with the same data element name.";
CM_ SG_ 310 FrntRdrDetn23RdrDetnRngV "Refer to the data element description in FrntRdrDetn1 with the same data element name.";
CM_ SG_ 310 FrntRdrDetn23RdrDetnSts "Refer to the data element description in FrntRdrDetn1 with the same data element name.";
CM_ SG_ 310 FrntRdrDetn24RdrDetnAzi "Refer to the data element description in FrntRdrDetn1 with the same data element name.";
CM_ SG_ 310 FrntRdrDetn24RdrDetnChks "Refer to the data element description in FrntRdrDetn1 with the same data element name.";
CM_ SG_ 310 FrntRdrDetn24RdrDetnCntr "Refer to the data element description in FrntRdrDetn1 with the same data element name.";
CM_ SG_ 310 FrntRdrDetn24RdrDetnConf "Refer to the data element description in FrntRdrDetn1 with the same data element name.";
CM_ SG_ 310 FrntRdrDetn24RdrDetnElevn "Refer to the data element description in FrntRdrDetn1 with the same data element name.";
CM_ SG_ 310 FrntRdrDetn24RdrDetnPwr "Refer to the data element description in FrntRdrDetn1 with the same data element name.";
CM_ SG_ 310 FrntRdrDetn24RdrDetnRng "Refer to the data element description in FrntRdrDetn1 with the same data element name.";
CM_ SG_ 310 FrntRdrDetn24RdrDetnRngV "Refer to the data element description in FrntRdrDetn1 with the same data element name.";
CM_ SG_ 310 FrntRdrDetn24RdrDetnSts "Refer to the data element description in FrntRdrDetn1 with the same data element name.";
CM_ SG_ 312 FrntRdrDetn25RdrDetnAzi "Refer to the data element description in FrntRdrDetn1 with the same data element name.";
CM_ SG_ 312 FrntRdrDetn25RdrDetnChks "Refer to the data element description in FrntRdrDetn1 with the same data element name.";
CM_ SG_ 312 FrntRdrDetn25RdrDetnCntr "Refer to the data element description in FrntRdrDetn1 with the same data element name.";
CM_ SG_ 312 FrntRdrDetn25RdrDetnConf "Refer to the data element description in FrntRdrDetn1 with the same data element name.";
CM_ SG_ 312 FrntRdrDetn25RdrDetnElevn "Refer to the data element description in FrntRdrDetn1 with the same data element name.";
CM_ SG_ 312 FrntRdrDetn25RdrDetnPwr "Refer to the data element description in FrntRdrDetn1 with the same data element name.";
CM_ SG_ 312 FrntRdrDetn25RdrDetnRng "Refer to the data element description in FrntRdrDetn1 with the same data element name.";
CM_ SG_ 312 FrntRdrDetn25RdrDetnRngV "Refer to the data element description in FrntRdrDetn1 with the same data element name.";
CM_ SG_ 312 FrntRdrDetn25RdrDetnSts "Refer to the data element description in FrntRdrDetn1 with the same data element name.";
CM_ SG_ 312 FrntRdrDetn26RdrDetnAzi "Refer to the data element description in FrntRdrDetn1 with the same data element name.";
CM_ SG_ 312 FrntRdrDetn26RdrDetnChks "Refer to the data element description in FrntRdrDetn1 with the same data element name.";
CM_ SG_ 312 FrntRdrDetn26RdrDetnCntr "Refer to the data element description in FrntRdrDetn1 with the same data element name.";
CM_ SG_ 312 FrntRdrDetn26RdrDetnConf "Refer to the data element description in FrntRdrDetn1 with the same data element name.";
CM_ SG_ 312 FrntRdrDetn26RdrDetnElevn "Refer to the data element description in FrntRdrDetn1 with the same data element name.";
CM_ SG_ 312 FrntRdrDetn26RdrDetnPwr "Refer to the data element description in FrntRdrDetn1 with the same data element name.";
CM_ SG_ 312 FrntRdrDetn26RdrDetnRng "Refer to the data element description in FrntRdrDetn1 with the same data element name.";
CM_ SG_ 312 FrntRdrDetn26RdrDetnRngV "Refer to the data element description in FrntRdrDetn1 with the same data element name.";
CM_ SG_ 312 FrntRdrDetn26RdrDetnSts "Refer to the data element description in FrntRdrDetn1 with the same data element name.";
CM_ SG_ 312 FrntRdrDetn27RdrDetnAzi "Refer to the data element description in FrntRdrDetn1 with the same data element name.";
CM_ SG_ 312 FrntRdrDetn27RdrDetnChks "Refer to the data element description in FrntRdrDetn1 with the same data element name.";
CM_ SG_ 312 FrntRdrDetn27RdrDetnCntr "Refer to the data element description in FrntRdrDetn1 with the same data element name.";
CM_ SG_ 312 FrntRdrDetn27RdrDetnConf "Refer to the data element description in FrntRdrDetn1 with the same data element name.";
CM_ SG_ 312 FrntRdrDetn27RdrDetnElevn "Refer to the data element description in FrntRdrDetn1 with the same data element name.";
CM_ SG_ 312 FrntRdrDetn27RdrDetnPwr "Refer to the data element description in FrntRdrDetn1 with the same data element name.";
CM_ SG_ 312 FrntRdrDetn27RdrDetnRng "Refer to the data element description in FrntRdrDetn1 with the same data element name.";
CM_ SG_ 312 FrntRdrDetn27RdrDetnRngV "Refer to the data element description in FrntRdrDetn1 with the same data element name.";
CM_ SG_ 312 FrntRdrDetn27RdrDetnSts "Refer to the data element description in FrntRdrDetn1 with the same data element name.";
CM_ SG_ 312 FrntRdrDetn28RdrDetnAzi "Refer to the data element description in FrntRdrDetn1 with the same data element name.";
CM_ SG_ 312 FrntRdrDetn28RdrDetnChks "Refer to the data element description in FrntRdrDetn1 with the same data element name.";
CM_ SG_ 312 FrntRdrDetn28RdrDetnCntr "Refer to the data element description in FrntRdrDetn1 with the same data element name.";
CM_ SG_ 312 FrntRdrDetn28RdrDetnConf "Refer to the data element description in FrntRdrDetn1 with the same data element name.";
CM_ SG_ 312 FrntRdrDetn28RdrDetnElevn "Refer to the data element description in FrntRdrDetn1 with the same data element name.";
CM_ SG_ 312 FrntRdrDetn28RdrDetnPwr "Refer to the data element description in FrntRdrDetn1 with the same data element name.";
CM_ SG_ 312 FrntRdrDetn28RdrDetnRng "Refer to the data element description in FrntRdrDetn1 with the same data element name.";
CM_ SG_ 312 FrntRdrDetn28RdrDetnRngV "Refer to the data element description in FrntRdrDetn1 with the same data element name.";
CM_ SG_ 312 FrntRdrDetn28RdrDetnSts "Refer to the data element description in FrntRdrDetn1 with the same data element name.";
CM_ SG_ 312 FrntRdrDetn29RdrDetnAzi "Refer to the data element description in FrntRdrDetn1 with the same data element name.";
CM_ SG_ 312 FrntRdrDetn29RdrDetnChks "Refer to the data element description in FrntRdrDetn1 with the same data element name.";
CM_ SG_ 312 FrntRdrDetn29RdrDetnCntr "Refer to the data element description in FrntRdrDetn1 with the same data element name.";
CM_ SG_ 312 FrntRdrDetn29RdrDetnConf "Refer to the data element description in FrntRdrDetn1 with the same data element name.";
CM_ SG_ 312 FrntRdrDetn29RdrDetnElevn "Refer to the data element description in FrntRdrDetn1 with the same data element name.";
CM_ SG_ 312 FrntRdrDetn29RdrDetnPwr "Refer to the data element description in FrntRdrDetn1 with the same data element name.";
CM_ SG_ 312 FrntRdrDetn29RdrDetnRng "Refer to the data element description in FrntRdrDetn1 with the same data element name.";
CM_ SG_ 312 FrntRdrDetn29RdrDetnRngV "Refer to the data element description in FrntRdrDetn1 with the same data element name.";
CM_ SG_ 312 FrntRdrDetn29RdrDetnSts "Refer to the data element description in FrntRdrDetn1 with the same data element name.";
CM_ SG_ 312 FrntRdrDetn30RdrDetnAzi "Refer to the data element description in FrntRdrDetn1 with the same data element name.";
CM_ SG_ 312 FrntRdrDetn30RdrDetnChks "Refer to the data element description in FrntRdrDetn1 with the same data element name.";
CM_ SG_ 312 FrntRdrDetn30RdrDetnCntr "Refer to the data element description in FrntRdrDetn1 with the same data element name.";
CM_ SG_ 312 FrntRdrDetn30RdrDetnConf "Refer to the data element description in FrntRdrDetn1 with the same data element name.";
CM_ SG_ 312 FrntRdrDetn30RdrDetnElevn "Refer to the data element description in FrntRdrDetn1 with the same data element name.";
CM_ SG_ 312 FrntRdrDetn30RdrDetnPwr "Refer to the data element description in FrntRdrDetn1 with the same data element name.";
CM_ SG_ 312 FrntRdrDetn30RdrDetnRng "Refer to the data element description in FrntRdrDetn1 with the same data element name.";
CM_ SG_ 312 FrntRdrDetn30RdrDetnRngV "Refer to the data element description in FrntRdrDetn1 with the same data element name.";
CM_ SG_ 312 FrntRdrDetn30RdrDetnSts "Refer to the data element description in FrntRdrDetn1 with the same data element name.";
CM_ SG_ 314 FrntRdrDetn31RdrDetnAzi "Refer to the data element description in FrntRdrDetn1 with the same data element name.";
CM_ SG_ 314 FrntRdrDetn31RdrDetnChks "Refer to the data element description in FrntRdrDetn1 with the same data element name.";
CM_ SG_ 314 FrntRdrDetn31RdrDetnCntr "Refer to the data element description in FrntRdrDetn1 with the same data element name.";
CM_ SG_ 314 FrntRdrDetn31RdrDetnConf "Refer to the data element description in FrntRdrDetn1 with the same data element name.";
CM_ SG_ 314 FrntRdrDetn31RdrDetnElevn "Refer to the data element description in FrntRdrDetn1 with the same data element name.";
CM_ SG_ 314 FrntRdrDetn31RdrDetnPwr "Refer to the data element description in FrntRdrDetn1 with the same data element name.";
CM_ SG_ 314 FrntRdrDetn31RdrDetnRng "Refer to the data element description in FrntRdrDetn1 with the same data element name.";
CM_ SG_ 314 FrntRdrDetn31RdrDetnRngV "Refer to the data element description in FrntRdrDetn1 with the same data element name.";
CM_ SG_ 314 FrntRdrDetn31RdrDetnSts "Refer to the data element description in FrntRdrDetn1 with the same data element name.";
CM_ SG_ 314 FrntRdrDetn32RdrDetnAzi "Refer to the data element description in FrntRdrDetn1 with the same data element name.";
CM_ SG_ 314 FrntRdrDetn32RdrDetnChks "Refer to the data element description in FrntRdrDetn1 with the same data element name.";
CM_ SG_ 314 FrntRdrDetn32RdrDetnCntr "Refer to the data element description in FrntRdrDetn1 with the same data element name.";
CM_ SG_ 314 FrntRdrDetn32RdrDetnConf "Refer to the data element description in FrntRdrDetn1 with the same data element name.";
CM_ SG_ 314 FrntRdrDetn32RdrDetnElevn "Refer to the data element description in FrntRdrDetn1 with the same data element name.";
CM_ SG_ 314 FrntRdrDetn32RdrDetnPwr "Refer to the data element description in FrntRdrDetn1 with the same data element name.";
CM_ SG_ 314 FrntRdrDetn32RdrDetnRng "Refer to the data element description in FrntRdrDetn1 with the same data element name.";
CM_ SG_ 314 FrntRdrDetn32RdrDetnRngV "Refer to the data element description in FrntRdrDetn1 with the same data element name.";
CM_ SG_ 314 FrntRdrDetn32RdrDetnSts "Refer to the data element description in FrntRdrDetn1 with the same data element name.";
CM_ SG_ 314 FrntRdrDetn33RdrDetnAzi "Refer to the data element description in FrntRdrDetn1 with the same data element name.";
CM_ SG_ 314 FrntRdrDetn33RdrDetnChks "Refer to the data element description in FrntRdrDetn1 with the same data element name.";
CM_ SG_ 314 FrntRdrDetn33RdrDetnCntr "Refer to the data element description in FrntRdrDetn1 with the same data element name.";
CM_ SG_ 314 FrntRdrDetn33RdrDetnConf "Refer to the data element description in FrntRdrDetn1 with the same data element name.";
CM_ SG_ 314 FrntRdrDetn33RdrDetnElevn "Refer to the data element description in FrntRdrDetn1 with the same data element name.";
CM_ SG_ 314 FrntRdrDetn33RdrDetnPwr "Refer to the data element description in FrntRdrDetn1 with the same data element name.";
CM_ SG_ 314 FrntRdrDetn33RdrDetnRng "Refer to the data element description in FrntRdrDetn1 with the same data element name.";
CM_ SG_ 314 FrntRdrDetn33RdrDetnRngV "Refer to the data element description in FrntRdrDetn1 with the same data element name.";
CM_ SG_ 314 FrntRdrDetn33RdrDetnSts "Refer to the data element description in FrntRdrDetn1 with the same data element name.";
CM_ SG_ 314 FrntRdrDetn34RdrDetnAzi "Refer to the data element description in FrntRdrDetn1 with the same data element name.";
CM_ SG_ 314 FrntRdrDetn34RdrDetnChks "Refer to the data element description in FrntRdrDetn1 with the same data element name.";
CM_ SG_ 314 FrntRdrDetn34RdrDetnCntr "Refer to the data element description in FrntRdrDetn1 with the same data element name.";
CM_ SG_ 314 FrntRdrDetn34RdrDetnConf "Refer to the data element description in FrntRdrDetn1 with the same data element name.";
CM_ SG_ 314 FrntRdrDetn34RdrDetnElevn "Refer to the data element description in FrntRdrDetn1 with the same data element name.";
CM_ SG_ 314 FrntRdrDetn34RdrDetnPwr "Refer to the data element description in FrntRdrDetn1 with the same data element name.";
CM_ SG_ 314 FrntRdrDetn34RdrDetnRng "Refer to the data element description in FrntRdrDetn1 with the same data element name.";
CM_ SG_ 314 FrntRdrDetn34RdrDetnRngV "Refer to the data element description in FrntRdrDetn1 with the same data element name.";
CM_ SG_ 314 FrntRdrDetn34RdrDetnSts "Refer to the data element description in FrntRdrDetn1 with the same data element name.";
CM_ SG_ 314 FrntRdrDetn35RdrDetnAzi "Refer to the data element description in FrntRdrDetn1 with the same data element name.";
CM_ SG_ 314 FrntRdrDetn35RdrDetnChks "Refer to the data element description in FrntRdrDetn1 with the same data element name.";
CM_ SG_ 314 FrntRdrDetn35RdrDetnCntr "Refer to the data element description in FrntRdrDetn1 with the same data element name.";
CM_ SG_ 314 FrntRdrDetn35RdrDetnConf "Refer to the data element description in FrntRdrDetn1 with the same data element name.";
CM_ SG_ 314 FrntRdrDetn35RdrDetnElevn "Refer to the data element description in FrntRdrDetn1 with the same data element name.";
CM_ SG_ 314 FrntRdrDetn35RdrDetnPwr "Refer to the data element description in FrntRdrDetn1 with the same data element name.";
CM_ SG_ 314 FrntRdrDetn35RdrDetnRng "Refer to the data element description in FrntRdrDetn1 with the same data element name.";
CM_ SG_ 314 FrntRdrDetn35RdrDetnRngV "Refer to the data element description in FrntRdrDetn1 with the same data element name.";
CM_ SG_ 314 FrntRdrDetn35RdrDetnSts "Refer to the data element description in FrntRdrDetn1 with the same data element name.";
CM_ SG_ 314 FrntRdrDetn36RdrDetnAzi "Refer to the data element description in FrntRdrDetn1 with the same data element name.";
CM_ SG_ 314 FrntRdrDetn36RdrDetnChks "Refer to the data element description in FrntRdrDetn1 with the same data element name.";
CM_ SG_ 314 FrntRdrDetn36RdrDetnCntr "Refer to the data element description in FrntRdrDetn1 with the same data element name.";
CM_ SG_ 314 FrntRdrDetn36RdrDetnConf "Refer to the data element description in FrntRdrDetn1 with the same data element name.";
CM_ SG_ 314 FrntRdrDetn36RdrDetnElevn "Refer to the data element description in FrntRdrDetn1 with the same data element name.";
CM_ SG_ 314 FrntRdrDetn36RdrDetnPwr "Refer to the data element description in FrntRdrDetn1 with the same data element name.";
CM_ SG_ 314 FrntRdrDetn36RdrDetnRng "Refer to the data element description in FrntRdrDetn1 with the same data element name.";
CM_ SG_ 314 FrntRdrDetn36RdrDetnRngV "Refer to the data element description in FrntRdrDetn1 with the same data element name.";
CM_ SG_ 314 FrntRdrDetn36RdrDetnSts "Refer to the data element description in FrntRdrDetn1 with the same data element name.";
CM_ SG_ 316 FrntRdrDetn37RdrDetnAzi "Refer to the data element description in FrntRdrDetn1 with the same data element name.";
CM_ SG_ 316 FrntRdrDetn37RdrDetnChks "Refer to the data element description in FrntRdrDetn1 with the same data element name.";
CM_ SG_ 316 FrntRdrDetn37RdrDetnCntr "Refer to the data element description in FrntRdrDetn1 with the same data element name.";
CM_ SG_ 316 FrntRdrDetn37RdrDetnConf "Refer to the data element description in FrntRdrDetn1 with the same data element name.";
CM_ SG_ 316 FrntRdrDetn37RdrDetnElevn "Refer to the data element description in FrntRdrDetn1 with the same data element name.";
CM_ SG_ 316 FrntRdrDetn37RdrDetnPwr "Refer to the data element description in FrntRdrDetn1 with the same data element name.";
CM_ SG_ 316 FrntRdrDetn37RdrDetnRng "Refer to the data element description in FrntRdrDetn1 with the same data element name.";
CM_ SG_ 316 FrntRdrDetn37RdrDetnRngV "Refer to the data element description in FrntRdrDetn1 with the same data element name.";
CM_ SG_ 316 FrntRdrDetn37RdrDetnSts "Refer to the data element description in FrntRdrDetn1 with the same data element name.";
CM_ SG_ 316 FrntRdrDetn38RdrDetnAzi "Refer to the data element description in FrntRdrDetn1 with the same data element name.";
CM_ SG_ 316 FrntRdrDetn38RdrDetnChks "Refer to the data element description in FrntRdrDetn1 with the same data element name.";
CM_ SG_ 316 FrntRdrDetn38RdrDetnCntr "Refer to the data element description in FrntRdrDetn1 with the same data element name.";
CM_ SG_ 316 FrntRdrDetn38RdrDetnConf "Refer to the data element description in FrntRdrDetn1 with the same data element name.";
CM_ SG_ 316 FrntRdrDetn38RdrDetnElevn "Refer to the data element description in FrntRdrDetn1 with the same data element name.";
CM_ SG_ 316 FrntRdrDetn38RdrDetnPwr "Refer to the data element description in FrntRdrDetn1 with the same data element name.";
CM_ SG_ 316 FrntRdrDetn38RdrDetnRng "Refer to the data element description in FrntRdrDetn1 with the same data element name.";
CM_ SG_ 316 FrntRdrDetn38RdrDetnRngV "Refer to the data element description in FrntRdrDetn1 with the same data element name.";
CM_ SG_ 316 FrntRdrDetn38RdrDetnSts "Refer to the data element description in FrntRdrDetn1 with the same data element name.";
CM_ SG_ 316 FrntRdrDetn39RdrDetnAzi "Refer to the data element description in FrntRdrDetn1 with the same data element name.";
CM_ SG_ 316 FrntRdrDetn39RdrDetnChks "Refer to the data element description in FrntRdrDetn1 with the same data element name.";
CM_ SG_ 316 FrntRdrDetn39RdrDetnCntr "Refer to the data element description in FrntRdrDetn1 with the same data element name.";
CM_ SG_ 316 FrntRdrDetn39RdrDetnConf "Refer to the data element description in FrntRdrDetn1 with the same data element name.";
CM_ SG_ 316 FrntRdrDetn39RdrDetnElevn "Refer to the data element description in FrntRdrDetn1 with the same data element name.";
CM_ SG_ 316 FrntRdrDetn39RdrDetnPwr "Refer to the data element description in FrntRdrDetn1 with the same data element name.";
CM_ SG_ 316 FrntRdrDetn39RdrDetnRng "Refer to the data element description in FrntRdrDetn1 with the same data element name.";
CM_ SG_ 316 FrntRdrDetn39RdrDetnRngV "Refer to the data element description in FrntRdrDetn1 with the same data element name.";
CM_ SG_ 316 FrntRdrDetn39RdrDetnSts "Refer to the data element description in FrntRdrDetn1 with the same data element name.";
CM_ SG_ 316 FrntRdrDetn40RdrDetnAzi "Refer to the data element description in FrntRdrDetn1 with the same data element name.";
CM_ SG_ 316 FrntRdrDetn40RdrDetnChks "Refer to the data element description in FrntRdrDetn1 with the same data element name.";
CM_ SG_ 316 FrntRdrDetn40RdrDetnCntr "Refer to the data element description in FrntRdrDetn1 with the same data element name.";
CM_ SG_ 316 FrntRdrDetn40RdrDetnConf "Refer to the data element description in FrntRdrDetn1 with the same data element name.";
CM_ SG_ 316 FrntRdrDetn40RdrDetnElevn "Refer to the data element description in FrntRdrDetn1 with the same data element name.";
CM_ SG_ 316 FrntRdrDetn40RdrDetnPwr "Refer to the data element description in FrntRdrDetn1 with the same data element name.";
CM_ SG_ 316 FrntRdrDetn40RdrDetnRng "Refer to the data element description in FrntRdrDetn1 with the same data element name.";
CM_ SG_ 316 FrntRdrDetn40RdrDetnRngV "Refer to the data element description in FrntRdrDetn1 with the same data element name.";
CM_ SG_ 316 FrntRdrDetn40RdrDetnSts "Refer to the data element description in FrntRdrDetn1 with the same data element name.";
CM_ SG_ 316 FrntRdrDetn41RdrDetnAzi "Refer to the data element description in FrntRdrDetn1 with the same data element name.";
CM_ SG_ 316 FrntRdrDetn41RdrDetnChks "Refer to the data element description in FrntRdrDetn1 with the same data element name.";
CM_ SG_ 316 FrntRdrDetn41RdrDetnCntr "Refer to the data element description in FrntRdrDetn1 with the same data element name.";
CM_ SG_ 316 FrntRdrDetn41RdrDetnConf "Refer to the data element description in FrntRdrDetn1 with the same data element name.";
CM_ SG_ 316 FrntRdrDetn41RdrDetnElevn "Refer to the data element description in FrntRdrDetn1 with the same data element name.";
CM_ SG_ 316 FrntRdrDetn41RdrDetnPwr "Refer to the data element description in FrntRdrDetn1 with the same data element name.";
CM_ SG_ 316 FrntRdrDetn41RdrDetnRng "Refer to the data element description in FrntRdrDetn1 with the same data element name.";
CM_ SG_ 316 FrntRdrDetn41RdrDetnRngV "Refer to the data element description in FrntRdrDetn1 with the same data element name.";
CM_ SG_ 316 FrntRdrDetn41RdrDetnSts "Refer to the data element description in FrntRdrDetn1 with the same data element name.";
CM_ SG_ 316 FrntRdrDetn42RdrDetnAzi "Refer to the data element description in FrntRdrDetn1 with the same data element name.";
CM_ SG_ 316 FrntRdrDetn42RdrDetnChks "Refer to the data element description in FrntRdrDetn1 with the same data element name.";
CM_ SG_ 316 FrntRdrDetn42RdrDetnCntr "Refer to the data element description in FrntRdrDetn1 with the same data element name.";
CM_ SG_ 316 FrntRdrDetn42RdrDetnConf "Refer to the data element description in FrntRdrDetn1 with the same data element name.";
CM_ SG_ 316 FrntRdrDetn42RdrDetnElevn "Refer to the data element description in FrntRdrDetn1 with the same data element name.";
CM_ SG_ 316 FrntRdrDetn42RdrDetnPwr "Refer to the data element description in FrntRdrDetn1 with the same data element name.";
CM_ SG_ 316 FrntRdrDetn42RdrDetnRng "Refer to the data element description in FrntRdrDetn1 with the same data element name.";
CM_ SG_ 316 FrntRdrDetn42RdrDetnRngV "Refer to the data element description in FrntRdrDetn1 with the same data element name.";
CM_ SG_ 316 FrntRdrDetn42RdrDetnSts "Refer to the data element description in FrntRdrDetn1 with the same data element name.";
CM_ SG_ 318 FrntRdrDetn43RdrDetnAzi "Refer to the data element description in FrntRdrDetn1 with the same data element name.";
CM_ SG_ 318 FrntRdrDetn43RdrDetnChks "Refer to the data element description in FrntRdrDetn1 with the same data element name.";
CM_ SG_ 318 FrntRdrDetn43RdrDetnCntr "Refer to the data element description in FrntRdrDetn1 with the same data element name.";
CM_ SG_ 318 FrntRdrDetn43RdrDetnConf "Refer to the data element description in FrntRdrDetn1 with the same data element name.";
CM_ SG_ 318 FrntRdrDetn43RdrDetnElevn "Refer to the data element description in FrntRdrDetn1 with the same data element name.";
CM_ SG_ 318 FrntRdrDetn43RdrDetnPwr "Refer to the data element description in FrntRdrDetn1 with the same data element name.";
CM_ SG_ 318 FrntRdrDetn43RdrDetnRng "Refer to the data element description in FrntRdrDetn1 with the same data element name.";
CM_ SG_ 318 FrntRdrDetn43RdrDetnRngV "Refer to the data element description in FrntRdrDetn1 with the same data element name.";
CM_ SG_ 318 FrntRdrDetn43RdrDetnSts "Refer to the data element description in FrntRdrDetn1 with the same data element name.";
CM_ SG_ 318 FrntRdrDetn44RdrDetnAzi "Refer to the data element description in FrntRdrDetn1 with the same data element name.";
CM_ SG_ 318 FrntRdrDetn44RdrDetnChks "Refer to the data element description in FrntRdrDetn1 with the same data element name.";
CM_ SG_ 318 FrntRdrDetn44RdrDetnCntr "Refer to the data element description in FrntRdrDetn1 with the same data element name.";
CM_ SG_ 318 FrntRdrDetn44RdrDetnConf "Refer to the data element description in FrntRdrDetn1 with the same data element name.";
CM_ SG_ 318 FrntRdrDetn44RdrDetnElevn "Refer to the data element description in FrntRdrDetn1 with the same data element name.";
CM_ SG_ 318 FrntRdrDetn44RdrDetnPwr "Refer to the data element description in FrntRdrDetn1 with the same data element name.";
CM_ SG_ 318 FrntRdrDetn44RdrDetnRng "Refer to the data element description in FrntRdrDetn1 with the same data element name.";
CM_ SG_ 318 FrntRdrDetn44RdrDetnRngV "Refer to the data element description in FrntRdrDetn1 with the same data element name.";
CM_ SG_ 318 FrntRdrDetn44RdrDetnSts "Refer to the data element description in FrntRdrDetn1 with the same data element name.";
CM_ SG_ 318 FrntRdrDetn45RdrDetnAzi "Refer to the data element description in FrntRdrDetn1 with the same data element name.";
CM_ SG_ 318 FrntRdrDetn45RdrDetnChks "Refer to the data element description in FrntRdrDetn1 with the same data element name.";
CM_ SG_ 318 FrntRdrDetn45RdrDetnCntr "Refer to the data element description in FrntRdrDetn1 with the same data element name.";
CM_ SG_ 318 FrntRdrDetn45RdrDetnConf "Refer to the data element description in FrntRdrDetn1 with the same data element name.";
CM_ SG_ 318 FrntRdrDetn45RdrDetnElevn "Refer to the data element description in FrntRdrDetn1 with the same data element name.";
CM_ SG_ 318 FrntRdrDetn45RdrDetnPwr "Refer to the data element description in FrntRdrDetn1 with the same data element name.";
CM_ SG_ 318 FrntRdrDetn45RdrDetnRng "Refer to the data element description in FrntRdrDetn1 with the same data element name.";
CM_ SG_ 318 FrntRdrDetn45RdrDetnRngV "Refer to the data element description in FrntRdrDetn1 with the same data element name.";
CM_ SG_ 318 FrntRdrDetn45RdrDetnSts "Refer to the data element description in FrntRdrDetn1 with the same data element name.";
CM_ SG_ 318 FrntRdrDetn46RdrDetnAzi "Refer to the data element description in FrntRdrDetn1 with the same data element name.";
CM_ SG_ 318 FrntRdrDetn46RdrDetnChks "Refer to the data element description in FrntRdrDetn1 with the same data element name.";
CM_ SG_ 318 FrntRdrDetn46RdrDetnCntr "Refer to the data element description in FrntRdrDetn1 with the same data element name.";
CM_ SG_ 318 FrntRdrDetn46RdrDetnConf "Refer to the data element description in FrntRdrDetn1 with the same data element name.";
CM_ SG_ 318 FrntRdrDetn46RdrDetnElevn "Refer to the data element description in FrntRdrDetn1 with the same data element name.";
CM_ SG_ 318 FrntRdrDetn46RdrDetnPwr "Refer to the data element description in FrntRdrDetn1 with the same data element name.";
CM_ SG_ 318 FrntRdrDetn46RdrDetnRng "Refer to the data element description in FrntRdrDetn1 with the same data element name.";
CM_ SG_ 318 FrntRdrDetn46RdrDetnRngV "Refer to the data element description in FrntRdrDetn1 with the same data element name.";
CM_ SG_ 318 FrntRdrDetn46RdrDetnSts "Refer to the data element description in FrntRdrDetn1 with the same data element name.";
CM_ SG_ 318 FrntRdrDetn47RdrDetnAzi "Refer to the data element description in FrntRdrDetn1 with the same data element name.";
CM_ SG_ 318 FrntRdrDetn47RdrDetnChks "Refer to the data element description in FrntRdrDetn1 with the same data element name.";
CM_ SG_ 318 FrntRdrDetn47RdrDetnCntr "Refer to the data element description in FrntRdrDetn1 with the same data element name.";
CM_ SG_ 318 FrntRdrDetn47RdrDetnConf "Refer to the data element description in FrntRdrDetn1 with the same data element name.";
CM_ SG_ 318 FrntRdrDetn47RdrDetnElevn "Refer to the data element description in FrntRdrDetn1 with the same data element name.";
CM_ SG_ 318 FrntRdrDetn47RdrDetnPwr "Refer to the data element description in FrntRdrDetn1 with the same data element name.";
CM_ SG_ 318 FrntRdrDetn47RdrDetnRng "Refer to the data element description in FrntRdrDetn1 with the same data element name.";
CM_ SG_ 318 FrntRdrDetn47RdrDetnRngV "Refer to the data element description in FrntRdrDetn1 with the same data element name.";
CM_ SG_ 318 FrntRdrDetn47RdrDetnSts "Refer to the data element description in FrntRdrDetn1 with the same data element name.";
CM_ SG_ 318 FrntRdrDetn48RdrDetnAzi "Refer to the data element description in FrntRdrDetn1 with the same data element name.";
CM_ SG_ 318 FrntRdrDetn48RdrDetnChks "Refer to the data element description in FrntRdrDetn1 with the same data element name.";
CM_ SG_ 318 FrntRdrDetn48RdrDetnCntr "Refer to the data element description in FrntRdrDetn1 with the same data element name.";
CM_ SG_ 318 FrntRdrDetn48RdrDetnConf "Refer to the data element description in FrntRdrDetn1 with the same data element name.";
CM_ SG_ 318 FrntRdrDetn48RdrDetnElevn "Refer to the data element description in FrntRdrDetn1 with the same data element name.";
CM_ SG_ 318 FrntRdrDetn48RdrDetnPwr "Refer to the data element description in FrntRdrDetn1 with the same data element name.";
CM_ SG_ 318 FrntRdrDetn48RdrDetnRng "Refer to the data element description in FrntRdrDetn1 with the same data element name.";
CM_ SG_ 318 FrntRdrDetn48RdrDetnRngV "Refer to the data element description in FrntRdrDetn1 with the same data element name.";
CM_ SG_ 318 FrntRdrDetn48RdrDetnSts "Refer to the data element description in FrntRdrDetn1 with the same data element name.";
CM_ SG_ 320 FrntRdrDetn49RdrDetnAzi "Refer to the data element description in FrntRdrDetn1 with the same data element name.";
CM_ SG_ 320 FrntRdrDetn49RdrDetnChks "Refer to the data element description in FrntRdrDetn1 with the same data element name.";
CM_ SG_ 320 FrntRdrDetn49RdrDetnCntr "Refer to the data element description in FrntRdrDetn1 with the same data element name.";
CM_ SG_ 320 FrntRdrDetn49RdrDetnConf "Refer to the data element description in FrntRdrDetn1 with the same data element name.";
CM_ SG_ 320 FrntRdrDetn49RdrDetnElevn "Refer to the data element description in FrntRdrDetn1 with the same data element name.";
CM_ SG_ 320 FrntRdrDetn49RdrDetnPwr "Refer to the data element description in FrntRdrDetn1 with the same data element name.";
CM_ SG_ 320 FrntRdrDetn49RdrDetnRng "Refer to the data element description in FrntRdrDetn1 with the same data element name.";
CM_ SG_ 320 FrntRdrDetn49RdrDetnRngV "Refer to the data element description in FrntRdrDetn1 with the same data element name.";
CM_ SG_ 320 FrntRdrDetn49RdrDetnSts "Refer to the data element description in FrntRdrDetn1 with the same data element name.";
CM_ SG_ 320 FrntRdrDetn50RdrDetnAzi "Refer to the data element description in FrntRdrDetn1 with the same data element name.";
CM_ SG_ 320 FrntRdrDetn50RdrDetnChks "Refer to the data element description in FrntRdrDetn1 with the same data element name.";
CM_ SG_ 320 FrntRdrDetn50RdrDetnCntr "Refer to the data element description in FrntRdrDetn1 with the same data element name.";
CM_ SG_ 320 FrntRdrDetn50RdrDetnConf "Refer to the data element description in FrntRdrDetn1 with the same data element name.";
CM_ SG_ 320 FrntRdrDetn50RdrDetnElevn "Refer to the data element description in FrntRdrDetn1 with the same data element name.";
CM_ SG_ 320 FrntRdrDetn50RdrDetnPwr "Refer to the data element description in FrntRdrDetn1 with the same data element name.";
CM_ SG_ 320 FrntRdrDetn50RdrDetnRng "Refer to the data element description in FrntRdrDetn1 with the same data element name.";
CM_ SG_ 320 FrntRdrDetn50RdrDetnRngV "Refer to the data element description in FrntRdrDetn1 with the same data element name.";
CM_ SG_ 320 FrntRdrDetn50RdrDetnSts "Refer to the data element description in FrntRdrDetn1 with the same data element name.";
CM_ SG_ 320 FrntRdrDetn51RdrDetnAzi "Refer to the data element description in FrntRdrDetn1 with the same data element name.";
CM_ SG_ 320 FrntRdrDetn51RdrDetnChks "Refer to the data element description in FrntRdrDetn1 with the same data element name.";
CM_ SG_ 320 FrntRdrDetn51RdrDetnCntr "Refer to the data element description in FrntRdrDetn1 with the same data element name.";
CM_ SG_ 320 FrntRdrDetn51RdrDetnConf "Refer to the data element description in FrntRdrDetn1 with the same data element name.";
CM_ SG_ 320 FrntRdrDetn51RdrDetnElevn "Refer to the data element description in FrntRdrDetn1 with the same data element name.";
CM_ SG_ 320 FrntRdrDetn51RdrDetnPwr "Refer to the data element description in FrntRdrDetn1 with the same data element name.";
CM_ SG_ 320 FrntRdrDetn51RdrDetnRng "Refer to the data element description in FrntRdrDetn1 with the same data element name.";
CM_ SG_ 320 FrntRdrDetn51RdrDetnRngV "Refer to the data element description in FrntRdrDetn1 with the same data element name.";
CM_ SG_ 320 FrntRdrDetn51RdrDetnSts "Refer to the data element description in FrntRdrDetn1 with the same data element name.";
CM_ SG_ 320 FrntRdrDetn52RdrDetnAzi "Refer to the data element description in FrntRdrDetn1 with the same data element name.";
CM_ SG_ 320 FrntRdrDetn52RdrDetnChks "Refer to the data element description in FrntRdrDetn1 with the same data element name.";
CM_ SG_ 320 FrntRdrDetn52RdrDetnCntr "Refer to the data element description in FrntRdrDetn1 with the same data element name.";
CM_ SG_ 320 FrntRdrDetn52RdrDetnConf "Refer to the data element description in FrntRdrDetn1 with the same data element name.";
CM_ SG_ 320 FrntRdrDetn52RdrDetnElevn "Refer to the data element description in FrntRdrDetn1 with the same data element name.";
CM_ SG_ 320 FrntRdrDetn52RdrDetnPwr "Refer to the data element description in FrntRdrDetn1 with the same data element name.";
CM_ SG_ 320 FrntRdrDetn52RdrDetnRng "Refer to the data element description in FrntRdrDetn1 with the same data element name.";
CM_ SG_ 320 FrntRdrDetn52RdrDetnRngV "Refer to the data element description in FrntRdrDetn1 with the same data element name.";
CM_ SG_ 320 FrntRdrDetn52RdrDetnSts "Refer to the data element description in FrntRdrDetn1 with the same data element name.";
CM_ SG_ 320 FrntRdrDetn53RdrDetnAzi "Refer to the data element description in FrntRdrDetn1 with the same data element name.";
CM_ SG_ 320 FrntRdrDetn53RdrDetnChks "Refer to the data element description in FrntRdrDetn1 with the same data element name.";
CM_ SG_ 320 FrntRdrDetn53RdrDetnCntr "Refer to the data element description in FrntRdrDetn1 with the same data element name.";
CM_ SG_ 320 FrntRdrDetn53RdrDetnConf "Refer to the data element description in FrntRdrDetn1 with the same data element name.";
CM_ SG_ 320 FrntRdrDetn53RdrDetnElevn "Refer to the data element description in FrntRdrDetn1 with the same data element name.";
CM_ SG_ 320 FrntRdrDetn53RdrDetnPwr "Refer to the data element description in FrntRdrDetn1 with the same data element name.";
CM_ SG_ 320 FrntRdrDetn53RdrDetnRng "Refer to the data element description in FrntRdrDetn1 with the same data element name.";
CM_ SG_ 320 FrntRdrDetn53RdrDetnRngV "Refer to the data element description in FrntRdrDetn1 with the same data element name.";
CM_ SG_ 320 FrntRdrDetn53RdrDetnSts "Refer to the data element description in FrntRdrDetn1 with the same data element name.";
CM_ SG_ 320 FrntRdrDetn54RdrDetnAzi "Refer to the data element description in FrntRdrDetn1 with the same data element name.";
CM_ SG_ 320 FrntRdrDetn54RdrDetnChks "Refer to the data element description in FrntRdrDetn1 with the same data element name.";
CM_ SG_ 320 FrntRdrDetn54RdrDetnCntr "Refer to the data element description in FrntRdrDetn1 with the same data element name.";
CM_ SG_ 320 FrntRdrDetn54RdrDetnConf "Refer to the data element description in FrntRdrDetn1 with the same data element name.";
CM_ SG_ 320 FrntRdrDetn54RdrDetnElevn "Refer to the data element description in FrntRdrDetn1 with the same data element name.";
CM_ SG_ 320 FrntRdrDetn54RdrDetnPwr "Refer to the data element description in FrntRdrDetn1 with the same data element name.";
CM_ SG_ 320 FrntRdrDetn54RdrDetnRng "Refer to the data element description in FrntRdrDetn1 with the same data element name.";
CM_ SG_ 320 FrntRdrDetn54RdrDetnRngV "Refer to the data element description in FrntRdrDetn1 with the same data element name.";
CM_ SG_ 320 FrntRdrDetn54RdrDetnSts "Refer to the data element description in FrntRdrDetn1 with the same data element name.";
CM_ SG_ 322 FrntRdrDetn55RdrDetnAzi "Refer to the data element description in FrntRdrDetn1 with the same data element name.";
CM_ SG_ 322 FrntRdrDetn55RdrDetnChks "Refer to the data element description in FrntRdrDetn1 with the same data element name.";
CM_ SG_ 322 FrntRdrDetn55RdrDetnCntr "Refer to the data element description in FrntRdrDetn1 with the same data element name.";
CM_ SG_ 322 FrntRdrDetn55RdrDetnConf "Refer to the data element description in FrntRdrDetn1 with the same data element name.";
CM_ SG_ 322 FrntRdrDetn55RdrDetnElevn "Refer to the data element description in FrntRdrDetn1 with the same data element name.";
CM_ SG_ 322 FrntRdrDetn55RdrDetnPwr "Refer to the data element description in FrntRdrDetn1 with the same data element name.";
CM_ SG_ 322 FrntRdrDetn55RdrDetnRng "Refer to the data element description in FrntRdrDetn1 with the same data element name.";
CM_ SG_ 322 FrntRdrDetn55RdrDetnRngV "Refer to the data element description in FrntRdrDetn1 with the same data element name.";
CM_ SG_ 322 FrntRdrDetn55RdrDetnSts "Refer to the data element description in FrntRdrDetn1 with the same data element name.";
CM_ SG_ 322 FrntRdrDetn56RdrDetnAzi "Refer to the data element description in FrntRdrDetn1 with the same data element name.";
CM_ SG_ 322 FrntRdrDetn56RdrDetnChks "Refer to the data element description in FrntRdrDetn1 with the same data element name.";
CM_ SG_ 322 FrntRdrDetn56RdrDetnCntr "Refer to the data element description in FrntRdrDetn1 with the same data element name.";
CM_ SG_ 322 FrntRdrDetn56RdrDetnConf "Refer to the data element description in FrntRdrDetn1 with the same data element name.";
CM_ SG_ 322 FrntRdrDetn56RdrDetnElevn "Refer to the data element description in FrntRdrDetn1 with the same data element name.";
CM_ SG_ 322 FrntRdrDetn56RdrDetnPwr "Refer to the data element description in FrntRdrDetn1 with the same data element name.";
CM_ SG_ 322 FrntRdrDetn56RdrDetnRng "Refer to the data element description in FrntRdrDetn1 with the same data element name.";
CM_ SG_ 322 FrntRdrDetn56RdrDetnRngV "Refer to the data element description in FrntRdrDetn1 with the same data element name.";
CM_ SG_ 322 FrntRdrDetn56RdrDetnSts "Refer to the data element description in FrntRdrDetn1 with the same data element name.";
CM_ SG_ 322 FrntRdrDetn57RdrDetnAzi "Refer to the data element description in FrntRdrDetn1 with the same data element name.";
CM_ SG_ 322 FrntRdrDetn57RdrDetnChks "Refer to the data element description in FrntRdrDetn1 with the same data element name.";
CM_ SG_ 322 FrntRdrDetn57RdrDetnCntr "Refer to the data element description in FrntRdrDetn1 with the same data element name.";
CM_ SG_ 322 FrntRdrDetn57RdrDetnConf "Refer to the data element description in FrntRdrDetn1 with the same data element name.";
CM_ SG_ 322 FrntRdrDetn57RdrDetnElevn "Refer to the data element description in FrntRdrDetn1 with the same data element name.";
CM_ SG_ 322 FrntRdrDetn57RdrDetnPwr "Refer to the data element description in FrntRdrDetn1 with the same data element name.";
CM_ SG_ 322 FrntRdrDetn57RdrDetnRng "Refer to the data element description in FrntRdrDetn1 with the same data element name.";
CM_ SG_ 322 FrntRdrDetn57RdrDetnRngV "Refer to the data element description in FrntRdrDetn1 with the same data element name.";
CM_ SG_ 322 FrntRdrDetn57RdrDetnSts "Refer to the data element description in FrntRdrDetn1 with the same data element name.";
CM_ SG_ 322 FrntRdrDetn58RdrDetnAzi "Refer to the data element description in FrntRdrDetn1 with the same data element name.";
CM_ SG_ 322 FrntRdrDetn58RdrDetnChks "Refer to the data element description in FrntRdrDetn1 with the same data element name.";
CM_ SG_ 322 FrntRdrDetn58RdrDetnCntr "Refer to the data element description in FrntRdrDetn1 with the same data element name.";
CM_ SG_ 322 FrntRdrDetn58RdrDetnConf "Refer to the data element description in FrntRdrDetn1 with the same data element name.";
CM_ SG_ 322 FrntRdrDetn58RdrDetnElevn "Refer to the data element description in FrntRdrDetn1 with the same data element name.";
CM_ SG_ 322 FrntRdrDetn58RdrDetnPwr "Refer to the data element description in FrntRdrDetn1 with the same data element name.";
CM_ SG_ 322 FrntRdrDetn58RdrDetnRng "Refer to the data element description in FrntRdrDetn1 with the same data element name.";
CM_ SG_ 322 FrntRdrDetn58RdrDetnRngV "Refer to the data element description in FrntRdrDetn1 with the same data element name.";
CM_ SG_ 322 FrntRdrDetn58RdrDetnSts "Refer to the data element description in FrntRdrDetn1 with the same data element name.";
CM_ SG_ 322 FrntRdrDetn59RdrDetnAzi "Refer to the data element description in FrntRdrDetn1 with the same data element name.";
CM_ SG_ 322 FrntRdrDetn59RdrDetnChks "Refer to the data element description in FrntRdrDetn1 with the same data element name.";
CM_ SG_ 322 FrntRdrDetn59RdrDetnCntr "Refer to the data element description in FrntRdrDetn1 with the same data element name.";
CM_ SG_ 322 FrntRdrDetn59RdrDetnConf "Refer to the data element description in FrntRdrDetn1 with the same data element name.";
CM_ SG_ 322 FrntRdrDetn59RdrDetnElevn "Refer to the data element description in FrntRdrDetn1 with the same data element name.";
CM_ SG_ 322 FrntRdrDetn59RdrDetnPwr "Refer to the data element description in FrntRdrDetn1 with the same data element name.";
CM_ SG_ 322 FrntRdrDetn59RdrDetnRng "Refer to the data element description in FrntRdrDetn1 with the same data element name.";
CM_ SG_ 322 FrntRdrDetn59RdrDetnRngV "Refer to the data element description in FrntRdrDetn1 with the same data element name.";
CM_ SG_ 322 FrntRdrDetn59RdrDetnSts "Refer to the data element description in FrntRdrDetn1 with the same data element name.";
CM_ SG_ 322 FrntRdrDetn60RdrDetnAzi "Refer to the data element description in FrntRdrDetn1 with the same data element name.";
CM_ SG_ 322 FrntRdrDetn60RdrDetnChks "Refer to the data element description in FrntRdrDetn1 with the same data element name.";
CM_ SG_ 322 FrntRdrDetn60RdrDetnCntr "Refer to the data element description in FrntRdrDetn1 with the same data element name.";
CM_ SG_ 322 FrntRdrDetn60RdrDetnConf "Refer to the data element description in FrntRdrDetn1 with the same data element name.";
CM_ SG_ 322 FrntRdrDetn60RdrDetnElevn "Refer to the data element description in FrntRdrDetn1 with the same data element name.";
CM_ SG_ 322 FrntRdrDetn60RdrDetnPwr "Refer to the data element description in FrntRdrDetn1 with the same data element name.";
CM_ SG_ 322 FrntRdrDetn60RdrDetnRng "Refer to the data element description in FrntRdrDetn1 with the same data element name.";
CM_ SG_ 322 FrntRdrDetn60RdrDetnRngV "Refer to the data element description in FrntRdrDetn1 with the same data element name.";
CM_ SG_ 322 FrntRdrDetn60RdrDetnSts "Refer to the data element description in FrntRdrDetn1 with the same data element name.";
CM_ SG_ 324 FrntRdrDetn61RdrDetnAzi "Refer to the data element description in FrntRdrDetn1 with the same data element name.";
CM_ SG_ 324 FrntRdrDetn61RdrDetnChks "Refer to the data element description in FrntRdrDetn1 with the same data element name.";
CM_ SG_ 324 FrntRdrDetn61RdrDetnCntr "Refer to the data element description in FrntRdrDetn1 with the same data element name.";
CM_ SG_ 324 FrntRdrDetn61RdrDetnConf "Refer to the data element description in FrntRdrDetn1 with the same data element name.";
CM_ SG_ 324 FrntRdrDetn61RdrDetnElevn "Refer to the data element description in FrntRdrDetn1 with the same data element name.";
CM_ SG_ 324 FrntRdrDetn61RdrDetnPwr "Refer to the data element description in FrntRdrDetn1 with the same data element name.";
CM_ SG_ 324 FrntRdrDetn61RdrDetnRng "Refer to the data element description in FrntRdrDetn1 with the same data element name.";
CM_ SG_ 324 FrntRdrDetn61RdrDetnRngV "Refer to the data element description in FrntRdrDetn1 with the same data element name.";
CM_ SG_ 324 FrntRdrDetn61RdrDetnSts "Refer to the data element description in FrntRdrDetn1 with the same data element name.";
CM_ SG_ 324 FrntRdrDetn62RdrDetnAzi "Refer to the data element description in FrntRdrDetn1 with the same data element name.";
CM_ SG_ 324 FrntRdrDetn62RdrDetnChks "Refer to the data element description in FrntRdrDetn1 with the same data element name.";
CM_ SG_ 324 FrntRdrDetn62RdrDetnCntr "Refer to the data element description in FrntRdrDetn1 with the same data element name.";
CM_ SG_ 324 FrntRdrDetn62RdrDetnConf "Refer to the data element description in FrntRdrDetn1 with the same data element name.";
CM_ SG_ 324 FrntRdrDetn62RdrDetnElevn "Refer to the data element description in FrntRdrDetn1 with the same data element name.";
CM_ SG_ 324 FrntRdrDetn62RdrDetnPwr "Refer to the data element description in FrntRdrDetn1 with the same data element name.";
CM_ SG_ 324 FrntRdrDetn62RdrDetnRng "Refer to the data element description in FrntRdrDetn1 with the same data element name.";
CM_ SG_ 324 FrntRdrDetn62RdrDetnRngV "Refer to the data element description in FrntRdrDetn1 with the same data element name.";
CM_ SG_ 324 FrntRdrDetn62RdrDetnSts "Refer to the data element description in FrntRdrDetn1 with the same data element name.";
CM_ SG_ 324 FrntRdrDetn63RdrDetnAzi "Refer to the data element description in FrntRdrDetn1 with the same data element name.";
CM_ SG_ 324 FrntRdrDetn63RdrDetnChks "Refer to the data element description in FrntRdrDetn1 with the same data element name.";
CM_ SG_ 324 FrntRdrDetn63RdrDetnCntr "Refer to the data element description in FrntRdrDetn1 with the same data element name.";
CM_ SG_ 324 FrntRdrDetn63RdrDetnConf "Refer to the data element description in FrntRdrDetn1 with the same data element name.";
CM_ SG_ 324 FrntRdrDetn63RdrDetnElevn "Refer to the data element description in FrntRdrDetn1 with the same data element name.";
CM_ SG_ 324 FrntRdrDetn63RdrDetnPwr "Refer to the data element description in FrntRdrDetn1 with the same data element name.";
CM_ SG_ 324 FrntRdrDetn63RdrDetnRng "Refer to the data element description in FrntRdrDetn1 with the same data element name.";
CM_ SG_ 324 FrntRdrDetn63RdrDetnRngV "Refer to the data element description in FrntRdrDetn1 with the same data element name.";
CM_ SG_ 324 FrntRdrDetn63RdrDetnSts "Refer to the data element description in FrntRdrDetn1 with the same data element name.";
CM_ SG_ 324 FrntRdrDetn64RdrDetnAzi "Refer to the data element description in FrntRdrDetn1 with the same data element name.";
CM_ SG_ 324 FrntRdrDetn64RdrDetnChks "Refer to the data element description in FrntRdrDetn1 with the same data element name.";
CM_ SG_ 324 FrntRdrDetn64RdrDetnCntr "Refer to the data element description in FrntRdrDetn1 with the same data element name.";
CM_ SG_ 324 FrntRdrDetn64RdrDetnConf "Refer to the data element description in FrntRdrDetn1 with the same data element name.";
CM_ SG_ 324 FrntRdrDetn64RdrDetnElevn "Refer to the data element description in FrntRdrDetn1 with the same data element name.";
CM_ SG_ 324 FrntRdrDetn64RdrDetnPwr "Refer to the data element description in FrntRdrDetn1 with the same data element name.";
CM_ SG_ 324 FrntRdrDetn64RdrDetnRng "Refer to the data element description in FrntRdrDetn1 with the same data element name.";
CM_ SG_ 324 FrntRdrDetn64RdrDetnRngV "Refer to the data element description in FrntRdrDetn1 with the same data element name.";
CM_ SG_ 324 FrntRdrDetn64RdrDetnSts "Refer to the data element description in FrntRdrDetn1 with the same data element name.";
CM_ SG_ 324 FrntRdrDetn65RdrDetnAzi "Refer to the data element description in FrntRdrDetn1 with the same data element name.";
CM_ SG_ 324 FrntRdrDetn65RdrDetnChks "Refer to the data element description in FrntRdrDetn1 with the same data element name.";
CM_ SG_ 324 FrntRdrDetn65RdrDetnCntr "Refer to the data element description in FrntRdrDetn1 with the same data element name.";
CM_ SG_ 324 FrntRdrDetn65RdrDetnConf "Refer to the data element description in FrntRdrDetn1 with the same data element name.";
CM_ SG_ 324 FrntRdrDetn65RdrDetnElevn "Refer to the data element description in FrntRdrDetn1 with the same data element name.";
CM_ SG_ 324 FrntRdrDetn65RdrDetnPwr "Refer to the data element description in FrntRdrDetn1 with the same data element name.";
CM_ SG_ 324 FrntRdrDetn65RdrDetnRng "Refer to the data element description in FrntRdrDetn1 with the same data element name.";
CM_ SG_ 324 FrntRdrDetn65RdrDetnRngV "Refer to the data element description in FrntRdrDetn1 with the same data element name.";
CM_ SG_ 324 FrntRdrDetn65RdrDetnSts "Refer to the data element description in FrntRdrDetn1 with the same data element name.";
CM_ SG_ 324 FrntRdrDetn66RdrDetnAzi "Refer to the data element description in FrntRdrDetn1 with the same data element name.";
CM_ SG_ 324 FrntRdrDetn66RdrDetnChks "Refer to the data element description in FrntRdrDetn1 with the same data element name.";
CM_ SG_ 324 FrntRdrDetn66RdrDetnCntr "Refer to the data element description in FrntRdrDetn1 with the same data element name.";
CM_ SG_ 324 FrntRdrDetn66RdrDetnConf "Refer to the data element description in FrntRdrDetn1 with the same data element name.";
CM_ SG_ 324 FrntRdrDetn66RdrDetnElevn "Refer to the data element description in FrntRdrDetn1 with the same data element name.";
CM_ SG_ 324 FrntRdrDetn66RdrDetnPwr "Refer to the data element description in FrntRdrDetn1 with the same data element name.";
CM_ SG_ 324 FrntRdrDetn66RdrDetnRng "Refer to the data element description in FrntRdrDetn1 with the same data element name.";
CM_ SG_ 324 FrntRdrDetn66RdrDetnRngV "Refer to the data element description in FrntRdrDetn1 with the same data element name.";
CM_ SG_ 324 FrntRdrDetn66RdrDetnSts "Refer to the data element description in FrntRdrDetn1 with the same data element name.";
BA_DEF_ BO_ "VFrameFormat" ENUM "StandardCAN","ExtendedCAN","reserved","J1939PG","reserved","reserved","reserved","reserved","reserved","reserved","reserved","reserved","reserved","reserved","StandardCAN_FD","ExtendedCAN_FD";
BA_DEF_ BO_ "CANFD_BRS" ENUM "0","1";
BA_DEF_ BO_ "GenMsgSendType" ENUM "cyclic", "spontaneous", "not-used", "not-used", "not-used", "cyclicAndSpontaneous", "not-used", "cyclicIfActive", "NoMsgSendType"; // [us]
BA_DEF_ BO_ "GenMsgCycleTime" INT 0 65536; // [ms]
BA_DEF_ BO_ "GenMsgStartDelayTime" INT 0 65536; // [ms]
BA_DEF_ BO_ "GenMsgDelayTime" INT 0 65536; // [ms]
BA_DEF_ SG_ "GenSigSendType" ENUM "Cyclic","OnWrite","OnWriteWithRepetition","OnChange","OnChangeWithRepetition","IfActive","IfActiveWithRepetition","NoSigSendType";
BA_DEF_ SG_ "GenSigStartValue" HEX 0 80000000;
BA_DEF_ BO_ "GenMsgILSupport" ENUM "No","Yes";
BA_DEF_ BO_ "NmAsrMessage" ENUM "No","Yes";
BA_DEF_ SG_ "GenSigFuncType" ENUM "NoFunction","n/a","n/a","n/a","n/a","n/a","n/a","n/a","n/a","n/a","n/a","n/a","n/a","n/a","n/a","CHK","CNTR","n/a","n/a","n/a","CNTR_AR_01","CRC_AR_01_BOTH","CRC_AR_01_ALT","CRC_AR_01_LOW","CRC_AR_01_NIBBLE","CNTR_AR_04","CRC_AR_04A","CNTR_AR_05","CRC_AR_05";
BA_DEF_ SG_ "GenSigDataID" STRING;

BA_DEF_DEF_ "VFrameFormat" "J1939PG";
BA_DEF_DEF_ "CANFD_BRS" "1";
BA_DEF_DEF_ "GenSigStartValue" 0;
BA_DEF_DEF_ "GenSigSendType" "NoSigSendType";
BA_DEF_DEF_ "GenMsgCycleTime" 0;
BA_DEF_DEF_ "GenMsgDelayTime" 0;
BA_DEF_DEF_ "GenMsgStartDelayTime" 0;
BA_DEF_DEF_ "GenMsgSendType" "NoMsgSendType";
BA_DEF_DEF_ "GenMsgILSupport" "Yes";
BA_DEF_DEF_ "NmAsrMessage" "No";
BA_DEF_DEF_ "GenSigFuncType" "NoFunction";
BA_DEF_DEF_ "GenSigDataID" "";
// Frame: FLRSafetyCANFD2Frame04
BA_ "VFrameFormat" BO_ 310 14;
BA_ "GenMsgSendType" BO_ 310 0;
BA_ "GenMsgCycleTime" BO_ 310 50.000;
BA_ "GenSigStartValue" SG_ 310 FrntRdrDetn19RdrDetnAzi 900;
BA_ "GenSigSendType" SG_ 310 FrntRdrDetn19RdrDetnAzi 0;
BA_ "GenSigSendType" SG_ 310 FrntRdrDetn19RdrDetnChks 0;
BA_ "GenSigFuncType" SG_ 310 FrntRdrDetn19RdrDetnChks 15;
BA_ "GenSigDataID" SG_ 310 FrntRdrDetn19RdrDetnChks "0x71A";
BA_ "GenSigSendType" SG_ 310 FrntRdrDetn19RdrDetnCntr 0;
BA_ "GenSigFuncType" SG_ 310 FrntRdrDetn19RdrDetnCntr 16;
BA_ "GenSigSendType" SG_ 310 FrntRdrDetn19RdrDetnConf 0;
BA_ "GenSigStartValue" SG_ 310 FrntRdrDetn19RdrDetnElevn 15;
BA_ "GenSigSendType" SG_ 310 FrntRdrDetn19RdrDetnElevn 0;
BA_ "GenSigSendType" SG_ 310 FrntRdrDetn19RdrDetnPwr 0;
BA_ "GenSigStartValue" SG_ 310 FrntRdrDetn19RdrDetnRng 10050;
BA_ "GenSigSendType" SG_ 310 FrntRdrDetn19RdrDetnRng 0;
BA_ "GenSigStartValue" SG_ 310 FrntRdrDetn19RdrDetnRngV 4000;
BA_ "GenSigSendType" SG_ 310 FrntRdrDetn19RdrDetnRngV 0;
BA_ "GenSigStartValue" SG_ 310 FrntRdrDetn19RdrDetnSts 3;
BA_ "GenSigSendType" SG_ 310 FrntRdrDetn19RdrDetnSts 0;
BA_ "GenSigStartValue" SG_ 310 FrntRdrDetn20RdrDetnAzi 900;
BA_ "GenSigSendType" SG_ 310 FrntRdrDetn20RdrDetnAzi 0;
BA_ "GenSigSendType" SG_ 310 FrntRdrDetn20RdrDetnChks 0;
BA_ "GenSigFuncType" SG_ 310 FrntRdrDetn20RdrDetnChks 15;
BA_ "GenSigDataID" SG_ 310 FrntRdrDetn20RdrDetnChks "0x71B";
BA_ "GenSigSendType" SG_ 310 FrntRdrDetn20RdrDetnCntr 0;
BA_ "GenSigFuncType" SG_ 310 FrntRdrDetn20RdrDetnCntr 16;
BA_ "GenSigSendType" SG_ 310 FrntRdrDetn20RdrDetnConf 0;
BA_ "GenSigStartValue" SG_ 310 FrntRdrDetn20RdrDetnElevn 15;
BA_ "GenSigSendType" SG_ 310 FrntRdrDetn20RdrDetnElevn 0;
BA_ "GenSigSendType" SG_ 310 FrntRdrDetn20RdrDetnPwr 0;
BA_ "GenSigStartValue" SG_ 310 FrntRdrDetn20RdrDetnRng 10050;
BA_ "GenSigSendType" SG_ 310 FrntRdrDetn20RdrDetnRng 0;
BA_ "GenSigStartValue" SG_ 310 FrntRdrDetn20RdrDetnRngV 4000;
BA_ "GenSigSendType" SG_ 310 FrntRdrDetn20RdrDetnRngV 0;
BA_ "GenSigStartValue" SG_ 310 FrntRdrDetn20RdrDetnSts 3;
BA_ "GenSigSendType" SG_ 310 FrntRdrDetn20RdrDetnSts 0;
BA_ "GenSigStartValue" SG_ 310 FrntRdrDetn21RdrDetnAzi 900;
BA_ "GenSigSendType" SG_ 310 FrntRdrDetn21RdrDetnAzi 0;
BA_ "GenSigSendType" SG_ 310 FrntRdrDetn21RdrDetnChks 0;
BA_ "GenSigFuncType" SG_ 310 FrntRdrDetn21RdrDetnChks 15;
BA_ "GenSigDataID" SG_ 310 FrntRdrDetn21RdrDetnChks "0x71C";
BA_ "GenSigSendType" SG_ 310 FrntRdrDetn21RdrDetnCntr 0;
BA_ "GenSigFuncType" SG_ 310 FrntRdrDetn21RdrDetnCntr 16;
BA_ "GenSigSendType" SG_ 310 FrntRdrDetn21RdrDetnConf 0;
BA_ "GenSigStartValue" SG_ 310 FrntRdrDetn21RdrDetnElevn 15;
BA_ "GenSigSendType" SG_ 310 FrntRdrDetn21RdrDetnElevn 0;
BA_ "GenSigSendType" SG_ 310 FrntRdrDetn21RdrDetnPwr 0;
BA_ "GenSigStartValue" SG_ 310 FrntRdrDetn21RdrDetnRng 10050;
BA_ "GenSigSendType" SG_ 310 FrntRdrDetn21RdrDetnRng 0;
BA_ "GenSigStartValue" SG_ 310 FrntRdrDetn21RdrDetnRngV 4000;
BA_ "GenSigSendType" SG_ 310 FrntRdrDetn21RdrDetnRngV 0;
BA_ "GenSigStartValue" SG_ 310 FrntRdrDetn21RdrDetnSts 3;
BA_ "GenSigSendType" SG_ 310 FrntRdrDetn21RdrDetnSts 0;
BA_ "GenSigStartValue" SG_ 310 FrntRdrDetn22RdrDetnAzi 900;
BA_ "GenSigSendType" SG_ 310 FrntRdrDetn22RdrDetnAzi 0;
BA_ "GenSigSendType" SG_ 310 FrntRdrDetn22RdrDetnChks 0;
BA_ "GenSigFuncType" SG_ 310 FrntRdrDetn22RdrDetnChks 15;
BA_ "GenSigDataID" SG_ 310 FrntRdrDetn22RdrDetnChks "0x71D";
BA_ "GenSigSendType" SG_ 310 FrntRdrDetn22RdrDetnCntr 0;
BA_ "GenSigFuncType" SG_ 310 FrntRdrDetn22RdrDetnCntr 16;
BA_ "GenSigSendType" SG_ 310 FrntRdrDetn22RdrDetnConf 0;
BA_ "GenSigStartValue" SG_ 310 FrntRdrDetn22RdrDetnElevn 15;
BA_ "GenSigSendType" SG_ 310 FrntRdrDetn22RdrDetnElevn 0;
BA_ "GenSigSendType" SG_ 310 FrntRdrDetn22RdrDetnPwr 0;
BA_ "GenSigStartValue" SG_ 310 FrntRdrDetn22RdrDetnRng 10050;
BA_ "GenSigSendType" SG_ 310 FrntRdrDetn22RdrDetnRng 0;
BA_ "GenSigStartValue" SG_ 310 FrntRdrDetn22RdrDetnRngV 4000;
BA_ "GenSigSendType" SG_ 310 FrntRdrDetn22RdrDetnRngV 0;
BA_ "GenSigStartValue" SG_ 310 FrntRdrDetn22RdrDetnSts 3;
BA_ "GenSigSendType" SG_ 310 FrntRdrDetn22RdrDetnSts 0;
BA_ "GenSigStartValue" SG_ 310 FrntRdrDetn23RdrDetnAzi 900;
BA_ "GenSigSendType" SG_ 310 FrntRdrDetn23RdrDetnAzi 0;
BA_ "GenSigSendType" SG_ 310 FrntRdrDetn23RdrDetnChks 0;
BA_ "GenSigFuncType" SG_ 310 FrntRdrDetn23RdrDetnChks 15;
BA_ "GenSigDataID" SG_ 310 FrntRdrDetn23RdrDetnChks "0x71E";
BA_ "GenSigSendType" SG_ 310 FrntRdrDetn23RdrDetnCntr 0;
BA_ "GenSigFuncType" SG_ 310 FrntRdrDetn23RdrDetnCntr 16;
BA_ "GenSigSendType" SG_ 310 FrntRdrDetn23RdrDetnConf 0;
BA_ "GenSigStartValue" SG_ 310 FrntRdrDetn23RdrDetnElevn 15;
BA_ "GenSigSendType" SG_ 310 FrntRdrDetn23RdrDetnElevn 0;
BA_ "GenSigSendType" SG_ 310 FrntRdrDetn23RdrDetnPwr 0;
BA_ "GenSigStartValue" SG_ 310 FrntRdrDetn23RdrDetnRng 10050;
BA_ "GenSigSendType" SG_ 310 FrntRdrDetn23RdrDetnRng 0;
BA_ "GenSigStartValue" SG_ 310 FrntRdrDetn23RdrDetnRngV 4000;
BA_ "GenSigSendType" SG_ 310 FrntRdrDetn23RdrDetnRngV 0;
BA_ "GenSigStartValue" SG_ 310 FrntRdrDetn23RdrDetnSts 3;
BA_ "GenSigSendType" SG_ 310 FrntRdrDetn23RdrDetnSts 0;
BA_ "GenSigStartValue" SG_ 310 FrntRdrDetn24RdrDetnAzi 900;
BA_ "GenSigSendType" SG_ 310 FrntRdrDetn24RdrDetnAzi 0;
BA_ "GenSigSendType" SG_ 310 FrntRdrDetn24RdrDetnChks 0;
BA_ "GenSigFuncType" SG_ 310 FrntRdrDetn24RdrDetnChks 15;
BA_ "GenSigDataID" SG_ 310 FrntRdrDetn24RdrDetnChks "0x71F";
BA_ "GenSigSendType" SG_ 310 FrntRdrDetn24RdrDetnCntr 0;
BA_ "GenSigFuncType" SG_ 310 FrntRdrDetn24RdrDetnCntr 16;
BA_ "GenSigSendType" SG_ 310 FrntRdrDetn24RdrDetnConf 0;
BA_ "GenSigStartValue" SG_ 310 FrntRdrDetn24RdrDetnElevn 15;
BA_ "GenSigSendType" SG_ 310 FrntRdrDetn24RdrDetnElevn 0;
BA_ "GenSigSendType" SG_ 310 FrntRdrDetn24RdrDetnPwr 0;
BA_ "GenSigStartValue" SG_ 310 FrntRdrDetn24RdrDetnRng 10050;
BA_ "GenSigSendType" SG_ 310 FrntRdrDetn24RdrDetnRng 0;
BA_ "GenSigStartValue" SG_ 310 FrntRdrDetn24RdrDetnRngV 4000;
BA_ "GenSigSendType" SG_ 310 FrntRdrDetn24RdrDetnRngV 0;
BA_ "GenSigStartValue" SG_ 310 FrntRdrDetn24RdrDetnSts 3;
BA_ "GenSigSendType" SG_ 310 FrntRdrDetn24RdrDetnSts 0;
// Frame: FLRSafetyCANFD2Frame05
BA_ "VFrameFormat" BO_ 312 14;
BA_ "GenMsgSendType" BO_ 312 0;
BA_ "GenMsgCycleTime" BO_ 312 50.000;
BA_ "GenSigStartValue" SG_ 312 FrntRdrDetn25RdrDetnAzi 900;
BA_ "GenSigSendType" SG_ 312 FrntRdrDetn25RdrDetnAzi 0;
BA_ "GenSigSendType" SG_ 312 FrntRdrDetn25RdrDetnChks 0;
BA_ "GenSigFuncType" SG_ 312 FrntRdrDetn25RdrDetnChks 15;
BA_ "GenSigDataID" SG_ 312 FrntRdrDetn25RdrDetnChks "0x720";
BA_ "GenSigSendType" SG_ 312 FrntRdrDetn25RdrDetnCntr 0;
BA_ "GenSigFuncType" SG_ 312 FrntRdrDetn25RdrDetnCntr 16;
BA_ "GenSigSendType" SG_ 312 FrntRdrDetn25RdrDetnConf 0;
BA_ "GenSigStartValue" SG_ 312 FrntRdrDetn25RdrDetnElevn 15;
BA_ "GenSigSendType" SG_ 312 FrntRdrDetn25RdrDetnElevn 0;
BA_ "GenSigSendType" SG_ 312 FrntRdrDetn25RdrDetnPwr 0;
BA_ "GenSigStartValue" SG_ 312 FrntRdrDetn25RdrDetnRng 10050;
BA_ "GenSigSendType" SG_ 312 FrntRdrDetn25RdrDetnRng 0;
BA_ "GenSigStartValue" SG_ 312 FrntRdrDetn25RdrDetnRngV 4000;
BA_ "GenSigSendType" SG_ 312 FrntRdrDetn25RdrDetnRngV 0;
BA_ "GenSigStartValue" SG_ 312 FrntRdrDetn25RdrDetnSts 3;
BA_ "GenSigSendType" SG_ 312 FrntRdrDetn25RdrDetnSts 0;
BA_ "GenSigStartValue" SG_ 312 FrntRdrDetn26RdrDetnAzi 900;
BA_ "GenSigSendType" SG_ 312 FrntRdrDetn26RdrDetnAzi 0;
BA_ "GenSigSendType" SG_ 312 FrntRdrDetn26RdrDetnChks 0;
BA_ "GenSigFuncType" SG_ 312 FrntRdrDetn26RdrDetnChks 15;
BA_ "GenSigDataID" SG_ 312 FrntRdrDetn26RdrDetnChks "0x721";
BA_ "GenSigSendType" SG_ 312 FrntRdrDetn26RdrDetnCntr 0;
BA_ "GenSigFuncType" SG_ 312 FrntRdrDetn26RdrDetnCntr 16;
BA_ "GenSigSendType" SG_ 312 FrntRdrDetn26RdrDetnConf 0;
BA_ "GenSigStartValue" SG_ 312 FrntRdrDetn26RdrDetnElevn 15;
BA_ "GenSigSendType" SG_ 312 FrntRdrDetn26RdrDetnElevn 0;
BA_ "GenSigSendType" SG_ 312 FrntRdrDetn26RdrDetnPwr 0;
BA_ "GenSigStartValue" SG_ 312 FrntRdrDetn26RdrDetnRng 10050;
BA_ "GenSigSendType" SG_ 312 FrntRdrDetn26RdrDetnRng 0;
BA_ "GenSigStartValue" SG_ 312 FrntRdrDetn26RdrDetnRngV 4000;
BA_ "GenSigSendType" SG_ 312 FrntRdrDetn26RdrDetnRngV 0;
BA_ "GenSigStartValue" SG_ 312 FrntRdrDetn26RdrDetnSts 3;
BA_ "GenSigSendType" SG_ 312 FrntRdrDetn26RdrDetnSts 0;
BA_ "GenSigStartValue" SG_ 312 FrntRdrDetn27RdrDetnAzi 900;
BA_ "GenSigSendType" SG_ 312 FrntRdrDetn27RdrDetnAzi 0;
BA_ "GenSigSendType" SG_ 312 FrntRdrDetn27RdrDetnChks 0;
BA_ "GenSigFuncType" SG_ 312 FrntRdrDetn27RdrDetnChks 15;
BA_ "GenSigDataID" SG_ 312 FrntRdrDetn27RdrDetnChks "0x722";
BA_ "GenSigSendType" SG_ 312 FrntRdrDetn27RdrDetnCntr 0;
BA_ "GenSigFuncType" SG_ 312 FrntRdrDetn27RdrDetnCntr 16;
BA_ "GenSigSendType" SG_ 312 FrntRdrDetn27RdrDetnConf 0;
BA_ "GenSigStartValue" SG_ 312 FrntRdrDetn27RdrDetnElevn 15;
BA_ "GenSigSendType" SG_ 312 FrntRdrDetn27RdrDetnElevn 0;
BA_ "GenSigSendType" SG_ 312 FrntRdrDetn27RdrDetnPwr 0;
BA_ "GenSigStartValue" SG_ 312 FrntRdrDetn27RdrDetnRng 10050;
BA_ "GenSigSendType" SG_ 312 FrntRdrDetn27RdrDetnRng 0;
BA_ "GenSigStartValue" SG_ 312 FrntRdrDetn27RdrDetnRngV 4000;
BA_ "GenSigSendType" SG_ 312 FrntRdrDetn27RdrDetnRngV 0;
BA_ "GenSigStartValue" SG_ 312 FrntRdrDetn27RdrDetnSts 3;
BA_ "GenSigSendType" SG_ 312 FrntRdrDetn27RdrDetnSts 0;
BA_ "GenSigStartValue" SG_ 312 FrntRdrDetn28RdrDetnAzi 900;
BA_ "GenSigSendType" SG_ 312 FrntRdrDetn28RdrDetnAzi 0;
BA_ "GenSigSendType" SG_ 312 FrntRdrDetn28RdrDetnChks 0;
BA_ "GenSigFuncType" SG_ 312 FrntRdrDetn28RdrDetnChks 15;
BA_ "GenSigDataID" SG_ 312 FrntRdrDetn28RdrDetnChks "0x723";
BA_ "GenSigSendType" SG_ 312 FrntRdrDetn28RdrDetnCntr 0;
BA_ "GenSigFuncType" SG_ 312 FrntRdrDetn28RdrDetnCntr 16;
BA_ "GenSigSendType" SG_ 312 FrntRdrDetn28RdrDetnConf 0;
BA_ "GenSigStartValue" SG_ 312 FrntRdrDetn28RdrDetnElevn 15;
BA_ "GenSigSendType" SG_ 312 FrntRdrDetn28RdrDetnElevn 0;
BA_ "GenSigSendType" SG_ 312 FrntRdrDetn28RdrDetnPwr 0;
BA_ "GenSigStartValue" SG_ 312 FrntRdrDetn28RdrDetnRng 10050;
BA_ "GenSigSendType" SG_ 312 FrntRdrDetn28RdrDetnRng 0;
BA_ "GenSigStartValue" SG_ 312 FrntRdrDetn28RdrDetnRngV 4000;
BA_ "GenSigSendType" SG_ 312 FrntRdrDetn28RdrDetnRngV 0;
BA_ "GenSigStartValue" SG_ 312 FrntRdrDetn28RdrDetnSts 3;
BA_ "GenSigSendType" SG_ 312 FrntRdrDetn28RdrDetnSts 0;
BA_ "GenSigStartValue" SG_ 312 FrntRdrDetn29RdrDetnAzi 900;
BA_ "GenSigSendType" SG_ 312 FrntRdrDetn29RdrDetnAzi 0;
BA_ "GenSigSendType" SG_ 312 FrntRdrDetn29RdrDetnChks 0;
BA_ "GenSigFuncType" SG_ 312 FrntRdrDetn29RdrDetnChks 15;
BA_ "GenSigDataID" SG_ 312 FrntRdrDetn29RdrDetnChks "0x724";
BA_ "GenSigSendType" SG_ 312 FrntRdrDetn29RdrDetnCntr 0;
BA_ "GenSigFuncType" SG_ 312 FrntRdrDetn29RdrDetnCntr 16;
BA_ "GenSigSendType" SG_ 312 FrntRdrDetn29RdrDetnConf 0;
BA_ "GenSigStartValue" SG_ 312 FrntRdrDetn29RdrDetnElevn 15;
BA_ "GenSigSendType" SG_ 312 FrntRdrDetn29RdrDetnElevn 0;
BA_ "GenSigSendType" SG_ 312 FrntRdrDetn29RdrDetnPwr 0;
BA_ "GenSigStartValue" SG_ 312 FrntRdrDetn29RdrDetnRng 10050;
BA_ "GenSigSendType" SG_ 312 FrntRdrDetn29RdrDetnRng 0;
BA_ "GenSigStartValue" SG_ 312 FrntRdrDetn29RdrDetnRngV 4000;
BA_ "GenSigSendType" SG_ 312 FrntRdrDetn29RdrDetnRngV 0;
BA_ "GenSigStartValue" SG_ 312 FrntRdrDetn29RdrDetnSts 3;
BA_ "GenSigSendType" SG_ 312 FrntRdrDetn29RdrDetnSts 0;
BA_ "GenSigStartValue" SG_ 312 FrntRdrDetn30RdrDetnAzi 900;
BA_ "GenSigSendType" SG_ 312 FrntRdrDetn30RdrDetnAzi 0;
BA_ "GenSigSendType" SG_ 312 FrntRdrDetn30RdrDetnChks 0;
BA_ "GenSigFuncType" SG_ 312 FrntRdrDetn30RdrDetnChks 15;
BA_ "GenSigDataID" SG_ 312 FrntRdrDetn30RdrDetnChks "0x725";
BA_ "GenSigSendType" SG_ 312 FrntRdrDetn30RdrDetnCntr 0;
BA_ "GenSigFuncType" SG_ 312 FrntRdrDetn30RdrDetnCntr 16;
BA_ "GenSigSendType" SG_ 312 FrntRdrDetn30RdrDetnConf 0;
BA_ "GenSigStartValue" SG_ 312 FrntRdrDetn30RdrDetnElevn 15;
BA_ "GenSigSendType" SG_ 312 FrntRdrDetn30RdrDetnElevn 0;
BA_ "GenSigSendType" SG_ 312 FrntRdrDetn30RdrDetnPwr 0;
BA_ "GenSigStartValue" SG_ 312 FrntRdrDetn30RdrDetnRng 10050;
BA_ "GenSigSendType" SG_ 312 FrntRdrDetn30RdrDetnRng 0;
BA_ "GenSigStartValue" SG_ 312 FrntRdrDetn30RdrDetnRngV 4000;
BA_ "GenSigSendType" SG_ 312 FrntRdrDetn30RdrDetnRngV 0;
BA_ "GenSigStartValue" SG_ 312 FrntRdrDetn30RdrDetnSts 3;
BA_ "GenSigSendType" SG_ 312 FrntRdrDetn30RdrDetnSts 0;
// Frame: FLRSafetyCANFD2Frame06
BA_ "VFrameFormat" BO_ 314 14;
BA_ "GenMsgSendType" BO_ 314 0;
BA_ "GenMsgCycleTime" BO_ 314 50.000;
BA_ "GenSigStartValue" SG_ 314 FrntRdrDetn31RdrDetnAzi 900;
BA_ "GenSigSendType" SG_ 314 FrntRdrDetn31RdrDetnAzi 0;
BA_ "GenSigSendType" SG_ 314 FrntRdrDetn31RdrDetnChks 0;
BA_ "GenSigFuncType" SG_ 314 FrntRdrDetn31RdrDetnChks 15;
BA_ "GenSigDataID" SG_ 314 FrntRdrDetn31RdrDetnChks "0x726";
BA_ "GenSigSendType" SG_ 314 FrntRdrDetn31RdrDetnCntr 0;
BA_ "GenSigFuncType" SG_ 314 FrntRdrDetn31RdrDetnCntr 16;
BA_ "GenSigSendType" SG_ 314 FrntRdrDetn31RdrDetnConf 0;
BA_ "GenSigStartValue" SG_ 314 FrntRdrDetn31RdrDetnElevn 15;
BA_ "GenSigSendType" SG_ 314 FrntRdrDetn31RdrDetnElevn 0;
BA_ "GenSigSendType" SG_ 314 FrntRdrDetn31RdrDetnPwr 0;
BA_ "GenSigStartValue" SG_ 314 FrntRdrDetn31RdrDetnRng 10050;
BA_ "GenSigSendType" SG_ 314 FrntRdrDetn31RdrDetnRng 0;
BA_ "GenSigStartValue" SG_ 314 FrntRdrDetn31RdrDetnRngV 4000;
BA_ "GenSigSendType" SG_ 314 FrntRdrDetn31RdrDetnRngV 0;
BA_ "GenSigStartValue" SG_ 314 FrntRdrDetn31RdrDetnSts 3;
BA_ "GenSigSendType" SG_ 314 FrntRdrDetn31RdrDetnSts 0;
BA_ "GenSigStartValue" SG_ 314 FrntRdrDetn32RdrDetnAzi 900;
BA_ "GenSigSendType" SG_ 314 FrntRdrDetn32RdrDetnAzi 0;
BA_ "GenSigSendType" SG_ 314 FrntRdrDetn32RdrDetnChks 0;
BA_ "GenSigFuncType" SG_ 314 FrntRdrDetn32RdrDetnChks 15;
BA_ "GenSigDataID" SG_ 314 FrntRdrDetn32RdrDetnChks "0x727";
BA_ "GenSigSendType" SG_ 314 FrntRdrDetn32RdrDetnCntr 0;
BA_ "GenSigFuncType" SG_ 314 FrntRdrDetn32RdrDetnCntr 16;
BA_ "GenSigSendType" SG_ 314 FrntRdrDetn32RdrDetnConf 0;
BA_ "GenSigStartValue" SG_ 314 FrntRdrDetn32RdrDetnElevn 15;
BA_ "GenSigSendType" SG_ 314 FrntRdrDetn32RdrDetnElevn 0;
BA_ "GenSigSendType" SG_ 314 FrntRdrDetn32RdrDetnPwr 0;
BA_ "GenSigStartValue" SG_ 314 FrntRdrDetn32RdrDetnRng 10050;
BA_ "GenSigSendType" SG_ 314 FrntRdrDetn32RdrDetnRng 0;
BA_ "GenSigStartValue" SG_ 314 FrntRdrDetn32RdrDetnRngV 4000;
BA_ "GenSigSendType" SG_ 314 FrntRdrDetn32RdrDetnRngV 0;
BA_ "GenSigStartValue" SG_ 314 FrntRdrDetn32RdrDetnSts 3;
BA_ "GenSigSendType" SG_ 314 FrntRdrDetn32RdrDetnSts 0;
BA_ "GenSigStartValue" SG_ 314 FrntRdrDetn33RdrDetnAzi 900;
BA_ "GenSigSendType" SG_ 314 FrntRdrDetn33RdrDetnAzi 0;
BA_ "GenSigSendType" SG_ 314 FrntRdrDetn33RdrDetnChks 0;
BA_ "GenSigFuncType" SG_ 314 FrntRdrDetn33RdrDetnChks 15;
BA_ "GenSigDataID" SG_ 314 FrntRdrDetn33RdrDetnChks "0x728";
BA_ "GenSigSendType" SG_ 314 FrntRdrDetn33RdrDetnCntr 0;
BA_ "GenSigFuncType" SG_ 314 FrntRdrDetn33RdrDetnCntr 16;
BA_ "GenSigSendType" SG_ 314 FrntRdrDetn33RdrDetnConf 0;
BA_ "GenSigStartValue" SG_ 314 FrntRdrDetn33RdrDetnElevn 15;
BA_ "GenSigSendType" SG_ 314 FrntRdrDetn33RdrDetnElevn 0;
BA_ "GenSigSendType" SG_ 314 FrntRdrDetn33RdrDetnPwr 0;
BA_ "GenSigStartValue" SG_ 314 FrntRdrDetn33RdrDetnRng 10050;
BA_ "GenSigSendType" SG_ 314 FrntRdrDetn33RdrDetnRng 0;
BA_ "GenSigStartValue" SG_ 314 FrntRdrDetn33RdrDetnRngV 4000;
BA_ "GenSigSendType" SG_ 314 FrntRdrDetn33RdrDetnRngV 0;
BA_ "GenSigStartValue" SG_ 314 FrntRdrDetn33RdrDetnSts 3;
BA_ "GenSigSendType" SG_ 314 FrntRdrDetn33RdrDetnSts 0;
BA_ "GenSigStartValue" SG_ 314 FrntRdrDetn34RdrDetnAzi 900;
BA_ "GenSigSendType" SG_ 314 FrntRdrDetn34RdrDetnAzi 0;
BA_ "GenSigSendType" SG_ 314 FrntRdrDetn34RdrDetnChks 0;
BA_ "GenSigFuncType" SG_ 314 FrntRdrDetn34RdrDetnChks 15;
BA_ "GenSigDataID" SG_ 314 FrntRdrDetn34RdrDetnChks "0x729";
BA_ "GenSigSendType" SG_ 314 FrntRdrDetn34RdrDetnCntr 0;
BA_ "GenSigFuncType" SG_ 314 FrntRdrDetn34RdrDetnCntr 16;
BA_ "GenSigSendType" SG_ 314 FrntRdrDetn34RdrDetnConf 0;
BA_ "GenSigStartValue" SG_ 314 FrntRdrDetn34RdrDetnElevn 15;
BA_ "GenSigSendType" SG_ 314 FrntRdrDetn34RdrDetnElevn 0;
BA_ "GenSigSendType" SG_ 314 FrntRdrDetn34RdrDetnPwr 0;
BA_ "GenSigStartValue" SG_ 314 FrntRdrDetn34RdrDetnRng 10050;
BA_ "GenSigSendType" SG_ 314 FrntRdrDetn34RdrDetnRng 0;
BA_ "GenSigStartValue" SG_ 314 FrntRdrDetn34RdrDetnRngV 4000;
BA_ "GenSigSendType" SG_ 314 FrntRdrDetn34RdrDetnRngV 0;
BA_ "GenSigStartValue" SG_ 314 FrntRdrDetn34RdrDetnSts 3;
BA_ "GenSigSendType" SG_ 314 FrntRdrDetn34RdrDetnSts 0;
BA_ "GenSigStartValue" SG_ 314 FrntRdrDetn35RdrDetnAzi 900;
BA_ "GenSigSendType" SG_ 314 FrntRdrDetn35RdrDetnAzi 0;
BA_ "GenSigSendType" SG_ 314 FrntRdrDetn35RdrDetnChks 0;
BA_ "GenSigFuncType" SG_ 314 FrntRdrDetn35RdrDetnChks 15;
BA_ "GenSigDataID" SG_ 314 FrntRdrDetn35RdrDetnChks "0x72A";
BA_ "GenSigSendType" SG_ 314 FrntRdrDetn35RdrDetnCntr 0;
BA_ "GenSigFuncType" SG_ 314 FrntRdrDetn35RdrDetnCntr 16;
BA_ "GenSigSendType" SG_ 314 FrntRdrDetn35RdrDetnConf 0;
BA_ "GenSigStartValue" SG_ 314 FrntRdrDetn35RdrDetnElevn 15;
BA_ "GenSigSendType" SG_ 314 FrntRdrDetn35RdrDetnElevn 0;
BA_ "GenSigSendType" SG_ 314 FrntRdrDetn35RdrDetnPwr 0;
BA_ "GenSigStartValue" SG_ 314 FrntRdrDetn35RdrDetnRng 10050;
BA_ "GenSigSendType" SG_ 314 FrntRdrDetn35RdrDetnRng 0;
BA_ "GenSigStartValue" SG_ 314 FrntRdrDetn35RdrDetnRngV 4000;
BA_ "GenSigSendType" SG_ 314 FrntRdrDetn35RdrDetnRngV 0;
BA_ "GenSigStartValue" SG_ 314 FrntRdrDetn35RdrDetnSts 3;
BA_ "GenSigSendType" SG_ 314 FrntRdrDetn35RdrDetnSts 0;
BA_ "GenSigStartValue" SG_ 314 FrntRdrDetn36RdrDetnAzi 900;
BA_ "GenSigSendType" SG_ 314 FrntRdrDetn36RdrDetnAzi 0;
BA_ "GenSigSendType" SG_ 314 FrntRdrDetn36RdrDetnChks 0;
BA_ "GenSigFuncType" SG_ 314 FrntRdrDetn36RdrDetnChks 15;
BA_ "GenSigDataID" SG_ 314 FrntRdrDetn36RdrDetnChks "0x72B";
BA_ "GenSigSendType" SG_ 314 FrntRdrDetn36RdrDetnCntr 0;
BA_ "GenSigFuncType" SG_ 314 FrntRdrDetn36RdrDetnCntr 16;
BA_ "GenSigSendType" SG_ 314 FrntRdrDetn36RdrDetnConf 0;
BA_ "GenSigStartValue" SG_ 314 FrntRdrDetn36RdrDetnElevn 15;
BA_ "GenSigSendType" SG_ 314 FrntRdrDetn36RdrDetnElevn 0;
BA_ "GenSigSendType" SG_ 314 FrntRdrDetn36RdrDetnPwr 0;
BA_ "GenSigStartValue" SG_ 314 FrntRdrDetn36RdrDetnRng 10050;
BA_ "GenSigSendType" SG_ 314 FrntRdrDetn36RdrDetnRng 0;
BA_ "GenSigStartValue" SG_ 314 FrntRdrDetn36RdrDetnRngV 4000;
BA_ "GenSigSendType" SG_ 314 FrntRdrDetn36RdrDetnRngV 0;
BA_ "GenSigStartValue" SG_ 314 FrntRdrDetn36RdrDetnSts 3;
BA_ "GenSigSendType" SG_ 314 FrntRdrDetn36RdrDetnSts 0;
// Frame: FLRSafetyCANFD2Frame07
BA_ "VFrameFormat" BO_ 316 14;
BA_ "GenMsgSendType" BO_ 316 0;
BA_ "GenMsgCycleTime" BO_ 316 50.000;
BA_ "GenSigStartValue" SG_ 316 FrntRdrDetn37RdrDetnAzi 900;
BA_ "GenSigSendType" SG_ 316 FrntRdrDetn37RdrDetnAzi 0;
BA_ "GenSigSendType" SG_ 316 FrntRdrDetn37RdrDetnChks 0;
BA_ "GenSigFuncType" SG_ 316 FrntRdrDetn37RdrDetnChks 15;
BA_ "GenSigDataID" SG_ 316 FrntRdrDetn37RdrDetnChks "0x72C";
BA_ "GenSigSendType" SG_ 316 FrntRdrDetn37RdrDetnCntr 0;
BA_ "GenSigFuncType" SG_ 316 FrntRdrDetn37RdrDetnCntr 16;
BA_ "GenSigSendType" SG_ 316 FrntRdrDetn37RdrDetnConf 0;
BA_ "GenSigStartValue" SG_ 316 FrntRdrDetn37RdrDetnElevn 15;
BA_ "GenSigSendType" SG_ 316 FrntRdrDetn37RdrDetnElevn 0;
BA_ "GenSigSendType" SG_ 316 FrntRdrDetn37RdrDetnPwr 0;
BA_ "GenSigStartValue" SG_ 316 FrntRdrDetn37RdrDetnRng 10050;
BA_ "GenSigSendType" SG_ 316 FrntRdrDetn37RdrDetnRng 0;
BA_ "GenSigStartValue" SG_ 316 FrntRdrDetn37RdrDetnRngV 4000;
BA_ "GenSigSendType" SG_ 316 FrntRdrDetn37RdrDetnRngV 0;
BA_ "GenSigStartValue" SG_ 316 FrntRdrDetn37RdrDetnSts 3;
BA_ "GenSigSendType" SG_ 316 FrntRdrDetn37RdrDetnSts 0;
BA_ "GenSigStartValue" SG_ 316 FrntRdrDetn38RdrDetnAzi 900;
BA_ "GenSigSendType" SG_ 316 FrntRdrDetn38RdrDetnAzi 0;
BA_ "GenSigSendType" SG_ 316 FrntRdrDetn38RdrDetnChks 0;
BA_ "GenSigFuncType" SG_ 316 FrntRdrDetn38RdrDetnChks 15;
BA_ "GenSigDataID" SG_ 316 FrntRdrDetn38RdrDetnChks "0x72D";
BA_ "GenSigSendType" SG_ 316 FrntRdrDetn38RdrDetnCntr 0;
BA_ "GenSigFuncType" SG_ 316 FrntRdrDetn38RdrDetnCntr 16;
BA_ "GenSigSendType" SG_ 316 FrntRdrDetn38RdrDetnConf 0;
BA_ "GenSigStartValue" SG_ 316 FrntRdrDetn38RdrDetnElevn 15;
BA_ "GenSigSendType" SG_ 316 FrntRdrDetn38RdrDetnElevn 0;
BA_ "GenSigSendType" SG_ 316 FrntRdrDetn38RdrDetnPwr 0;
BA_ "GenSigStartValue" SG_ 316 FrntRdrDetn38RdrDetnRng 10050;
BA_ "GenSigSendType" SG_ 316 FrntRdrDetn38RdrDetnRng 0;
BA_ "GenSigStartValue" SG_ 316 FrntRdrDetn38RdrDetnRngV 4000;
BA_ "GenSigSendType" SG_ 316 FrntRdrDetn38RdrDetnRngV 0;
BA_ "GenSigStartValue" SG_ 316 FrntRdrDetn38RdrDetnSts 3;
BA_ "GenSigSendType" SG_ 316 FrntRdrDetn38RdrDetnSts 0;
BA_ "GenSigStartValue" SG_ 316 FrntRdrDetn39RdrDetnAzi 900;
BA_ "GenSigSendType" SG_ 316 FrntRdrDetn39RdrDetnAzi 0;
BA_ "GenSigSendType" SG_ 316 FrntRdrDetn39RdrDetnChks 0;
BA_ "GenSigFuncType" SG_ 316 FrntRdrDetn39RdrDetnChks 15;
BA_ "GenSigDataID" SG_ 316 FrntRdrDetn39RdrDetnChks "0x72E";
BA_ "GenSigSendType" SG_ 316 FrntRdrDetn39RdrDetnCntr 0;
BA_ "GenSigFuncType" SG_ 316 FrntRdrDetn39RdrDetnCntr 16;
BA_ "GenSigSendType" SG_ 316 FrntRdrDetn39RdrDetnConf 0;
BA_ "GenSigStartValue" SG_ 316 FrntRdrDetn39RdrDetnElevn 15;
BA_ "GenSigSendType" SG_ 316 FrntRdrDetn39RdrDetnElevn 0;
BA_ "GenSigSendType" SG_ 316 FrntRdrDetn39RdrDetnPwr 0;
BA_ "GenSigStartValue" SG_ 316 FrntRdrDetn39RdrDetnRng 10050;
BA_ "GenSigSendType" SG_ 316 FrntRdrDetn39RdrDetnRng 0;
BA_ "GenSigStartValue" SG_ 316 FrntRdrDetn39RdrDetnRngV 4000;
BA_ "GenSigSendType" SG_ 316 FrntRdrDetn39RdrDetnRngV 0;
BA_ "GenSigStartValue" SG_ 316 FrntRdrDetn39RdrDetnSts 3;
BA_ "GenSigSendType" SG_ 316 FrntRdrDetn39RdrDetnSts 0;
BA_ "GenSigStartValue" SG_ 316 FrntRdrDetn40RdrDetnAzi 900;
BA_ "GenSigSendType" SG_ 316 FrntRdrDetn40RdrDetnAzi 0;
BA_ "GenSigSendType" SG_ 316 FrntRdrDetn40RdrDetnChks 0;
BA_ "GenSigFuncType" SG_ 316 FrntRdrDetn40RdrDetnChks 15;
BA_ "GenSigDataID" SG_ 316 FrntRdrDetn40RdrDetnChks "0x72F";
BA_ "GenSigSendType" SG_ 316 FrntRdrDetn40RdrDetnCntr 0;
BA_ "GenSigFuncType" SG_ 316 FrntRdrDetn40RdrDetnCntr 16;
BA_ "GenSigSendType" SG_ 316 FrntRdrDetn40RdrDetnConf 0;
BA_ "GenSigStartValue" SG_ 316 FrntRdrDetn40RdrDetnElevn 15;
BA_ "GenSigSendType" SG_ 316 FrntRdrDetn40RdrDetnElevn 0;
BA_ "GenSigSendType" SG_ 316 FrntRdrDetn40RdrDetnPwr 0;
BA_ "GenSigStartValue" SG_ 316 FrntRdrDetn40RdrDetnRng 10050;
BA_ "GenSigSendType" SG_ 316 FrntRdrDetn40RdrDetnRng 0;
BA_ "GenSigStartValue" SG_ 316 FrntRdrDetn40RdrDetnRngV 4000;
BA_ "GenSigSendType" SG_ 316 FrntRdrDetn40RdrDetnRngV 0;
BA_ "GenSigStartValue" SG_ 316 FrntRdrDetn40RdrDetnSts 3;
BA_ "GenSigSendType" SG_ 316 FrntRdrDetn40RdrDetnSts 0;
BA_ "GenSigStartValue" SG_ 316 FrntRdrDetn41RdrDetnAzi 900;
BA_ "GenSigSendType" SG_ 316 FrntRdrDetn41RdrDetnAzi 0;
BA_ "GenSigSendType" SG_ 316 FrntRdrDetn41RdrDetnChks 0;
BA_ "GenSigFuncType" SG_ 316 FrntRdrDetn41RdrDetnChks 15;
BA_ "GenSigDataID" SG_ 316 FrntRdrDetn41RdrDetnChks "0x730";
BA_ "GenSigSendType" SG_ 316 FrntRdrDetn41RdrDetnCntr 0;
BA_ "GenSigFuncType" SG_ 316 FrntRdrDetn41RdrDetnCntr 16;
BA_ "GenSigSendType" SG_ 316 FrntRdrDetn41RdrDetnConf 0;
BA_ "GenSigStartValue" SG_ 316 FrntRdrDetn41RdrDetnElevn 15;
BA_ "GenSigSendType" SG_ 316 FrntRdrDetn41RdrDetnElevn 0;
BA_ "GenSigSendType" SG_ 316 FrntRdrDetn41RdrDetnPwr 0;
BA_ "GenSigStartValue" SG_ 316 FrntRdrDetn41RdrDetnRng 10050;
BA_ "GenSigSendType" SG_ 316 FrntRdrDetn41RdrDetnRng 0;
BA_ "GenSigStartValue" SG_ 316 FrntRdrDetn41RdrDetnRngV 4000;
BA_ "GenSigSendType" SG_ 316 FrntRdrDetn41RdrDetnRngV 0;
BA_ "GenSigStartValue" SG_ 316 FrntRdrDetn41RdrDetnSts 3;
BA_ "GenSigSendType" SG_ 316 FrntRdrDetn41RdrDetnSts 0;
BA_ "GenSigStartValue" SG_ 316 FrntRdrDetn42RdrDetnAzi 900;
BA_ "GenSigSendType" SG_ 316 FrntRdrDetn42RdrDetnAzi 0;
BA_ "GenSigSendType" SG_ 316 FrntRdrDetn42RdrDetnChks 0;
BA_ "GenSigFuncType" SG_ 316 FrntRdrDetn42RdrDetnChks 15;
BA_ "GenSigDataID" SG_ 316 FrntRdrDetn42RdrDetnChks "0x731";
BA_ "GenSigSendType" SG_ 316 FrntRdrDetn42RdrDetnCntr 0;
BA_ "GenSigFuncType" SG_ 316 FrntRdrDetn42RdrDetnCntr 16;
BA_ "GenSigSendType" SG_ 316 FrntRdrDetn42RdrDetnConf 0;
BA_ "GenSigStartValue" SG_ 316 FrntRdrDetn42RdrDetnElevn 15;
BA_ "GenSigSendType" SG_ 316 FrntRdrDetn42RdrDetnElevn 0;
BA_ "GenSigSendType" SG_ 316 FrntRdrDetn42RdrDetnPwr 0;
BA_ "GenSigStartValue" SG_ 316 FrntRdrDetn42RdrDetnRng 10050;
BA_ "GenSigSendType" SG_ 316 FrntRdrDetn42RdrDetnRng 0;
BA_ "GenSigStartValue" SG_ 316 FrntRdrDetn42RdrDetnRngV 4000;
BA_ "GenSigSendType" SG_ 316 FrntRdrDetn42RdrDetnRngV 0;
BA_ "GenSigStartValue" SG_ 316 FrntRdrDetn42RdrDetnSts 3;
BA_ "GenSigSendType" SG_ 316 FrntRdrDetn42RdrDetnSts 0;
// Frame: FLRSafetyCANFD2Frame08
BA_ "VFrameFormat" BO_ 318 14;
BA_ "GenMsgSendType" BO_ 318 0;
BA_ "GenMsgCycleTime" BO_ 318 50.000;
BA_ "GenSigStartValue" SG_ 318 FrntRdrDetn43RdrDetnAzi 900;
BA_ "GenSigSendType" SG_ 318 FrntRdrDetn43RdrDetnAzi 0;
BA_ "GenSigSendType" SG_ 318 FrntRdrDetn43RdrDetnChks 0;
BA_ "GenSigFuncType" SG_ 318 FrntRdrDetn43RdrDetnChks 15;
BA_ "GenSigDataID" SG_ 318 FrntRdrDetn43RdrDetnChks "0x732";
BA_ "GenSigSendType" SG_ 318 FrntRdrDetn43RdrDetnCntr 0;
BA_ "GenSigFuncType" SG_ 318 FrntRdrDetn43RdrDetnCntr 16;
BA_ "GenSigSendType" SG_ 318 FrntRdrDetn43RdrDetnConf 0;
BA_ "GenSigStartValue" SG_ 318 FrntRdrDetn43RdrDetnElevn 15;
BA_ "GenSigSendType" SG_ 318 FrntRdrDetn43RdrDetnElevn 0;
BA_ "GenSigSendType" SG_ 318 FrntRdrDetn43RdrDetnPwr 0;
BA_ "GenSigStartValue" SG_ 318 FrntRdrDetn43RdrDetnRng 10050;
BA_ "GenSigSendType" SG_ 318 FrntRdrDetn43RdrDetnRng 0;
BA_ "GenSigStartValue" SG_ 318 FrntRdrDetn43RdrDetnRngV 4000;
BA_ "GenSigSendType" SG_ 318 FrntRdrDetn43RdrDetnRngV 0;
BA_ "GenSigStartValue" SG_ 318 FrntRdrDetn43RdrDetnSts 3;
BA_ "GenSigSendType" SG_ 318 FrntRdrDetn43RdrDetnSts 0;
BA_ "GenSigStartValue" SG_ 318 FrntRdrDetn44RdrDetnAzi 900;
BA_ "GenSigSendType" SG_ 318 FrntRdrDetn44RdrDetnAzi 0;
BA_ "GenSigSendType" SG_ 318 FrntRdrDetn44RdrDetnChks 0;
BA_ "GenSigFuncType" SG_ 318 FrntRdrDetn44RdrDetnChks 15;
BA_ "GenSigDataID" SG_ 318 FrntRdrDetn44RdrDetnChks "0x733";
BA_ "GenSigSendType" SG_ 318 FrntRdrDetn44RdrDetnCntr 0;
BA_ "GenSigFuncType" SG_ 318 FrntRdrDetn44RdrDetnCntr 16;
BA_ "GenSigSendType" SG_ 318 FrntRdrDetn44RdrDetnConf 0;
BA_ "GenSigStartValue" SG_ 318 FrntRdrDetn44RdrDetnElevn 15;
BA_ "GenSigSendType" SG_ 318 FrntRdrDetn44RdrDetnElevn 0;
BA_ "GenSigSendType" SG_ 318 FrntRdrDetn44RdrDetnPwr 0;
BA_ "GenSigStartValue" SG_ 318 FrntRdrDetn44RdrDetnRng 10050;
BA_ "GenSigSendType" SG_ 318 FrntRdrDetn44RdrDetnRng 0;
BA_ "GenSigStartValue" SG_ 318 FrntRdrDetn44RdrDetnRngV 4000;
BA_ "GenSigSendType" SG_ 318 FrntRdrDetn44RdrDetnRngV 0;
BA_ "GenSigStartValue" SG_ 318 FrntRdrDetn44RdrDetnSts 3;
BA_ "GenSigSendType" SG_ 318 FrntRdrDetn44RdrDetnSts 0;
BA_ "GenSigStartValue" SG_ 318 FrntRdrDetn45RdrDetnAzi 900;
BA_ "GenSigSendType" SG_ 318 FrntRdrDetn45RdrDetnAzi 0;
BA_ "GenSigSendType" SG_ 318 FrntRdrDetn45RdrDetnChks 0;
BA_ "GenSigFuncType" SG_ 318 FrntRdrDetn45RdrDetnChks 15;
BA_ "GenSigDataID" SG_ 318 FrntRdrDetn45RdrDetnChks "0x734";
BA_ "GenSigSendType" SG_ 318 FrntRdrDetn45RdrDetnCntr 0;
BA_ "GenSigFuncType" SG_ 318 FrntRdrDetn45RdrDetnCntr 16;
BA_ "GenSigSendType" SG_ 318 FrntRdrDetn45RdrDetnConf 0;
BA_ "GenSigStartValue" SG_ 318 FrntRdrDetn45RdrDetnElevn 15;
BA_ "GenSigSendType" SG_ 318 FrntRdrDetn45RdrDetnElevn 0;
BA_ "GenSigSendType" SG_ 318 FrntRdrDetn45RdrDetnPwr 0;
BA_ "GenSigStartValue" SG_ 318 FrntRdrDetn45RdrDetnRng 10050;
BA_ "GenSigSendType" SG_ 318 FrntRdrDetn45RdrDetnRng 0;
BA_ "GenSigStartValue" SG_ 318 FrntRdrDetn45RdrDetnRngV 4000;
BA_ "GenSigSendType" SG_ 318 FrntRdrDetn45RdrDetnRngV 0;
BA_ "GenSigStartValue" SG_ 318 FrntRdrDetn45RdrDetnSts 3;
BA_ "GenSigSendType" SG_ 318 FrntRdrDetn45RdrDetnSts 0;
BA_ "GenSigStartValue" SG_ 318 FrntRdrDetn46RdrDetnAzi 900;
BA_ "GenSigSendType" SG_ 318 FrntRdrDetn46RdrDetnAzi 0;
BA_ "GenSigSendType" SG_ 318 FrntRdrDetn46RdrDetnChks 0;
BA_ "GenSigFuncType" SG_ 318 FrntRdrDetn46RdrDetnChks 15;
BA_ "GenSigDataID" SG_ 318 FrntRdrDetn46RdrDetnChks "0x735";
BA_ "GenSigSendType" SG_ 318 FrntRdrDetn46RdrDetnCntr 0;
BA_ "GenSigFuncType" SG_ 318 FrntRdrDetn46RdrDetnCntr 16;
BA_ "GenSigSendType" SG_ 318 FrntRdrDetn46RdrDetnConf 0;
BA_ "GenSigStartValue" SG_ 318 FrntRdrDetn46RdrDetnElevn 15;
BA_ "GenSigSendType" SG_ 318 FrntRdrDetn46RdrDetnElevn 0;
BA_ "GenSigSendType" SG_ 318 FrntRdrDetn46RdrDetnPwr 0;
BA_ "GenSigStartValue" SG_ 318 FrntRdrDetn46RdrDetnRng 10050;
BA_ "GenSigSendType" SG_ 318 FrntRdrDetn46RdrDetnRng 0;
BA_ "GenSigStartValue" SG_ 318 FrntRdrDetn46RdrDetnRngV 4000;
BA_ "GenSigSendType" SG_ 318 FrntRdrDetn46RdrDetnRngV 0;
BA_ "GenSigStartValue" SG_ 318 FrntRdrDetn46RdrDetnSts 3;
BA_ "GenSigSendType" SG_ 318 FrntRdrDetn46RdrDetnSts 0;
BA_ "GenSigStartValue" SG_ 318 FrntRdrDetn47RdrDetnAzi 900;
BA_ "GenSigSendType" SG_ 318 FrntRdrDetn47RdrDetnAzi 0;
BA_ "GenSigSendType" SG_ 318 FrntRdrDetn47RdrDetnChks 0;
BA_ "GenSigFuncType" SG_ 318 FrntRdrDetn47RdrDetnChks 15;
BA_ "GenSigDataID" SG_ 318 FrntRdrDetn47RdrDetnChks "0x736";
BA_ "GenSigSendType" SG_ 318 FrntRdrDetn47RdrDetnCntr 0;
BA_ "GenSigFuncType" SG_ 318 FrntRdrDetn47RdrDetnCntr 16;
BA_ "GenSigSendType" SG_ 318 FrntRdrDetn47RdrDetnConf 0;
BA_ "GenSigStartValue" SG_ 318 FrntRdrDetn47RdrDetnElevn 15;
BA_ "GenSigSendType" SG_ 318 FrntRdrDetn47RdrDetnElevn 0;
BA_ "GenSigSendType" SG_ 318 FrntRdrDetn47RdrDetnPwr 0;
BA_ "GenSigStartValue" SG_ 318 FrntRdrDetn47RdrDetnRng 10050;
BA_ "GenSigSendType" SG_ 318 FrntRdrDetn47RdrDetnRng 0;
BA_ "GenSigStartValue" SG_ 318 FrntRdrDetn47RdrDetnRngV 4000;
BA_ "GenSigSendType" SG_ 318 FrntRdrDetn47RdrDetnRngV 0;
BA_ "GenSigStartValue" SG_ 318 FrntRdrDetn47RdrDetnSts 3;
BA_ "GenSigSendType" SG_ 318 FrntRdrDetn47RdrDetnSts 0;
BA_ "GenSigStartValue" SG_ 318 FrntRdrDetn48RdrDetnAzi 900;
BA_ "GenSigSendType" SG_ 318 FrntRdrDetn48RdrDetnAzi 0;
BA_ "GenSigSendType" SG_ 318 FrntRdrDetn48RdrDetnChks 0;
BA_ "GenSigFuncType" SG_ 318 FrntRdrDetn48RdrDetnChks 15;
BA_ "GenSigDataID" SG_ 318 FrntRdrDetn48RdrDetnChks "0x737";
BA_ "GenSigSendType" SG_ 318 FrntRdrDetn48RdrDetnCntr 0;
BA_ "GenSigFuncType" SG_ 318 FrntRdrDetn48RdrDetnCntr 16;
BA_ "GenSigSendType" SG_ 318 FrntRdrDetn48RdrDetnConf 0;
BA_ "GenSigStartValue" SG_ 318 FrntRdrDetn48RdrDetnElevn 15;
BA_ "GenSigSendType" SG_ 318 FrntRdrDetn48RdrDetnElevn 0;
BA_ "GenSigSendType" SG_ 318 FrntRdrDetn48RdrDetnPwr 0;
BA_ "GenSigStartValue" SG_ 318 FrntRdrDetn48RdrDetnRng 10050;
BA_ "GenSigSendType" SG_ 318 FrntRdrDetn48RdrDetnRng 0;
BA_ "GenSigStartValue" SG_ 318 FrntRdrDetn48RdrDetnRngV 4000;
BA_ "GenSigSendType" SG_ 318 FrntRdrDetn48RdrDetnRngV 0;
BA_ "GenSigStartValue" SG_ 318 FrntRdrDetn48RdrDetnSts 3;
BA_ "GenSigSendType" SG_ 318 FrntRdrDetn48RdrDetnSts 0;
// Frame: FLRSafetyCANFD2Frame09
BA_ "VFrameFormat" BO_ 320 14;
BA_ "GenMsgSendType" BO_ 320 0;
BA_ "GenMsgCycleTime" BO_ 320 50.000;
BA_ "GenSigStartValue" SG_ 320 FrntRdrDetn49RdrDetnAzi 900;
BA_ "GenSigSendType" SG_ 320 FrntRdrDetn49RdrDetnAzi 0;
BA_ "GenSigSendType" SG_ 320 FrntRdrDetn49RdrDetnChks 0;
BA_ "GenSigFuncType" SG_ 320 FrntRdrDetn49RdrDetnChks 15;
BA_ "GenSigDataID" SG_ 320 FrntRdrDetn49RdrDetnChks "0x738";
BA_ "GenSigSendType" SG_ 320 FrntRdrDetn49RdrDetnCntr 0;
BA_ "GenSigFuncType" SG_ 320 FrntRdrDetn49RdrDetnCntr 16;
BA_ "GenSigSendType" SG_ 320 FrntRdrDetn49RdrDetnConf 0;
BA_ "GenSigStartValue" SG_ 320 FrntRdrDetn49RdrDetnElevn 15;
BA_ "GenSigSendType" SG_ 320 FrntRdrDetn49RdrDetnElevn 0;
BA_ "GenSigSendType" SG_ 320 FrntRdrDetn49RdrDetnPwr 0;
BA_ "GenSigStartValue" SG_ 320 FrntRdrDetn49RdrDetnRng 10050;
BA_ "GenSigSendType" SG_ 320 FrntRdrDetn49RdrDetnRng 0;
BA_ "GenSigStartValue" SG_ 320 FrntRdrDetn49RdrDetnRngV 4000;
BA_ "GenSigSendType" SG_ 320 FrntRdrDetn49RdrDetnRngV 0;
BA_ "GenSigStartValue" SG_ 320 FrntRdrDetn49RdrDetnSts 3;
BA_ "GenSigSendType" SG_ 320 FrntRdrDetn49RdrDetnSts 0;
BA_ "GenSigStartValue" SG_ 320 FrntRdrDetn50RdrDetnAzi 900;
BA_ "GenSigSendType" SG_ 320 FrntRdrDetn50RdrDetnAzi 0;
BA_ "GenSigSendType" SG_ 320 FrntRdrDetn50RdrDetnChks 0;
BA_ "GenSigFuncType" SG_ 320 FrntRdrDetn50RdrDetnChks 15;
BA_ "GenSigDataID" SG_ 320 FrntRdrDetn50RdrDetnChks "0x739";
BA_ "GenSigSendType" SG_ 320 FrntRdrDetn50RdrDetnCntr 0;
BA_ "GenSigFuncType" SG_ 320 FrntRdrDetn50RdrDetnCntr 16;
BA_ "GenSigSendType" SG_ 320 FrntRdrDetn50RdrDetnConf 0;
BA_ "GenSigStartValue" SG_ 320 FrntRdrDetn50RdrDetnElevn 15;
BA_ "GenSigSendType" SG_ 320 FrntRdrDetn50RdrDetnElevn 0;
BA_ "GenSigSendType" SG_ 320 FrntRdrDetn50RdrDetnPwr 0;
BA_ "GenSigStartValue" SG_ 320 FrntRdrDetn50RdrDetnRng 10050;
BA_ "GenSigSendType" SG_ 320 FrntRdrDetn50RdrDetnRng 0;
BA_ "GenSigStartValue" SG_ 320 FrntRdrDetn50RdrDetnRngV 4000;
BA_ "GenSigSendType" SG_ 320 FrntRdrDetn50RdrDetnRngV 0;
BA_ "GenSigStartValue" SG_ 320 FrntRdrDetn50RdrDetnSts 3;
BA_ "GenSigSendType" SG_ 320 FrntRdrDetn50RdrDetnSts 0;
BA_ "GenSigStartValue" SG_ 320 FrntRdrDetn51RdrDetnAzi 900;
BA_ "GenSigSendType" SG_ 320 FrntRdrDetn51RdrDetnAzi 0;
BA_ "GenSigSendType" SG_ 320 FrntRdrDetn51RdrDetnChks 0;
BA_ "GenSigFuncType" SG_ 320 FrntRdrDetn51RdrDetnChks 15;
BA_ "GenSigDataID" SG_ 320 FrntRdrDetn51RdrDetnChks "0x73A";
BA_ "GenSigSendType" SG_ 320 FrntRdrDetn51RdrDetnCntr 0;
BA_ "GenSigFuncType" SG_ 320 FrntRdrDetn51RdrDetnCntr 16;
BA_ "GenSigSendType" SG_ 320 FrntRdrDetn51RdrDetnConf 0;
BA_ "GenSigStartValue" SG_ 320 FrntRdrDetn51RdrDetnElevn 15;
BA_ "GenSigSendType" SG_ 320 FrntRdrDetn51RdrDetnElevn 0;
BA_ "GenSigSendType" SG_ 320 FrntRdrDetn51RdrDetnPwr 0;
BA_ "GenSigStartValue" SG_ 320 FrntRdrDetn51RdrDetnRng 10050;
BA_ "GenSigSendType" SG_ 320 FrntRdrDetn51RdrDetnRng 0;
BA_ "GenSigStartValue" SG_ 320 FrntRdrDetn51RdrDetnRngV 4000;
BA_ "GenSigSendType" SG_ 320 FrntRdrDetn51RdrDetnRngV 0;
BA_ "GenSigStartValue" SG_ 320 FrntRdrDetn51RdrDetnSts 3;
BA_ "GenSigSendType" SG_ 320 FrntRdrDetn51RdrDetnSts 0;
BA_ "GenSigStartValue" SG_ 320 FrntRdrDetn52RdrDetnAzi 900;
BA_ "GenSigSendType" SG_ 320 FrntRdrDetn52RdrDetnAzi 0;
BA_ "GenSigSendType" SG_ 320 FrntRdrDetn52RdrDetnChks 0;
BA_ "GenSigFuncType" SG_ 320 FrntRdrDetn52RdrDetnChks 15;
BA_ "GenSigDataID" SG_ 320 FrntRdrDetn52RdrDetnChks "0x73B";
BA_ "GenSigSendType" SG_ 320 FrntRdrDetn52RdrDetnCntr 0;
BA_ "GenSigFuncType" SG_ 320 FrntRdrDetn52RdrDetnCntr 16;
BA_ "GenSigSendType" SG_ 320 FrntRdrDetn52RdrDetnConf 0;
BA_ "GenSigStartValue" SG_ 320 FrntRdrDetn52RdrDetnElevn 15;
BA_ "GenSigSendType" SG_ 320 FrntRdrDetn52RdrDetnElevn 0;
BA_ "GenSigSendType" SG_ 320 FrntRdrDetn52RdrDetnPwr 0;
BA_ "GenSigStartValue" SG_ 320 FrntRdrDetn52RdrDetnRng 10050;
BA_ "GenSigSendType" SG_ 320 FrntRdrDetn52RdrDetnRng 0;
BA_ "GenSigStartValue" SG_ 320 FrntRdrDetn52RdrDetnRngV 4000;
BA_ "GenSigSendType" SG_ 320 FrntRdrDetn52RdrDetnRngV 0;
BA_ "GenSigStartValue" SG_ 320 FrntRdrDetn52RdrDetnSts 3;
BA_ "GenSigSendType" SG_ 320 FrntRdrDetn52RdrDetnSts 0;
BA_ "GenSigStartValue" SG_ 320 FrntRdrDetn53RdrDetnAzi 900;
BA_ "GenSigSendType" SG_ 320 FrntRdrDetn53RdrDetnAzi 0;
BA_ "GenSigSendType" SG_ 320 FrntRdrDetn53RdrDetnChks 0;
BA_ "GenSigFuncType" SG_ 320 FrntRdrDetn53RdrDetnChks 15;
BA_ "GenSigDataID" SG_ 320 FrntRdrDetn53RdrDetnChks "0x73C";
BA_ "GenSigSendType" SG_ 320 FrntRdrDetn53RdrDetnCntr 0;
BA_ "GenSigFuncType" SG_ 320 FrntRdrDetn53RdrDetnCntr 16;
BA_ "GenSigSendType" SG_ 320 FrntRdrDetn53RdrDetnConf 0;
BA_ "GenSigStartValue" SG_ 320 FrntRdrDetn53RdrDetnElevn 15;
BA_ "GenSigSendType" SG_ 320 FrntRdrDetn53RdrDetnElevn 0;
BA_ "GenSigSendType" SG_ 320 FrntRdrDetn53RdrDetnPwr 0;
BA_ "GenSigStartValue" SG_ 320 FrntRdrDetn53RdrDetnRng 10050;
BA_ "GenSigSendType" SG_ 320 FrntRdrDetn53RdrDetnRng 0;
BA_ "GenSigStartValue" SG_ 320 FrntRdrDetn53RdrDetnRngV 4000;
BA_ "GenSigSendType" SG_ 320 FrntRdrDetn53RdrDetnRngV 0;
BA_ "GenSigStartValue" SG_ 320 FrntRdrDetn53RdrDetnSts 3;
BA_ "GenSigSendType" SG_ 320 FrntRdrDetn53RdrDetnSts 0;
BA_ "GenSigStartValue" SG_ 320 FrntRdrDetn54RdrDetnAzi 900;
BA_ "GenSigSendType" SG_ 320 FrntRdrDetn54RdrDetnAzi 0;
BA_ "GenSigSendType" SG_ 320 FrntRdrDetn54RdrDetnChks 0;
BA_ "GenSigFuncType" SG_ 320 FrntRdrDetn54RdrDetnChks 15;
BA_ "GenSigDataID" SG_ 320 FrntRdrDetn54RdrDetnChks "0x73D";
BA_ "GenSigSendType" SG_ 320 FrntRdrDetn54RdrDetnCntr 0;
BA_ "GenSigFuncType" SG_ 320 FrntRdrDetn54RdrDetnCntr 16;
BA_ "GenSigSendType" SG_ 320 FrntRdrDetn54RdrDetnConf 0;
BA_ "GenSigStartValue" SG_ 320 FrntRdrDetn54RdrDetnElevn 15;
BA_ "GenSigSendType" SG_ 320 FrntRdrDetn54RdrDetnElevn 0;
BA_ "GenSigSendType" SG_ 320 FrntRdrDetn54RdrDetnPwr 0;
BA_ "GenSigStartValue" SG_ 320 FrntRdrDetn54RdrDetnRng 10050;
BA_ "GenSigSendType" SG_ 320 FrntRdrDetn54RdrDetnRng 0;
BA_ "GenSigStartValue" SG_ 320 FrntRdrDetn54RdrDetnRngV 4000;
BA_ "GenSigSendType" SG_ 320 FrntRdrDetn54RdrDetnRngV 0;
BA_ "GenSigStartValue" SG_ 320 FrntRdrDetn54RdrDetnSts 3;
BA_ "GenSigSendType" SG_ 320 FrntRdrDetn54RdrDetnSts 0;
// Frame: FLRSafetyCANFD2Frame10
BA_ "VFrameFormat" BO_ 322 14;
BA_ "GenMsgSendType" BO_ 322 0;
BA_ "GenMsgCycleTime" BO_ 322 50.000;
BA_ "GenSigStartValue" SG_ 322 FrntRdrDetn55RdrDetnAzi 900;
BA_ "GenSigSendType" SG_ 322 FrntRdrDetn55RdrDetnAzi 0;
BA_ "GenSigSendType" SG_ 322 FrntRdrDetn55RdrDetnChks 0;
BA_ "GenSigFuncType" SG_ 322 FrntRdrDetn55RdrDetnChks 15;
BA_ "GenSigDataID" SG_ 322 FrntRdrDetn55RdrDetnChks "0x73E";
BA_ "GenSigSendType" SG_ 322 FrntRdrDetn55RdrDetnCntr 0;
BA_ "GenSigFuncType" SG_ 322 FrntRdrDetn55RdrDetnCntr 16;
BA_ "GenSigSendType" SG_ 322 FrntRdrDetn55RdrDetnConf 0;
BA_ "GenSigStartValue" SG_ 322 FrntRdrDetn55RdrDetnElevn 15;
BA_ "GenSigSendType" SG_ 322 FrntRdrDetn55RdrDetnElevn 0;
BA_ "GenSigSendType" SG_ 322 FrntRdrDetn55RdrDetnPwr 0;
BA_ "GenSigStartValue" SG_ 322 FrntRdrDetn55RdrDetnRng 10050;
BA_ "GenSigSendType" SG_ 322 FrntRdrDetn55RdrDetnRng 0;
BA_ "GenSigStartValue" SG_ 322 FrntRdrDetn55RdrDetnRngV 4000;
BA_ "GenSigSendType" SG_ 322 FrntRdrDetn55RdrDetnRngV 0;
BA_ "GenSigStartValue" SG_ 322 FrntRdrDetn55RdrDetnSts 3;
BA_ "GenSigSendType" SG_ 322 FrntRdrDetn55RdrDetnSts 0;
BA_ "GenSigStartValue" SG_ 322 FrntRdrDetn56RdrDetnAzi 900;
BA_ "GenSigSendType" SG_ 322 FrntRdrDetn56RdrDetnAzi 0;
BA_ "GenSigSendType" SG_ 322 FrntRdrDetn56RdrDetnChks 0;
BA_ "GenSigFuncType" SG_ 322 FrntRdrDetn56RdrDetnChks 15;
BA_ "GenSigDataID" SG_ 322 FrntRdrDetn56RdrDetnChks "0x73F";
BA_ "GenSigSendType" SG_ 322 FrntRdrDetn56RdrDetnCntr 0;
BA_ "GenSigFuncType" SG_ 322 FrntRdrDetn56RdrDetnCntr 16;
BA_ "GenSigSendType" SG_ 322 FrntRdrDetn56RdrDetnConf 0;
BA_ "GenSigStartValue" SG_ 322 FrntRdrDetn56RdrDetnElevn 15;
BA_ "GenSigSendType" SG_ 322 FrntRdrDetn56RdrDetnElevn 0;
BA_ "GenSigSendType" SG_ 322 FrntRdrDetn56RdrDetnPwr 0;
BA_ "GenSigStartValue" SG_ 322 FrntRdrDetn56RdrDetnRng 10050;
BA_ "GenSigSendType" SG_ 322 FrntRdrDetn56RdrDetnRng 0;
BA_ "GenSigStartValue" SG_ 322 FrntRdrDetn56RdrDetnRngV 4000;
BA_ "GenSigSendType" SG_ 322 FrntRdrDetn56RdrDetnRngV 0;
BA_ "GenSigStartValue" SG_ 322 FrntRdrDetn56RdrDetnSts 3;
BA_ "GenSigSendType" SG_ 322 FrntRdrDetn56RdrDetnSts 0;
BA_ "GenSigStartValue" SG_ 322 FrntRdrDetn57RdrDetnAzi 900;
BA_ "GenSigSendType" SG_ 322 FrntRdrDetn57RdrDetnAzi 0;
BA_ "GenSigSendType" SG_ 322 FrntRdrDetn57RdrDetnChks 0;
BA_ "GenSigFuncType" SG_ 322 FrntRdrDetn57RdrDetnChks 15;
BA_ "GenSigDataID" SG_ 322 FrntRdrDetn57RdrDetnChks "0x740";
BA_ "GenSigSendType" SG_ 322 FrntRdrDetn57RdrDetnCntr 0;
BA_ "GenSigFuncType" SG_ 322 FrntRdrDetn57RdrDetnCntr 16;
BA_ "GenSigSendType" SG_ 322 FrntRdrDetn57RdrDetnConf 0;
BA_ "GenSigStartValue" SG_ 322 FrntRdrDetn57RdrDetnElevn 15;
BA_ "GenSigSendType" SG_ 322 FrntRdrDetn57RdrDetnElevn 0;
BA_ "GenSigSendType" SG_ 322 FrntRdrDetn57RdrDetnPwr 0;
BA_ "GenSigStartValue" SG_ 322 FrntRdrDetn57RdrDetnRng 10050;
BA_ "GenSigSendType" SG_ 322 FrntRdrDetn57RdrDetnRng 0;
BA_ "GenSigStartValue" SG_ 322 FrntRdrDetn57RdrDetnRngV 4000;
BA_ "GenSigSendType" SG_ 322 FrntRdrDetn57RdrDetnRngV 0;
BA_ "GenSigStartValue" SG_ 322 FrntRdrDetn57RdrDetnSts 3;
BA_ "GenSigSendType" SG_ 322 FrntRdrDetn57RdrDetnSts 0;
BA_ "GenSigStartValue" SG_ 322 FrntRdrDetn58RdrDetnAzi 900;
BA_ "GenSigSendType" SG_ 322 FrntRdrDetn58RdrDetnAzi 0;
BA_ "GenSigSendType" SG_ 322 FrntRdrDetn58RdrDetnChks 0;
BA_ "GenSigFuncType" SG_ 322 FrntRdrDetn58RdrDetnChks 15;
BA_ "GenSigDataID" SG_ 322 FrntRdrDetn58RdrDetnChks "0x741";
BA_ "GenSigSendType" SG_ 322 FrntRdrDetn58RdrDetnCntr 0;
BA_ "GenSigFuncType" SG_ 322 FrntRdrDetn58RdrDetnCntr 16;
BA_ "GenSigSendType" SG_ 322 FrntRdrDetn58RdrDetnConf 0;
BA_ "GenSigStartValue" SG_ 322 FrntRdrDetn58RdrDetnElevn 15;
BA_ "GenSigSendType" SG_ 322 FrntRdrDetn58RdrDetnElevn 0;
BA_ "GenSigSendType" SG_ 322 FrntRdrDetn58RdrDetnPwr 0;
BA_ "GenSigStartValue" SG_ 322 FrntRdrDetn58RdrDetnRng 10050;
BA_ "GenSigSendType" SG_ 322 FrntRdrDetn58RdrDetnRng 0;
BA_ "GenSigStartValue" SG_ 322 FrntRdrDetn58RdrDetnRngV 4000;
BA_ "GenSigSendType" SG_ 322 FrntRdrDetn58RdrDetnRngV 0;
BA_ "GenSigStartValue" SG_ 322 FrntRdrDetn58RdrDetnSts 3;
BA_ "GenSigSendType" SG_ 322 FrntRdrDetn58RdrDetnSts 0;
BA_ "GenSigStartValue" SG_ 322 FrntRdrDetn59RdrDetnAzi 900;
BA_ "GenSigSendType" SG_ 322 FrntRdrDetn59RdrDetnAzi 0;
BA_ "GenSigSendType" SG_ 322 FrntRdrDetn59RdrDetnChks 0;
BA_ "GenSigFuncType" SG_ 322 FrntRdrDetn59RdrDetnChks 15;
BA_ "GenSigDataID" SG_ 322 FrntRdrDetn59RdrDetnChks "0x742";
BA_ "GenSigSendType" SG_ 322 FrntRdrDetn59RdrDetnCntr 0;
BA_ "GenSigFuncType" SG_ 322 FrntRdrDetn59RdrDetnCntr 16;
BA_ "GenSigSendType" SG_ 322 FrntRdrDetn59RdrDetnConf 0;
BA_ "GenSigStartValue" SG_ 322 FrntRdrDetn59RdrDetnElevn 15;
BA_ "GenSigSendType" SG_ 322 FrntRdrDetn59RdrDetnElevn 0;
BA_ "GenSigSendType" SG_ 322 FrntRdrDetn59RdrDetnPwr 0;
BA_ "GenSigStartValue" SG_ 322 FrntRdrDetn59RdrDetnRng 10050;
BA_ "GenSigSendType" SG_ 322 FrntRdrDetn59RdrDetnRng 0;
BA_ "GenSigStartValue" SG_ 322 FrntRdrDetn59RdrDetnRngV 4000;
BA_ "GenSigSendType" SG_ 322 FrntRdrDetn59RdrDetnRngV 0;
BA_ "GenSigStartValue" SG_ 322 FrntRdrDetn59RdrDetnSts 3;
BA_ "GenSigSendType" SG_ 322 FrntRdrDetn59RdrDetnSts 0;
BA_ "GenSigStartValue" SG_ 322 FrntRdrDetn60RdrDetnAzi 900;
BA_ "GenSigSendType" SG_ 322 FrntRdrDetn60RdrDetnAzi 0;
BA_ "GenSigSendType" SG_ 322 FrntRdrDetn60RdrDetnChks 0;
BA_ "GenSigFuncType" SG_ 322 FrntRdrDetn60RdrDetnChks 15;
BA_ "GenSigDataID" SG_ 322 FrntRdrDetn60RdrDetnChks "0x743";
BA_ "GenSigSendType" SG_ 322 FrntRdrDetn60RdrDetnCntr 0;
BA_ "GenSigFuncType" SG_ 322 FrntRdrDetn60RdrDetnCntr 16;
BA_ "GenSigSendType" SG_ 322 FrntRdrDetn60RdrDetnConf 0;
BA_ "GenSigStartValue" SG_ 322 FrntRdrDetn60RdrDetnElevn 15;
BA_ "GenSigSendType" SG_ 322 FrntRdrDetn60RdrDetnElevn 0;
BA_ "GenSigSendType" SG_ 322 FrntRdrDetn60RdrDetnPwr 0;
BA_ "GenSigStartValue" SG_ 322 FrntRdrDetn60RdrDetnRng 10050;
BA_ "GenSigSendType" SG_ 322 FrntRdrDetn60RdrDetnRng 0;
BA_ "GenSigStartValue" SG_ 322 FrntRdrDetn60RdrDetnRngV 4000;
BA_ "GenSigSendType" SG_ 322 FrntRdrDetn60RdrDetnRngV 0;
BA_ "GenSigStartValue" SG_ 322 FrntRdrDetn60RdrDetnSts 3;
BA_ "GenSigSendType" SG_ 322 FrntRdrDetn60RdrDetnSts 0;
// Frame: FLRSafetyCANFD2Frame11
BA_ "VFrameFormat" BO_ 324 14;
BA_ "GenMsgSendType" BO_ 324 0;
BA_ "GenMsgCycleTime" BO_ 324 50.000;
BA_ "GenSigStartValue" SG_ 324 FrntRdrDetn61RdrDetnAzi 900;
BA_ "GenSigSendType" SG_ 324 FrntRdrDetn61RdrDetnAzi 0;
BA_ "GenSigSendType" SG_ 324 FrntRdrDetn61RdrDetnChks 0;
BA_ "GenSigFuncType" SG_ 324 FrntRdrDetn61RdrDetnChks 15;
BA_ "GenSigDataID" SG_ 324 FrntRdrDetn61RdrDetnChks "0x744";
BA_ "GenSigSendType" SG_ 324 FrntRdrDetn61RdrDetnCntr 0;
BA_ "GenSigFuncType" SG_ 324 FrntRdrDetn61RdrDetnCntr 16;
BA_ "GenSigSendType" SG_ 324 FrntRdrDetn61RdrDetnConf 0;
BA_ "GenSigStartValue" SG_ 324 FrntRdrDetn61RdrDetnElevn 15;
BA_ "GenSigSendType" SG_ 324 FrntRdrDetn61RdrDetnElevn 0;
BA_ "GenSigSendType" SG_ 324 FrntRdrDetn61RdrDetnPwr 0;
BA_ "GenSigStartValue" SG_ 324 FrntRdrDetn61RdrDetnRng 10050;
BA_ "GenSigSendType" SG_ 324 FrntRdrDetn61RdrDetnRng 0;
BA_ "GenSigStartValue" SG_ 324 FrntRdrDetn61RdrDetnRngV 4000;
BA_ "GenSigSendType" SG_ 324 FrntRdrDetn61RdrDetnRngV 0;
BA_ "GenSigStartValue" SG_ 324 FrntRdrDetn61RdrDetnSts 3;
BA_ "GenSigSendType" SG_ 324 FrntRdrDetn61RdrDetnSts 0;
BA_ "GenSigStartValue" SG_ 324 FrntRdrDetn62RdrDetnAzi 900;
BA_ "GenSigSendType" SG_ 324 FrntRdrDetn62RdrDetnAzi 0;
BA_ "GenSigSendType" SG_ 324 FrntRdrDetn62RdrDetnChks 0;
BA_ "GenSigFuncType" SG_ 324 FrntRdrDetn62RdrDetnChks 15;
BA_ "GenSigDataID" SG_ 324 FrntRdrDetn62RdrDetnChks "0x745";
BA_ "GenSigSendType" SG_ 324 FrntRdrDetn62RdrDetnCntr 0;
BA_ "GenSigFuncType" SG_ 324 FrntRdrDetn62RdrDetnCntr 16;
BA_ "GenSigSendType" SG_ 324 FrntRdrDetn62RdrDetnConf 0;
BA_ "GenSigStartValue" SG_ 324 FrntRdrDetn62RdrDetnElevn 15;
BA_ "GenSigSendType" SG_ 324 FrntRdrDetn62RdrDetnElevn 0;
BA_ "GenSigSendType" SG_ 324 FrntRdrDetn62RdrDetnPwr 0;
BA_ "GenSigStartValue" SG_ 324 FrntRdrDetn62RdrDetnRng 10050;
BA_ "GenSigSendType" SG_ 324 FrntRdrDetn62RdrDetnRng 0;
BA_ "GenSigStartValue" SG_ 324 FrntRdrDetn62RdrDetnRngV 4000;
BA_ "GenSigSendType" SG_ 324 FrntRdrDetn62RdrDetnRngV 0;
BA_ "GenSigStartValue" SG_ 324 FrntRdrDetn62RdrDetnSts 3;
BA_ "GenSigSendType" SG_ 324 FrntRdrDetn62RdrDetnSts 0;
BA_ "GenSigStartValue" SG_ 324 FrntRdrDetn63RdrDetnAzi 900;
BA_ "GenSigSendType" SG_ 324 FrntRdrDetn63RdrDetnAzi 0;
BA_ "GenSigSendType" SG_ 324 FrntRdrDetn63RdrDetnChks 0;
BA_ "GenSigFuncType" SG_ 324 FrntRdrDetn63RdrDetnChks 15;
BA_ "GenSigDataID" SG_ 324 FrntRdrDetn63RdrDetnChks "0x746";
BA_ "GenSigSendType" SG_ 324 FrntRdrDetn63RdrDetnCntr 0;
BA_ "GenSigFuncType" SG_ 324 FrntRdrDetn63RdrDetnCntr 16;
BA_ "GenSigSendType" SG_ 324 FrntRdrDetn63RdrDetnConf 0;
BA_ "GenSigStartValue" SG_ 324 FrntRdrDetn63RdrDetnElevn 15;
BA_ "GenSigSendType" SG_ 324 FrntRdrDetn63RdrDetnElevn 0;
BA_ "GenSigSendType" SG_ 324 FrntRdrDetn63RdrDetnPwr 0;
BA_ "GenSigStartValue" SG_ 324 FrntRdrDetn63RdrDetnRng 10050;
BA_ "GenSigSendType" SG_ 324 FrntRdrDetn63RdrDetnRng 0;
BA_ "GenSigStartValue" SG_ 324 FrntRdrDetn63RdrDetnRngV 4000;
BA_ "GenSigSendType" SG_ 324 FrntRdrDetn63RdrDetnRngV 0;
BA_ "GenSigStartValue" SG_ 324 FrntRdrDetn63RdrDetnSts 3;
BA_ "GenSigSendType" SG_ 324 FrntRdrDetn63RdrDetnSts 0;
BA_ "GenSigStartValue" SG_ 324 FrntRdrDetn64RdrDetnAzi 900;
BA_ "GenSigSendType" SG_ 324 FrntRdrDetn64RdrDetnAzi 0;
BA_ "GenSigSendType" SG_ 324 FrntRdrDetn64RdrDetnChks 0;
BA_ "GenSigFuncType" SG_ 324 FrntRdrDetn64RdrDetnChks 15;
BA_ "GenSigDataID" SG_ 324 FrntRdrDetn64RdrDetnChks "0x747";
BA_ "GenSigSendType" SG_ 324 FrntRdrDetn64RdrDetnCntr 0;
BA_ "GenSigFuncType" SG_ 324 FrntRdrDetn64RdrDetnCntr 16;
BA_ "GenSigSendType" SG_ 324 FrntRdrDetn64RdrDetnConf 0;
BA_ "GenSigStartValue" SG_ 324 FrntRdrDetn64RdrDetnElevn 15;
BA_ "GenSigSendType" SG_ 324 FrntRdrDetn64RdrDetnElevn 0;
BA_ "GenSigSendType" SG_ 324 FrntRdrDetn64RdrDetnPwr 0;
BA_ "GenSigStartValue" SG_ 324 FrntRdrDetn64RdrDetnRng 10050;
BA_ "GenSigSendType" SG_ 324 FrntRdrDetn64RdrDetnRng 0;
BA_ "GenSigStartValue" SG_ 324 FrntRdrDetn64RdrDetnRngV 4000;
BA_ "GenSigSendType" SG_ 324 FrntRdrDetn64RdrDetnRngV 0;
BA_ "GenSigStartValue" SG_ 324 FrntRdrDetn64RdrDetnSts 3;
BA_ "GenSigSendType" SG_ 324 FrntRdrDetn64RdrDetnSts 0;
BA_ "GenSigStartValue" SG_ 324 FrntRdrDetn65RdrDetnAzi 900;
BA_ "GenSigSendType" SG_ 324 FrntRdrDetn65RdrDetnAzi 0;
BA_ "GenSigSendType" SG_ 324 FrntRdrDetn65RdrDetnChks 0;
BA_ "GenSigFuncType" SG_ 324 FrntRdrDetn65RdrDetnChks 15;
BA_ "GenSigDataID" SG_ 324 FrntRdrDetn65RdrDetnChks "0x748";
BA_ "GenSigSendType" SG_ 324 FrntRdrDetn65RdrDetnCntr 0;
BA_ "GenSigFuncType" SG_ 324 FrntRdrDetn65RdrDetnCntr 16;
BA_ "GenSigSendType" SG_ 324 FrntRdrDetn65RdrDetnConf 0;
BA_ "GenSigStartValue" SG_ 324 FrntRdrDetn65RdrDetnElevn 15;
BA_ "GenSigSendType" SG_ 324 FrntRdrDetn65RdrDetnElevn 0;
BA_ "GenSigSendType" SG_ 324 FrntRdrDetn65RdrDetnPwr 0;
BA_ "GenSigStartValue" SG_ 324 FrntRdrDetn65RdrDetnRng 10050;
BA_ "GenSigSendType" SG_ 324 FrntRdrDetn65RdrDetnRng 0;
BA_ "GenSigStartValue" SG_ 324 FrntRdrDetn65RdrDetnRngV 4000;
BA_ "GenSigSendType" SG_ 324 FrntRdrDetn65RdrDetnRngV 0;
BA_ "GenSigStartValue" SG_ 324 FrntRdrDetn65RdrDetnSts 3;
BA_ "GenSigSendType" SG_ 324 FrntRdrDetn65RdrDetnSts 0;
BA_ "GenSigStartValue" SG_ 324 FrntRdrDetn66RdrDetnAzi 900;
BA_ "GenSigSendType" SG_ 324 FrntRdrDetn66RdrDetnAzi 0;
BA_ "GenSigSendType" SG_ 324 FrntRdrDetn66RdrDetnChks 0;
BA_ "GenSigFuncType" SG_ 324 FrntRdrDetn66RdrDetnChks 15;
BA_ "GenSigDataID" SG_ 324 FrntRdrDetn66RdrDetnChks "0x749";
BA_ "GenSigSendType" SG_ 324 FrntRdrDetn66RdrDetnCntr 0;
BA_ "GenSigFuncType" SG_ 324 FrntRdrDetn66RdrDetnCntr 16;
BA_ "GenSigSendType" SG_ 324 FrntRdrDetn66RdrDetnConf 0;
BA_ "GenSigStartValue" SG_ 324 FrntRdrDetn66RdrDetnElevn 15;
BA_ "GenSigSendType" SG_ 324 FrntRdrDetn66RdrDetnElevn 0;
BA_ "GenSigSendType" SG_ 324 FrntRdrDetn66RdrDetnPwr 0;
BA_ "GenSigStartValue" SG_ 324 FrntRdrDetn66RdrDetnRng 10050;
BA_ "GenSigSendType" SG_ 324 FrntRdrDetn66RdrDetnRng 0;
BA_ "GenSigStartValue" SG_ 324 FrntRdrDetn66RdrDetnRngV 4000;
BA_ "GenSigSendType" SG_ 324 FrntRdrDetn66RdrDetnRngV 0;
BA_ "GenSigStartValue" SG_ 324 FrntRdrDetn66RdrDetnSts 3;
BA_ "GenSigSendType" SG_ 324 FrntRdrDetn66RdrDetnSts 0;
VAL_ 310 FrntRdrDetn19RdrDetnSts 0 "RdrDetnSts_Ukwn" 1 "RdrDetnSts_Movg" 2 "RdrDetnSts_Staty" 3 "RdrDetnSts_Invalid";
VAL_ 310 FrntRdrDetn20RdrDetnSts 0 "RdrDetnSts_Ukwn" 1 "RdrDetnSts_Movg" 2 "RdrDetnSts_Staty" 3 "RdrDetnSts_Invalid";
VAL_ 310 FrntRdrDetn21RdrDetnSts 0 "RdrDetnSts_Ukwn" 1 "RdrDetnSts_Movg" 2 "RdrDetnSts_Staty" 3 "RdrDetnSts_Invalid";
VAL_ 310 FrntRdrDetn22RdrDetnSts 0 "RdrDetnSts_Ukwn" 1 "RdrDetnSts_Movg" 2 "RdrDetnSts_Staty" 3 "RdrDetnSts_Invalid";
VAL_ 310 FrntRdrDetn23RdrDetnSts 0 "RdrDetnSts_Ukwn" 1 "RdrDetnSts_Movg" 2 "RdrDetnSts_Staty" 3 "RdrDetnSts_Invalid";
VAL_ 310 FrntRdrDetn24RdrDetnSts 0 "RdrDetnSts_Ukwn" 1 "RdrDetnSts_Movg" 2 "RdrDetnSts_Staty" 3 "RdrDetnSts_Invalid";
VAL_ 312 FrntRdrDetn25RdrDetnSts 0 "RdrDetnSts_Ukwn" 1 "RdrDetnSts_Movg" 2 "RdrDetnSts_Staty" 3 "RdrDetnSts_Invalid";
VAL_ 312 FrntRdrDetn26RdrDetnSts 0 "RdrDetnSts_Ukwn" 1 "RdrDetnSts_Movg" 2 "RdrDetnSts_Staty" 3 "RdrDetnSts_Invalid";
VAL_ 312 FrntRdrDetn27RdrDetnSts 0 "RdrDetnSts_Ukwn" 1 "RdrDetnSts_Movg" 2 "RdrDetnSts_Staty" 3 "RdrDetnSts_Invalid";
VAL_ 312 FrntRdrDetn28RdrDetnSts 0 "RdrDetnSts_Ukwn" 1 "RdrDetnSts_Movg" 2 "RdrDetnSts_Staty" 3 "RdrDetnSts_Invalid";
VAL_ 312 FrntRdrDetn29RdrDetnSts 0 "RdrDetnSts_Ukwn" 1 "RdrDetnSts_Movg" 2 "RdrDetnSts_Staty" 3 "RdrDetnSts_Invalid";
VAL_ 312 FrntRdrDetn30RdrDetnSts 0 "RdrDetnSts_Ukwn" 1 "RdrDetnSts_Movg" 2 "RdrDetnSts_Staty" 3 "RdrDetnSts_Invalid";
VAL_ 314 FrntRdrDetn31RdrDetnSts 0 "RdrDetnSts_Ukwn" 1 "RdrDetnSts_Movg" 2 "RdrDetnSts_Staty" 3 "RdrDetnSts_Invalid";
VAL_ 314 FrntRdrDetn32RdrDetnSts 0 "RdrDetnSts_Ukwn" 1 "RdrDetnSts_Movg" 2 "RdrDetnSts_Staty" 3 "RdrDetnSts_Invalid";
VAL_ 314 FrntRdrDetn33RdrDetnSts 0 "RdrDetnSts_Ukwn" 1 "RdrDetnSts_Movg" 2 "RdrDetnSts_Staty" 3 "RdrDetnSts_Invalid";
VAL_ 314 FrntRdrDetn34RdrDetnSts 0 "RdrDetnSts_Ukwn" 1 "RdrDetnSts_Movg" 2 "RdrDetnSts_Staty" 3 "RdrDetnSts_Invalid";
VAL_ 314 FrntRdrDetn35RdrDetnSts 0 "RdrDetnSts_Ukwn" 1 "RdrDetnSts_Movg" 2 "RdrDetnSts_Staty" 3 "RdrDetnSts_Invalid";
VAL_ 314 FrntRdrDetn36RdrDetnSts 0 "RdrDetnSts_Ukwn" 1 "RdrDetnSts_Movg" 2 "RdrDetnSts_Staty" 3 "RdrDetnSts_Invalid";
VAL_ 316 FrntRdrDetn37RdrDetnSts 0 "RdrDetnSts_Ukwn" 1 "RdrDetnSts_Movg" 2 "RdrDetnSts_Staty" 3 "RdrDetnSts_Invalid";
VAL_ 316 FrntRdrDetn38RdrDetnSts 0 "RdrDetnSts_Ukwn" 1 "RdrDetnSts_Movg" 2 "RdrDetnSts_Staty" 3 "RdrDetnSts_Invalid";
VAL_ 316 FrntRdrDetn39RdrDetnSts 0 "RdrDetnSts_Ukwn" 1 "RdrDetnSts_Movg" 2 "RdrDetnSts_Staty" 3 "RdrDetnSts_Invalid";
VAL_ 316 FrntRdrDetn40RdrDetnSts 0 "RdrDetnSts_Ukwn" 1 "RdrDetnSts_Movg" 2 "RdrDetnSts_Staty" 3 "RdrDetnSts_Invalid";
VAL_ 316 FrntRdrDetn41RdrDetnSts 0 "RdrDetnSts_Ukwn" 1 "RdrDetnSts_Movg" 2 "RdrDetnSts_Staty" 3 "RdrDetnSts_Invalid";
VAL_ 316 FrntRdrDetn42RdrDetnSts 0 "RdrDetnSts_Ukwn" 1 "RdrDetnSts_Movg" 2 "RdrDetnSts_Staty" 3 "RdrDetnSts_Invalid";
VAL_ 318 FrntRdrDetn43RdrDetnSts 0 "RdrDetnSts_Ukwn" 1 "RdrDetnSts_Movg" 2 "RdrDetnSts_Staty" 3 "RdrDetnSts_Invalid";
VAL_ 318 FrntRdrDetn44RdrDetnSts 0 "RdrDetnSts_Ukwn" 1 "RdrDetnSts_Movg" 2 "RdrDetnSts_Staty" 3 "RdrDetnSts_Invalid";
VAL_ 318 FrntRdrDetn45RdrDetnSts 0 "RdrDetnSts_Ukwn" 1 "RdrDetnSts_Movg" 2 "RdrDetnSts_Staty" 3 "RdrDetnSts_Invalid";
VAL_ 318 FrntRdrDetn46RdrDetnSts 0 "RdrDetnSts_Ukwn" 1 "RdrDetnSts_Movg" 2 "RdrDetnSts_Staty" 3 "RdrDetnSts_Invalid";
VAL_ 318 FrntRdrDetn47RdrDetnSts 0 "RdrDetnSts_Ukwn" 1 "RdrDetnSts_Movg" 2 "RdrDetnSts_Staty" 3 "RdrDetnSts_Invalid";
VAL_ 318 FrntRdrDetn48RdrDetnSts 0 "RdrDetnSts_Ukwn" 1 "RdrDetnSts_Movg" 2 "RdrDetnSts_Staty" 3 "RdrDetnSts_Invalid";
VAL_ 320 FrntRdrDetn49RdrDetnSts 0 "RdrDetnSts_Ukwn" 1 "RdrDetnSts_Movg" 2 "RdrDetnSts_Staty" 3 "RdrDetnSts_Invalid";
VAL_ 320 FrntRdrDetn50RdrDetnSts 0 "RdrDetnSts_Ukwn" 1 "RdrDetnSts_Movg" 2 "RdrDetnSts_Staty" 3 "RdrDetnSts_Invalid";
VAL_ 320 FrntRdrDetn51RdrDetnSts 0 "RdrDetnSts_Ukwn" 1 "RdrDetnSts_Movg" 2 "RdrDetnSts_Staty" 3 "RdrDetnSts_Invalid";
VAL_ 320 FrntRdrDetn52RdrDetnSts 0 "RdrDetnSts_Ukwn" 1 "RdrDetnSts_Movg" 2 "RdrDetnSts_Staty" 3 "RdrDetnSts_Invalid";
VAL_ 320 FrntRdrDetn53RdrDetnSts 0 "RdrDetnSts_Ukwn" 1 "RdrDetnSts_Movg" 2 "RdrDetnSts_Staty" 3 "RdrDetnSts_Invalid";
VAL_ 320 FrntRdrDetn54RdrDetnSts 0 "RdrDetnSts_Ukwn" 1 "RdrDetnSts_Movg" 2 "RdrDetnSts_Staty" 3 "RdrDetnSts_Invalid";
VAL_ 322 FrntRdrDetn55RdrDetnSts 0 "RdrDetnSts_Ukwn" 1 "RdrDetnSts_Movg" 2 "RdrDetnSts_Staty" 3 "RdrDetnSts_Invalid";
VAL_ 322 FrntRdrDetn56RdrDetnSts 0 "RdrDetnSts_Ukwn" 1 "RdrDetnSts_Movg" 2 "RdrDetnSts_Staty" 3 "RdrDetnSts_Invalid";
VAL_ 322 FrntRdrDetn57RdrDetnSts 0 "RdrDetnSts_Ukwn" 1 "RdrDetnSts_Movg" 2 "RdrDetnSts_Staty" 3 "RdrDetnSts_Invalid";
VAL_ 322 FrntRdrDetn58RdrDetnSts 0 "RdrDetnSts_Ukwn" 1 "RdrDetnSts_Movg" 2 "RdrDetnSts_Staty" 3 "RdrDetnSts_Invalid";
VAL_ 322 FrntRdrDetn59RdrDetnSts 0 "RdrDetnSts_Ukwn" 1 "RdrDetnSts_Movg" 2 "RdrDetnSts_Staty" 3 "RdrDetnSts_Invalid";
VAL_ 322 FrntRdrDetn60RdrDetnSts 0 "RdrDetnSts_Ukwn" 1 "RdrDetnSts_Movg" 2 "RdrDetnSts_Staty" 3 "RdrDetnSts_Invalid";
VAL_ 324 FrntRdrDetn61RdrDetnSts 0 "RdrDetnSts_Ukwn" 1 "RdrDetnSts_Movg" 2 "RdrDetnSts_Staty" 3 "RdrDetnSts_Invalid";
VAL_ 324 FrntRdrDetn62RdrDetnSts 0 "RdrDetnSts_Ukwn" 1 "RdrDetnSts_Movg" 2 "RdrDetnSts_Staty" 3 "RdrDetnSts_Invalid";
VAL_ 324 FrntRdrDetn63RdrDetnSts 0 "RdrDetnSts_Ukwn" 1 "RdrDetnSts_Movg" 2 "RdrDetnSts_Staty" 3 "RdrDetnSts_Invalid";
VAL_ 324 FrntRdrDetn64RdrDetnSts 0 "RdrDetnSts_Ukwn" 1 "RdrDetnSts_Movg" 2 "RdrDetnSts_Staty" 3 "RdrDetnSts_Invalid";
VAL_ 324 FrntRdrDetn65RdrDetnSts 0 "RdrDetnSts_Ukwn" 1 "RdrDetnSts_Movg" 2 "RdrDetnSts_Staty" 3 "RdrDetnSts_Invalid";
VAL_ 324 FrntRdrDetn66RdrDetnSts 0 "RdrDetnSts_Ukwn" 1 "RdrDetnSts_Movg" 2 "RdrDetnSts_Staty" 3 "RdrDetnSts_Invalid";
SIG_GROUP_ 310 FrntRdrDetn19 1 : FrntRdrDetn19RdrDetnAzi FrntRdrDetn19RdrDetnChks FrntRdrDetn19RdrDetnCntr FrntRdrDetn19RdrDetnConf FrntRdrDetn19RdrDetnElevn FrntRdrDetn19RdrDetnPwr FrntRdrDetn19RdrDetnRng FrntRdrDetn19RdrDetnRngV FrntRdrDetn19RdrDetnSts;
SIG_GROUP_ 310 FrntRdrDetn20 1 : FrntRdrDetn20RdrDetnAzi FrntRdrDetn20RdrDetnChks FrntRdrDetn20RdrDetnCntr FrntRdrDetn20RdrDetnConf FrntRdrDetn20RdrDetnElevn FrntRdrDetn20RdrDetnPwr FrntRdrDetn20RdrDetnRng FrntRdrDetn20RdrDetnRngV FrntRdrDetn20RdrDetnSts;
SIG_GROUP_ 310 FrntRdrDetn21 1 : FrntRdrDetn21RdrDetnAzi FrntRdrDetn21RdrDetnChks FrntRdrDetn21RdrDetnCntr FrntRdrDetn21RdrDetnConf FrntRdrDetn21RdrDetnElevn FrntRdrDetn21RdrDetnPwr FrntRdrDetn21RdrDetnRng FrntRdrDetn21RdrDetnRngV FrntRdrDetn21RdrDetnSts;
SIG_GROUP_ 310 FrntRdrDetn22 1 : FrntRdrDetn22RdrDetnAzi FrntRdrDetn22RdrDetnChks FrntRdrDetn22RdrDetnCntr FrntRdrDetn22RdrDetnConf FrntRdrDetn22RdrDetnElevn FrntRdrDetn22RdrDetnPwr FrntRdrDetn22RdrDetnRng FrntRdrDetn22RdrDetnRngV FrntRdrDetn22RdrDetnSts;
SIG_GROUP_ 310 FrntRdrDetn23 1 : FrntRdrDetn23RdrDetnAzi FrntRdrDetn23RdrDetnChks FrntRdrDetn23RdrDetnCntr FrntRdrDetn23RdrDetnConf FrntRdrDetn23RdrDetnElevn FrntRdrDetn23RdrDetnPwr FrntRdrDetn23RdrDetnRng FrntRdrDetn23RdrDetnRngV FrntRdrDetn23RdrDetnSts;
SIG_GROUP_ 310 FrntRdrDetn24 1 : FrntRdrDetn24RdrDetnAzi FrntRdrDetn24RdrDetnChks FrntRdrDetn24RdrDetnCntr FrntRdrDetn24RdrDetnConf FrntRdrDetn24RdrDetnElevn FrntRdrDetn24RdrDetnPwr FrntRdrDetn24RdrDetnRng FrntRdrDetn24RdrDetnRngV FrntRdrDetn24RdrDetnSts;
SIG_GROUP_ 312 FrntRdrDetn25 1 : FrntRdrDetn25RdrDetnAzi FrntRdrDetn25RdrDetnChks FrntRdrDetn25RdrDetnCntr FrntRdrDetn25RdrDetnConf FrntRdrDetn25RdrDetnElevn FrntRdrDetn25RdrDetnPwr FrntRdrDetn25RdrDetnRng FrntRdrDetn25RdrDetnRngV FrntRdrDetn25RdrDetnSts;
SIG_GROUP_ 312 FrntRdrDetn26 1 : FrntRdrDetn26RdrDetnAzi FrntRdrDetn26RdrDetnChks FrntRdrDetn26RdrDetnCntr FrntRdrDetn26RdrDetnConf FrntRdrDetn26RdrDetnElevn FrntRdrDetn26RdrDetnPwr FrntRdrDetn26RdrDetnRng FrntRdrDetn26RdrDetnRngV FrntRdrDetn26RdrDetnSts;
SIG_GROUP_ 312 FrntRdrDetn27 1 : FrntRdrDetn27RdrDetnAzi FrntRdrDetn27RdrDetnChks FrntRdrDetn27RdrDetnCntr FrntRdrDetn27RdrDetnConf FrntRdrDetn27RdrDetnElevn FrntRdrDetn27RdrDetnPwr FrntRdrDetn27RdrDetnRng FrntRdrDetn27RdrDetnRngV FrntRdrDetn27RdrDetnSts;
SIG_GROUP_ 312 FrntRdrDetn28 1 : FrntRdrDetn28RdrDetnAzi FrntRdrDetn28RdrDetnChks FrntRdrDetn28RdrDetnCntr FrntRdrDetn28RdrDetnConf FrntRdrDetn28RdrDetnElevn FrntRdrDetn28RdrDetnPwr FrntRdrDetn28RdrDetnRng FrntRdrDetn28RdrDetnRngV FrntRdrDetn28RdrDetnSts;
SIG_GROUP_ 312 FrntRdrDetn29 1 : FrntRdrDetn29RdrDetnAzi FrntRdrDetn29RdrDetnChks FrntRdrDetn29RdrDetnCntr FrntRdrDetn29RdrDetnConf FrntRdrDetn29RdrDetnElevn FrntRdrDetn29RdrDetnPwr FrntRdrDetn29RdrDetnRng FrntRdrDetn29RdrDetnRngV FrntRdrDetn29RdrDetnSts;
SIG_GROUP_ 312 FrntRdrDetn30 1 : FrntRdrDetn30RdrDetnAzi FrntRdrDetn30RdrDetnChks FrntRdrDetn30RdrDetnCntr FrntRdrDetn30RdrDetnConf FrntRdrDetn30RdrDetnElevn FrntRdrDetn30RdrDetnPwr FrntRdrDetn30RdrDetnRng FrntRdrDetn30RdrDetnRngV FrntRdrDetn30RdrDetnSts;
SIG_GROUP_ 314 FrntRdrDetn31 1 : FrntRdrDetn31RdrDetnAzi FrntRdrDetn31RdrDetnChks FrntRdrDetn31RdrDetnCntr FrntRdrDetn31RdrDetnConf FrntRdrDetn31RdrDetnElevn FrntRdrDetn31RdrDetnPwr FrntRdrDetn31RdrDetnRng FrntRdrDetn31RdrDetnRngV FrntRdrDetn31RdrDetnSts;
SIG_GROUP_ 314 FrntRdrDetn32 1 : FrntRdrDetn32RdrDetnAzi FrntRdrDetn32RdrDetnChks FrntRdrDetn32RdrDetnCntr FrntRdrDetn32RdrDetnConf FrntRdrDetn32RdrDetnElevn FrntRdrDetn32RdrDetnPwr FrntRdrDetn32RdrDetnRng FrntRdrDetn32RdrDetnRngV FrntRdrDetn32RdrDetnSts;
SIG_GROUP_ 314 FrntRdrDetn33 1 : FrntRdrDetn33RdrDetnAzi FrntRdrDetn33RdrDetnChks FrntRdrDetn33RdrDetnCntr FrntRdrDetn33RdrDetnConf FrntRdrDetn33RdrDetnElevn FrntRdrDetn33RdrDetnPwr FrntRdrDetn33RdrDetnRng FrntRdrDetn33RdrDetnRngV FrntRdrDetn33RdrDetnSts;
SIG_GROUP_ 314 FrntRdrDetn34 1 : FrntRdrDetn34RdrDetnAzi FrntRdrDetn34RdrDetnChks FrntRdrDetn34RdrDetnCntr FrntRdrDetn34RdrDetnConf FrntRdrDetn34RdrDetnElevn FrntRdrDetn34RdrDetnPwr FrntRdrDetn34RdrDetnRng FrntRdrDetn34RdrDetnRngV FrntRdrDetn34RdrDetnSts;
SIG_GROUP_ 314 FrntRdrDetn35 1 : FrntRdrDetn35RdrDetnAzi FrntRdrDetn35RdrDetnChks FrntRdrDetn35RdrDetnCntr FrntRdrDetn35RdrDetnConf FrntRdrDetn35RdrDetnElevn FrntRdrDetn35RdrDetnPwr FrntRdrDetn35RdrDetnRng FrntRdrDetn35RdrDetnRngV FrntRdrDetn35RdrDetnSts;
SIG_GROUP_ 314 FrntRdrDetn36 1 : FrntRdrDetn36RdrDetnAzi FrntRdrDetn36RdrDetnChks FrntRdrDetn36RdrDetnCntr FrntRdrDetn36RdrDetnConf FrntRdrDetn36RdrDetnElevn FrntRdrDetn36RdrDetnPwr FrntRdrDetn36RdrDetnRng FrntRdrDetn36RdrDetnRngV FrntRdrDetn36RdrDetnSts;
SIG_GROUP_ 316 FrntRdrDetn37 1 : FrntRdrDetn37RdrDetnAzi FrntRdrDetn37RdrDetnChks FrntRdrDetn37RdrDetnCntr FrntRdrDetn37RdrDetnConf FrntRdrDetn37RdrDetnElevn FrntRdrDetn37RdrDetnPwr FrntRdrDetn37RdrDetnRng FrntRdrDetn37RdrDetnRngV FrntRdrDetn37RdrDetnSts;
SIG_GROUP_ 316 FrntRdrDetn38 1 : FrntRdrDetn38RdrDetnAzi FrntRdrDetn38RdrDetnChks FrntRdrDetn38RdrDetnCntr FrntRdrDetn38RdrDetnConf FrntRdrDetn38RdrDetnElevn FrntRdrDetn38RdrDetnPwr FrntRdrDetn38RdrDetnRng FrntRdrDetn38RdrDetnRngV FrntRdrDetn38RdrDetnSts;
SIG_GROUP_ 316 FrntRdrDetn39 1 : FrntRdrDetn39RdrDetnAzi FrntRdrDetn39RdrDetnChks FrntRdrDetn39RdrDetnCntr FrntRdrDetn39RdrDetnConf FrntRdrDetn39RdrDetnElevn FrntRdrDetn39RdrDetnPwr FrntRdrDetn39RdrDetnRng FrntRdrDetn39RdrDetnRngV FrntRdrDetn39RdrDetnSts;
SIG_GROUP_ 316 FrntRdrDetn40 1 : FrntRdrDetn40RdrDetnAzi FrntRdrDetn40RdrDetnChks FrntRdrDetn40RdrDetnCntr FrntRdrDetn40RdrDetnConf FrntRdrDetn40RdrDetnElevn FrntRdrDetn40RdrDetnPwr FrntRdrDetn40RdrDetnRng FrntRdrDetn40RdrDetnRngV FrntRdrDetn40RdrDetnSts;
SIG_GROUP_ 316 FrntRdrDetn41 1 : FrntRdrDetn41RdrDetnAzi FrntRdrDetn41RdrDetnChks FrntRdrDetn41RdrDetnCntr FrntRdrDetn41RdrDetnConf FrntRdrDetn41RdrDetnElevn FrntRdrDetn41RdrDetnPwr FrntRdrDetn41RdrDetnRng FrntRdrDetn41RdrDetnRngV FrntRdrDetn41RdrDetnSts;
SIG_GROUP_ 316 FrntRdrDetn42 1 : FrntRdrDetn42RdrDetnAzi FrntRdrDetn42RdrDetnChks FrntRdrDetn42RdrDetnCntr FrntRdrDetn42RdrDetnConf FrntRdrDetn42RdrDetnElevn FrntRdrDetn42RdrDetnPwr FrntRdrDetn42RdrDetnRng FrntRdrDetn42RdrDetnRngV FrntRdrDetn42RdrDetnSts;
SIG_GROUP_ 318 FrntRdrDetn43 1 : FrntRdrDetn43RdrDetnAzi FrntRdrDetn43RdrDetnChks FrntRdrDetn43RdrDetnCntr FrntRdrDetn43RdrDetnConf FrntRdrDetn43RdrDetnElevn FrntRdrDetn43RdrDetnPwr FrntRdrDetn43RdrDetnRng FrntRdrDetn43RdrDetnRngV FrntRdrDetn43RdrDetnSts;
SIG_GROUP_ 318 FrntRdrDetn44 1 : FrntRdrDetn44RdrDetnAzi FrntRdrDetn44RdrDetnChks FrntRdrDetn44RdrDetnCntr FrntRdrDetn44RdrDetnConf FrntRdrDetn44RdrDetnElevn FrntRdrDetn44RdrDetnPwr FrntRdrDetn44RdrDetnRng FrntRdrDetn44RdrDetnRngV FrntRdrDetn44RdrDetnSts;
SIG_GROUP_ 318 FrntRdrDetn45 1 : FrntRdrDetn45RdrDetnAzi FrntRdrDetn45RdrDetnChks FrntRdrDetn45RdrDetnCntr FrntRdrDetn45RdrDetnConf FrntRdrDetn45RdrDetnElevn FrntRdrDetn45RdrDetnPwr FrntRdrDetn45RdrDetnRng FrntRdrDetn45RdrDetnRngV FrntRdrDetn45RdrDetnSts;
SIG_GROUP_ 318 FrntRdrDetn46 1 : FrntRdrDetn46RdrDetnAzi FrntRdrDetn46RdrDetnChks FrntRdrDetn46RdrDetnCntr FrntRdrDetn46RdrDetnConf FrntRdrDetn46RdrDetnElevn FrntRdrDetn46RdrDetnPwr FrntRdrDetn46RdrDetnRng FrntRdrDetn46RdrDetnRngV FrntRdrDetn46RdrDetnSts;
SIG_GROUP_ 318 FrntRdrDetn47 1 : FrntRdrDetn47RdrDetnAzi FrntRdrDetn47RdrDetnChks FrntRdrDetn47RdrDetnCntr FrntRdrDetn47RdrDetnConf FrntRdrDetn47RdrDetnElevn FrntRdrDetn47RdrDetnPwr FrntRdrDetn47RdrDetnRng FrntRdrDetn47RdrDetnRngV FrntRdrDetn47RdrDetnSts;
SIG_GROUP_ 318 FrntRdrDetn48 1 : FrntRdrDetn48RdrDetnAzi FrntRdrDetn48RdrDetnChks FrntRdrDetn48RdrDetnCntr FrntRdrDetn48RdrDetnConf FrntRdrDetn48RdrDetnElevn FrntRdrDetn48RdrDetnPwr FrntRdrDetn48RdrDetnRng FrntRdrDetn48RdrDetnRngV FrntRdrDetn48RdrDetnSts;
SIG_GROUP_ 320 FrntRdrDetn49 1 : FrntRdrDetn49RdrDetnAzi FrntRdrDetn49RdrDetnChks FrntRdrDetn49RdrDetnCntr FrntRdrDetn49RdrDetnConf FrntRdrDetn49RdrDetnElevn FrntRdrDetn49RdrDetnPwr FrntRdrDetn49RdrDetnRng FrntRdrDetn49RdrDetnRngV FrntRdrDetn49RdrDetnSts;
SIG_GROUP_ 320 FrntRdrDetn50 1 : FrntRdrDetn50RdrDetnAzi FrntRdrDetn50RdrDetnChks FrntRdrDetn50RdrDetnCntr FrntRdrDetn50RdrDetnConf FrntRdrDetn50RdrDetnElevn FrntRdrDetn50RdrDetnPwr FrntRdrDetn50RdrDetnRng FrntRdrDetn50RdrDetnRngV FrntRdrDetn50RdrDetnSts;
SIG_GROUP_ 320 FrntRdrDetn51 1 : FrntRdrDetn51RdrDetnAzi FrntRdrDetn51RdrDetnChks FrntRdrDetn51RdrDetnCntr FrntRdrDetn51RdrDetnConf FrntRdrDetn51RdrDetnElevn FrntRdrDetn51RdrDetnPwr FrntRdrDetn51RdrDetnRng FrntRdrDetn51RdrDetnRngV FrntRdrDetn51RdrDetnSts;
SIG_GROUP_ 320 FrntRdrDetn52 1 : FrntRdrDetn52RdrDetnAzi FrntRdrDetn52RdrDetnChks FrntRdrDetn52RdrDetnCntr FrntRdrDetn52RdrDetnConf FrntRdrDetn52RdrDetnElevn FrntRdrDetn52RdrDetnPwr FrntRdrDetn52RdrDetnRng FrntRdrDetn52RdrDetnRngV FrntRdrDetn52RdrDetnSts;
SIG_GROUP_ 320 FrntRdrDetn53 1 : FrntRdrDetn53RdrDetnAzi FrntRdrDetn53RdrDetnChks FrntRdrDetn53RdrDetnCntr FrntRdrDetn53RdrDetnConf FrntRdrDetn53RdrDetnElevn FrntRdrDetn53RdrDetnPwr FrntRdrDetn53RdrDetnRng FrntRdrDetn53RdrDetnRngV FrntRdrDetn53RdrDetnSts;
SIG_GROUP_ 320 FrntRdrDetn54 1 : FrntRdrDetn54RdrDetnAzi FrntRdrDetn54RdrDetnChks FrntRdrDetn54RdrDetnCntr FrntRdrDetn54RdrDetnConf FrntRdrDetn54RdrDetnElevn FrntRdrDetn54RdrDetnPwr FrntRdrDetn54RdrDetnRng FrntRdrDetn54RdrDetnRngV FrntRdrDetn54RdrDetnSts;
SIG_GROUP_ 322 FrntRdrDetn55 1 : FrntRdrDetn55RdrDetnAzi FrntRdrDetn55RdrDetnChks FrntRdrDetn55RdrDetnCntr FrntRdrDetn55RdrDetnConf FrntRdrDetn55RdrDetnElevn FrntRdrDetn55RdrDetnPwr FrntRdrDetn55RdrDetnRng FrntRdrDetn55RdrDetnRngV FrntRdrDetn55RdrDetnSts;
SIG_GROUP_ 322 FrntRdrDetn56 1 : FrntRdrDetn56RdrDetnAzi FrntRdrDetn56RdrDetnChks FrntRdrDetn56RdrDetnCntr FrntRdrDetn56RdrDetnConf FrntRdrDetn56RdrDetnElevn FrntRdrDetn56RdrDetnPwr FrntRdrDetn56RdrDetnRng FrntRdrDetn56RdrDetnRngV FrntRdrDetn56RdrDetnSts;
SIG_GROUP_ 322 FrntRdrDetn57 1 : FrntRdrDetn57RdrDetnAzi FrntRdrDetn57RdrDetnChks FrntRdrDetn57RdrDetnCntr FrntRdrDetn57RdrDetnConf FrntRdrDetn57RdrDetnElevn FrntRdrDetn57RdrDetnPwr FrntRdrDetn57RdrDetnRng FrntRdrDetn57RdrDetnRngV FrntRdrDetn57RdrDetnSts;
SIG_GROUP_ 322 FrntRdrDetn58 1 : FrntRdrDetn58RdrDetnAzi FrntRdrDetn58RdrDetnChks FrntRdrDetn58RdrDetnCntr FrntRdrDetn58RdrDetnConf FrntRdrDetn58RdrDetnElevn FrntRdrDetn58RdrDetnPwr FrntRdrDetn58RdrDetnRng FrntRdrDetn58RdrDetnRngV FrntRdrDetn58RdrDetnSts;
SIG_GROUP_ 322 FrntRdrDetn59 1 : FrntRdrDetn59RdrDetnAzi FrntRdrDetn59RdrDetnChks FrntRdrDetn59RdrDetnCntr FrntRdrDetn59RdrDetnConf FrntRdrDetn59RdrDetnElevn FrntRdrDetn59RdrDetnPwr FrntRdrDetn59RdrDetnRng FrntRdrDetn59RdrDetnRngV FrntRdrDetn59RdrDetnSts;
SIG_GROUP_ 322 FrntRdrDetn60 1 : FrntRdrDetn60RdrDetnAzi FrntRdrDetn60RdrDetnChks FrntRdrDetn60RdrDetnCntr FrntRdrDetn60RdrDetnConf FrntRdrDetn60RdrDetnElevn FrntRdrDetn60RdrDetnPwr FrntRdrDetn60RdrDetnRng FrntRdrDetn60RdrDetnRngV FrntRdrDetn60RdrDetnSts;
SIG_GROUP_ 324 FrntRdrDetn61 1 : FrntRdrDetn61RdrDetnAzi FrntRdrDetn61RdrDetnChks FrntRdrDetn61RdrDetnCntr FrntRdrDetn61RdrDetnConf FrntRdrDetn61RdrDetnElevn FrntRdrDetn61RdrDetnPwr FrntRdrDetn61RdrDetnRng FrntRdrDetn61RdrDetnRngV FrntRdrDetn61RdrDetnSts;
SIG_GROUP_ 324 FrntRdrDetn62 1 : FrntRdrDetn62RdrDetnAzi FrntRdrDetn62RdrDetnChks FrntRdrDetn62RdrDetnCntr FrntRdrDetn62RdrDetnConf FrntRdrDetn62RdrDetnElevn FrntRdrDetn62RdrDetnPwr FrntRdrDetn62RdrDetnRng FrntRdrDetn62RdrDetnRngV FrntRdrDetn62RdrDetnSts;
SIG_GROUP_ 324 FrntRdrDetn63 1 : FrntRdrDetn63RdrDetnAzi FrntRdrDetn63RdrDetnChks FrntRdrDetn63RdrDetnCntr FrntRdrDetn63RdrDetnConf FrntRdrDetn63RdrDetnElevn FrntRdrDetn63RdrDetnPwr FrntRdrDetn63RdrDetnRng FrntRdrDetn63RdrDetnRngV FrntRdrDetn63RdrDetnSts;
SIG_GROUP_ 324 FrntRdrDetn64 1 : FrntRdrDetn64RdrDetnAzi FrntRdrDetn64RdrDetnChks FrntRdrDetn64RdrDetnCntr FrntRdrDetn64RdrDetnConf FrntRdrDetn64RdrDetnElevn FrntRdrDetn64RdrDetnPwr FrntRdrDetn64RdrDetnRng FrntRdrDetn64RdrDetnRngV FrntRdrDetn64RdrDetnSts;
SIG_GROUP_ 324 FrntRdrDetn65 1 : FrntRdrDetn65RdrDetnAzi FrntRdrDetn65RdrDetnChks FrntRdrDetn65RdrDetnCntr FrntRdrDetn65RdrDetnConf FrntRdrDetn65RdrDetnElevn FrntRdrDetn65RdrDetnPwr FrntRdrDetn65RdrDetnRng FrntRdrDetn65RdrDetnRngV FrntRdrDetn65RdrDetnSts;
SIG_GROUP_ 324 FrntRdrDetn66 1 : FrntRdrDetn66RdrDetnAzi FrntRdrDetn66RdrDetnChks FrntRdrDetn66RdrDetnCntr FrntRdrDetn66RdrDetnConf FrntRdrDetn66RdrDetnElevn FrntRdrDetn66RdrDetnPwr FrntRdrDetn66RdrDetnRng FrntRdrDetn66RdrDetnRngV FrntRdrDetn66RdrDetnSts;
