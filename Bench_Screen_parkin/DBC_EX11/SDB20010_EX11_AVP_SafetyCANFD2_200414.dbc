// *************************************************************************** *
// *                                                                           *
// *                      Mentor Graphics Corporation                          *
// *                          All rights reserved                              *
// *                                                                           *
// *************************************************************************** *
// *                                                                           *
// * Description:         CANDB File                                           *
// * Generated at:        2020-04-14 13:13:01                                  *
// * System:              SDB20010                                             *
// * Variant:             EX11_AVP                                             *
// * Network:             SafetyCANFD2                                         *
// *                                                                           *
// *************************************************************************** *
// *                                                                           *
// *             THIS CONFIGURATION MIGHT CONTAIN SOME ERRORS                  *
// *              IF THE INPUT MODEL WAS NOT PROPERLY FORMED!                  *
// *                    Do Not Use this File directly!                         *
// *                                                                           *
// *************************************************************************** *
VERSION "SafetyCANFD2"

NS_ :

BS_:

BU_:  ASDM ETC FLC FLR PAS

BO_ 378 FLRSafetyCANFD2Frame38: 64 FLR
 SG_ FrntRdrObj4_UB : 291|1@0+ (1,0) [0|1] "" ASDM,PAS
 SG_ FrntRdrObj4Heading : 287|12@0+ (0.1,-180.0) [-180.0|180.0] "Deg" ASDM,PAS
 SG_ FrntRdrObj4ObjBoxCenterLat : 23|9@0+ (0.1,-25.0) [-25.0|25.0] "m" ASDM,PAS
 SG_ FrntRdrObj4ObjBoxCenterLgt : 30|9@0+ (0.1,-25.0) [-25.0|25.0] "m" ASDM,PAS
 SG_ FrntRdrObj4ObservationHist : 63|32@0+ (1.0,0.0) [0.0|4294967295.0] "Unitless" ASDM,PAS
 SG_ FrntRdrObj4RdrObjAx : 7|8@0- (0.1,0.0) [-12.8|12.700000000000001] "m/s^2" ASDM,PAS
 SG_ FrntRdrObj4RdrObjAy : 15|8@0- (0.1,0.0) [-12.8|12.700000000000001] "m/s^2" ASDM,PAS
 SG_ FrntRdrObj4RdrObjBoxLength : 37|9@0+ (0.1,0.0) [0.0|50.0] "m" ASDM,PAS
 SG_ FrntRdrObj4RdrObjBoxWidth : 44|9@0+ (0.1,0.0) [0.0|50.0] "m" ASDM,PAS
 SG_ FrntRdrObj4RdrObjChks : 95|8@0+ (1.0,0.0) [0.0|255.0] "Unitless" ASDM,PAS
 SG_ FrntRdrObj4RdrObjCntr : 103|4@0+ (1.0,0.0) [0.0|15.0] "Unitless" ASDM,PAS
 SG_ FrntRdrObj4RdrObjCoastCnt : 279|5@0+ (1.0,0.0) [0.0|31.0] "Unitless" ASDM,PAS
 SG_ FrntRdrObj4RdrObjConf : 99|4@0+ (7.0,0.0) [0.0|105.0] "%" ASDM,PAS
 SG_ FrntRdrObj4RdrObjDx : 191|13@0+ (0.05,-200.0) [-200.0|200.0] "m" ASDM,PAS
 SG_ FrntRdrObj4RdrObjDxStdDe : 111|8@0+ (0.05,0.0) [0.0|12.700000000000001] "m" ASDM,PAS
 SG_ FrntRdrObj4RdrObjDy : 119|13@0+ (0.05,-200.0) [-200.0|200.0] "m" ASDM,PAS
 SG_ FrntRdrObj4RdrObjDyStdDe : 183|8@0+ (0.05,0.0) [0.0|12.700000000000001] "m" ASDM,PAS
 SG_ FrntRdrObj4RdrObjElevnConf : 223|4@0+ (7.0,0.0) [0.0|105.0] "%" ASDM,PAS
 SG_ FrntRdrObj4RdrObjElevnSts : 153|2@0+ (1,0) [0|3] "" ASDM,PAS
 SG_ FrntRdrObj4RdrObjID : 167|8@0+ (1.0,0.0) [0.0|255.0] "Unitless" ASDM,PAS
 SG_ FrntRdrObj4RdrObjIsInFreeSpace : 192|1@0+ (1,0) [0|1] "" ASDM,PAS
 SG_ FrntRdrObj4RdrObjMirrProblty : 219|4@0+ (7.0,0.0) [0.0|105.0] "%" ASDM,PAS
 SG_ FrntRdrObj4RdrObjMtnPat : 122|3@0+ (1,0) [0|7] "" ASDM,PAS
 SG_ FrntRdrObj4RdrObjNotRealProblty : 231|4@0+ (7.0,0.0) [0.0|105.0] "%" ASDM,PAS
 SG_ FrntRdrObj4RdrObjStatyCnt : 239|7@0+ (1.0,0.0) [0.0|127.0] "Unitless" ASDM,PAS
 SG_ FrntRdrObj4RdrObjTiAlv : 247|7@0+ (1.0,0.0) [0.0|127.0] "Unitless" ASDM,PAS
 SG_ FrntRdrObj4RdrObjTrackSts : 194|2@0+ (1,0) [0|3] "" ASDM,PAS
 SG_ FrntRdrObj4RdrObjTyp : 51|4@0+ (1,0) [0|15] "" ASDM,PAS
 SG_ FrntRdrObj4RdrObjTypConfBike : 175|4@0+ (7.0,0.0) [0.0|105.0] "%" ASDM,PAS
 SG_ FrntRdrObj4RdrObjTypConfPed : 171|4@0+ (7.0,0.0) [0.0|105.0] "%" ASDM,PAS
 SG_ FrntRdrObj4RdrObjTypConfVeh : 227|4@0+ (7.0,0.0) [0.0|105.0] "%" ASDM,PAS
 SG_ FrntRdrObj4RdrObjVx : 255|14@0+ (0.02,-128.0) [-128.0|128.0] "m/s" ASDM,PAS
 SG_ FrntRdrObj4RdrObjVxStdDe : 271|6@0+ (0.05,0.0) [0.0|2.0] "m/s" ASDM,PAS
 SG_ FrntRdrObj4RdrObjVy : 207|14@0+ (0.02,-128.0) [-128.0|128.0] "m/s" ASDM,PAS
 SG_ FrntRdrObj4RdrObjVyStdDe : 159|6@0+ (0.05,0.0) [0.0|2.0] "m/s" ASDM,PAS
 SG_ FrntRdrObj4RelVx : 135|12@0+ (0.02,-35.6) [-35.6|35.6] "m/s" ASDM,PAS
 SG_ FrntRdrObj4RelVy : 139|12@0+ (0.02,-35.6) [-35.6|35.6] "m/s" ASDM,PAS

BO_ 380 FLRSafetyCANFD2Frame39: 64 FLR
 SG_ FrntRdrObj5_UB : 291|1@0+ (1,0) [0|1] "" ASDM,PAS
 SG_ FrntRdrObj5Heading : 287|12@0+ (0.1,-180.0) [-180.0|180.0] "Deg" ASDM,PAS
 SG_ FrntRdrObj5ObjBoxCenterLat : 23|9@0+ (0.1,-25.0) [-25.0|25.0] "m" ASDM,PAS
 SG_ FrntRdrObj5ObjBoxCenterLgt : 30|9@0+ (0.1,-25.0) [-25.0|25.0] "m" ASDM,PAS
 SG_ FrntRdrObj5ObservationHist : 63|32@0+ (1.0,0.0) [0.0|4294967295.0] "Unitless" ASDM,PAS
 SG_ FrntRdrObj5RdrObjAx : 7|8@0- (0.1,0.0) [-12.8|12.700000000000001] "m/s^2" ASDM,PAS
 SG_ FrntRdrObj5RdrObjAy : 15|8@0- (0.1,0.0) [-12.8|12.700000000000001] "m/s^2" ASDM,PAS
 SG_ FrntRdrObj5RdrObjBoxLength : 37|9@0+ (0.1,0.0) [0.0|50.0] "m" ASDM,PAS
 SG_ FrntRdrObj5RdrObjBoxWidth : 44|9@0+ (0.1,0.0) [0.0|50.0] "m" ASDM,PAS
 SG_ FrntRdrObj5RdrObjChks : 95|8@0+ (1.0,0.0) [0.0|255.0] "Unitless" ASDM,PAS
 SG_ FrntRdrObj5RdrObjCntr : 103|4@0+ (1.0,0.0) [0.0|15.0] "Unitless" ASDM,PAS
 SG_ FrntRdrObj5RdrObjCoastCnt : 279|5@0+ (1.0,0.0) [0.0|31.0] "Unitless" ASDM,PAS
 SG_ FrntRdrObj5RdrObjConf : 99|4@0+ (7.0,0.0) [0.0|105.0] "%" ASDM,PAS
 SG_ FrntRdrObj5RdrObjDx : 191|13@0+ (0.05,-200.0) [-200.0|200.0] "m" ASDM,PAS
 SG_ FrntRdrObj5RdrObjDxStdDe : 111|8@0+ (0.05,0.0) [0.0|12.700000000000001] "m" ASDM,PAS
 SG_ FrntRdrObj5RdrObjDy : 119|13@0+ (0.05,-200.0) [-200.0|200.0] "m" ASDM,PAS
 SG_ FrntRdrObj5RdrObjDyStdDe : 183|8@0+ (0.05,0.0) [0.0|12.700000000000001] "m" ASDM,PAS
 SG_ FrntRdrObj5RdrObjElevnConf : 223|4@0+ (7.0,0.0) [0.0|105.0] "%" ASDM,PAS
 SG_ FrntRdrObj5RdrObjElevnSts : 153|2@0+ (1,0) [0|3] "" ASDM,PAS
 SG_ FrntRdrObj5RdrObjID : 167|8@0+ (1.0,0.0) [0.0|255.0] "Unitless" ASDM,PAS
 SG_ FrntRdrObj5RdrObjIsInFreeSpace : 192|1@0+ (1,0) [0|1] "" ASDM,PAS
 SG_ FrntRdrObj5RdrObjMirrProblty : 219|4@0+ (7.0,0.0) [0.0|105.0] "%" ASDM,PAS
 SG_ FrntRdrObj5RdrObjMtnPat : 122|3@0+ (1,0) [0|7] "" ASDM,PAS
 SG_ FrntRdrObj5RdrObjNotRealProblty : 231|4@0+ (7.0,0.0) [0.0|105.0] "%" ASDM,PAS
 SG_ FrntRdrObj5RdrObjStatyCnt : 239|7@0+ (1.0,0.0) [0.0|127.0] "Unitless" ASDM,PAS
 SG_ FrntRdrObj5RdrObjTiAlv : 247|7@0+ (1.0,0.0) [0.0|127.0] "Unitless" ASDM,PAS
 SG_ FrntRdrObj5RdrObjTrackSts : 194|2@0+ (1,0) [0|3] "" ASDM,PAS
 SG_ FrntRdrObj5RdrObjTyp : 51|4@0+ (1,0) [0|15] "" ASDM,PAS
 SG_ FrntRdrObj5RdrObjTypConfBike : 175|4@0+ (7.0,0.0) [0.0|105.0] "%" ASDM,PAS
 SG_ FrntRdrObj5RdrObjTypConfPed : 171|4@0+ (7.0,0.0) [0.0|105.0] "%" ASDM,PAS
 SG_ FrntRdrObj5RdrObjTypConfVeh : 227|4@0+ (7.0,0.0) [0.0|105.0] "%" ASDM,PAS
 SG_ FrntRdrObj5RdrObjVx : 255|14@0+ (0.02,-128.0) [-128.0|128.0] "m/s" ASDM,PAS
 SG_ FrntRdrObj5RdrObjVxStdDe : 271|6@0+ (0.05,0.0) [0.0|2.0] "m/s" ASDM,PAS
 SG_ FrntRdrObj5RdrObjVy : 207|14@0+ (0.02,-128.0) [-128.0|128.0] "m/s" ASDM,PAS
 SG_ FrntRdrObj5RdrObjVyStdDe : 159|6@0+ (0.05,0.0) [0.0|2.0] "m/s" ASDM,PAS
 SG_ FrntRdrObj5RelVx : 135|12@0+ (0.02,-35.6) [-35.6|35.6] "m/s" ASDM,PAS
 SG_ FrntRdrObj5RelVy : 139|12@0+ (0.02,-35.6) [-35.6|35.6] "m/s" ASDM,PAS

BO_ 382 FLRSafetyCANFD2Frame40: 64 FLR
 SG_ FrntRdrObj6_UB : 291|1@0+ (1,0) [0|1] "" ASDM,PAS
 SG_ FrntRdrObj6Heading : 287|12@0+ (0.1,-180.0) [-180.0|180.0] "Deg" ASDM,PAS
 SG_ FrntRdrObj6ObjBoxCenterLat : 23|9@0+ (0.1,-25.0) [-25.0|25.0] "m" ASDM,PAS
 SG_ FrntRdrObj6ObjBoxCenterLgt : 30|9@0+ (0.1,-25.0) [-25.0|25.0] "m" ASDM,PAS
 SG_ FrntRdrObj6ObservationHist : 63|32@0+ (1.0,0.0) [0.0|4294967295.0] "Unitless" ASDM,PAS
 SG_ FrntRdrObj6RdrObjAx : 7|8@0- (0.1,0.0) [-12.8|12.700000000000001] "m/s^2" ASDM,PAS
 SG_ FrntRdrObj6RdrObjAy : 15|8@0- (0.1,0.0) [-12.8|12.700000000000001] "m/s^2" ASDM,PAS
 SG_ FrntRdrObj6RdrObjBoxLength : 37|9@0+ (0.1,0.0) [0.0|50.0] "m" ASDM,PAS
 SG_ FrntRdrObj6RdrObjBoxWidth : 44|9@0+ (0.1,0.0) [0.0|50.0] "m" ASDM,PAS
 SG_ FrntRdrObj6RdrObjChks : 95|8@0+ (1.0,0.0) [0.0|255.0] "Unitless" ASDM,PAS
 SG_ FrntRdrObj6RdrObjCntr : 103|4@0+ (1.0,0.0) [0.0|15.0] "Unitless" ASDM,PAS
 SG_ FrntRdrObj6RdrObjCoastCnt : 279|5@0+ (1.0,0.0) [0.0|31.0] "Unitless" ASDM,PAS
 SG_ FrntRdrObj6RdrObjConf : 99|4@0+ (7.0,0.0) [0.0|105.0] "%" ASDM,PAS
 SG_ FrntRdrObj6RdrObjDx : 191|13@0+ (0.05,-200.0) [-200.0|200.0] "m" ASDM,PAS
 SG_ FrntRdrObj6RdrObjDxStdDe : 111|8@0+ (0.05,0.0) [0.0|12.700000000000001] "m" ASDM,PAS
 SG_ FrntRdrObj6RdrObjDy : 119|13@0+ (0.05,-200.0) [-200.0|200.0] "m" ASDM,PAS
 SG_ FrntRdrObj6RdrObjDyStdDe : 183|8@0+ (0.05,0.0) [0.0|12.700000000000001] "m" ASDM,PAS
 SG_ FrntRdrObj6RdrObjElevnConf : 223|4@0+ (7.0,0.0) [0.0|105.0] "%" ASDM,PAS
 SG_ FrntRdrObj6RdrObjElevnSts : 153|2@0+ (1,0) [0|3] "" ASDM,PAS
 SG_ FrntRdrObj6RdrObjID : 167|8@0+ (1.0,0.0) [0.0|255.0] "Unitless" ASDM,PAS
 SG_ FrntRdrObj6RdrObjIsInFreeSpace : 192|1@0+ (1,0) [0|1] "" ASDM,PAS
 SG_ FrntRdrObj6RdrObjMirrProblty : 219|4@0+ (7.0,0.0) [0.0|105.0] "%" ASDM,PAS
 SG_ FrntRdrObj6RdrObjMtnPat : 122|3@0+ (1,0) [0|7] "" ASDM,PAS
 SG_ FrntRdrObj6RdrObjNotRealProblty : 231|4@0+ (7.0,0.0) [0.0|105.0] "%" ASDM,PAS
 SG_ FrntRdrObj6RdrObjStatyCnt : 239|7@0+ (1.0,0.0) [0.0|127.0] "Unitless" ASDM,PAS
 SG_ FrntRdrObj6RdrObjTiAlv : 247|7@0+ (1.0,0.0) [0.0|127.0] "Unitless" ASDM,PAS
 SG_ FrntRdrObj6RdrObjTrackSts : 194|2@0+ (1,0) [0|3] "" ASDM,PAS
 SG_ FrntRdrObj6RdrObjTyp : 51|4@0+ (1,0) [0|15] "" ASDM,PAS
 SG_ FrntRdrObj6RdrObjTypConfBike : 175|4@0+ (7.0,0.0) [0.0|105.0] "%" ASDM,PAS
 SG_ FrntRdrObj6RdrObjTypConfPed : 171|4@0+ (7.0,0.0) [0.0|105.0] "%" ASDM,PAS
 SG_ FrntRdrObj6RdrObjTypConfVeh : 227|4@0+ (7.0,0.0) [0.0|105.0] "%" ASDM,PAS
 SG_ FrntRdrObj6RdrObjVx : 255|14@0+ (0.02,-128.0) [-128.0|128.0] "m/s" ASDM,PAS
 SG_ FrntRdrObj6RdrObjVxStdDe : 271|6@0+ (0.05,0.0) [0.0|2.0] "m/s" ASDM,PAS
 SG_ FrntRdrObj6RdrObjVy : 207|14@0+ (0.02,-128.0) [-128.0|128.0] "m/s" ASDM,PAS
 SG_ FrntRdrObj6RdrObjVyStdDe : 159|6@0+ (0.05,0.0) [0.0|2.0] "m/s" ASDM,PAS
 SG_ FrntRdrObj6RelVx : 135|12@0+ (0.02,-35.6) [-35.6|35.6] "m/s" ASDM,PAS
 SG_ FrntRdrObj6RelVy : 139|12@0+ (0.02,-35.6) [-35.6|35.6] "m/s" ASDM,PAS

BO_ 384 FLRSafetyCANFD2Frame41: 64 FLR
 SG_ FrntRdrObj7_UB : 291|1@0+ (1,0) [0|1] "" ASDM,PAS
 SG_ FrntRdrObj7Heading : 287|12@0+ (0.1,-180.0) [-180.0|180.0] "Deg" ASDM,PAS
 SG_ FrntRdrObj7ObjBoxCenterLat : 23|9@0+ (0.1,-25.0) [-25.0|25.0] "m" ASDM,PAS
 SG_ FrntRdrObj7ObjBoxCenterLgt : 30|9@0+ (0.1,-25.0) [-25.0|25.0] "m" ASDM,PAS
 SG_ FrntRdrObj7ObservationHist : 63|32@0+ (1.0,0.0) [0.0|4294967295.0] "Unitless" ASDM,PAS
 SG_ FrntRdrObj7RdrObjAx : 7|8@0- (0.1,0.0) [-12.8|12.700000000000001] "m/s^2" ASDM,PAS
 SG_ FrntRdrObj7RdrObjAy : 15|8@0- (0.1,0.0) [-12.8|12.700000000000001] "m/s^2" ASDM,PAS
 SG_ FrntRdrObj7RdrObjBoxLength : 37|9@0+ (0.1,0.0) [0.0|50.0] "m" ASDM,PAS
 SG_ FrntRdrObj7RdrObjBoxWidth : 44|9@0+ (0.1,0.0) [0.0|50.0] "m" ASDM,PAS
 SG_ FrntRdrObj7RdrObjChks : 95|8@0+ (1.0,0.0) [0.0|255.0] "Unitless" ASDM,PAS
 SG_ FrntRdrObj7RdrObjCntr : 103|4@0+ (1.0,0.0) [0.0|15.0] "Unitless" ASDM,PAS
 SG_ FrntRdrObj7RdrObjCoastCnt : 279|5@0+ (1.0,0.0) [0.0|31.0] "Unitless" ASDM,PAS
 SG_ FrntRdrObj7RdrObjConf : 99|4@0+ (7.0,0.0) [0.0|105.0] "%" ASDM,PAS
 SG_ FrntRdrObj7RdrObjDx : 191|13@0+ (0.05,-200.0) [-200.0|200.0] "m" ASDM,PAS
 SG_ FrntRdrObj7RdrObjDxStdDe : 111|8@0+ (0.05,0.0) [0.0|12.700000000000001] "m" ASDM,PAS
 SG_ FrntRdrObj7RdrObjDy : 119|13@0+ (0.05,-200.0) [-200.0|200.0] "m" ASDM,PAS
 SG_ FrntRdrObj7RdrObjDyStdDe : 183|8@0+ (0.05,0.0) [0.0|12.700000000000001] "m" ASDM,PAS
 SG_ FrntRdrObj7RdrObjElevnConf : 223|4@0+ (7.0,0.0) [0.0|105.0] "%" ASDM,PAS
 SG_ FrntRdrObj7RdrObjElevnSts : 153|2@0+ (1,0) [0|3] "" ASDM,PAS
 SG_ FrntRdrObj7RdrObjID : 167|8@0+ (1.0,0.0) [0.0|255.0] "Unitless" ASDM,PAS
 SG_ FrntRdrObj7RdrObjIsInFreeSpace : 192|1@0+ (1,0) [0|1] "" ASDM,PAS
 SG_ FrntRdrObj7RdrObjMirrProblty : 219|4@0+ (7.0,0.0) [0.0|105.0] "%" ASDM,PAS
 SG_ FrntRdrObj7RdrObjMtnPat : 122|3@0+ (1,0) [0|7] "" ASDM,PAS
 SG_ FrntRdrObj7RdrObjNotRealProblty : 231|4@0+ (7.0,0.0) [0.0|105.0] "%" ASDM,PAS
 SG_ FrntRdrObj7RdrObjStatyCnt : 239|7@0+ (1.0,0.0) [0.0|127.0] "Unitless" ASDM,PAS
 SG_ FrntRdrObj7RdrObjTiAlv : 247|7@0+ (1.0,0.0) [0.0|127.0] "Unitless" ASDM,PAS
 SG_ FrntRdrObj7RdrObjTrackSts : 194|2@0+ (1,0) [0|3] "" ASDM,PAS
 SG_ FrntRdrObj7RdrObjTyp : 51|4@0+ (1,0) [0|15] "" ASDM,PAS
 SG_ FrntRdrObj7RdrObjTypConfBike : 175|4@0+ (7.0,0.0) [0.0|105.0] "%" ASDM,PAS
 SG_ FrntRdrObj7RdrObjTypConfPed : 171|4@0+ (7.0,0.0) [0.0|105.0] "%" ASDM,PAS
 SG_ FrntRdrObj7RdrObjTypConfVeh : 227|4@0+ (7.0,0.0) [0.0|105.0] "%" ASDM,PAS
 SG_ FrntRdrObj7RdrObjVx : 255|14@0+ (0.02,-128.0) [-128.0|128.0] "m/s" ASDM,PAS
 SG_ FrntRdrObj7RdrObjVxStdDe : 271|6@0+ (0.05,0.0) [0.0|2.0] "m/s" ASDM,PAS
 SG_ FrntRdrObj7RdrObjVy : 207|14@0+ (0.02,-128.0) [-128.0|128.0] "m/s" ASDM,PAS
 SG_ FrntRdrObj7RdrObjVyStdDe : 159|6@0+ (0.05,0.0) [0.0|2.0] "m/s" ASDM,PAS
 SG_ FrntRdrObj7RelVx : 135|12@0+ (0.02,-35.6) [-35.6|35.6] "m/s" ASDM,PAS
 SG_ FrntRdrObj7RelVy : 139|12@0+ (0.02,-35.6) [-35.6|35.6] "m/s" ASDM,PAS

BO_ 386 FLRSafetyCANFD2Frame42: 64 FLR
 SG_ FrntRdrObj8_UB : 291|1@0+ (1,0) [0|1] "" ASDM,PAS
 SG_ FrntRdrObj8Heading : 287|12@0+ (0.1,-180.0) [-180.0|180.0] "Deg" ASDM,PAS
 SG_ FrntRdrObj8ObjBoxCenterLat : 23|9@0+ (0.1,-25.0) [-25.0|25.0] "m" ASDM,PAS
 SG_ FrntRdrObj8ObjBoxCenterLgt : 30|9@0+ (0.1,-25.0) [-25.0|25.0] "m" ASDM,PAS
 SG_ FrntRdrObj8ObservationHist : 63|32@0+ (1.0,0.0) [0.0|4294967295.0] "Unitless" ASDM,PAS
 SG_ FrntRdrObj8RdrObjAx : 7|8@0- (0.1,0.0) [-12.8|12.700000000000001] "m/s^2" ASDM,PAS
 SG_ FrntRdrObj8RdrObjAy : 15|8@0- (0.1,0.0) [-12.8|12.700000000000001] "m/s^2" ASDM,PAS
 SG_ FrntRdrObj8RdrObjBoxLength : 37|9@0+ (0.1,0.0) [0.0|50.0] "m" ASDM,PAS
 SG_ FrntRdrObj8RdrObjBoxWidth : 44|9@0+ (0.1,0.0) [0.0|50.0] "m" ASDM,PAS
 SG_ FrntRdrObj8RdrObjChks : 95|8@0+ (1.0,0.0) [0.0|255.0] "Unitless" ASDM,PAS
 SG_ FrntRdrObj8RdrObjCntr : 103|4@0+ (1.0,0.0) [0.0|15.0] "Unitless" ASDM,PAS
 SG_ FrntRdrObj8RdrObjCoastCnt : 279|5@0+ (1.0,0.0) [0.0|31.0] "Unitless" ASDM,PAS
 SG_ FrntRdrObj8RdrObjConf : 99|4@0+ (7.0,0.0) [0.0|105.0] "%" ASDM,PAS
 SG_ FrntRdrObj8RdrObjDx : 191|13@0+ (0.05,-200.0) [-200.0|200.0] "m" ASDM,PAS
 SG_ FrntRdrObj8RdrObjDxStdDe : 111|8@0+ (0.05,0.0) [0.0|12.700000000000001] "m" ASDM,PAS
 SG_ FrntRdrObj8RdrObjDy : 119|13@0+ (0.05,-200.0) [-200.0|200.0] "m" ASDM,PAS
 SG_ FrntRdrObj8RdrObjDyStdDe : 183|8@0+ (0.05,0.0) [0.0|12.700000000000001] "m" ASDM,PAS
 SG_ FrntRdrObj8RdrObjElevnConf : 223|4@0+ (7.0,0.0) [0.0|105.0] "%" ASDM,PAS
 SG_ FrntRdrObj8RdrObjElevnSts : 153|2@0+ (1,0) [0|3] "" ASDM,PAS
 SG_ FrntRdrObj8RdrObjID : 167|8@0+ (1.0,0.0) [0.0|255.0] "Unitless" ASDM,PAS
 SG_ FrntRdrObj8RdrObjIsInFreeSpace : 192|1@0+ (1,0) [0|1] "" ASDM,PAS
 SG_ FrntRdrObj8RdrObjMirrProblty : 219|4@0+ (7.0,0.0) [0.0|105.0] "%" ASDM,PAS
 SG_ FrntRdrObj8RdrObjMtnPat : 122|3@0+ (1,0) [0|7] "" ASDM,PAS
 SG_ FrntRdrObj8RdrObjNotRealProblty : 231|4@0+ (7.0,0.0) [0.0|105.0] "%" ASDM,PAS
 SG_ FrntRdrObj8RdrObjStatyCnt : 239|7@0+ (1.0,0.0) [0.0|127.0] "Unitless" ASDM,PAS
 SG_ FrntRdrObj8RdrObjTiAlv : 247|7@0+ (1.0,0.0) [0.0|127.0] "Unitless" ASDM,PAS
 SG_ FrntRdrObj8RdrObjTrackSts : 194|2@0+ (1,0) [0|3] "" ASDM,PAS
 SG_ FrntRdrObj8RdrObjTyp : 51|4@0+ (1,0) [0|15] "" ASDM,PAS
 SG_ FrntRdrObj8RdrObjTypConfBike : 175|4@0+ (7.0,0.0) [0.0|105.0] "%" ASDM,PAS
 SG_ FrntRdrObj8RdrObjTypConfPed : 171|4@0+ (7.0,0.0) [0.0|105.0] "%" ASDM,PAS
 SG_ FrntRdrObj8RdrObjTypConfVeh : 227|4@0+ (7.0,0.0) [0.0|105.0] "%" ASDM,PAS
 SG_ FrntRdrObj8RdrObjVx : 255|14@0+ (0.02,-128.0) [-128.0|128.0] "m/s" ASDM,PAS
 SG_ FrntRdrObj8RdrObjVxStdDe : 271|6@0+ (0.05,0.0) [0.0|2.0] "m/s" ASDM,PAS
 SG_ FrntRdrObj8RdrObjVy : 207|14@0+ (0.02,-128.0) [-128.0|128.0] "m/s" ASDM,PAS
 SG_ FrntRdrObj8RdrObjVyStdDe : 159|6@0+ (0.05,0.0) [0.0|2.0] "m/s" ASDM,PAS
 SG_ FrntRdrObj8RelVx : 135|12@0+ (0.02,-35.6) [-35.6|35.6] "m/s" ASDM,PAS
 SG_ FrntRdrObj8RelVy : 139|12@0+ (0.02,-35.6) [-35.6|35.6] "m/s" ASDM,PAS

BO_ 388 FLRSafetyCANFD2Frame43: 64 FLR
 SG_ FrntRdrObj9_UB : 291|1@0+ (1,0) [0|1] "" ASDM,PAS
 SG_ FrntRdrObj9Heading : 287|12@0+ (0.1,-180.0) [-180.0|180.0] "Deg" ASDM,PAS
 SG_ FrntRdrObj9ObjBoxCenterLat : 23|9@0+ (0.1,-25.0) [-25.0|25.0] "m" ASDM,PAS
 SG_ FrntRdrObj9ObjBoxCenterLgt : 30|9@0+ (0.1,-25.0) [-25.0|25.0] "m" ASDM,PAS
 SG_ FrntRdrObj9ObservationHist : 63|32@0+ (1.0,0.0) [0.0|4294967295.0] "Unitless" ASDM,PAS
 SG_ FrntRdrObj9RdrObjAx : 7|8@0- (0.1,0.0) [-12.8|12.700000000000001] "m/s^2" ASDM,PAS
 SG_ FrntRdrObj9RdrObjAy : 15|8@0- (0.1,0.0) [-12.8|12.700000000000001] "m/s^2" ASDM,PAS
 SG_ FrntRdrObj9RdrObjBoxLength : 37|9@0+ (0.1,0.0) [0.0|50.0] "m" ASDM,PAS
 SG_ FrntRdrObj9RdrObjBoxWidth : 44|9@0+ (0.1,0.0) [0.0|50.0] "m" ASDM,PAS
 SG_ FrntRdrObj9RdrObjChks : 95|8@0+ (1.0,0.0) [0.0|255.0] "Unitless" ASDM,PAS
 SG_ FrntRdrObj9RdrObjCntr : 103|4@0+ (1.0,0.0) [0.0|15.0] "Unitless" ASDM,PAS
 SG_ FrntRdrObj9RdrObjCoastCnt : 279|5@0+ (1.0,0.0) [0.0|31.0] "Unitless" ASDM,PAS
 SG_ FrntRdrObj9RdrObjConf : 99|4@0+ (7.0,0.0) [0.0|105.0] "%" ASDM,PAS
 SG_ FrntRdrObj9RdrObjDx : 191|13@0+ (0.05,-200.0) [-200.0|200.0] "m" ASDM,PAS
 SG_ FrntRdrObj9RdrObjDxStdDe : 111|8@0+ (0.05,0.0) [0.0|12.700000000000001] "m" ASDM,PAS
 SG_ FrntRdrObj9RdrObjDy : 119|13@0+ (0.05,-200.0) [-200.0|200.0] "m" ASDM,PAS
 SG_ FrntRdrObj9RdrObjDyStdDe : 183|8@0+ (0.05,0.0) [0.0|12.700000000000001] "m" ASDM,PAS
 SG_ FrntRdrObj9RdrObjElevnConf : 223|4@0+ (7.0,0.0) [0.0|105.0] "%" ASDM,PAS
 SG_ FrntRdrObj9RdrObjElevnSts : 153|2@0+ (1,0) [0|3] "" ASDM,PAS
 SG_ FrntRdrObj9RdrObjID : 167|8@0+ (1.0,0.0) [0.0|255.0] "Unitless" ASDM,PAS
 SG_ FrntRdrObj9RdrObjIsInFreeSpace : 192|1@0+ (1,0) [0|1] "" ASDM,PAS
 SG_ FrntRdrObj9RdrObjMirrProblty : 219|4@0+ (7.0,0.0) [0.0|105.0] "%" ASDM,PAS
 SG_ FrntRdrObj9RdrObjMtnPat : 122|3@0+ (1,0) [0|7] "" ASDM,PAS
 SG_ FrntRdrObj9RdrObjNotRealProblty : 231|4@0+ (7.0,0.0) [0.0|105.0] "%" ASDM,PAS
 SG_ FrntRdrObj9RdrObjStatyCnt : 239|7@0+ (1.0,0.0) [0.0|127.0] "Unitless" ASDM,PAS
 SG_ FrntRdrObj9RdrObjTiAlv : 247|7@0+ (1.0,0.0) [0.0|127.0] "Unitless" ASDM,PAS
 SG_ FrntRdrObj9RdrObjTrackSts : 194|2@0+ (1,0) [0|3] "" ASDM,PAS
 SG_ FrntRdrObj9RdrObjTyp : 51|4@0+ (1,0) [0|15] "" ASDM,PAS
 SG_ FrntRdrObj9RdrObjTypConfBike : 175|4@0+ (7.0,0.0) [0.0|105.0] "%" ASDM,PAS
 SG_ FrntRdrObj9RdrObjTypConfPed : 171|4@0+ (7.0,0.0) [0.0|105.0] "%" ASDM,PAS
 SG_ FrntRdrObj9RdrObjTypConfVeh : 227|4@0+ (7.0,0.0) [0.0|105.0] "%" ASDM,PAS
 SG_ FrntRdrObj9RdrObjVx : 255|14@0+ (0.02,-128.0) [-128.0|128.0] "m/s" ASDM,PAS
 SG_ FrntRdrObj9RdrObjVxStdDe : 271|6@0+ (0.05,0.0) [0.0|2.0] "m/s" ASDM,PAS
 SG_ FrntRdrObj9RdrObjVy : 207|14@0+ (0.02,-128.0) [-128.0|128.0] "m/s" ASDM,PAS
 SG_ FrntRdrObj9RdrObjVyStdDe : 159|6@0+ (0.05,0.0) [0.0|2.0] "m/s" ASDM,PAS
 SG_ FrntRdrObj9RelVx : 135|12@0+ (0.02,-35.6) [-35.6|35.6] "m/s" ASDM,PAS
 SG_ FrntRdrObj9RelVy : 139|12@0+ (0.02,-35.6) [-35.6|35.6] "m/s" ASDM,PAS

BO_ 390 FLRSafetyCANFD2Frame44: 64 FLR
 SG_ FrntRdrObj10_UB : 291|1@0+ (1,0) [0|1] "" ASDM,PAS
 SG_ FrntRdrObj10Heading : 287|12@0+ (0.1,-180.0) [-180.0|180.0] "Deg" ASDM,PAS
 SG_ FrntRdrObj10ObjBoxCenterLat : 23|9@0+ (0.1,-25.0) [-25.0|25.0] "m" ASDM,PAS
 SG_ FrntRdrObj10ObjBoxCenterLgt : 30|9@0+ (0.1,-25.0) [-25.0|25.0] "m" ASDM,PAS
 SG_ FrntRdrObj10ObservationHist : 63|32@0+ (1.0,0.0) [0.0|4294967295.0] "Unitless" ASDM,PAS
 SG_ FrntRdrObj10RdrObjAx : 7|8@0- (0.1,0.0) [-12.8|12.700000000000001] "m/s^2" ASDM,PAS
 SG_ FrntRdrObj10RdrObjAy : 15|8@0- (0.1,0.0) [-12.8|12.700000000000001] "m/s^2" ASDM,PAS
 SG_ FrntRdrObj10RdrObjBoxLength : 37|9@0+ (0.1,0.0) [0.0|50.0] "m" ASDM,PAS
 SG_ FrntRdrObj10RdrObjBoxWidth : 44|9@0+ (0.1,0.0) [0.0|50.0] "m" ASDM,PAS
 SG_ FrntRdrObj10RdrObjChks : 95|8@0+ (1.0,0.0) [0.0|255.0] "Unitless" ASDM,PAS
 SG_ FrntRdrObj10RdrObjCntr : 103|4@0+ (1.0,0.0) [0.0|15.0] "Unitless" ASDM,PAS
 SG_ FrntRdrObj10RdrObjCoastCnt : 279|5@0+ (1.0,0.0) [0.0|31.0] "Unitless" ASDM,PAS
 SG_ FrntRdrObj10RdrObjConf : 99|4@0+ (7.0,0.0) [0.0|105.0] "%" ASDM,PAS
 SG_ FrntRdrObj10RdrObjDx : 191|13@0+ (0.05,-200.0) [-200.0|200.0] "m" ASDM,PAS
 SG_ FrntRdrObj10RdrObjDxStdDe : 111|8@0+ (0.05,0.0) [0.0|12.700000000000001] "m" ASDM,PAS
 SG_ FrntRdrObj10RdrObjDy : 119|13@0+ (0.05,-200.0) [-200.0|200.0] "m" ASDM,PAS
 SG_ FrntRdrObj10RdrObjDyStdDe : 183|8@0+ (0.05,0.0) [0.0|12.700000000000001] "m" ASDM,PAS
 SG_ FrntRdrObj10RdrObjElevnConf : 223|4@0+ (7.0,0.0) [0.0|105.0] "%" ASDM,PAS
 SG_ FrntRdrObj10RdrObjElevnSts : 153|2@0+ (1,0) [0|3] "" ASDM,PAS
 SG_ FrntRdrObj10RdrObjID : 167|8@0+ (1.0,0.0) [0.0|255.0] "Unitless" ASDM,PAS
 SG_ FrntRdrObj10RdrObjIsInFreeSpace : 192|1@0+ (1,0) [0|1] "" ASDM,PAS
 SG_ FrntRdrObj10RdrObjMirrProblty : 219|4@0+ (7.0,0.0) [0.0|105.0] "%" ASDM,PAS
 SG_ FrntRdrObj10RdrObjMtnPat : 122|3@0+ (1,0) [0|7] "" ASDM,PAS
 SG_ FrntRdrObj10RdrObjNotRealProblty : 231|4@0+ (7.0,0.0) [0.0|105.0] "%" ASDM,PAS
 SG_ FrntRdrObj10RdrObjStatyCnt : 239|7@0+ (1.0,0.0) [0.0|127.0] "Unitless" ASDM,PAS
 SG_ FrntRdrObj10RdrObjTiAlv : 247|7@0+ (1.0,0.0) [0.0|127.0] "Unitless" ASDM,PAS
 SG_ FrntRdrObj10RdrObjTrackSts : 194|2@0+ (1,0) [0|3] "" ASDM,PAS
 SG_ FrntRdrObj10RdrObjTyp : 51|4@0+ (1,0) [0|15] "" ASDM,PAS
 SG_ FrntRdrObj10RdrObjTypConfBike : 175|4@0+ (7.0,0.0) [0.0|105.0] "%" ASDM,PAS
 SG_ FrntRdrObj10RdrObjTypConfPed : 171|4@0+ (7.0,0.0) [0.0|105.0] "%" ASDM,PAS
 SG_ FrntRdrObj10RdrObjTypConfVeh : 227|4@0+ (7.0,0.0) [0.0|105.0] "%" ASDM,PAS
 SG_ FrntRdrObj10RdrObjVx : 255|14@0+ (0.02,-128.0) [-128.0|128.0] "m/s" ASDM,PAS
 SG_ FrntRdrObj10RdrObjVxStdDe : 271|6@0+ (0.05,0.0) [0.0|2.0] "m/s" ASDM,PAS
 SG_ FrntRdrObj10RdrObjVy : 207|14@0+ (0.02,-128.0) [-128.0|128.0] "m/s" ASDM,PAS
 SG_ FrntRdrObj10RdrObjVyStdDe : 159|6@0+ (0.05,0.0) [0.0|2.0] "m/s" ASDM,PAS
 SG_ FrntRdrObj10RelVx : 135|12@0+ (0.02,-35.6) [-35.6|35.6] "m/s" ASDM,PAS
 SG_ FrntRdrObj10RelVy : 139|12@0+ (0.02,-35.6) [-35.6|35.6] "m/s" ASDM,PAS

BO_ 392 FLRSafetyCANFD2Frame45: 64 FLR
 SG_ FrntRdrObj11_UB : 291|1@0+ (1,0) [0|1] "" ASDM,PAS
 SG_ FrntRdrObj11Heading : 287|12@0+ (0.1,-180.0) [-180.0|180.0] "Deg" ASDM,PAS
 SG_ FrntRdrObj11ObjBoxCenterLat : 23|9@0+ (0.1,-25.0) [-25.0|25.0] "m" ASDM,PAS
 SG_ FrntRdrObj11ObjBoxCenterLgt : 30|9@0+ (0.1,-25.0) [-25.0|25.0] "m" ASDM,PAS
 SG_ FrntRdrObj11ObservationHist : 63|32@0+ (1.0,0.0) [0.0|4294967295.0] "Unitless" ASDM,PAS
 SG_ FrntRdrObj11RdrObjAx : 7|8@0- (0.1,0.0) [-12.8|12.700000000000001] "m/s^2" ASDM,PAS
 SG_ FrntRdrObj11RdrObjAy : 15|8@0- (0.1,0.0) [-12.8|12.700000000000001] "m/s^2" ASDM,PAS
 SG_ FrntRdrObj11RdrObjBoxLength : 37|9@0+ (0.1,0.0) [0.0|50.0] "m" ASDM,PAS
 SG_ FrntRdrObj11RdrObjBoxWidth : 44|9@0+ (0.1,0.0) [0.0|50.0] "m" ASDM,PAS
 SG_ FrntRdrObj11RdrObjChks : 95|8@0+ (1.0,0.0) [0.0|255.0] "Unitless" ASDM,PAS
 SG_ FrntRdrObj11RdrObjCntr : 103|4@0+ (1.0,0.0) [0.0|15.0] "Unitless" ASDM,PAS
 SG_ FrntRdrObj11RdrObjCoastCnt : 279|5@0+ (1.0,0.0) [0.0|31.0] "Unitless" ASDM,PAS
 SG_ FrntRdrObj11RdrObjConf : 99|4@0+ (7.0,0.0) [0.0|105.0] "%" ASDM,PAS
 SG_ FrntRdrObj11RdrObjDx : 191|13@0+ (0.05,-200.0) [-200.0|200.0] "m" ASDM,PAS
 SG_ FrntRdrObj11RdrObjDxStdDe : 111|8@0+ (0.05,0.0) [0.0|12.700000000000001] "m" ASDM,PAS
 SG_ FrntRdrObj11RdrObjDy : 119|13@0+ (0.05,-200.0) [-200.0|200.0] "m" ASDM,PAS
 SG_ FrntRdrObj11RdrObjDyStdDe : 183|8@0+ (0.05,0.0) [0.0|12.700000000000001] "m" ASDM,PAS
 SG_ FrntRdrObj11RdrObjElevnConf : 223|4@0+ (7.0,0.0) [0.0|105.0] "%" ASDM,PAS
 SG_ FrntRdrObj11RdrObjElevnSts : 153|2@0+ (1,0) [0|3] "" ASDM,PAS
 SG_ FrntRdrObj11RdrObjID : 167|8@0+ (1.0,0.0) [0.0|255.0] "Unitless" ASDM,PAS
 SG_ FrntRdrObj11RdrObjIsInFreeSpace : 192|1@0+ (1,0) [0|1] "" ASDM,PAS
 SG_ FrntRdrObj11RdrObjMirrProblty : 219|4@0+ (7.0,0.0) [0.0|105.0] "%" ASDM,PAS
 SG_ FrntRdrObj11RdrObjMtnPat : 122|3@0+ (1,0) [0|7] "" ASDM,PAS
 SG_ FrntRdrObj11RdrObjNotRealProblty : 231|4@0+ (7.0,0.0) [0.0|105.0] "%" ASDM,PAS
 SG_ FrntRdrObj11RdrObjStatyCnt : 239|7@0+ (1.0,0.0) [0.0|127.0] "Unitless" ASDM,PAS
 SG_ FrntRdrObj11RdrObjTiAlv : 247|7@0+ (1.0,0.0) [0.0|127.0] "Unitless" ASDM,PAS
 SG_ FrntRdrObj11RdrObjTrackSts : 194|2@0+ (1,0) [0|3] "" ASDM,PAS
 SG_ FrntRdrObj11RdrObjTyp : 51|4@0+ (1,0) [0|15] "" ASDM,PAS
 SG_ FrntRdrObj11RdrObjTypConfBike : 175|4@0+ (7.0,0.0) [0.0|105.0] "%" ASDM,PAS
 SG_ FrntRdrObj11RdrObjTypConfPed : 171|4@0+ (7.0,0.0) [0.0|105.0] "%" ASDM,PAS
 SG_ FrntRdrObj11RdrObjTypConfVeh : 227|4@0+ (7.0,0.0) [0.0|105.0] "%" ASDM,PAS
 SG_ FrntRdrObj11RdrObjVx : 255|14@0+ (0.02,-128.0) [-128.0|128.0] "m/s" ASDM,PAS
 SG_ FrntRdrObj11RdrObjVxStdDe : 271|6@0+ (0.05,0.0) [0.0|2.0] "m/s" ASDM,PAS
 SG_ FrntRdrObj11RdrObjVy : 207|14@0+ (0.02,-128.0) [-128.0|128.0] "m/s" ASDM,PAS
 SG_ FrntRdrObj11RdrObjVyStdDe : 159|6@0+ (0.05,0.0) [0.0|2.0] "m/s" ASDM,PAS
 SG_ FrntRdrObj11RelVx : 135|12@0+ (0.02,-35.6) [-35.6|35.6] "m/s" ASDM,PAS
 SG_ FrntRdrObj11RelVy : 139|12@0+ (0.02,-35.6) [-35.6|35.6] "m/s" ASDM,PAS

BO_ 394 FLRSafetyCANFD2Frame46: 64 FLR
 SG_ FrntRdrObj12_UB : 291|1@0+ (1,0) [0|1] "" ASDM,PAS
 SG_ FrntRdrObj12Heading : 287|12@0+ (0.1,-180.0) [-180.0|180.0] "Deg" ASDM,PAS
 SG_ FrntRdrObj12ObjBoxCenterLat : 23|9@0+ (0.1,-25.0) [-25.0|25.0] "m" ASDM,PAS
 SG_ FrntRdrObj12ObjBoxCenterLgt : 30|9@0+ (0.1,-25.0) [-25.0|25.0] "m" ASDM,PAS
 SG_ FrntRdrObj12ObservationHist : 63|32@0+ (1.0,0.0) [0.0|4294967295.0] "Unitless" ASDM,PAS
 SG_ FrntRdrObj12RdrObjAx : 7|8@0- (0.1,0.0) [-12.8|12.700000000000001] "m/s^2" ASDM,PAS
 SG_ FrntRdrObj12RdrObjAy : 15|8@0- (0.1,0.0) [-12.8|12.700000000000001] "m/s^2" ASDM,PAS
 SG_ FrntRdrObj12RdrObjBoxLength : 37|9@0+ (0.1,0.0) [0.0|50.0] "m" ASDM,PAS
 SG_ FrntRdrObj12RdrObjBoxWidth : 44|9@0+ (0.1,0.0) [0.0|50.0] "m" ASDM,PAS
 SG_ FrntRdrObj12RdrObjChks : 95|8@0+ (1.0,0.0) [0.0|255.0] "Unitless" ASDM,PAS
 SG_ FrntRdrObj12RdrObjCntr : 103|4@0+ (1.0,0.0) [0.0|15.0] "Unitless" ASDM,PAS
 SG_ FrntRdrObj12RdrObjCoastCnt : 279|5@0+ (1.0,0.0) [0.0|31.0] "Unitless" ASDM,PAS
 SG_ FrntRdrObj12RdrObjConf : 99|4@0+ (7.0,0.0) [0.0|105.0] "%" ASDM,PAS
 SG_ FrntRdrObj12RdrObjDx : 191|13@0+ (0.05,-200.0) [-200.0|200.0] "m" ASDM,PAS
 SG_ FrntRdrObj12RdrObjDxStdDe : 111|8@0+ (0.05,0.0) [0.0|12.700000000000001] "m" ASDM,PAS
 SG_ FrntRdrObj12RdrObjDy : 119|13@0+ (0.05,-200.0) [-200.0|200.0] "m" ASDM,PAS
 SG_ FrntRdrObj12RdrObjDyStdDe : 183|8@0+ (0.05,0.0) [0.0|12.700000000000001] "m" ASDM,PAS
 SG_ FrntRdrObj12RdrObjElevnConf : 223|4@0+ (7.0,0.0) [0.0|105.0] "%" ASDM,PAS
 SG_ FrntRdrObj12RdrObjElevnSts : 153|2@0+ (1,0) [0|3] "" ASDM,PAS
 SG_ FrntRdrObj12RdrObjID : 167|8@0+ (1.0,0.0) [0.0|255.0] "Unitless" ASDM,PAS
 SG_ FrntRdrObj12RdrObjIsInFreeSpace : 192|1@0+ (1,0) [0|1] "" ASDM,PAS
 SG_ FrntRdrObj12RdrObjMirrProblty : 219|4@0+ (7.0,0.0) [0.0|105.0] "%" ASDM,PAS
 SG_ FrntRdrObj12RdrObjMtnPat : 122|3@0+ (1,0) [0|7] "" ASDM,PAS
 SG_ FrntRdrObj12RdrObjNotRealProblty : 231|4@0+ (7.0,0.0) [0.0|105.0] "%" ASDM,PAS
 SG_ FrntRdrObj12RdrObjStatyCnt : 239|7@0+ (1.0,0.0) [0.0|127.0] "Unitless" ASDM,PAS
 SG_ FrntRdrObj12RdrObjTiAlv : 247|7@0+ (1.0,0.0) [0.0|127.0] "Unitless" ASDM,PAS
 SG_ FrntRdrObj12RdrObjTrackSts : 194|2@0+ (1,0) [0|3] "" ASDM,PAS
 SG_ FrntRdrObj12RdrObjTyp : 51|4@0+ (1,0) [0|15] "" ASDM,PAS
 SG_ FrntRdrObj12RdrObjTypConfBike : 175|4@0+ (7.0,0.0) [0.0|105.0] "%" ASDM,PAS
 SG_ FrntRdrObj12RdrObjTypConfPed : 171|4@0+ (7.0,0.0) [0.0|105.0] "%" ASDM,PAS
 SG_ FrntRdrObj12RdrObjTypConfVeh : 227|4@0+ (7.0,0.0) [0.0|105.0] "%" ASDM,PAS
 SG_ FrntRdrObj12RdrObjVx : 255|14@0+ (0.02,-128.0) [-128.0|128.0] "m/s" ASDM,PAS
 SG_ FrntRdrObj12RdrObjVxStdDe : 271|6@0+ (0.05,0.0) [0.0|2.0] "m/s" ASDM,PAS
 SG_ FrntRdrObj12RdrObjVy : 207|14@0+ (0.02,-128.0) [-128.0|128.0] "m/s" ASDM,PAS
 SG_ FrntRdrObj12RdrObjVyStdDe : 159|6@0+ (0.05,0.0) [0.0|2.0] "m/s" ASDM,PAS
 SG_ FrntRdrObj12RelVx : 135|12@0+ (0.02,-35.6) [-35.6|35.6] "m/s" ASDM,PAS
 SG_ FrntRdrObj12RelVy : 139|12@0+ (0.02,-35.6) [-35.6|35.6] "m/s" ASDM,PAS

BO_ 396 FLRSafetyCANFD2Frame47: 64 FLR
 SG_ FrntRdrObj13_UB : 291|1@0+ (1,0) [0|1] "" ASDM,PAS
 SG_ FrntRdrObj13Heading : 287|12@0+ (0.1,-180.0) [-180.0|180.0] "Deg" ASDM,PAS
 SG_ FrntRdrObj13ObjBoxCenterLat : 23|9@0+ (0.1,-25.0) [-25.0|25.0] "m" ASDM,PAS
 SG_ FrntRdrObj13ObjBoxCenterLgt : 30|9@0+ (0.1,-25.0) [-25.0|25.0] "m" ASDM,PAS
 SG_ FrntRdrObj13ObservationHist : 63|32@0+ (1.0,0.0) [0.0|4294967295.0] "Unitless" ASDM,PAS
 SG_ FrntRdrObj13RdrObjAx : 7|8@0- (0.1,0.0) [-12.8|12.700000000000001] "m/s^2" ASDM,PAS
 SG_ FrntRdrObj13RdrObjAy : 15|8@0- (0.1,0.0) [-12.8|12.700000000000001] "m/s^2" ASDM,PAS
 SG_ FrntRdrObj13RdrObjBoxLength : 37|9@0+ (0.1,0.0) [0.0|50.0] "m" ASDM,PAS
 SG_ FrntRdrObj13RdrObjBoxWidth : 44|9@0+ (0.1,0.0) [0.0|50.0] "m" ASDM,PAS
 SG_ FrntRdrObj13RdrObjChks : 95|8@0+ (1.0,0.0) [0.0|255.0] "Unitless" ASDM,PAS
 SG_ FrntRdrObj13RdrObjCntr : 103|4@0+ (1.0,0.0) [0.0|15.0] "Unitless" ASDM,PAS
 SG_ FrntRdrObj13RdrObjCoastCnt : 279|5@0+ (1.0,0.0) [0.0|31.0] "Unitless" ASDM,PAS
 SG_ FrntRdrObj13RdrObjConf : 99|4@0+ (7.0,0.0) [0.0|105.0] "%" ASDM,PAS
 SG_ FrntRdrObj13RdrObjDx : 191|13@0+ (0.05,-200.0) [-200.0|200.0] "m" ASDM,PAS
 SG_ FrntRdrObj13RdrObjDxStdDe : 111|8@0+ (0.05,0.0) [0.0|12.700000000000001] "m" ASDM,PAS
 SG_ FrntRdrObj13RdrObjDy : 119|13@0+ (0.05,-200.0) [-200.0|200.0] "m" ASDM,PAS
 SG_ FrntRdrObj13RdrObjDyStdDe : 183|8@0+ (0.05,0.0) [0.0|12.700000000000001] "m" ASDM,PAS
 SG_ FrntRdrObj13RdrObjElevnConf : 223|4@0+ (7.0,0.0) [0.0|105.0] "%" ASDM,PAS
 SG_ FrntRdrObj13RdrObjElevnSts : 153|2@0+ (1,0) [0|3] "" ASDM,PAS
 SG_ FrntRdrObj13RdrObjID : 167|8@0+ (1.0,0.0) [0.0|255.0] "Unitless" ASDM,PAS
 SG_ FrntRdrObj13RdrObjIsInFreeSpace : 192|1@0+ (1,0) [0|1] "" ASDM,PAS
 SG_ FrntRdrObj13RdrObjMirrProblty : 219|4@0+ (7.0,0.0) [0.0|105.0] "%" ASDM,PAS
 SG_ FrntRdrObj13RdrObjMtnPat : 122|3@0+ (1,0) [0|7] "" ASDM,PAS
 SG_ FrntRdrObj13RdrObjNotRealProblty : 231|4@0+ (7.0,0.0) [0.0|105.0] "%" ASDM,PAS
 SG_ FrntRdrObj13RdrObjStatyCnt : 239|7@0+ (1.0,0.0) [0.0|127.0] "Unitless" ASDM,PAS
 SG_ FrntRdrObj13RdrObjTiAlv : 247|7@0+ (1.0,0.0) [0.0|127.0] "Unitless" ASDM,PAS
 SG_ FrntRdrObj13RdrObjTrackSts : 194|2@0+ (1,0) [0|3] "" ASDM,PAS
 SG_ FrntRdrObj13RdrObjTyp : 51|4@0+ (1,0) [0|15] "" ASDM,PAS
 SG_ FrntRdrObj13RdrObjTypConfBike : 175|4@0+ (7.0,0.0) [0.0|105.0] "%" ASDM,PAS
 SG_ FrntRdrObj13RdrObjTypConfPed : 171|4@0+ (7.0,0.0) [0.0|105.0] "%" ASDM,PAS
 SG_ FrntRdrObj13RdrObjTypConfVeh : 227|4@0+ (7.0,0.0) [0.0|105.0] "%" ASDM,PAS
 SG_ FrntRdrObj13RdrObjVx : 255|14@0+ (0.02,-128.0) [-128.0|128.0] "m/s" ASDM,PAS
 SG_ FrntRdrObj13RdrObjVxStdDe : 271|6@0+ (0.05,0.0) [0.0|2.0] "m/s" ASDM,PAS
 SG_ FrntRdrObj13RdrObjVy : 207|14@0+ (0.02,-128.0) [-128.0|128.0] "m/s" ASDM,PAS
 SG_ FrntRdrObj13RdrObjVyStdDe : 159|6@0+ (0.05,0.0) [0.0|2.0] "m/s" ASDM,PAS
 SG_ FrntRdrObj13RelVx : 135|12@0+ (0.02,-35.6) [-35.6|35.6] "m/s" ASDM,PAS
 SG_ FrntRdrObj13RelVy : 139|12@0+ (0.02,-35.6) [-35.6|35.6] "m/s" ASDM,PAS

BO_ 398 FLRSafetyCANFD2Frame48: 64 FLR
 SG_ FrntRdrObj14_UB : 291|1@0+ (1,0) [0|1] "" ASDM,PAS
 SG_ FrntRdrObj14Heading : 287|12@0+ (0.1,-180.0) [-180.0|180.0] "Deg" ASDM,PAS
 SG_ FrntRdrObj14ObjBoxCenterLat : 23|9@0+ (0.1,-25.0) [-25.0|25.0] "m" ASDM,PAS
 SG_ FrntRdrObj14ObjBoxCenterLgt : 30|9@0+ (0.1,-25.0) [-25.0|25.0] "m" ASDM,PAS
 SG_ FrntRdrObj14ObservationHist : 63|32@0+ (1.0,0.0) [0.0|4294967295.0] "Unitless" ASDM,PAS
 SG_ FrntRdrObj14RdrObjAx : 7|8@0- (0.1,0.0) [-12.8|12.700000000000001] "m/s^2" ASDM,PAS
 SG_ FrntRdrObj14RdrObjAy : 15|8@0- (0.1,0.0) [-12.8|12.700000000000001] "m/s^2" ASDM,PAS
 SG_ FrntRdrObj14RdrObjBoxLength : 37|9@0+ (0.1,0.0) [0.0|50.0] "m" ASDM,PAS
 SG_ FrntRdrObj14RdrObjBoxWidth : 44|9@0+ (0.1,0.0) [0.0|50.0] "m" ASDM,PAS
 SG_ FrntRdrObj14RdrObjChks : 95|8@0+ (1.0,0.0) [0.0|255.0] "Unitless" ASDM,PAS
 SG_ FrntRdrObj14RdrObjCntr : 103|4@0+ (1.0,0.0) [0.0|15.0] "Unitless" ASDM,PAS
 SG_ FrntRdrObj14RdrObjCoastCnt : 279|5@0+ (1.0,0.0) [0.0|31.0] "Unitless" ASDM,PAS
 SG_ FrntRdrObj14RdrObjConf : 99|4@0+ (7.0,0.0) [0.0|105.0] "%" ASDM,PAS
 SG_ FrntRdrObj14RdrObjDx : 191|13@0+ (0.05,-200.0) [-200.0|200.0] "m" ASDM,PAS
 SG_ FrntRdrObj14RdrObjDxStdDe : 111|8@0+ (0.05,0.0) [0.0|12.700000000000001] "m" ASDM,PAS
 SG_ FrntRdrObj14RdrObjDy : 119|13@0+ (0.05,-200.0) [-200.0|200.0] "m" ASDM,PAS
 SG_ FrntRdrObj14RdrObjDyStdDe : 183|8@0+ (0.05,0.0) [0.0|12.700000000000001] "m" ASDM,PAS
 SG_ FrntRdrObj14RdrObjElevnConf : 223|4@0+ (7.0,0.0) [0.0|105.0] "%" ASDM,PAS
 SG_ FrntRdrObj14RdrObjElevnSts : 153|2@0+ (1,0) [0|3] "" ASDM,PAS
 SG_ FrntRdrObj14RdrObjID : 167|8@0+ (1.0,0.0) [0.0|255.0] "Unitless" ASDM,PAS
 SG_ FrntRdrObj14RdrObjIsInFreeSpace : 192|1@0+ (1,0) [0|1] "" ASDM,PAS
 SG_ FrntRdrObj14RdrObjMirrProblty : 219|4@0+ (7.0,0.0) [0.0|105.0] "%" ASDM,PAS
 SG_ FrntRdrObj14RdrObjMtnPat : 122|3@0+ (1,0) [0|7] "" ASDM,PAS
 SG_ FrntRdrObj14RdrObjNotRealProblty : 231|4@0+ (7.0,0.0) [0.0|105.0] "%" ASDM,PAS
 SG_ FrntRdrObj14RdrObjStatyCnt : 239|7@0+ (1.0,0.0) [0.0|127.0] "Unitless" ASDM,PAS
 SG_ FrntRdrObj14RdrObjTiAlv : 247|7@0+ (1.0,0.0) [0.0|127.0] "Unitless" ASDM,PAS
 SG_ FrntRdrObj14RdrObjTrackSts : 194|2@0+ (1,0) [0|3] "" ASDM,PAS
 SG_ FrntRdrObj14RdrObjTyp : 51|4@0+ (1,0) [0|15] "" ASDM,PAS
 SG_ FrntRdrObj14RdrObjTypConfBike : 175|4@0+ (7.0,0.0) [0.0|105.0] "%" ASDM,PAS
 SG_ FrntRdrObj14RdrObjTypConfPed : 171|4@0+ (7.0,0.0) [0.0|105.0] "%" ASDM,PAS
 SG_ FrntRdrObj14RdrObjTypConfVeh : 227|4@0+ (7.0,0.0) [0.0|105.0] "%" ASDM,PAS
 SG_ FrntRdrObj14RdrObjVx : 255|14@0+ (0.02,-128.0) [-128.0|128.0] "m/s" ASDM,PAS
 SG_ FrntRdrObj14RdrObjVxStdDe : 271|6@0+ (0.05,0.0) [0.0|2.0] "m/s" ASDM,PAS
 SG_ FrntRdrObj14RdrObjVy : 207|14@0+ (0.02,-128.0) [-128.0|128.0] "m/s" ASDM,PAS
 SG_ FrntRdrObj14RdrObjVyStdDe : 159|6@0+ (0.05,0.0) [0.0|2.0] "m/s" ASDM,PAS
 SG_ FrntRdrObj14RelVx : 135|12@0+ (0.02,-35.6) [-35.6|35.6] "m/s" ASDM,PAS
 SG_ FrntRdrObj14RelVy : 139|12@0+ (0.02,-35.6) [-35.6|35.6] "m/s" ASDM,PAS

BO_ 400 FLRSafetyCANFD2Frame49: 64 FLR
 SG_ FrntRdrObj15_UB : 291|1@0+ (1,0) [0|1] "" ASDM,PAS
 SG_ FrntRdrObj15Heading : 287|12@0+ (0.1,-180.0) [-180.0|180.0] "Deg" ASDM,PAS
 SG_ FrntRdrObj15ObjBoxCenterLat : 23|9@0+ (0.1,-25.0) [-25.0|25.0] "m" ASDM,PAS
 SG_ FrntRdrObj15ObjBoxCenterLgt : 30|9@0+ (0.1,-25.0) [-25.0|25.0] "m" ASDM,PAS
 SG_ FrntRdrObj15ObservationHist : 63|32@0+ (1.0,0.0) [0.0|4294967295.0] "Unitless" ASDM,PAS
 SG_ FrntRdrObj15RdrObjAx : 7|8@0- (0.1,0.0) [-12.8|12.700000000000001] "m/s^2" ASDM,PAS
 SG_ FrntRdrObj15RdrObjAy : 15|8@0- (0.1,0.0) [-12.8|12.700000000000001] "m/s^2" ASDM,PAS
 SG_ FrntRdrObj15RdrObjBoxLength : 37|9@0+ (0.1,0.0) [0.0|50.0] "m" ASDM,PAS
 SG_ FrntRdrObj15RdrObjBoxWidth : 44|9@0+ (0.1,0.0) [0.0|50.0] "m" ASDM,PAS
 SG_ FrntRdrObj15RdrObjChks : 95|8@0+ (1.0,0.0) [0.0|255.0] "Unitless" ASDM,PAS
 SG_ FrntRdrObj15RdrObjCntr : 103|4@0+ (1.0,0.0) [0.0|15.0] "Unitless" ASDM,PAS
 SG_ FrntRdrObj15RdrObjCoastCnt : 279|5@0+ (1.0,0.0) [0.0|31.0] "Unitless" ASDM,PAS
 SG_ FrntRdrObj15RdrObjConf : 99|4@0+ (7.0,0.0) [0.0|105.0] "%" ASDM,PAS
 SG_ FrntRdrObj15RdrObjDx : 191|13@0+ (0.05,-200.0) [-200.0|200.0] "m" ASDM,PAS
 SG_ FrntRdrObj15RdrObjDxStdDe : 111|8@0+ (0.05,0.0) [0.0|12.700000000000001] "m" ASDM,PAS
 SG_ FrntRdrObj15RdrObjDy : 119|13@0+ (0.05,-200.0) [-200.0|200.0] "m" ASDM,PAS
 SG_ FrntRdrObj15RdrObjDyStdDe : 183|8@0+ (0.05,0.0) [0.0|12.700000000000001] "m" ASDM,PAS
 SG_ FrntRdrObj15RdrObjElevnConf : 223|4@0+ (7.0,0.0) [0.0|105.0] "%" ASDM,PAS
 SG_ FrntRdrObj15RdrObjElevnSts : 153|2@0+ (1,0) [0|3] "" ASDM,PAS
 SG_ FrntRdrObj15RdrObjID : 167|8@0+ (1.0,0.0) [0.0|255.0] "Unitless" ASDM,PAS
 SG_ FrntRdrObj15RdrObjIsInFreeSpace : 192|1@0+ (1,0) [0|1] "" ASDM,PAS
 SG_ FrntRdrObj15RdrObjMirrProblty : 219|4@0+ (7.0,0.0) [0.0|105.0] "%" ASDM,PAS
 SG_ FrntRdrObj15RdrObjMtnPat : 122|3@0+ (1,0) [0|7] "" ASDM,PAS
 SG_ FrntRdrObj15RdrObjNotRealProblty : 231|4@0+ (7.0,0.0) [0.0|105.0] "%" ASDM,PAS
 SG_ FrntRdrObj15RdrObjStatyCnt : 239|7@0+ (1.0,0.0) [0.0|127.0] "Unitless" ASDM,PAS
 SG_ FrntRdrObj15RdrObjTiAlv : 247|7@0+ (1.0,0.0) [0.0|127.0] "Unitless" ASDM,PAS
 SG_ FrntRdrObj15RdrObjTrackSts : 194|2@0+ (1,0) [0|3] "" ASDM,PAS
 SG_ FrntRdrObj15RdrObjTyp : 51|4@0+ (1,0) [0|15] "" ASDM,PAS
 SG_ FrntRdrObj15RdrObjTypConfBike : 175|4@0+ (7.0,0.0) [0.0|105.0] "%" ASDM,PAS
 SG_ FrntRdrObj15RdrObjTypConfPed : 171|4@0+ (7.0,0.0) [0.0|105.0] "%" ASDM,PAS
 SG_ FrntRdrObj15RdrObjTypConfVeh : 227|4@0+ (7.0,0.0) [0.0|105.0] "%" ASDM,PAS
 SG_ FrntRdrObj15RdrObjVx : 255|14@0+ (0.02,-128.0) [-128.0|128.0] "m/s" ASDM,PAS
 SG_ FrntRdrObj15RdrObjVxStdDe : 271|6@0+ (0.05,0.0) [0.0|2.0] "m/s" ASDM,PAS
 SG_ FrntRdrObj15RdrObjVy : 207|14@0+ (0.02,-128.0) [-128.0|128.0] "m/s" ASDM,PAS
 SG_ FrntRdrObj15RdrObjVyStdDe : 159|6@0+ (0.05,0.0) [0.0|2.0] "m/s" ASDM,PAS
 SG_ FrntRdrObj15RelVx : 135|12@0+ (0.02,-35.6) [-35.6|35.6] "m/s" ASDM,PAS
 SG_ FrntRdrObj15RelVy : 139|12@0+ (0.02,-35.6) [-35.6|35.6] "m/s" ASDM,PAS

BO_ 402 FLRSafetyCANFD2Frame50: 64 FLR
 SG_ FrntRdrObj16_UB : 291|1@0+ (1,0) [0|1] "" ASDM,PAS
 SG_ FrntRdrObj16Heading : 287|12@0+ (0.1,-180.0) [-180.0|180.0] "Deg" ASDM,PAS
 SG_ FrntRdrObj16ObjBoxCenterLat : 23|9@0+ (0.1,-25.0) [-25.0|25.0] "m" ASDM,PAS
 SG_ FrntRdrObj16ObjBoxCenterLgt : 30|9@0+ (0.1,-25.0) [-25.0|25.0] "m" ASDM,PAS
 SG_ FrntRdrObj16ObservationHist : 63|32@0+ (1.0,0.0) [0.0|4294967295.0] "Unitless" ASDM,PAS
 SG_ FrntRdrObj16RdrObjAx : 7|8@0- (0.1,0.0) [-12.8|12.700000000000001] "m/s^2" ASDM,PAS
 SG_ FrntRdrObj16RdrObjAy : 15|8@0- (0.1,0.0) [-12.8|12.700000000000001] "m/s^2" ASDM,PAS
 SG_ FrntRdrObj16RdrObjBoxLength : 37|9@0+ (0.1,0.0) [0.0|50.0] "m" ASDM,PAS
 SG_ FrntRdrObj16RdrObjBoxWidth : 44|9@0+ (0.1,0.0) [0.0|50.0] "m" ASDM,PAS
 SG_ FrntRdrObj16RdrObjChks : 95|8@0+ (1.0,0.0) [0.0|255.0] "Unitless" ASDM,PAS
 SG_ FrntRdrObj16RdrObjCntr : 103|4@0+ (1.0,0.0) [0.0|15.0] "Unitless" ASDM,PAS
 SG_ FrntRdrObj16RdrObjCoastCnt : 279|5@0+ (1.0,0.0) [0.0|31.0] "Unitless" ASDM,PAS
 SG_ FrntRdrObj16RdrObjConf : 99|4@0+ (7.0,0.0) [0.0|105.0] "%" ASDM,PAS
 SG_ FrntRdrObj16RdrObjDx : 191|13@0+ (0.05,-200.0) [-200.0|200.0] "m" ASDM,PAS
 SG_ FrntRdrObj16RdrObjDxStdDe : 111|8@0+ (0.05,0.0) [0.0|12.700000000000001] "m" ASDM,PAS
 SG_ FrntRdrObj16RdrObjDy : 119|13@0+ (0.05,-200.0) [-200.0|200.0] "m" ASDM,PAS
 SG_ FrntRdrObj16RdrObjDyStdDe : 183|8@0+ (0.05,0.0) [0.0|12.700000000000001] "m" ASDM,PAS
 SG_ FrntRdrObj16RdrObjElevnConf : 223|4@0+ (7.0,0.0) [0.0|105.0] "%" ASDM,PAS
 SG_ FrntRdrObj16RdrObjElevnSts : 153|2@0+ (1,0) [0|3] "" ASDM,PAS
 SG_ FrntRdrObj16RdrObjID : 167|8@0+ (1.0,0.0) [0.0|255.0] "Unitless" ASDM,PAS
 SG_ FrntRdrObj16RdrObjIsInFreeSpace : 192|1@0+ (1,0) [0|1] "" ASDM,PAS
 SG_ FrntRdrObj16RdrObjMirrProblty : 219|4@0+ (7.0,0.0) [0.0|105.0] "%" ASDM,PAS
 SG_ FrntRdrObj16RdrObjMtnPat : 122|3@0+ (1,0) [0|7] "" ASDM,PAS
 SG_ FrntRdrObj16RdrObjNotRealProblty : 231|4@0+ (7.0,0.0) [0.0|105.0] "%" ASDM,PAS
 SG_ FrntRdrObj16RdrObjStatyCnt : 239|7@0+ (1.0,0.0) [0.0|127.0] "Unitless" ASDM,PAS
 SG_ FrntRdrObj16RdrObjTiAlv : 247|7@0+ (1.0,0.0) [0.0|127.0] "Unitless" ASDM,PAS
 SG_ FrntRdrObj16RdrObjTrackSts : 194|2@0+ (1,0) [0|3] "" ASDM,PAS
 SG_ FrntRdrObj16RdrObjTyp : 51|4@0+ (1,0) [0|15] "" ASDM,PAS
 SG_ FrntRdrObj16RdrObjTypConfBike : 175|4@0+ (7.0,0.0) [0.0|105.0] "%" ASDM,PAS
 SG_ FrntRdrObj16RdrObjTypConfPed : 171|4@0+ (7.0,0.0) [0.0|105.0] "%" ASDM,PAS
 SG_ FrntRdrObj16RdrObjTypConfVeh : 227|4@0+ (7.0,0.0) [0.0|105.0] "%" ASDM,PAS
 SG_ FrntRdrObj16RdrObjVx : 255|14@0+ (0.02,-128.0) [-128.0|128.0] "m/s" ASDM,PAS
 SG_ FrntRdrObj16RdrObjVxStdDe : 271|6@0+ (0.05,0.0) [0.0|2.0] "m/s" ASDM,PAS
 SG_ FrntRdrObj16RdrObjVy : 207|14@0+ (0.02,-128.0) [-128.0|128.0] "m/s" ASDM,PAS
 SG_ FrntRdrObj16RdrObjVyStdDe : 159|6@0+ (0.05,0.0) [0.0|2.0] "m/s" ASDM,PAS
 SG_ FrntRdrObj16RelVx : 135|12@0+ (0.02,-35.6) [-35.6|35.6] "m/s" ASDM,PAS
 SG_ FrntRdrObj16RelVy : 139|12@0+ (0.02,-35.6) [-35.6|35.6] "m/s" ASDM,PAS

BO_ 404 FLRSafetyCANFD2Frame51: 64 FLR
 SG_ FrntRdrObj17_UB : 291|1@0+ (1,0) [0|1] "" ASDM,PAS
 SG_ FrntRdrObj17Heading : 287|12@0+ (0.1,-180.0) [-180.0|180.0] "Deg" ASDM,PAS
 SG_ FrntRdrObj17ObjBoxCenterLat : 23|9@0+ (0.1,-25.0) [-25.0|25.0] "m" ASDM,PAS
 SG_ FrntRdrObj17ObjBoxCenterLgt : 30|9@0+ (0.1,-25.0) [-25.0|25.0] "m" ASDM,PAS
 SG_ FrntRdrObj17ObservationHist : 63|32@0+ (1.0,0.0) [0.0|4294967295.0] "Unitless" ASDM,PAS
 SG_ FrntRdrObj17RdrObjAx : 7|8@0- (0.1,0.0) [-12.8|12.700000000000001] "m/s^2" ASDM,PAS
 SG_ FrntRdrObj17RdrObjAy : 15|8@0- (0.1,0.0) [-12.8|12.700000000000001] "m/s^2" ASDM,PAS
 SG_ FrntRdrObj17RdrObjBoxLength : 37|9@0+ (0.1,0.0) [0.0|50.0] "m" ASDM,PAS
 SG_ FrntRdrObj17RdrObjBoxWidth : 44|9@0+ (0.1,0.0) [0.0|50.0] "m" ASDM,PAS
 SG_ FrntRdrObj17RdrObjChks : 95|8@0+ (1.0,0.0) [0.0|255.0] "Unitless" ASDM,PAS
 SG_ FrntRdrObj17RdrObjCntr : 103|4@0+ (1.0,0.0) [0.0|15.0] "Unitless" ASDM,PAS
 SG_ FrntRdrObj17RdrObjCoastCnt : 279|5@0+ (1.0,0.0) [0.0|31.0] "Unitless" ASDM,PAS
 SG_ FrntRdrObj17RdrObjConf : 99|4@0+ (7.0,0.0) [0.0|105.0] "%" ASDM,PAS
 SG_ FrntRdrObj17RdrObjDx : 191|13@0+ (0.05,-200.0) [-200.0|200.0] "m" ASDM,PAS
 SG_ FrntRdrObj17RdrObjDxStdDe : 111|8@0+ (0.05,0.0) [0.0|12.700000000000001] "m" ASDM,PAS
 SG_ FrntRdrObj17RdrObjDy : 119|13@0+ (0.05,-200.0) [-200.0|200.0] "m" ASDM,PAS
 SG_ FrntRdrObj17RdrObjDyStdDe : 183|8@0+ (0.05,0.0) [0.0|12.700000000000001] "m" ASDM,PAS
 SG_ FrntRdrObj17RdrObjElevnConf : 223|4@0+ (7.0,0.0) [0.0|105.0] "%" ASDM,PAS
 SG_ FrntRdrObj17RdrObjElevnSts : 153|2@0+ (1,0) [0|3] "" ASDM,PAS
 SG_ FrntRdrObj17RdrObjID : 167|8@0+ (1.0,0.0) [0.0|255.0] "Unitless" ASDM,PAS
 SG_ FrntRdrObj17RdrObjIsInFreeSpace : 192|1@0+ (1,0) [0|1] "" ASDM,PAS
 SG_ FrntRdrObj17RdrObjMirrProblty : 219|4@0+ (7.0,0.0) [0.0|105.0] "%" ASDM,PAS
 SG_ FrntRdrObj17RdrObjMtnPat : 122|3@0+ (1,0) [0|7] "" ASDM,PAS
 SG_ FrntRdrObj17RdrObjNotRealProblty : 231|4@0+ (7.0,0.0) [0.0|105.0] "%" ASDM,PAS
 SG_ FrntRdrObj17RdrObjStatyCnt : 239|7@0+ (1.0,0.0) [0.0|127.0] "Unitless" ASDM,PAS
 SG_ FrntRdrObj17RdrObjTiAlv : 247|7@0+ (1.0,0.0) [0.0|127.0] "Unitless" ASDM,PAS
 SG_ FrntRdrObj17RdrObjTrackSts : 194|2@0+ (1,0) [0|3] "" ASDM,PAS
 SG_ FrntRdrObj17RdrObjTyp : 51|4@0+ (1,0) [0|15] "" ASDM,PAS
 SG_ FrntRdrObj17RdrObjTypConfBike : 175|4@0+ (7.0,0.0) [0.0|105.0] "%" ASDM,PAS
 SG_ FrntRdrObj17RdrObjTypConfPed : 171|4@0+ (7.0,0.0) [0.0|105.0] "%" ASDM,PAS
 SG_ FrntRdrObj17RdrObjTypConfVeh : 227|4@0+ (7.0,0.0) [0.0|105.0] "%" ASDM,PAS
 SG_ FrntRdrObj17RdrObjVx : 255|14@0+ (0.02,-128.0) [-128.0|128.0] "m/s" ASDM,PAS
 SG_ FrntRdrObj17RdrObjVxStdDe : 271|6@0+ (0.05,0.0) [0.0|2.0] "m/s" ASDM,PAS
 SG_ FrntRdrObj17RdrObjVy : 207|14@0+ (0.02,-128.0) [-128.0|128.0] "m/s" ASDM,PAS
 SG_ FrntRdrObj17RdrObjVyStdDe : 159|6@0+ (0.05,0.0) [0.0|2.0] "m/s" ASDM,PAS
 SG_ FrntRdrObj17RelVx : 135|12@0+ (0.02,-35.6) [-35.6|35.6] "m/s" ASDM,PAS
 SG_ FrntRdrObj17RelVy : 139|12@0+ (0.02,-35.6) [-35.6|35.6] "m/s" ASDM,PAS

CM_ SG_ 378 FrntRdrObj4Heading "Refer to the data element description in FrntRdrObj1 with the same data element name.";
CM_ SG_ 378 FrntRdrObj4ObjBoxCenterLat "Refer to the data element description in FrntRdrObj1 with the same data element name.";
CM_ SG_ 378 FrntRdrObj4ObjBoxCenterLgt "Refer to the data element description in FrntRdrObj1 with the same data element name.";
CM_ SG_ 378 FrntRdrObj4ObservationHist "Refer to the data element description in FrntRdrObj1 with the same data element name.";
CM_ SG_ 378 FrntRdrObj4RdrObjAx "Refer to the data element description in FrntRdrObj1 with the same data element name.";
CM_ SG_ 378 FrntRdrObj4RdrObjAy "Refer to the data element description in FrntRdrObj1 with the same data element name.";
CM_ SG_ 378 FrntRdrObj4RdrObjBoxLength "Refer to the data element description in FrntRdrObj1 with the same data element name.";
CM_ SG_ 378 FrntRdrObj4RdrObjBoxWidth "Refer to the data element description in FrntRdrObj1 with the same data element name.";
CM_ SG_ 378 FrntRdrObj4RdrObjChks "Refer to the data element description in FrntRdrObj1 with the same data element name.";
CM_ SG_ 378 FrntRdrObj4RdrObjCntr "Refer to the data element description in FrntRdrObj1 with the same data element name.";
CM_ SG_ 378 FrntRdrObj4RdrObjCoastCnt "Refer to the data element description in FrntRdrObj1 with the same data element name.";
CM_ SG_ 378 FrntRdrObj4RdrObjConf "Refer to the data element description in FrntRdrObj1 with the same data element name.";
CM_ SG_ 378 FrntRdrObj4RdrObjDx "Refer to the data element description in FrntRdrObj1 with the same data element name.";
CM_ SG_ 378 FrntRdrObj4RdrObjDxStdDe "Refer to the data element description in FrntRdrObj1 with the same data element name.";
CM_ SG_ 378 FrntRdrObj4RdrObjDy "Refer to the data element description in FrntRdrObj1 with the same data element name.";
CM_ SG_ 378 FrntRdrObj4RdrObjDyStdDe "Refer to the data element description in FrntRdrObj1 with the same data element name.";
CM_ SG_ 378 FrntRdrObj4RdrObjElevnConf "Refer to the data element description in FrntRdrObj1 with the same data element name.";
CM_ SG_ 378 FrntRdrObj4RdrObjElevnSts "Refer to the data element description in FrntRdrObj1 with the same data element name.";
CM_ SG_ 378 FrntRdrObj4RdrObjID "Refer to the data element description in FrntRdrObj1 with the same data element name.";
CM_ SG_ 378 FrntRdrObj4RdrObjIsInFreeSpace "Refer to the data element description in FrntRdrObj1 with the same data element name.";
CM_ SG_ 378 FrntRdrObj4RdrObjMirrProblty "Refer to the data element description in FrntRdrObj1 with the same data element name.";
CM_ SG_ 378 FrntRdrObj4RdrObjMtnPat "Refer to the data element description in FrntRdrObj1 with the same data element name.";
CM_ SG_ 378 FrntRdrObj4RdrObjNotRealProblty "Refer to the data element description in FrntRdrObj1 with the same data element name.";
CM_ SG_ 378 FrntRdrObj4RdrObjStatyCnt "Refer to the data element description in FrntRdrObj1 with the same data element name.";
CM_ SG_ 378 FrntRdrObj4RdrObjTiAlv "Refer to the data element description in FrntRdrObj1 with the same data element name.";
CM_ SG_ 378 FrntRdrObj4RdrObjTrackSts "Refer to the data element description in FrntRdrObj1 with the same data element name.";
CM_ SG_ 378 FrntRdrObj4RdrObjTyp "Refer to the data element description in FrntRdrObj1 with the same data element name.";
CM_ SG_ 378 FrntRdrObj4RdrObjTypConfBike "Refer to the data element description in FrntRdrObj1 with the same data element name.";
CM_ SG_ 378 FrntRdrObj4RdrObjTypConfPed "Refer to the data element description in FrntRdrObj1 with the same data element name.";
CM_ SG_ 378 FrntRdrObj4RdrObjTypConfVeh "Refer to the data element description in FrntRdrObj1 with the same data element name.";
CM_ SG_ 378 FrntRdrObj4RdrObjVx "Refer to the data element description in FrntRdrObj1 with the same data element name.";
CM_ SG_ 378 FrntRdrObj4RdrObjVxStdDe "Refer to the data element description in FrntRdrObj1 with the same data element name.";
CM_ SG_ 378 FrntRdrObj4RdrObjVy "Refer to the data element description in FrntRdrObj1 with the same data element name.";
CM_ SG_ 378 FrntRdrObj4RdrObjVyStdDe "Refer to the data element description in FrntRdrObj1 with the same data element name.";
CM_ SG_ 378 FrntRdrObj4RelVx "Refer to the data element description in FrntRdrObj1 with the same data element name.";
CM_ SG_ 378 FrntRdrObj4RelVy "Refer to the data element description in FrntRdrObj1 with the same data element name.";
CM_ SG_ 380 FrntRdrObj5Heading "Refer to the data element description in FrntRdrObj1 with the same data element name.";
CM_ SG_ 380 FrntRdrObj5ObjBoxCenterLat "Refer to the data element description in FrntRdrObj1 with the same data element name.";
CM_ SG_ 380 FrntRdrObj5ObjBoxCenterLgt "Refer to the data element description in FrntRdrObj1 with the same data element name.";
CM_ SG_ 380 FrntRdrObj5ObservationHist "Refer to the data element description in FrntRdrObj1 with the same data element name.";
CM_ SG_ 380 FrntRdrObj5RdrObjAx "Refer to the data element description in FrntRdrObj1 with the same data element name.";
CM_ SG_ 380 FrntRdrObj5RdrObjAy "Refer to the data element description in FrntRdrObj1 with the same data element name.";
CM_ SG_ 380 FrntRdrObj5RdrObjBoxLength "Refer to the data element description in FrntRdrObj1 with the same data element name.";
CM_ SG_ 380 FrntRdrObj5RdrObjBoxWidth "Refer to the data element description in FrntRdrObj1 with the same data element name.";
CM_ SG_ 380 FrntRdrObj5RdrObjChks "Refer to the data element description in FrntRdrObj1 with the same data element name.";
CM_ SG_ 380 FrntRdrObj5RdrObjCntr "Refer to the data element description in FrntRdrObj1 with the same data element name.";
CM_ SG_ 380 FrntRdrObj5RdrObjCoastCnt "Refer to the data element description in FrntRdrObj1 with the same data element name.";
CM_ SG_ 380 FrntRdrObj5RdrObjConf "Refer to the data element description in FrntRdrObj1 with the same data element name.";
CM_ SG_ 380 FrntRdrObj5RdrObjDx "Refer to the data element description in FrntRdrObj1 with the same data element name.";
CM_ SG_ 380 FrntRdrObj5RdrObjDxStdDe "Refer to the data element description in FrntRdrObj1 with the same data element name.";
CM_ SG_ 380 FrntRdrObj5RdrObjDy "Refer to the data element description in FrntRdrObj1 with the same data element name.";
CM_ SG_ 380 FrntRdrObj5RdrObjDyStdDe "Refer to the data element description in FrntRdrObj1 with the same data element name.";
CM_ SG_ 380 FrntRdrObj5RdrObjElevnConf "Refer to the data element description in FrntRdrObj1 with the same data element name.";
CM_ SG_ 380 FrntRdrObj5RdrObjElevnSts "Refer to the data element description in FrntRdrObj1 with the same data element name.";
CM_ SG_ 380 FrntRdrObj5RdrObjID "Refer to the data element description in FrntRdrObj1 with the same data element name.";
CM_ SG_ 380 FrntRdrObj5RdrObjIsInFreeSpace "Refer to the data element description in FrntRdrObj1 with the same data element name.";
CM_ SG_ 380 FrntRdrObj5RdrObjMirrProblty "Refer to the data element description in FrntRdrObj1 with the same data element name.";
CM_ SG_ 380 FrntRdrObj5RdrObjMtnPat "Refer to the data element description in FrntRdrObj1 with the same data element name.";
CM_ SG_ 380 FrntRdrObj5RdrObjNotRealProblty "Refer to the data element description in FrntRdrObj1 with the same data element name.";
CM_ SG_ 380 FrntRdrObj5RdrObjStatyCnt "Refer to the data element description in FrntRdrObj1 with the same data element name.";
CM_ SG_ 380 FrntRdrObj5RdrObjTiAlv "Refer to the data element description in FrntRdrObj1 with the same data element name.";
CM_ SG_ 380 FrntRdrObj5RdrObjTrackSts "Refer to the data element description in FrntRdrObj1 with the same data element name.";
CM_ SG_ 380 FrntRdrObj5RdrObjTyp "Refer to the data element description in FrntRdrObj1 with the same data element name.";
CM_ SG_ 380 FrntRdrObj5RdrObjTypConfBike "Refer to the data element description in FrntRdrObj1 with the same data element name.";
CM_ SG_ 380 FrntRdrObj5RdrObjTypConfPed "Refer to the data element description in FrntRdrObj1 with the same data element name.";
CM_ SG_ 380 FrntRdrObj5RdrObjTypConfVeh "Refer to the data element description in FrntRdrObj1 with the same data element name.";
CM_ SG_ 380 FrntRdrObj5RdrObjVx "Refer to the data element description in FrntRdrObj1 with the same data element name.";
CM_ SG_ 380 FrntRdrObj5RdrObjVxStdDe "Refer to the data element description in FrntRdrObj1 with the same data element name.";
CM_ SG_ 380 FrntRdrObj5RdrObjVy "Refer to the data element description in FrntRdrObj1 with the same data element name.";
CM_ SG_ 380 FrntRdrObj5RdrObjVyStdDe "Refer to the data element description in FrntRdrObj1 with the same data element name.";
CM_ SG_ 380 FrntRdrObj5RelVx "Refer to the data element description in FrntRdrObj1 with the same data element name.";
CM_ SG_ 380 FrntRdrObj5RelVy "Refer to the data element description in FrntRdrObj1 with the same data element name.";
CM_ SG_ 382 FrntRdrObj6Heading "Refer to the data element description in FrntRdrObj1 with the same data element name.";
CM_ SG_ 382 FrntRdrObj6ObjBoxCenterLat "Refer to the data element description in FrntRdrObj1 with the same data element name.";
CM_ SG_ 382 FrntRdrObj6ObjBoxCenterLgt "Refer to the data element description in FrntRdrObj1 with the same data element name.";
CM_ SG_ 382 FrntRdrObj6ObservationHist "Refer to the data element description in FrntRdrObj1 with the same data element name.";
CM_ SG_ 382 FrntRdrObj6RdrObjAx "Refer to the data element description in FrntRdrObj1 with the same data element name.";
CM_ SG_ 382 FrntRdrObj6RdrObjAy "Refer to the data element description in FrntRdrObj1 with the same data element name.";
CM_ SG_ 382 FrntRdrObj6RdrObjBoxLength "Refer to the data element description in FrntRdrObj1 with the same data element name.";
CM_ SG_ 382 FrntRdrObj6RdrObjBoxWidth "Refer to the data element description in FrntRdrObj1 with the same data element name.";
CM_ SG_ 382 FrntRdrObj6RdrObjChks "Refer to the data element description in FrntRdrObj1 with the same data element name.";
CM_ SG_ 382 FrntRdrObj6RdrObjCntr "Refer to the data element description in FrntRdrObj1 with the same data element name.";
CM_ SG_ 382 FrntRdrObj6RdrObjCoastCnt "Refer to the data element description in FrntRdrObj1 with the same data element name.";
CM_ SG_ 382 FrntRdrObj6RdrObjConf "Refer to the data element description in FrntRdrObj1 with the same data element name.";
CM_ SG_ 382 FrntRdrObj6RdrObjDx "Refer to the data element description in FrntRdrObj1 with the same data element name.";
CM_ SG_ 382 FrntRdrObj6RdrObjDxStdDe "Refer to the data element description in FrntRdrObj1 with the same data element name.";
CM_ SG_ 382 FrntRdrObj6RdrObjDy "Refer to the data element description in FrntRdrObj1 with the same data element name.";
CM_ SG_ 382 FrntRdrObj6RdrObjDyStdDe "Refer to the data element description in FrntRdrObj1 with the same data element name.";
CM_ SG_ 382 FrntRdrObj6RdrObjElevnConf "Refer to the data element description in FrntRdrObj1 with the same data element name.";
CM_ SG_ 382 FrntRdrObj6RdrObjElevnSts "Refer to the data element description in FrntRdrObj1 with the same data element name.";
CM_ SG_ 382 FrntRdrObj6RdrObjID "Refer to the data element description in FrntRdrObj1 with the same data element name.";
CM_ SG_ 382 FrntRdrObj6RdrObjIsInFreeSpace "Refer to the data element description in FrntRdrObj1 with the same data element name.";
CM_ SG_ 382 FrntRdrObj6RdrObjMirrProblty "Refer to the data element description in FrntRdrObj1 with the same data element name.";
CM_ SG_ 382 FrntRdrObj6RdrObjMtnPat "Refer to the data element description in FrntRdrObj1 with the same data element name.";
CM_ SG_ 382 FrntRdrObj6RdrObjNotRealProblty "Refer to the data element description in FrntRdrObj1 with the same data element name.";
CM_ SG_ 382 FrntRdrObj6RdrObjStatyCnt "Refer to the data element description in FrntRdrObj1 with the same data element name.";
CM_ SG_ 382 FrntRdrObj6RdrObjTiAlv "Refer to the data element description in FrntRdrObj1 with the same data element name.";
CM_ SG_ 382 FrntRdrObj6RdrObjTrackSts "Refer to the data element description in FrntRdrObj1 with the same data element name.";
CM_ SG_ 382 FrntRdrObj6RdrObjTyp "Refer to the data element description in FrntRdrObj1 with the same data element name.";
CM_ SG_ 382 FrntRdrObj6RdrObjTypConfBike "Refer to the data element description in FrntRdrObj1 with the same data element name.";
CM_ SG_ 382 FrntRdrObj6RdrObjTypConfPed "Refer to the data element description in FrntRdrObj1 with the same data element name.";
CM_ SG_ 382 FrntRdrObj6RdrObjTypConfVeh "Refer to the data element description in FrntRdrObj1 with the same data element name.";
CM_ SG_ 382 FrntRdrObj6RdrObjVx "Refer to the data element description in FrntRdrObj1 with the same data element name.";
CM_ SG_ 382 FrntRdrObj6RdrObjVxStdDe "Refer to the data element description in FrntRdrObj1 with the same data element name.";
CM_ SG_ 382 FrntRdrObj6RdrObjVy "Refer to the data element description in FrntRdrObj1 with the same data element name.";
CM_ SG_ 382 FrntRdrObj6RdrObjVyStdDe "Refer to the data element description in FrntRdrObj1 with the same data element name.";
CM_ SG_ 382 FrntRdrObj6RelVx "Refer to the data element description in FrntRdrObj1 with the same data element name.";
CM_ SG_ 382 FrntRdrObj6RelVy "Refer to the data element description in FrntRdrObj1 with the same data element name.";
CM_ SG_ 384 FrntRdrObj7Heading "Refer to the data element description in FrntRdrObj1 with the same data element name.";
CM_ SG_ 384 FrntRdrObj7ObjBoxCenterLat "Refer to the data element description in FrntRdrObj1 with the same data element name.";
CM_ SG_ 384 FrntRdrObj7ObjBoxCenterLgt "Refer to the data element description in FrntRdrObj1 with the same data element name.";
CM_ SG_ 384 FrntRdrObj7ObservationHist "Refer to the data element description in FrntRdrObj1 with the same data element name.";
CM_ SG_ 384 FrntRdrObj7RdrObjAx "Refer to the data element description in FrntRdrObj1 with the same data element name.";
CM_ SG_ 384 FrntRdrObj7RdrObjAy "Refer to the data element description in FrntRdrObj1 with the same data element name.";
CM_ SG_ 384 FrntRdrObj7RdrObjBoxLength "Refer to the data element description in FrntRdrObj1 with the same data element name.";
CM_ SG_ 384 FrntRdrObj7RdrObjBoxWidth "Refer to the data element description in FrntRdrObj1 with the same data element name.";
CM_ SG_ 384 FrntRdrObj7RdrObjChks "Refer to the data element description in FrntRdrObj1 with the same data element name.";
CM_ SG_ 384 FrntRdrObj7RdrObjCntr "Refer to the data element description in FrntRdrObj1 with the same data element name.";
CM_ SG_ 384 FrntRdrObj7RdrObjCoastCnt "Refer to the data element description in FrntRdrObj1 with the same data element name.";
CM_ SG_ 384 FrntRdrObj7RdrObjConf "Refer to the data element description in FrntRdrObj1 with the same data element name.";
CM_ SG_ 384 FrntRdrObj7RdrObjDx "Refer to the data element description in FrntRdrObj1 with the same data element name.";
CM_ SG_ 384 FrntRdrObj7RdrObjDxStdDe "Refer to the data element description in FrntRdrObj1 with the same data element name.";
CM_ SG_ 384 FrntRdrObj7RdrObjDy "Refer to the data element description in FrntRdrObj1 with the same data element name.";
CM_ SG_ 384 FrntRdrObj7RdrObjDyStdDe "Refer to the data element description in FrntRdrObj1 with the same data element name.";
CM_ SG_ 384 FrntRdrObj7RdrObjElevnConf "Refer to the data element description in FrntRdrObj1 with the same data element name.";
CM_ SG_ 384 FrntRdrObj7RdrObjElevnSts "Refer to the data element description in FrntRdrObj1 with the same data element name.";
CM_ SG_ 384 FrntRdrObj7RdrObjID "Refer to the data element description in FrntRdrObj1 with the same data element name.";
CM_ SG_ 384 FrntRdrObj7RdrObjIsInFreeSpace "Refer to the data element description in FrntRdrObj1 with the same data element name.";
CM_ SG_ 384 FrntRdrObj7RdrObjMirrProblty "Refer to the data element description in FrntRdrObj1 with the same data element name.";
CM_ SG_ 384 FrntRdrObj7RdrObjMtnPat "Refer to the data element description in FrntRdrObj1 with the same data element name.";
CM_ SG_ 384 FrntRdrObj7RdrObjNotRealProblty "Refer to the data element description in FrntRdrObj1 with the same data element name.";
CM_ SG_ 384 FrntRdrObj7RdrObjStatyCnt "Refer to the data element description in FrntRdrObj1 with the same data element name.";
CM_ SG_ 384 FrntRdrObj7RdrObjTiAlv "Refer to the data element description in FrntRdrObj1 with the same data element name.";
CM_ SG_ 384 FrntRdrObj7RdrObjTrackSts "Refer to the data element description in FrntRdrObj1 with the same data element name.";
CM_ SG_ 384 FrntRdrObj7RdrObjTyp "Refer to the data element description in FrntRdrObj1 with the same data element name.";
CM_ SG_ 384 FrntRdrObj7RdrObjTypConfBike "Refer to the data element description in FrntRdrObj1 with the same data element name.";
CM_ SG_ 384 FrntRdrObj7RdrObjTypConfPed "Refer to the data element description in FrntRdrObj1 with the same data element name.";
CM_ SG_ 384 FrntRdrObj7RdrObjTypConfVeh "Refer to the data element description in FrntRdrObj1 with the same data element name.";
CM_ SG_ 384 FrntRdrObj7RdrObjVx "Refer to the data element description in FrntRdrObj1 with the same data element name.";
CM_ SG_ 384 FrntRdrObj7RdrObjVxStdDe "Refer to the data element description in FrntRdrObj1 with the same data element name.";
CM_ SG_ 384 FrntRdrObj7RdrObjVy "Refer to the data element description in FrntRdrObj1 with the same data element name.";
CM_ SG_ 384 FrntRdrObj7RdrObjVyStdDe "Refer to the data element description in FrntRdrObj1 with the same data element name.";
CM_ SG_ 384 FrntRdrObj7RelVx "Refer to the data element description in FrntRdrObj1 with the same data element name.";
CM_ SG_ 384 FrntRdrObj7RelVy "Refer to the data element description in FrntRdrObj1 with the same data element name.";
CM_ SG_ 386 FrntRdrObj8Heading "Refer to the data element description in FrntRdrObj1 with the same data element name.";
CM_ SG_ 386 FrntRdrObj8ObjBoxCenterLat "Refer to the data element description in FrntRdrObj1 with the same data element name.";
CM_ SG_ 386 FrntRdrObj8ObjBoxCenterLgt "Refer to the data element description in FrntRdrObj1 with the same data element name.";
CM_ SG_ 386 FrntRdrObj8ObservationHist "Refer to the data element description in FrntRdrObj1 with the same data element name.";
CM_ SG_ 386 FrntRdrObj8RdrObjAx "Refer to the data element description in FrntRdrObj1 with the same data element name.";
CM_ SG_ 386 FrntRdrObj8RdrObjAy "Refer to the data element description in FrntRdrObj1 with the same data element name.";
CM_ SG_ 386 FrntRdrObj8RdrObjBoxLength "Refer to the data element description in FrntRdrObj1 with the same data element name.";
CM_ SG_ 386 FrntRdrObj8RdrObjBoxWidth "Refer to the data element description in FrntRdrObj1 with the same data element name.";
CM_ SG_ 386 FrntRdrObj8RdrObjChks "Refer to the data element description in FrntRdrObj1 with the same data element name.";
CM_ SG_ 386 FrntRdrObj8RdrObjCntr "Refer to the data element description in FrntRdrObj1 with the same data element name.";
CM_ SG_ 386 FrntRdrObj8RdrObjCoastCnt "Refer to the data element description in FrntRdrObj1 with the same data element name.";
CM_ SG_ 386 FrntRdrObj8RdrObjConf "Refer to the data element description in FrntRdrObj1 with the same data element name.";
CM_ SG_ 386 FrntRdrObj8RdrObjDx "Refer to the data element description in FrntRdrObj1 with the same data element name.";
CM_ SG_ 386 FrntRdrObj8RdrObjDxStdDe "Refer to the data element description in FrntRdrObj1 with the same data element name.";
CM_ SG_ 386 FrntRdrObj8RdrObjDy "Refer to the data element description in FrntRdrObj1 with the same data element name.";
CM_ SG_ 386 FrntRdrObj8RdrObjDyStdDe "Refer to the data element description in FrntRdrObj1 with the same data element name.";
CM_ SG_ 386 FrntRdrObj8RdrObjElevnConf "Refer to the data element description in FrntRdrObj1 with the same data element name.";
CM_ SG_ 386 FrntRdrObj8RdrObjElevnSts "Refer to the data element description in FrntRdrObj1 with the same data element name.";
CM_ SG_ 386 FrntRdrObj8RdrObjID "Refer to the data element description in FrntRdrObj1 with the same data element name.";
CM_ SG_ 386 FrntRdrObj8RdrObjIsInFreeSpace "Refer to the data element description in FrntRdrObj1 with the same data element name.";
CM_ SG_ 386 FrntRdrObj8RdrObjMirrProblty "Refer to the data element description in FrntRdrObj1 with the same data element name.";
CM_ SG_ 386 FrntRdrObj8RdrObjMtnPat "Refer to the data element description in FrntRdrObj1 with the same data element name.";
CM_ SG_ 386 FrntRdrObj8RdrObjNotRealProblty "Refer to the data element description in FrntRdrObj1 with the same data element name.";
CM_ SG_ 386 FrntRdrObj8RdrObjStatyCnt "Refer to the data element description in FrntRdrObj1 with the same data element name.";
CM_ SG_ 386 FrntRdrObj8RdrObjTiAlv "Refer to the data element description in FrntRdrObj1 with the same data element name.";
CM_ SG_ 386 FrntRdrObj8RdrObjTrackSts "Refer to the data element description in FrntRdrObj1 with the same data element name.";
CM_ SG_ 386 FrntRdrObj8RdrObjTyp "Refer to the data element description in FrntRdrObj1 with the same data element name.";
CM_ SG_ 386 FrntRdrObj8RdrObjTypConfBike "Refer to the data element description in FrntRdrObj1 with the same data element name.";
CM_ SG_ 386 FrntRdrObj8RdrObjTypConfPed "Refer to the data element description in FrntRdrObj1 with the same data element name.";
CM_ SG_ 386 FrntRdrObj8RdrObjTypConfVeh "Refer to the data element description in FrntRdrObj1 with the same data element name.";
CM_ SG_ 386 FrntRdrObj8RdrObjVx "Refer to the data element description in FrntRdrObj1 with the same data element name.";
CM_ SG_ 386 FrntRdrObj8RdrObjVxStdDe "Refer to the data element description in FrntRdrObj1 with the same data element name.";
CM_ SG_ 386 FrntRdrObj8RdrObjVy "Refer to the data element description in FrntRdrObj1 with the same data element name.";
CM_ SG_ 386 FrntRdrObj8RdrObjVyStdDe "Refer to the data element description in FrntRdrObj1 with the same data element name.";
CM_ SG_ 386 FrntRdrObj8RelVx "Refer to the data element description in FrntRdrObj1 with the same data element name.";
CM_ SG_ 386 FrntRdrObj8RelVy "Refer to the data element description in FrntRdrObj1 with the same data element name.";
CM_ SG_ 388 FrntRdrObj9Heading "Refer to the data element description in FrntRdrObj1 with the same data element name.";
CM_ SG_ 388 FrntRdrObj9ObjBoxCenterLat "Refer to the data element description in FrntRdrObj1 with the same data element name.";
CM_ SG_ 388 FrntRdrObj9ObjBoxCenterLgt "Refer to the data element description in FrntRdrObj1 with the same data element name.";
CM_ SG_ 388 FrntRdrObj9ObservationHist "Refer to the data element description in FrntRdrObj1 with the same data element name.";
CM_ SG_ 388 FrntRdrObj9RdrObjAx "Refer to the data element description in FrntRdrObj1 with the same data element name.";
CM_ SG_ 388 FrntRdrObj9RdrObjAy "Refer to the data element description in FrntRdrObj1 with the same data element name.";
CM_ SG_ 388 FrntRdrObj9RdrObjBoxLength "Refer to the data element description in FrntRdrObj1 with the same data element name.";
CM_ SG_ 388 FrntRdrObj9RdrObjBoxWidth "Refer to the data element description in FrntRdrObj1 with the same data element name.";
CM_ SG_ 388 FrntRdrObj9RdrObjChks "Refer to the data element description in FrntRdrObj1 with the same data element name.";
CM_ SG_ 388 FrntRdrObj9RdrObjCntr "Refer to the data element description in FrntRdrObj1 with the same data element name.";
CM_ SG_ 388 FrntRdrObj9RdrObjCoastCnt "Refer to the data element description in FrntRdrObj1 with the same data element name.";
CM_ SG_ 388 FrntRdrObj9RdrObjConf "Refer to the data element description in FrntRdrObj1 with the same data element name.";
CM_ SG_ 388 FrntRdrObj9RdrObjDx "Refer to the data element description in FrntRdrObj1 with the same data element name.";
CM_ SG_ 388 FrntRdrObj9RdrObjDxStdDe "Refer to the data element description in FrntRdrObj1 with the same data element name.";
CM_ SG_ 388 FrntRdrObj9RdrObjDy "Refer to the data element description in FrntRdrObj1 with the same data element name.";
CM_ SG_ 388 FrntRdrObj9RdrObjDyStdDe "Refer to the data element description in FrntRdrObj1 with the same data element name.";
CM_ SG_ 388 FrntRdrObj9RdrObjElevnConf "Refer to the data element description in FrntRdrObj1 with the same data element name.";
CM_ SG_ 388 FrntRdrObj9RdrObjElevnSts "Refer to the data element description in FrntRdrObj1 with the same data element name.";
CM_ SG_ 388 FrntRdrObj9RdrObjID "Refer to the data element description in FrntRdrObj1 with the same data element name.";
CM_ SG_ 388 FrntRdrObj9RdrObjIsInFreeSpace "Refer to the data element description in FrntRdrObj1 with the same data element name.";
CM_ SG_ 388 FrntRdrObj9RdrObjMirrProblty "Refer to the data element description in FrntRdrObj1 with the same data element name.";
CM_ SG_ 388 FrntRdrObj9RdrObjMtnPat "Refer to the data element description in FrntRdrObj1 with the same data element name.";
CM_ SG_ 388 FrntRdrObj9RdrObjNotRealProblty "Refer to the data element description in FrntRdrObj1 with the same data element name.";
CM_ SG_ 388 FrntRdrObj9RdrObjStatyCnt "Refer to the data element description in FrntRdrObj1 with the same data element name.";
CM_ SG_ 388 FrntRdrObj9RdrObjTiAlv "Refer to the data element description in FrntRdrObj1 with the same data element name.";
CM_ SG_ 388 FrntRdrObj9RdrObjTrackSts "Refer to the data element description in FrntRdrObj1 with the same data element name.";
CM_ SG_ 388 FrntRdrObj9RdrObjTyp "Refer to the data element description in FrntRdrObj1 with the same data element name.";
CM_ SG_ 388 FrntRdrObj9RdrObjTypConfBike "Refer to the data element description in FrntRdrObj1 with the same data element name.";
CM_ SG_ 388 FrntRdrObj9RdrObjTypConfPed "Refer to the data element description in FrntRdrObj1 with the same data element name.";
CM_ SG_ 388 FrntRdrObj9RdrObjTypConfVeh "Refer to the data element description in FrntRdrObj1 with the same data element name.";
CM_ SG_ 388 FrntRdrObj9RdrObjVx "Refer to the data element description in FrntRdrObj1 with the same data element name.";
CM_ SG_ 388 FrntRdrObj9RdrObjVxStdDe "Refer to the data element description in FrntRdrObj1 with the same data element name.";
CM_ SG_ 388 FrntRdrObj9RdrObjVy "Refer to the data element description in FrntRdrObj1 with the same data element name.";
CM_ SG_ 388 FrntRdrObj9RdrObjVyStdDe "Refer to the data element description in FrntRdrObj1 with the same data element name.";
CM_ SG_ 388 FrntRdrObj9RelVx "Refer to the data element description in FrntRdrObj1 with the same data element name.";
CM_ SG_ 388 FrntRdrObj9RelVy "Refer to the data element description in FrntRdrObj1 with the same data element name.";
CM_ SG_ 390 FrntRdrObj10Heading "Refer to the data element description in FrntRdrObj1 with the same data element name.";
CM_ SG_ 390 FrntRdrObj10ObjBoxCenterLat "Refer to the data element description in FrntRdrObj1 with the same data element name.";
CM_ SG_ 390 FrntRdrObj10ObjBoxCenterLgt "Refer to the data element description in FrntRdrObj1 with the same data element name.";
CM_ SG_ 390 FrntRdrObj10ObservationHist "Refer to the data element description in FrntRdrObj1 with the same data element name.";
CM_ SG_ 390 FrntRdrObj10RdrObjAx "Refer to the data element description in FrntRdrObj1 with the same data element name.";
CM_ SG_ 390 FrntRdrObj10RdrObjAy "Refer to the data element description in FrntRdrObj1 with the same data element name.";
CM_ SG_ 390 FrntRdrObj10RdrObjBoxLength "Refer to the data element description in FrntRdrObj1 with the same data element name.";
CM_ SG_ 390 FrntRdrObj10RdrObjBoxWidth "Refer to the data element description in FrntRdrObj1 with the same data element name.";
CM_ SG_ 390 FrntRdrObj10RdrObjChks "Refer to the data element description in FrntRdrObj1 with the same data element name.";
CM_ SG_ 390 FrntRdrObj10RdrObjCntr "Refer to the data element description in FrntRdrObj1 with the same data element name.";
CM_ SG_ 390 FrntRdrObj10RdrObjCoastCnt "Refer to the data element description in FrntRdrObj1 with the same data element name.";
CM_ SG_ 390 FrntRdrObj10RdrObjConf "Refer to the data element description in FrntRdrObj1 with the same data element name.";
CM_ SG_ 390 FrntRdrObj10RdrObjDx "Refer to the data element description in FrntRdrObj1 with the same data element name.";
CM_ SG_ 390 FrntRdrObj10RdrObjDxStdDe "Refer to the data element description in FrntRdrObj1 with the same data element name.";
CM_ SG_ 390 FrntRdrObj10RdrObjDy "Refer to the data element description in FrntRdrObj1 with the same data element name.";
CM_ SG_ 390 FrntRdrObj10RdrObjDyStdDe "Refer to the data element description in FrntRdrObj1 with the same data element name.";
CM_ SG_ 390 FrntRdrObj10RdrObjElevnConf "Refer to the data element description in FrntRdrObj1 with the same data element name.";
CM_ SG_ 390 FrntRdrObj10RdrObjElevnSts "Refer to the data element description in FrntRdrObj1 with the same data element name.";
CM_ SG_ 390 FrntRdrObj10RdrObjID "Refer to the data element description in FrntRdrObj1 with the same data element name.";
CM_ SG_ 390 FrntRdrObj10RdrObjIsInFreeSpace "Refer to the data element description in FrntRdrObj1 with the same data element name.";
CM_ SG_ 390 FrntRdrObj10RdrObjMirrProblty "Refer to the data element description in FrntRdrObj1 with the same data element name.";
CM_ SG_ 390 FrntRdrObj10RdrObjMtnPat "Refer to the data element description in FrntRdrObj1 with the same data element name.";
CM_ SG_ 390 FrntRdrObj10RdrObjNotRealProblty "Refer to the data element description in FrntRdrObj1 with the same data element name.";
CM_ SG_ 390 FrntRdrObj10RdrObjStatyCnt "Refer to the data element description in FrntRdrObj1 with the same data element name.";
CM_ SG_ 390 FrntRdrObj10RdrObjTiAlv "Refer to the data element description in FrntRdrObj1 with the same data element name.";
CM_ SG_ 390 FrntRdrObj10RdrObjTrackSts "Refer to the data element description in FrntRdrObj1 with the same data element name.";
CM_ SG_ 390 FrntRdrObj10RdrObjTyp "Refer to the data element description in FrntRdrObj1 with the same data element name.";
CM_ SG_ 390 FrntRdrObj10RdrObjTypConfBike "Refer to the data element description in FrntRdrObj1 with the same data element name.";
CM_ SG_ 390 FrntRdrObj10RdrObjTypConfPed "Refer to the data element description in FrntRdrObj1 with the same data element name.";
CM_ SG_ 390 FrntRdrObj10RdrObjTypConfVeh "Refer to the data element description in FrntRdrObj1 with the same data element name.";
CM_ SG_ 390 FrntRdrObj10RdrObjVx "Refer to the data element description in FrntRdrObj1 with the same data element name.";
CM_ SG_ 390 FrntRdrObj10RdrObjVxStdDe "Refer to the data element description in FrntRdrObj1 with the same data element name.";
CM_ SG_ 390 FrntRdrObj10RdrObjVy "Refer to the data element description in FrntRdrObj1 with the same data element name.";
CM_ SG_ 390 FrntRdrObj10RdrObjVyStdDe "Refer to the data element description in FrntRdrObj1 with the same data element name.";
CM_ SG_ 390 FrntRdrObj10RelVx "Refer to the data element description in FrntRdrObj1 with the same data element name.";
CM_ SG_ 390 FrntRdrObj10RelVy "Refer to the data element description in FrntRdrObj1 with the same data element name.";
CM_ SG_ 392 FrntRdrObj11Heading "Refer to the data element description in FrntRdrObj1 with the same data element name.";
CM_ SG_ 392 FrntRdrObj11ObjBoxCenterLat "Refer to the data element description in FrntRdrObj1 with the same data element name.";
CM_ SG_ 392 FrntRdrObj11ObjBoxCenterLgt "Refer to the data element description in FrntRdrObj1 with the same data element name.";
CM_ SG_ 392 FrntRdrObj11ObservationHist "Refer to the data element description in FrntRdrObj1 with the same data element name.";
CM_ SG_ 392 FrntRdrObj11RdrObjAx "Refer to the data element description in FrntRdrObj1 with the same data element name.";
CM_ SG_ 392 FrntRdrObj11RdrObjAy "Refer to the data element description in FrntRdrObj1 with the same data element name.";
CM_ SG_ 392 FrntRdrObj11RdrObjBoxLength "Refer to the data element description in FrntRdrObj1 with the same data element name.";
CM_ SG_ 392 FrntRdrObj11RdrObjBoxWidth "Refer to the data element description in FrntRdrObj1 with the same data element name.";
CM_ SG_ 392 FrntRdrObj11RdrObjChks "Refer to the data element description in FrntRdrObj1 with the same data element name.";
CM_ SG_ 392 FrntRdrObj11RdrObjCntr "Refer to the data element description in FrntRdrObj1 with the same data element name.";
CM_ SG_ 392 FrntRdrObj11RdrObjCoastCnt "Refer to the data element description in FrntRdrObj1 with the same data element name.";
CM_ SG_ 392 FrntRdrObj11RdrObjConf "Refer to the data element description in FrntRdrObj1 with the same data element name.";
CM_ SG_ 392 FrntRdrObj11RdrObjDx "Refer to the data element description in FrntRdrObj1 with the same data element name.";
CM_ SG_ 392 FrntRdrObj11RdrObjDxStdDe "Refer to the data element description in FrntRdrObj1 with the same data element name.";
CM_ SG_ 392 FrntRdrObj11RdrObjDy "Refer to the data element description in FrntRdrObj1 with the same data element name.";
CM_ SG_ 392 FrntRdrObj11RdrObjDyStdDe "Refer to the data element description in FrntRdrObj1 with the same data element name.";
CM_ SG_ 392 FrntRdrObj11RdrObjElevnConf "Refer to the data element description in FrntRdrObj1 with the same data element name.";
CM_ SG_ 392 FrntRdrObj11RdrObjElevnSts "Refer to the data element description in FrntRdrObj1 with the same data element name.";
CM_ SG_ 392 FrntRdrObj11RdrObjID "Refer to the data element description in FrntRdrObj1 with the same data element name.";
CM_ SG_ 392 FrntRdrObj11RdrObjIsInFreeSpace "Refer to the data element description in FrntRdrObj1 with the same data element name.";
CM_ SG_ 392 FrntRdrObj11RdrObjMirrProblty "Refer to the data element description in FrntRdrObj1 with the same data element name.";
CM_ SG_ 392 FrntRdrObj11RdrObjMtnPat "Refer to the data element description in FrntRdrObj1 with the same data element name.";
CM_ SG_ 392 FrntRdrObj11RdrObjNotRealProblty "Refer to the data element description in FrntRdrObj1 with the same data element name.";
CM_ SG_ 392 FrntRdrObj11RdrObjStatyCnt "Refer to the data element description in FrntRdrObj1 with the same data element name.";
CM_ SG_ 392 FrntRdrObj11RdrObjTiAlv "Refer to the data element description in FrntRdrObj1 with the same data element name.";
CM_ SG_ 392 FrntRdrObj11RdrObjTrackSts "Refer to the data element description in FrntRdrObj1 with the same data element name.";
CM_ SG_ 392 FrntRdrObj11RdrObjTyp "Refer to the data element description in FrntRdrObj1 with the same data element name.";
CM_ SG_ 392 FrntRdrObj11RdrObjTypConfBike "Refer to the data element description in FrntRdrObj1 with the same data element name.";
CM_ SG_ 392 FrntRdrObj11RdrObjTypConfPed "Refer to the data element description in FrntRdrObj1 with the same data element name.";
CM_ SG_ 392 FrntRdrObj11RdrObjTypConfVeh "Refer to the data element description in FrntRdrObj1 with the same data element name.";
CM_ SG_ 392 FrntRdrObj11RdrObjVx "Refer to the data element description in FrntRdrObj1 with the same data element name.";
CM_ SG_ 392 FrntRdrObj11RdrObjVxStdDe "Refer to the data element description in FrntRdrObj1 with the same data element name.";
CM_ SG_ 392 FrntRdrObj11RdrObjVy "Refer to the data element description in FrntRdrObj1 with the same data element name.";
CM_ SG_ 392 FrntRdrObj11RdrObjVyStdDe "Refer to the data element description in FrntRdrObj1 with the same data element name.";
CM_ SG_ 392 FrntRdrObj11RelVx "Refer to the data element description in FrntRdrObj1 with the same data element name.";
CM_ SG_ 392 FrntRdrObj11RelVy "Refer to the data element description in FrntRdrObj1 with the same data element name.";
CM_ SG_ 394 FrntRdrObj12Heading "Refer to the data element description in FrntRdrObj1 with the same data element name.";
CM_ SG_ 394 FrntRdrObj12ObjBoxCenterLat "Refer to the data element description in FrntRdrObj1 with the same data element name.";
CM_ SG_ 394 FrntRdrObj12ObjBoxCenterLgt "Refer to the data element description in FrntRdrObj1 with the same data element name.";
CM_ SG_ 394 FrntRdrObj12ObservationHist "Refer to the data element description in FrntRdrObj1 with the same data element name.";
CM_ SG_ 394 FrntRdrObj12RdrObjAx "Refer to the data element description in FrntRdrObj1 with the same data element name.";
CM_ SG_ 394 FrntRdrObj12RdrObjAy "Refer to the data element description in FrntRdrObj1 with the same data element name.";
CM_ SG_ 394 FrntRdrObj12RdrObjBoxLength "Refer to the data element description in FrntRdrObj1 with the same data element name.";
CM_ SG_ 394 FrntRdrObj12RdrObjBoxWidth "Refer to the data element description in FrntRdrObj1 with the same data element name.";
CM_ SG_ 394 FrntRdrObj12RdrObjChks "Refer to the data element description in FrntRdrObj1 with the same data element name.";
CM_ SG_ 394 FrntRdrObj12RdrObjCntr "Refer to the data element description in FrntRdrObj1 with the same data element name.";
CM_ SG_ 394 FrntRdrObj12RdrObjCoastCnt "Refer to the data element description in FrntRdrObj1 with the same data element name.";
CM_ SG_ 394 FrntRdrObj12RdrObjConf "Refer to the data element description in FrntRdrObj1 with the same data element name.";
CM_ SG_ 394 FrntRdrObj12RdrObjDx "Refer to the data element description in FrntRdrObj1 with the same data element name.";
CM_ SG_ 394 FrntRdrObj12RdrObjDxStdDe "Refer to the data element description in FrntRdrObj1 with the same data element name.";
CM_ SG_ 394 FrntRdrObj12RdrObjDy "Refer to the data element description in FrntRdrObj1 with the same data element name.";
CM_ SG_ 394 FrntRdrObj12RdrObjDyStdDe "Refer to the data element description in FrntRdrObj1 with the same data element name.";
CM_ SG_ 394 FrntRdrObj12RdrObjElevnConf "Refer to the data element description in FrntRdrObj1 with the same data element name.";
CM_ SG_ 394 FrntRdrObj12RdrObjElevnSts "Refer to the data element description in FrntRdrObj1 with the same data element name.";
CM_ SG_ 394 FrntRdrObj12RdrObjID "Refer to the data element description in FrntRdrObj1 with the same data element name.";
CM_ SG_ 394 FrntRdrObj12RdrObjIsInFreeSpace "Refer to the data element description in FrntRdrObj1 with the same data element name.";
CM_ SG_ 394 FrntRdrObj12RdrObjMirrProblty "Refer to the data element description in FrntRdrObj1 with the same data element name.";
CM_ SG_ 394 FrntRdrObj12RdrObjMtnPat "Refer to the data element description in FrntRdrObj1 with the same data element name.";
CM_ SG_ 394 FrntRdrObj12RdrObjNotRealProblty "Refer to the data element description in FrntRdrObj1 with the same data element name.";
CM_ SG_ 394 FrntRdrObj12RdrObjStatyCnt "Refer to the data element description in FrntRdrObj1 with the same data element name.";
CM_ SG_ 394 FrntRdrObj12RdrObjTiAlv "Refer to the data element description in FrntRdrObj1 with the same data element name.";
CM_ SG_ 394 FrntRdrObj12RdrObjTrackSts "Refer to the data element description in FrntRdrObj1 with the same data element name.";
CM_ SG_ 394 FrntRdrObj12RdrObjTyp "Refer to the data element description in FrntRdrObj1 with the same data element name.";
CM_ SG_ 394 FrntRdrObj12RdrObjTypConfBike "Refer to the data element description in FrntRdrObj1 with the same data element name.";
CM_ SG_ 394 FrntRdrObj12RdrObjTypConfPed "Refer to the data element description in FrntRdrObj1 with the same data element name.";
CM_ SG_ 394 FrntRdrObj12RdrObjTypConfVeh "Refer to the data element description in FrntRdrObj1 with the same data element name.";
CM_ SG_ 394 FrntRdrObj12RdrObjVx "Refer to the data element description in FrntRdrObj1 with the same data element name.";
CM_ SG_ 394 FrntRdrObj12RdrObjVxStdDe "Refer to the data element description in FrntRdrObj1 with the same data element name.";
CM_ SG_ 394 FrntRdrObj12RdrObjVy "Refer to the data element description in FrntRdrObj1 with the same data element name.";
CM_ SG_ 394 FrntRdrObj12RdrObjVyStdDe "Refer to the data element description in FrntRdrObj1 with the same data element name.";
CM_ SG_ 394 FrntRdrObj12RelVx "Refer to the data element description in FrntRdrObj1 with the same data element name.";
CM_ SG_ 394 FrntRdrObj12RelVy "Refer to the data element description in FrntRdrObj1 with the same data element name.";
CM_ SG_ 396 FrntRdrObj13Heading "Refer to the data element description in FrntRdrObj1 with the same data element name.";
CM_ SG_ 396 FrntRdrObj13ObjBoxCenterLat "Refer to the data element description in FrntRdrObj1 with the same data element name.";
CM_ SG_ 396 FrntRdrObj13ObjBoxCenterLgt "Refer to the data element description in FrntRdrObj1 with the same data element name.";
CM_ SG_ 396 FrntRdrObj13ObservationHist "Refer to the data element description in FrntRdrObj1 with the same data element name.";
CM_ SG_ 396 FrntRdrObj13RdrObjAx "Refer to the data element description in FrntRdrObj1 with the same data element name.";
CM_ SG_ 396 FrntRdrObj13RdrObjAy "Refer to the data element description in FrntRdrObj1 with the same data element name.";
CM_ SG_ 396 FrntRdrObj13RdrObjBoxLength "Refer to the data element description in FrntRdrObj1 with the same data element name.";
CM_ SG_ 396 FrntRdrObj13RdrObjBoxWidth "Refer to the data element description in FrntRdrObj1 with the same data element name.";
CM_ SG_ 396 FrntRdrObj13RdrObjChks "Refer to the data element description in FrntRdrObj1 with the same data element name.";
CM_ SG_ 396 FrntRdrObj13RdrObjCntr "Refer to the data element description in FrntRdrObj1 with the same data element name.";
CM_ SG_ 396 FrntRdrObj13RdrObjCoastCnt "Refer to the data element description in FrntRdrObj1 with the same data element name.";
CM_ SG_ 396 FrntRdrObj13RdrObjConf "Refer to the data element description in FrntRdrObj1 with the same data element name.";
CM_ SG_ 396 FrntRdrObj13RdrObjDx "Refer to the data element description in FrntRdrObj1 with the same data element name.";
CM_ SG_ 396 FrntRdrObj13RdrObjDxStdDe "Refer to the data element description in FrntRdrObj1 with the same data element name.";
CM_ SG_ 396 FrntRdrObj13RdrObjDy "Refer to the data element description in FrntRdrObj1 with the same data element name.";
CM_ SG_ 396 FrntRdrObj13RdrObjDyStdDe "Refer to the data element description in FrntRdrObj1 with the same data element name.";
CM_ SG_ 396 FrntRdrObj13RdrObjElevnConf "Refer to the data element description in FrntRdrObj1 with the same data element name.";
CM_ SG_ 396 FrntRdrObj13RdrObjElevnSts "Refer to the data element description in FrntRdrObj1 with the same data element name.";
CM_ SG_ 396 FrntRdrObj13RdrObjID "Refer to the data element description in FrntRdrObj1 with the same data element name.";
CM_ SG_ 396 FrntRdrObj13RdrObjIsInFreeSpace "Refer to the data element description in FrntRdrObj1 with the same data element name.";
CM_ SG_ 396 FrntRdrObj13RdrObjMirrProblty "Refer to the data element description in FrntRdrObj1 with the same data element name.";
CM_ SG_ 396 FrntRdrObj13RdrObjMtnPat "Refer to the data element description in FrntRdrObj1 with the same data element name.";
CM_ SG_ 396 FrntRdrObj13RdrObjNotRealProblty "Refer to the data element description in FrntRdrObj1 with the same data element name.";
CM_ SG_ 396 FrntRdrObj13RdrObjStatyCnt "Refer to the data element description in FrntRdrObj1 with the same data element name.";
CM_ SG_ 396 FrntRdrObj13RdrObjTiAlv "Refer to the data element description in FrntRdrObj1 with the same data element name.";
CM_ SG_ 396 FrntRdrObj13RdrObjTrackSts "Refer to the data element description in FrntRdrObj1 with the same data element name.";
CM_ SG_ 396 FrntRdrObj13RdrObjTyp "Refer to the data element description in FrntRdrObj1 with the same data element name.";
CM_ SG_ 396 FrntRdrObj13RdrObjTypConfBike "Refer to the data element description in FrntRdrObj1 with the same data element name.";
CM_ SG_ 396 FrntRdrObj13RdrObjTypConfPed "Refer to the data element description in FrntRdrObj1 with the same data element name.";
CM_ SG_ 396 FrntRdrObj13RdrObjTypConfVeh "Refer to the data element description in FrntRdrObj1 with the same data element name.";
CM_ SG_ 396 FrntRdrObj13RdrObjVx "Refer to the data element description in FrntRdrObj1 with the same data element name.";
CM_ SG_ 396 FrntRdrObj13RdrObjVxStdDe "Refer to the data element description in FrntRdrObj1 with the same data element name.";
CM_ SG_ 396 FrntRdrObj13RdrObjVy "Refer to the data element description in FrntRdrObj1 with the same data element name.";
CM_ SG_ 396 FrntRdrObj13RdrObjVyStdDe "Refer to the data element description in FrntRdrObj1 with the same data element name.";
CM_ SG_ 396 FrntRdrObj13RelVx "Refer to the data element description in FrntRdrObj1 with the same data element name.";
CM_ SG_ 396 FrntRdrObj13RelVy "Refer to the data element description in FrntRdrObj1 with the same data element name.";
CM_ SG_ 398 FrntRdrObj14Heading "Refer to the data element description in FrntRdrObj1 with the same data element name.";
CM_ SG_ 398 FrntRdrObj14ObjBoxCenterLat "Refer to the data element description in FrntRdrObj1 with the same data element name.";
CM_ SG_ 398 FrntRdrObj14ObjBoxCenterLgt "Refer to the data element description in FrntRdrObj1 with the same data element name.";
CM_ SG_ 398 FrntRdrObj14ObservationHist "Refer to the data element description in FrntRdrObj1 with the same data element name.";
CM_ SG_ 398 FrntRdrObj14RdrObjAx "Refer to the data element description in FrntRdrObj1 with the same data element name.";
CM_ SG_ 398 FrntRdrObj14RdrObjAy "Refer to the data element description in FrntRdrObj1 with the same data element name.";
CM_ SG_ 398 FrntRdrObj14RdrObjBoxLength "Refer to the data element description in FrntRdrObj1 with the same data element name.";
CM_ SG_ 398 FrntRdrObj14RdrObjBoxWidth "Refer to the data element description in FrntRdrObj1 with the same data element name.";
CM_ SG_ 398 FrntRdrObj14RdrObjChks "Refer to the data element description in FrntRdrObj1 with the same data element name.";
CM_ SG_ 398 FrntRdrObj14RdrObjCntr "Refer to the data element description in FrntRdrObj1 with the same data element name.";
CM_ SG_ 398 FrntRdrObj14RdrObjCoastCnt "Refer to the data element description in FrntRdrObj1 with the same data element name.";
CM_ SG_ 398 FrntRdrObj14RdrObjConf "Refer to the data element description in FrntRdrObj1 with the same data element name.";
CM_ SG_ 398 FrntRdrObj14RdrObjDx "Refer to the data element description in FrntRdrObj1 with the same data element name.";
CM_ SG_ 398 FrntRdrObj14RdrObjDxStdDe "Refer to the data element description in FrntRdrObj1 with the same data element name.";
CM_ SG_ 398 FrntRdrObj14RdrObjDy "Refer to the data element description in FrntRdrObj1 with the same data element name.";
CM_ SG_ 398 FrntRdrObj14RdrObjDyStdDe "Refer to the data element description in FrntRdrObj1 with the same data element name.";
CM_ SG_ 398 FrntRdrObj14RdrObjElevnConf "Refer to the data element description in FrntRdrObj1 with the same data element name.";
CM_ SG_ 398 FrntRdrObj14RdrObjElevnSts "Refer to the data element description in FrntRdrObj1 with the same data element name.";
CM_ SG_ 398 FrntRdrObj14RdrObjID "Refer to the data element description in FrntRdrObj1 with the same data element name.";
CM_ SG_ 398 FrntRdrObj14RdrObjIsInFreeSpace "Refer to the data element description in FrntRdrObj1 with the same data element name.";
CM_ SG_ 398 FrntRdrObj14RdrObjMirrProblty "Refer to the data element description in FrntRdrObj1 with the same data element name.";
CM_ SG_ 398 FrntRdrObj14RdrObjMtnPat "Refer to the data element description in FrntRdrObj1 with the same data element name.";
CM_ SG_ 398 FrntRdrObj14RdrObjNotRealProblty "Refer to the data element description in FrntRdrObj1 with the same data element name.";
CM_ SG_ 398 FrntRdrObj14RdrObjStatyCnt "Refer to the data element description in FrntRdrObj1 with the same data element name.";
CM_ SG_ 398 FrntRdrObj14RdrObjTiAlv "Refer to the data element description in FrntRdrObj1 with the same data element name.";
CM_ SG_ 398 FrntRdrObj14RdrObjTrackSts "Refer to the data element description in FrntRdrObj1 with the same data element name.";
CM_ SG_ 398 FrntRdrObj14RdrObjTyp "Refer to the data element description in FrntRdrObj1 with the same data element name.";
CM_ SG_ 398 FrntRdrObj14RdrObjTypConfBike "Refer to the data element description in FrntRdrObj1 with the same data element name.";
CM_ SG_ 398 FrntRdrObj14RdrObjTypConfPed "Refer to the data element description in FrntRdrObj1 with the same data element name.";
CM_ SG_ 398 FrntRdrObj14RdrObjTypConfVeh "Refer to the data element description in FrntRdrObj1 with the same data element name.";
CM_ SG_ 398 FrntRdrObj14RdrObjVx "Refer to the data element description in FrntRdrObj1 with the same data element name.";
CM_ SG_ 398 FrntRdrObj14RdrObjVxStdDe "Refer to the data element description in FrntRdrObj1 with the same data element name.";
CM_ SG_ 398 FrntRdrObj14RdrObjVy "Refer to the data element description in FrntRdrObj1 with the same data element name.";
CM_ SG_ 398 FrntRdrObj14RdrObjVyStdDe "Refer to the data element description in FrntRdrObj1 with the same data element name.";
CM_ SG_ 398 FrntRdrObj14RelVx "Refer to the data element description in FrntRdrObj1 with the same data element name.";
CM_ SG_ 398 FrntRdrObj14RelVy "Refer to the data element description in FrntRdrObj1 with the same data element name.";
CM_ SG_ 400 FrntRdrObj15Heading "Refer to the data element description in FrntRdrObj1 with the same data element name.";
CM_ SG_ 400 FrntRdrObj15ObjBoxCenterLat "Refer to the data element description in FrntRdrObj1 with the same data element name.";
CM_ SG_ 400 FrntRdrObj15ObjBoxCenterLgt "Refer to the data element description in FrntRdrObj1 with the same data element name.";
CM_ SG_ 400 FrntRdrObj15ObservationHist "Refer to the data element description in FrntRdrObj1 with the same data element name.";
CM_ SG_ 400 FrntRdrObj15RdrObjAx "Refer to the data element description in FrntRdrObj1 with the same data element name.";
CM_ SG_ 400 FrntRdrObj15RdrObjAy "Refer to the data element description in FrntRdrObj1 with the same data element name.";
CM_ SG_ 400 FrntRdrObj15RdrObjBoxLength "Refer to the data element description in FrntRdrObj1 with the same data element name.";
CM_ SG_ 400 FrntRdrObj15RdrObjBoxWidth "Refer to the data element description in FrntRdrObj1 with the same data element name.";
CM_ SG_ 400 FrntRdrObj15RdrObjChks "Refer to the data element description in FrntRdrObj1 with the same data element name.";
CM_ SG_ 400 FrntRdrObj15RdrObjCntr "Refer to the data element description in FrntRdrObj1 with the same data element name.";
CM_ SG_ 400 FrntRdrObj15RdrObjCoastCnt "Refer to the data element description in FrntRdrObj1 with the same data element name.";
CM_ SG_ 400 FrntRdrObj15RdrObjConf "Refer to the data element description in FrntRdrObj1 with the same data element name.";
CM_ SG_ 400 FrntRdrObj15RdrObjDx "Refer to the data element description in FrntRdrObj1 with the same data element name.";
CM_ SG_ 400 FrntRdrObj15RdrObjDxStdDe "Refer to the data element description in FrntRdrObj1 with the same data element name.";
CM_ SG_ 400 FrntRdrObj15RdrObjDy "Refer to the data element description in FrntRdrObj1 with the same data element name.";
CM_ SG_ 400 FrntRdrObj15RdrObjDyStdDe "Refer to the data element description in FrntRdrObj1 with the same data element name.";
CM_ SG_ 400 FrntRdrObj15RdrObjElevnConf "Refer to the data element description in FrntRdrObj1 with the same data element name.";
CM_ SG_ 400 FrntRdrObj15RdrObjElevnSts "Refer to the data element description in FrntRdrObj1 with the same data element name.";
CM_ SG_ 400 FrntRdrObj15RdrObjID "Refer to the data element description in FrntRdrObj1 with the same data element name.";
CM_ SG_ 400 FrntRdrObj15RdrObjIsInFreeSpace "Refer to the data element description in FrntRdrObj1 with the same data element name.";
CM_ SG_ 400 FrntRdrObj15RdrObjMirrProblty "Refer to the data element description in FrntRdrObj1 with the same data element name.";
CM_ SG_ 400 FrntRdrObj15RdrObjMtnPat "Refer to the data element description in FrntRdrObj1 with the same data element name.";
CM_ SG_ 400 FrntRdrObj15RdrObjNotRealProblty "Refer to the data element description in FrntRdrObj1 with the same data element name.";
CM_ SG_ 400 FrntRdrObj15RdrObjStatyCnt "Refer to the data element description in FrntRdrObj1 with the same data element name.";
CM_ SG_ 400 FrntRdrObj15RdrObjTiAlv "Refer to the data element description in FrntRdrObj1 with the same data element name.";
CM_ SG_ 400 FrntRdrObj15RdrObjTrackSts "Refer to the data element description in FrntRdrObj1 with the same data element name.";
CM_ SG_ 400 FrntRdrObj15RdrObjTyp "Refer to the data element description in FrntRdrObj1 with the same data element name.";
CM_ SG_ 400 FrntRdrObj15RdrObjTypConfBike "Refer to the data element description in FrntRdrObj1 with the same data element name.";
CM_ SG_ 400 FrntRdrObj15RdrObjTypConfPed "Refer to the data element description in FrntRdrObj1 with the same data element name.";
CM_ SG_ 400 FrntRdrObj15RdrObjTypConfVeh "Refer to the data element description in FrntRdrObj1 with the same data element name.";
CM_ SG_ 400 FrntRdrObj15RdrObjVx "Refer to the data element description in FrntRdrObj1 with the same data element name.";
CM_ SG_ 400 FrntRdrObj15RdrObjVxStdDe "Refer to the data element description in FrntRdrObj1 with the same data element name.";
CM_ SG_ 400 FrntRdrObj15RdrObjVy "Refer to the data element description in FrntRdrObj1 with the same data element name.";
CM_ SG_ 400 FrntRdrObj15RdrObjVyStdDe "Refer to the data element description in FrntRdrObj1 with the same data element name.";
CM_ SG_ 400 FrntRdrObj15RelVx "Refer to the data element description in FrntRdrObj1 with the same data element name.";
CM_ SG_ 400 FrntRdrObj15RelVy "Refer to the data element description in FrntRdrObj1 with the same data element name.";
CM_ SG_ 402 FrntRdrObj16Heading "Refer to the data element description in FrntRdrObj1 with the same data element name.";
CM_ SG_ 402 FrntRdrObj16ObjBoxCenterLat "Refer to the data element description in FrntRdrObj1 with the same data element name.";
CM_ SG_ 402 FrntRdrObj16ObjBoxCenterLgt "Refer to the data element description in FrntRdrObj1 with the same data element name.";
CM_ SG_ 402 FrntRdrObj16ObservationHist "Refer to the data element description in FrntRdrObj1 with the same data element name.";
CM_ SG_ 402 FrntRdrObj16RdrObjAx "Refer to the data element description in FrntRdrObj1 with the same data element name.";
CM_ SG_ 402 FrntRdrObj16RdrObjAy "Refer to the data element description in FrntRdrObj1 with the same data element name.";
CM_ SG_ 402 FrntRdrObj16RdrObjBoxLength "Refer to the data element description in FrntRdrObj1 with the same data element name.";
CM_ SG_ 402 FrntRdrObj16RdrObjBoxWidth "Refer to the data element description in FrntRdrObj1 with the same data element name.";
CM_ SG_ 402 FrntRdrObj16RdrObjChks "Refer to the data element description in FrntRdrObj1 with the same data element name.";
CM_ SG_ 402 FrntRdrObj16RdrObjCntr "Refer to the data element description in FrntRdrObj1 with the same data element name.";
CM_ SG_ 402 FrntRdrObj16RdrObjCoastCnt "Refer to the data element description in FrntRdrObj1 with the same data element name.";
CM_ SG_ 402 FrntRdrObj16RdrObjConf "Refer to the data element description in FrntRdrObj1 with the same data element name.";
CM_ SG_ 402 FrntRdrObj16RdrObjDx "Refer to the data element description in FrntRdrObj1 with the same data element name.";
CM_ SG_ 402 FrntRdrObj16RdrObjDxStdDe "Refer to the data element description in FrntRdrObj1 with the same data element name.";
CM_ SG_ 402 FrntRdrObj16RdrObjDy "Refer to the data element description in FrntRdrObj1 with the same data element name.";
CM_ SG_ 402 FrntRdrObj16RdrObjDyStdDe "Refer to the data element description in FrntRdrObj1 with the same data element name.";
CM_ SG_ 402 FrntRdrObj16RdrObjElevnConf "Refer to the data element description in FrntRdrObj1 with the same data element name.";
CM_ SG_ 402 FrntRdrObj16RdrObjElevnSts "Refer to the data element description in FrntRdrObj1 with the same data element name.";
CM_ SG_ 402 FrntRdrObj16RdrObjID "Refer to the data element description in FrntRdrObj1 with the same data element name.";
CM_ SG_ 402 FrntRdrObj16RdrObjIsInFreeSpace "Refer to the data element description in FrntRdrObj1 with the same data element name.";
CM_ SG_ 402 FrntRdrObj16RdrObjMirrProblty "Refer to the data element description in FrntRdrObj1 with the same data element name.";
CM_ SG_ 402 FrntRdrObj16RdrObjMtnPat "Refer to the data element description in FrntRdrObj1 with the same data element name.";
CM_ SG_ 402 FrntRdrObj16RdrObjNotRealProblty "Refer to the data element description in FrntRdrObj1 with the same data element name.";
CM_ SG_ 402 FrntRdrObj16RdrObjStatyCnt "Refer to the data element description in FrntRdrObj1 with the same data element name.";
CM_ SG_ 402 FrntRdrObj16RdrObjTiAlv "Refer to the data element description in FrntRdrObj1 with the same data element name.";
CM_ SG_ 402 FrntRdrObj16RdrObjTrackSts "Refer to the data element description in FrntRdrObj1 with the same data element name.";
CM_ SG_ 402 FrntRdrObj16RdrObjTyp "Refer to the data element description in FrntRdrObj1 with the same data element name.";
CM_ SG_ 402 FrntRdrObj16RdrObjTypConfBike "Refer to the data element description in FrntRdrObj1 with the same data element name.";
CM_ SG_ 402 FrntRdrObj16RdrObjTypConfPed "Refer to the data element description in FrntRdrObj1 with the same data element name.";
CM_ SG_ 402 FrntRdrObj16RdrObjTypConfVeh "Refer to the data element description in FrntRdrObj1 with the same data element name.";
CM_ SG_ 402 FrntRdrObj16RdrObjVx "Refer to the data element description in FrntRdrObj1 with the same data element name.";
CM_ SG_ 402 FrntRdrObj16RdrObjVxStdDe "Refer to the data element description in FrntRdrObj1 with the same data element name.";
CM_ SG_ 402 FrntRdrObj16RdrObjVy "Refer to the data element description in FrntRdrObj1 with the same data element name.";
CM_ SG_ 402 FrntRdrObj16RdrObjVyStdDe "Refer to the data element description in FrntRdrObj1 with the same data element name.";
CM_ SG_ 402 FrntRdrObj16RelVx "Refer to the data element description in FrntRdrObj1 with the same data element name.";
CM_ SG_ 402 FrntRdrObj16RelVy "Refer to the data element description in FrntRdrObj1 with the same data element name.";
CM_ SG_ 404 FrntRdrObj17Heading "Refer to the data element description in FrntRdrObj1 with the same data element name.";
CM_ SG_ 404 FrntRdrObj17ObjBoxCenterLat "Refer to the data element description in FrntRdrObj1 with the same data element name.";
CM_ SG_ 404 FrntRdrObj17ObjBoxCenterLgt "Refer to the data element description in FrntRdrObj1 with the same data element name.";
CM_ SG_ 404 FrntRdrObj17ObservationHist "Refer to the data element description in FrntRdrObj1 with the same data element name.";
CM_ SG_ 404 FrntRdrObj17RdrObjAx "Refer to the data element description in FrntRdrObj1 with the same data element name.";
CM_ SG_ 404 FrntRdrObj17RdrObjAy "Refer to the data element description in FrntRdrObj1 with the same data element name.";
CM_ SG_ 404 FrntRdrObj17RdrObjBoxLength "Refer to the data element description in FrntRdrObj1 with the same data element name.";
CM_ SG_ 404 FrntRdrObj17RdrObjBoxWidth "Refer to the data element description in FrntRdrObj1 with the same data element name.";
CM_ SG_ 404 FrntRdrObj17RdrObjChks "Refer to the data element description in FrntRdrObj1 with the same data element name.";
CM_ SG_ 404 FrntRdrObj17RdrObjCntr "Refer to the data element description in FrntRdrObj1 with the same data element name.";
CM_ SG_ 404 FrntRdrObj17RdrObjCoastCnt "Refer to the data element description in FrntRdrObj1 with the same data element name.";
CM_ SG_ 404 FrntRdrObj17RdrObjConf "Refer to the data element description in FrntRdrObj1 with the same data element name.";
CM_ SG_ 404 FrntRdrObj17RdrObjDx "Refer to the data element description in FrntRdrObj1 with the same data element name.";
CM_ SG_ 404 FrntRdrObj17RdrObjDxStdDe "Refer to the data element description in FrntRdrObj1 with the same data element name.";
CM_ SG_ 404 FrntRdrObj17RdrObjDy "Refer to the data element description in FrntRdrObj1 with the same data element name.";
CM_ SG_ 404 FrntRdrObj17RdrObjDyStdDe "Refer to the data element description in FrntRdrObj1 with the same data element name.";
CM_ SG_ 404 FrntRdrObj17RdrObjElevnConf "Refer to the data element description in FrntRdrObj1 with the same data element name.";
CM_ SG_ 404 FrntRdrObj17RdrObjElevnSts "Refer to the data element description in FrntRdrObj1 with the same data element name.";
CM_ SG_ 404 FrntRdrObj17RdrObjID "Refer to the data element description in FrntRdrObj1 with the same data element name.";
CM_ SG_ 404 FrntRdrObj17RdrObjIsInFreeSpace "Refer to the data element description in FrntRdrObj1 with the same data element name.";
CM_ SG_ 404 FrntRdrObj17RdrObjMirrProblty "Refer to the data element description in FrntRdrObj1 with the same data element name.";
CM_ SG_ 404 FrntRdrObj17RdrObjMtnPat "Refer to the data element description in FrntRdrObj1 with the same data element name.";
CM_ SG_ 404 FrntRdrObj17RdrObjNotRealProblty "Refer to the data element description in FrntRdrObj1 with the same data element name.";
CM_ SG_ 404 FrntRdrObj17RdrObjStatyCnt "Refer to the data element description in FrntRdrObj1 with the same data element name.";
CM_ SG_ 404 FrntRdrObj17RdrObjTiAlv "Refer to the data element description in FrntRdrObj1 with the same data element name.";
CM_ SG_ 404 FrntRdrObj17RdrObjTrackSts "Refer to the data element description in FrntRdrObj1 with the same data element name.";
CM_ SG_ 404 FrntRdrObj17RdrObjTyp "Refer to the data element description in FrntRdrObj1 with the same data element name.";
CM_ SG_ 404 FrntRdrObj17RdrObjTypConfBike "Refer to the data element description in FrntRdrObj1 with the same data element name.";
CM_ SG_ 404 FrntRdrObj17RdrObjTypConfPed "Refer to the data element description in FrntRdrObj1 with the same data element name.";
CM_ SG_ 404 FrntRdrObj17RdrObjTypConfVeh "Refer to the data element description in FrntRdrObj1 with the same data element name.";
CM_ SG_ 404 FrntRdrObj17RdrObjVx "Refer to the data element description in FrntRdrObj1 with the same data element name.";
CM_ SG_ 404 FrntRdrObj17RdrObjVxStdDe "Refer to the data element description in FrntRdrObj1 with the same data element name.";
CM_ SG_ 404 FrntRdrObj17RdrObjVy "Refer to the data element description in FrntRdrObj1 with the same data element name.";
CM_ SG_ 404 FrntRdrObj17RdrObjVyStdDe "Refer to the data element description in FrntRdrObj1 with the same data element name.";
CM_ SG_ 404 FrntRdrObj17RelVx "Refer to the data element description in FrntRdrObj1 with the same data element name.";
CM_ SG_ 404 FrntRdrObj17RelVy "Refer to the data element description in FrntRdrObj1 with the same data element name.";
BA_DEF_ BO_ "VFrameFormat" ENUM "StandardCAN","ExtendedCAN","reserved","J1939PG","reserved","reserved","reserved","reserved","reserved","reserved","reserved","reserved","reserved","reserved","StandardCAN_FD","ExtendedCAN_FD";
BA_DEF_ BO_ "CANFD_BRS" ENUM "0","1";
BA_DEF_ BO_ "GenMsgSendType" ENUM "cyclic", "spontaneous", "not-used", "not-used", "not-used", "cyclicAndSpontaneous", "not-used", "cyclicIfActive", "NoMsgSendType"; // [us]
BA_DEF_ BO_ "GenMsgCycleTime" INT 0 65536; // [ms]
BA_DEF_ BO_ "GenMsgStartDelayTime" INT 0 65536; // [ms]
BA_DEF_ BO_ "GenMsgDelayTime" INT 0 65536; // [ms]
BA_DEF_ SG_ "GenSigSendType" ENUM "Cyclic","OnWrite","OnWriteWithRepetition","OnChange","OnChangeWithRepetition","IfActive","IfActiveWithRepetition","NoSigSendType";
BA_DEF_ SG_ "GenSigStartValue" HEX 0 80000000;
BA_DEF_ BO_ "GenMsgILSupport" ENUM "No","Yes";
BA_DEF_ BO_ "NmAsrMessage" ENUM "No","Yes";
BA_DEF_ SG_ "GenSigFuncType" ENUM "NoFunction","n/a","n/a","n/a","n/a","n/a","n/a","n/a","n/a","n/a","n/a","n/a","n/a","n/a","n/a","CHK","CNTR","n/a","n/a","n/a","CNTR_AR_01","CRC_AR_01_BOTH","CRC_AR_01_ALT","CRC_AR_01_LOW","CRC_AR_01_NIBBLE","CNTR_AR_04","CRC_AR_04A","CNTR_AR_05","CRC_AR_05";
BA_DEF_ SG_ "GenSigDataID" STRING;

BA_DEF_DEF_ "VFrameFormat" "J1939PG";
BA_DEF_DEF_ "CANFD_BRS" "1";
BA_DEF_DEF_ "GenSigStartValue" 0;
BA_DEF_DEF_ "GenSigSendType" "NoSigSendType";
BA_DEF_DEF_ "GenMsgCycleTime" 0;
BA_DEF_DEF_ "GenMsgDelayTime" 0;
BA_DEF_DEF_ "GenMsgStartDelayTime" 0;
BA_DEF_DEF_ "GenMsgSendType" "NoMsgSendType";
BA_DEF_DEF_ "GenMsgILSupport" "Yes";
BA_DEF_DEF_ "NmAsrMessage" "No";
BA_DEF_DEF_ "GenSigFuncType" "NoFunction";
BA_DEF_DEF_ "GenSigDataID" "";
// Frame: FLRSafetyCANFD2Frame38
BA_ "VFrameFormat" BO_ 378 14;
BA_ "GenMsgSendType" BO_ 378 0;
BA_ "GenMsgCycleTime" BO_ 378 50.000;
BA_ "GenSigStartValue" SG_ 378 FrntRdrObj4Heading 1800;
BA_ "GenSigSendType" SG_ 378 FrntRdrObj4Heading 0;
BA_ "GenSigStartValue" SG_ 378 FrntRdrObj4ObjBoxCenterLat 250;
BA_ "GenSigSendType" SG_ 378 FrntRdrObj4ObjBoxCenterLat 0;
BA_ "GenSigStartValue" SG_ 378 FrntRdrObj4ObjBoxCenterLgt 250;
BA_ "GenSigSendType" SG_ 378 FrntRdrObj4ObjBoxCenterLgt 0;
BA_ "GenSigSendType" SG_ 378 FrntRdrObj4ObservationHist 0;
BA_ "GenSigSendType" SG_ 378 FrntRdrObj4RdrObjAx 0;
BA_ "GenSigSendType" SG_ 378 FrntRdrObj4RdrObjAy 0;
BA_ "GenSigSendType" SG_ 378 FrntRdrObj4RdrObjBoxLength 0;
BA_ "GenSigSendType" SG_ 378 FrntRdrObj4RdrObjBoxWidth 0;
BA_ "GenSigSendType" SG_ 378 FrntRdrObj4RdrObjChks 0;
BA_ "GenSigFuncType" SG_ 378 FrntRdrObj4RdrObjChks 15;
BA_ "GenSigDataID" SG_ 378 FrntRdrObj4RdrObjChks "0x7D3";
BA_ "GenSigSendType" SG_ 378 FrntRdrObj4RdrObjCntr 0;
BA_ "GenSigFuncType" SG_ 378 FrntRdrObj4RdrObjCntr 16;
BA_ "GenSigStartValue" SG_ 378 FrntRdrObj4RdrObjCoastCnt 31;
BA_ "GenSigSendType" SG_ 378 FrntRdrObj4RdrObjCoastCnt 0;
BA_ "GenSigSendType" SG_ 378 FrntRdrObj4RdrObjConf 0;
BA_ "GenSigSendType" SG_ 378 FrntRdrObj4RdrObjDx 0;
BA_ "GenSigSendType" SG_ 378 FrntRdrObj4RdrObjDxStdDe 0;
BA_ "GenSigStartValue" SG_ 378 FrntRdrObj4RdrObjDy 4000;
BA_ "GenSigSendType" SG_ 378 FrntRdrObj4RdrObjDy 0;
BA_ "GenSigSendType" SG_ 378 FrntRdrObj4RdrObjDyStdDe 0;
BA_ "GenSigSendType" SG_ 378 FrntRdrObj4RdrObjElevnConf 0;
BA_ "GenSigSendType" SG_ 378 FrntRdrObj4RdrObjElevnSts 0;
BA_ "GenSigSendType" SG_ 378 FrntRdrObj4RdrObjID 0;
BA_ "GenSigSendType" SG_ 378 FrntRdrObj4RdrObjIsInFreeSpace 0;
BA_ "GenSigSendType" SG_ 378 FrntRdrObj4RdrObjMirrProblty 0;
BA_ "GenSigSendType" SG_ 378 FrntRdrObj4RdrObjMtnPat 0;
BA_ "GenSigSendType" SG_ 378 FrntRdrObj4RdrObjNotRealProblty 0;
BA_ "GenSigSendType" SG_ 378 FrntRdrObj4RdrObjStatyCnt 0;
BA_ "GenSigSendType" SG_ 378 FrntRdrObj4RdrObjTiAlv 0;
BA_ "GenSigSendType" SG_ 378 FrntRdrObj4RdrObjTrackSts 0;
BA_ "GenSigSendType" SG_ 378 FrntRdrObj4RdrObjTyp 0;
BA_ "GenSigSendType" SG_ 378 FrntRdrObj4RdrObjTypConfBike 0;
BA_ "GenSigSendType" SG_ 378 FrntRdrObj4RdrObjTypConfPed 0;
BA_ "GenSigSendType" SG_ 378 FrntRdrObj4RdrObjTypConfVeh 0;
BA_ "GenSigStartValue" SG_ 378 FrntRdrObj4RdrObjVx 6400;
BA_ "GenSigSendType" SG_ 378 FrntRdrObj4RdrObjVx 0;
BA_ "GenSigSendType" SG_ 378 FrntRdrObj4RdrObjVxStdDe 0;
BA_ "GenSigStartValue" SG_ 378 FrntRdrObj4RdrObjVy 6400;
BA_ "GenSigSendType" SG_ 378 FrntRdrObj4RdrObjVy 0;
BA_ "GenSigSendType" SG_ 378 FrntRdrObj4RdrObjVyStdDe 0;
BA_ "GenSigStartValue" SG_ 378 FrntRdrObj4RelVx 1780;
BA_ "GenSigSendType" SG_ 378 FrntRdrObj4RelVx 0;
BA_ "GenSigStartValue" SG_ 378 FrntRdrObj4RelVy 1780;
BA_ "GenSigSendType" SG_ 378 FrntRdrObj4RelVy 0;
// Frame: FLRSafetyCANFD2Frame39
BA_ "VFrameFormat" BO_ 380 14;
BA_ "GenMsgSendType" BO_ 380 0;
BA_ "GenMsgCycleTime" BO_ 380 50.000;
BA_ "GenSigStartValue" SG_ 380 FrntRdrObj5Heading 1800;
BA_ "GenSigSendType" SG_ 380 FrntRdrObj5Heading 0;
BA_ "GenSigStartValue" SG_ 380 FrntRdrObj5ObjBoxCenterLat 250;
BA_ "GenSigSendType" SG_ 380 FrntRdrObj5ObjBoxCenterLat 0;
BA_ "GenSigStartValue" SG_ 380 FrntRdrObj5ObjBoxCenterLgt 250;
BA_ "GenSigSendType" SG_ 380 FrntRdrObj5ObjBoxCenterLgt 0;
BA_ "GenSigSendType" SG_ 380 FrntRdrObj5ObservationHist 0;
BA_ "GenSigSendType" SG_ 380 FrntRdrObj5RdrObjAx 0;
BA_ "GenSigSendType" SG_ 380 FrntRdrObj5RdrObjAy 0;
BA_ "GenSigSendType" SG_ 380 FrntRdrObj5RdrObjBoxLength 0;
BA_ "GenSigSendType" SG_ 380 FrntRdrObj5RdrObjBoxWidth 0;
BA_ "GenSigSendType" SG_ 380 FrntRdrObj5RdrObjChks 0;
BA_ "GenSigFuncType" SG_ 380 FrntRdrObj5RdrObjChks 15;
BA_ "GenSigDataID" SG_ 380 FrntRdrObj5RdrObjChks "0x7D4";
BA_ "GenSigSendType" SG_ 380 FrntRdrObj5RdrObjCntr 0;
BA_ "GenSigFuncType" SG_ 380 FrntRdrObj5RdrObjCntr 16;
BA_ "GenSigStartValue" SG_ 380 FrntRdrObj5RdrObjCoastCnt 31;
BA_ "GenSigSendType" SG_ 380 FrntRdrObj5RdrObjCoastCnt 0;
BA_ "GenSigSendType" SG_ 380 FrntRdrObj5RdrObjConf 0;
BA_ "GenSigSendType" SG_ 380 FrntRdrObj5RdrObjDx 0;
BA_ "GenSigSendType" SG_ 380 FrntRdrObj5RdrObjDxStdDe 0;
BA_ "GenSigStartValue" SG_ 380 FrntRdrObj5RdrObjDy 4000;
BA_ "GenSigSendType" SG_ 380 FrntRdrObj5RdrObjDy 0;
BA_ "GenSigSendType" SG_ 380 FrntRdrObj5RdrObjDyStdDe 0;
BA_ "GenSigSendType" SG_ 380 FrntRdrObj5RdrObjElevnConf 0;
BA_ "GenSigSendType" SG_ 380 FrntRdrObj5RdrObjElevnSts 0;
BA_ "GenSigSendType" SG_ 380 FrntRdrObj5RdrObjID 0;
BA_ "GenSigSendType" SG_ 380 FrntRdrObj5RdrObjIsInFreeSpace 0;
BA_ "GenSigSendType" SG_ 380 FrntRdrObj5RdrObjMirrProblty 0;
BA_ "GenSigSendType" SG_ 380 FrntRdrObj5RdrObjMtnPat 0;
BA_ "GenSigSendType" SG_ 380 FrntRdrObj5RdrObjNotRealProblty 0;
BA_ "GenSigSendType" SG_ 380 FrntRdrObj5RdrObjStatyCnt 0;
BA_ "GenSigSendType" SG_ 380 FrntRdrObj5RdrObjTiAlv 0;
BA_ "GenSigSendType" SG_ 380 FrntRdrObj5RdrObjTrackSts 0;
BA_ "GenSigSendType" SG_ 380 FrntRdrObj5RdrObjTyp 0;
BA_ "GenSigSendType" SG_ 380 FrntRdrObj5RdrObjTypConfBike 0;
BA_ "GenSigSendType" SG_ 380 FrntRdrObj5RdrObjTypConfPed 0;
BA_ "GenSigSendType" SG_ 380 FrntRdrObj5RdrObjTypConfVeh 0;
BA_ "GenSigStartValue" SG_ 380 FrntRdrObj5RdrObjVx 6400;
BA_ "GenSigSendType" SG_ 380 FrntRdrObj5RdrObjVx 0;
BA_ "GenSigSendType" SG_ 380 FrntRdrObj5RdrObjVxStdDe 0;
BA_ "GenSigStartValue" SG_ 380 FrntRdrObj5RdrObjVy 6400;
BA_ "GenSigSendType" SG_ 380 FrntRdrObj5RdrObjVy 0;
BA_ "GenSigSendType" SG_ 380 FrntRdrObj5RdrObjVyStdDe 0;
BA_ "GenSigStartValue" SG_ 380 FrntRdrObj5RelVx 1780;
BA_ "GenSigSendType" SG_ 380 FrntRdrObj5RelVx 0;
BA_ "GenSigStartValue" SG_ 380 FrntRdrObj5RelVy 1780;
BA_ "GenSigSendType" SG_ 380 FrntRdrObj5RelVy 0;
// Frame: FLRSafetyCANFD2Frame40
BA_ "VFrameFormat" BO_ 382 14;
BA_ "GenMsgSendType" BO_ 382 0;
BA_ "GenMsgCycleTime" BO_ 382 50.000;
BA_ "GenSigStartValue" SG_ 382 FrntRdrObj6Heading 1800;
BA_ "GenSigSendType" SG_ 382 FrntRdrObj6Heading 0;
BA_ "GenSigStartValue" SG_ 382 FrntRdrObj6ObjBoxCenterLat 250;
BA_ "GenSigSendType" SG_ 382 FrntRdrObj6ObjBoxCenterLat 0;
BA_ "GenSigStartValue" SG_ 382 FrntRdrObj6ObjBoxCenterLgt 250;
BA_ "GenSigSendType" SG_ 382 FrntRdrObj6ObjBoxCenterLgt 0;
BA_ "GenSigSendType" SG_ 382 FrntRdrObj6ObservationHist 0;
BA_ "GenSigSendType" SG_ 382 FrntRdrObj6RdrObjAx 0;
BA_ "GenSigSendType" SG_ 382 FrntRdrObj6RdrObjAy 0;
BA_ "GenSigSendType" SG_ 382 FrntRdrObj6RdrObjBoxLength 0;
BA_ "GenSigSendType" SG_ 382 FrntRdrObj6RdrObjBoxWidth 0;
BA_ "GenSigSendType" SG_ 382 FrntRdrObj6RdrObjChks 0;
BA_ "GenSigFuncType" SG_ 382 FrntRdrObj6RdrObjChks 15;
BA_ "GenSigDataID" SG_ 382 FrntRdrObj6RdrObjChks "0x7D5";
BA_ "GenSigSendType" SG_ 382 FrntRdrObj6RdrObjCntr 0;
BA_ "GenSigFuncType" SG_ 382 FrntRdrObj6RdrObjCntr 16;
BA_ "GenSigStartValue" SG_ 382 FrntRdrObj6RdrObjCoastCnt 31;
BA_ "GenSigSendType" SG_ 382 FrntRdrObj6RdrObjCoastCnt 0;
BA_ "GenSigSendType" SG_ 382 FrntRdrObj6RdrObjConf 0;
BA_ "GenSigSendType" SG_ 382 FrntRdrObj6RdrObjDx 0;
BA_ "GenSigSendType" SG_ 382 FrntRdrObj6RdrObjDxStdDe 0;
BA_ "GenSigStartValue" SG_ 382 FrntRdrObj6RdrObjDy 4000;
BA_ "GenSigSendType" SG_ 382 FrntRdrObj6RdrObjDy 0;
BA_ "GenSigSendType" SG_ 382 FrntRdrObj6RdrObjDyStdDe 0;
BA_ "GenSigSendType" SG_ 382 FrntRdrObj6RdrObjElevnConf 0;
BA_ "GenSigSendType" SG_ 382 FrntRdrObj6RdrObjElevnSts 0;
BA_ "GenSigSendType" SG_ 382 FrntRdrObj6RdrObjID 0;
BA_ "GenSigSendType" SG_ 382 FrntRdrObj6RdrObjIsInFreeSpace 0;
BA_ "GenSigSendType" SG_ 382 FrntRdrObj6RdrObjMirrProblty 0;
BA_ "GenSigSendType" SG_ 382 FrntRdrObj6RdrObjMtnPat 0;
BA_ "GenSigSendType" SG_ 382 FrntRdrObj6RdrObjNotRealProblty 0;
BA_ "GenSigSendType" SG_ 382 FrntRdrObj6RdrObjStatyCnt 0;
BA_ "GenSigSendType" SG_ 382 FrntRdrObj6RdrObjTiAlv 0;
BA_ "GenSigSendType" SG_ 382 FrntRdrObj6RdrObjTrackSts 0;
BA_ "GenSigSendType" SG_ 382 FrntRdrObj6RdrObjTyp 0;
BA_ "GenSigSendType" SG_ 382 FrntRdrObj6RdrObjTypConfBike 0;
BA_ "GenSigSendType" SG_ 382 FrntRdrObj6RdrObjTypConfPed 0;
BA_ "GenSigSendType" SG_ 382 FrntRdrObj6RdrObjTypConfVeh 0;
BA_ "GenSigStartValue" SG_ 382 FrntRdrObj6RdrObjVx 6400;
BA_ "GenSigSendType" SG_ 382 FrntRdrObj6RdrObjVx 0;
BA_ "GenSigSendType" SG_ 382 FrntRdrObj6RdrObjVxStdDe 0;
BA_ "GenSigStartValue" SG_ 382 FrntRdrObj6RdrObjVy 6400;
BA_ "GenSigSendType" SG_ 382 FrntRdrObj6RdrObjVy 0;
BA_ "GenSigSendType" SG_ 382 FrntRdrObj6RdrObjVyStdDe 0;
BA_ "GenSigStartValue" SG_ 382 FrntRdrObj6RelVx 1780;
BA_ "GenSigSendType" SG_ 382 FrntRdrObj6RelVx 0;
BA_ "GenSigStartValue" SG_ 382 FrntRdrObj6RelVy 1780;
BA_ "GenSigSendType" SG_ 382 FrntRdrObj6RelVy 0;
// Frame: FLRSafetyCANFD2Frame41
BA_ "VFrameFormat" BO_ 384 14;
BA_ "GenMsgSendType" BO_ 384 0;
BA_ "GenMsgCycleTime" BO_ 384 50.000;
BA_ "GenSigStartValue" SG_ 384 FrntRdrObj7Heading 1800;
BA_ "GenSigSendType" SG_ 384 FrntRdrObj7Heading 0;
BA_ "GenSigStartValue" SG_ 384 FrntRdrObj7ObjBoxCenterLat 250;
BA_ "GenSigSendType" SG_ 384 FrntRdrObj7ObjBoxCenterLat 0;
BA_ "GenSigStartValue" SG_ 384 FrntRdrObj7ObjBoxCenterLgt 250;
BA_ "GenSigSendType" SG_ 384 FrntRdrObj7ObjBoxCenterLgt 0;
BA_ "GenSigSendType" SG_ 384 FrntRdrObj7ObservationHist 0;
BA_ "GenSigSendType" SG_ 384 FrntRdrObj7RdrObjAx 0;
BA_ "GenSigSendType" SG_ 384 FrntRdrObj7RdrObjAy 0;
BA_ "GenSigSendType" SG_ 384 FrntRdrObj7RdrObjBoxLength 0;
BA_ "GenSigSendType" SG_ 384 FrntRdrObj7RdrObjBoxWidth 0;
BA_ "GenSigSendType" SG_ 384 FrntRdrObj7RdrObjChks 0;
BA_ "GenSigFuncType" SG_ 384 FrntRdrObj7RdrObjChks 15;
BA_ "GenSigDataID" SG_ 384 FrntRdrObj7RdrObjChks "0x7D6";
BA_ "GenSigSendType" SG_ 384 FrntRdrObj7RdrObjCntr 0;
BA_ "GenSigFuncType" SG_ 384 FrntRdrObj7RdrObjCntr 16;
BA_ "GenSigStartValue" SG_ 384 FrntRdrObj7RdrObjCoastCnt 31;
BA_ "GenSigSendType" SG_ 384 FrntRdrObj7RdrObjCoastCnt 0;
BA_ "GenSigSendType" SG_ 384 FrntRdrObj7RdrObjConf 0;
BA_ "GenSigSendType" SG_ 384 FrntRdrObj7RdrObjDx 0;
BA_ "GenSigSendType" SG_ 384 FrntRdrObj7RdrObjDxStdDe 0;
BA_ "GenSigStartValue" SG_ 384 FrntRdrObj7RdrObjDy 4000;
BA_ "GenSigSendType" SG_ 384 FrntRdrObj7RdrObjDy 0;
BA_ "GenSigSendType" SG_ 384 FrntRdrObj7RdrObjDyStdDe 0;
BA_ "GenSigSendType" SG_ 384 FrntRdrObj7RdrObjElevnConf 0;
BA_ "GenSigSendType" SG_ 384 FrntRdrObj7RdrObjElevnSts 0;
BA_ "GenSigSendType" SG_ 384 FrntRdrObj7RdrObjID 0;
BA_ "GenSigSendType" SG_ 384 FrntRdrObj7RdrObjIsInFreeSpace 0;
BA_ "GenSigSendType" SG_ 384 FrntRdrObj7RdrObjMirrProblty 0;
BA_ "GenSigSendType" SG_ 384 FrntRdrObj7RdrObjMtnPat 0;
BA_ "GenSigSendType" SG_ 384 FrntRdrObj7RdrObjNotRealProblty 0;
BA_ "GenSigSendType" SG_ 384 FrntRdrObj7RdrObjStatyCnt 0;
BA_ "GenSigSendType" SG_ 384 FrntRdrObj7RdrObjTiAlv 0;
BA_ "GenSigSendType" SG_ 384 FrntRdrObj7RdrObjTrackSts 0;
BA_ "GenSigSendType" SG_ 384 FrntRdrObj7RdrObjTyp 0;
BA_ "GenSigSendType" SG_ 384 FrntRdrObj7RdrObjTypConfBike 0;
BA_ "GenSigSendType" SG_ 384 FrntRdrObj7RdrObjTypConfPed 0;
BA_ "GenSigSendType" SG_ 384 FrntRdrObj7RdrObjTypConfVeh 0;
BA_ "GenSigStartValue" SG_ 384 FrntRdrObj7RdrObjVx 6400;
BA_ "GenSigSendType" SG_ 384 FrntRdrObj7RdrObjVx 0;
BA_ "GenSigSendType" SG_ 384 FrntRdrObj7RdrObjVxStdDe 0;
BA_ "GenSigStartValue" SG_ 384 FrntRdrObj7RdrObjVy 6400;
BA_ "GenSigSendType" SG_ 384 FrntRdrObj7RdrObjVy 0;
BA_ "GenSigSendType" SG_ 384 FrntRdrObj7RdrObjVyStdDe 0;
BA_ "GenSigStartValue" SG_ 384 FrntRdrObj7RelVx 1780;
BA_ "GenSigSendType" SG_ 384 FrntRdrObj7RelVx 0;
BA_ "GenSigStartValue" SG_ 384 FrntRdrObj7RelVy 1780;
BA_ "GenSigSendType" SG_ 384 FrntRdrObj7RelVy 0;
// Frame: FLRSafetyCANFD2Frame42
BA_ "VFrameFormat" BO_ 386 14;
BA_ "GenMsgSendType" BO_ 386 0;
BA_ "GenMsgCycleTime" BO_ 386 50.000;
BA_ "GenSigStartValue" SG_ 386 FrntRdrObj8Heading 1800;
BA_ "GenSigSendType" SG_ 386 FrntRdrObj8Heading 0;
BA_ "GenSigStartValue" SG_ 386 FrntRdrObj8ObjBoxCenterLat 250;
BA_ "GenSigSendType" SG_ 386 FrntRdrObj8ObjBoxCenterLat 0;
BA_ "GenSigStartValue" SG_ 386 FrntRdrObj8ObjBoxCenterLgt 250;
BA_ "GenSigSendType" SG_ 386 FrntRdrObj8ObjBoxCenterLgt 0;
BA_ "GenSigSendType" SG_ 386 FrntRdrObj8ObservationHist 0;
BA_ "GenSigSendType" SG_ 386 FrntRdrObj8RdrObjAx 0;
BA_ "GenSigSendType" SG_ 386 FrntRdrObj8RdrObjAy 0;
BA_ "GenSigSendType" SG_ 386 FrntRdrObj8RdrObjBoxLength 0;
BA_ "GenSigSendType" SG_ 386 FrntRdrObj8RdrObjBoxWidth 0;
BA_ "GenSigSendType" SG_ 386 FrntRdrObj8RdrObjChks 0;
BA_ "GenSigFuncType" SG_ 386 FrntRdrObj8RdrObjChks 15;
BA_ "GenSigDataID" SG_ 386 FrntRdrObj8RdrObjChks "0x7D7";
BA_ "GenSigSendType" SG_ 386 FrntRdrObj8RdrObjCntr 0;
BA_ "GenSigFuncType" SG_ 386 FrntRdrObj8RdrObjCntr 16;
BA_ "GenSigStartValue" SG_ 386 FrntRdrObj8RdrObjCoastCnt 31;
BA_ "GenSigSendType" SG_ 386 FrntRdrObj8RdrObjCoastCnt 0;
BA_ "GenSigSendType" SG_ 386 FrntRdrObj8RdrObjConf 0;
BA_ "GenSigSendType" SG_ 386 FrntRdrObj8RdrObjDx 0;
BA_ "GenSigSendType" SG_ 386 FrntRdrObj8RdrObjDxStdDe 0;
BA_ "GenSigStartValue" SG_ 386 FrntRdrObj8RdrObjDy 4000;
BA_ "GenSigSendType" SG_ 386 FrntRdrObj8RdrObjDy 0;
BA_ "GenSigSendType" SG_ 386 FrntRdrObj8RdrObjDyStdDe 0;
BA_ "GenSigSendType" SG_ 386 FrntRdrObj8RdrObjElevnConf 0;
BA_ "GenSigSendType" SG_ 386 FrntRdrObj8RdrObjElevnSts 0;
BA_ "GenSigSendType" SG_ 386 FrntRdrObj8RdrObjID 0;
BA_ "GenSigSendType" SG_ 386 FrntRdrObj8RdrObjIsInFreeSpace 0;
BA_ "GenSigSendType" SG_ 386 FrntRdrObj8RdrObjMirrProblty 0;
BA_ "GenSigSendType" SG_ 386 FrntRdrObj8RdrObjMtnPat 0;
BA_ "GenSigSendType" SG_ 386 FrntRdrObj8RdrObjNotRealProblty 0;
BA_ "GenSigSendType" SG_ 386 FrntRdrObj8RdrObjStatyCnt 0;
BA_ "GenSigSendType" SG_ 386 FrntRdrObj8RdrObjTiAlv 0;
BA_ "GenSigSendType" SG_ 386 FrntRdrObj8RdrObjTrackSts 0;
BA_ "GenSigSendType" SG_ 386 FrntRdrObj8RdrObjTyp 0;
BA_ "GenSigSendType" SG_ 386 FrntRdrObj8RdrObjTypConfBike 0;
BA_ "GenSigSendType" SG_ 386 FrntRdrObj8RdrObjTypConfPed 0;
BA_ "GenSigSendType" SG_ 386 FrntRdrObj8RdrObjTypConfVeh 0;
BA_ "GenSigStartValue" SG_ 386 FrntRdrObj8RdrObjVx 6400;
BA_ "GenSigSendType" SG_ 386 FrntRdrObj8RdrObjVx 0;
BA_ "GenSigSendType" SG_ 386 FrntRdrObj8RdrObjVxStdDe 0;
BA_ "GenSigStartValue" SG_ 386 FrntRdrObj8RdrObjVy 6400;
BA_ "GenSigSendType" SG_ 386 FrntRdrObj8RdrObjVy 0;
BA_ "GenSigSendType" SG_ 386 FrntRdrObj8RdrObjVyStdDe 0;
BA_ "GenSigStartValue" SG_ 386 FrntRdrObj8RelVx 1780;
BA_ "GenSigSendType" SG_ 386 FrntRdrObj8RelVx 0;
BA_ "GenSigStartValue" SG_ 386 FrntRdrObj8RelVy 1780;
BA_ "GenSigSendType" SG_ 386 FrntRdrObj8RelVy 0;
// Frame: FLRSafetyCANFD2Frame43
BA_ "VFrameFormat" BO_ 388 14;
BA_ "GenMsgSendType" BO_ 388 0;
BA_ "GenMsgCycleTime" BO_ 388 50.000;
BA_ "GenSigStartValue" SG_ 388 FrntRdrObj9Heading 1800;
BA_ "GenSigSendType" SG_ 388 FrntRdrObj9Heading 0;
BA_ "GenSigStartValue" SG_ 388 FrntRdrObj9ObjBoxCenterLat 250;
BA_ "GenSigSendType" SG_ 388 FrntRdrObj9ObjBoxCenterLat 0;
BA_ "GenSigStartValue" SG_ 388 FrntRdrObj9ObjBoxCenterLgt 250;
BA_ "GenSigSendType" SG_ 388 FrntRdrObj9ObjBoxCenterLgt 0;
BA_ "GenSigSendType" SG_ 388 FrntRdrObj9ObservationHist 0;
BA_ "GenSigSendType" SG_ 388 FrntRdrObj9RdrObjAx 0;
BA_ "GenSigSendType" SG_ 388 FrntRdrObj9RdrObjAy 0;
BA_ "GenSigSendType" SG_ 388 FrntRdrObj9RdrObjBoxLength 0;
BA_ "GenSigSendType" SG_ 388 FrntRdrObj9RdrObjBoxWidth 0;
BA_ "GenSigSendType" SG_ 388 FrntRdrObj9RdrObjChks 0;
BA_ "GenSigFuncType" SG_ 388 FrntRdrObj9RdrObjChks 15;
BA_ "GenSigDataID" SG_ 388 FrntRdrObj9RdrObjChks "0x7D8";
BA_ "GenSigSendType" SG_ 388 FrntRdrObj9RdrObjCntr 0;
BA_ "GenSigFuncType" SG_ 388 FrntRdrObj9RdrObjCntr 16;
BA_ "GenSigStartValue" SG_ 388 FrntRdrObj9RdrObjCoastCnt 31;
BA_ "GenSigSendType" SG_ 388 FrntRdrObj9RdrObjCoastCnt 0;
BA_ "GenSigSendType" SG_ 388 FrntRdrObj9RdrObjConf 0;
BA_ "GenSigSendType" SG_ 388 FrntRdrObj9RdrObjDx 0;
BA_ "GenSigSendType" SG_ 388 FrntRdrObj9RdrObjDxStdDe 0;
BA_ "GenSigStartValue" SG_ 388 FrntRdrObj9RdrObjDy 4000;
BA_ "GenSigSendType" SG_ 388 FrntRdrObj9RdrObjDy 0;
BA_ "GenSigSendType" SG_ 388 FrntRdrObj9RdrObjDyStdDe 0;
BA_ "GenSigSendType" SG_ 388 FrntRdrObj9RdrObjElevnConf 0;
BA_ "GenSigSendType" SG_ 388 FrntRdrObj9RdrObjElevnSts 0;
BA_ "GenSigSendType" SG_ 388 FrntRdrObj9RdrObjID 0;
BA_ "GenSigSendType" SG_ 388 FrntRdrObj9RdrObjIsInFreeSpace 0;
BA_ "GenSigSendType" SG_ 388 FrntRdrObj9RdrObjMirrProblty 0;
BA_ "GenSigSendType" SG_ 388 FrntRdrObj9RdrObjMtnPat 0;
BA_ "GenSigSendType" SG_ 388 FrntRdrObj9RdrObjNotRealProblty 0;
BA_ "GenSigSendType" SG_ 388 FrntRdrObj9RdrObjStatyCnt 0;
BA_ "GenSigSendType" SG_ 388 FrntRdrObj9RdrObjTiAlv 0;
BA_ "GenSigSendType" SG_ 388 FrntRdrObj9RdrObjTrackSts 0;
BA_ "GenSigSendType" SG_ 388 FrntRdrObj9RdrObjTyp 0;
BA_ "GenSigSendType" SG_ 388 FrntRdrObj9RdrObjTypConfBike 0;
BA_ "GenSigSendType" SG_ 388 FrntRdrObj9RdrObjTypConfPed 0;
BA_ "GenSigSendType" SG_ 388 FrntRdrObj9RdrObjTypConfVeh 0;
BA_ "GenSigStartValue" SG_ 388 FrntRdrObj9RdrObjVx 6400;
BA_ "GenSigSendType" SG_ 388 FrntRdrObj9RdrObjVx 0;
BA_ "GenSigSendType" SG_ 388 FrntRdrObj9RdrObjVxStdDe 0;
BA_ "GenSigStartValue" SG_ 388 FrntRdrObj9RdrObjVy 6400;
BA_ "GenSigSendType" SG_ 388 FrntRdrObj9RdrObjVy 0;
BA_ "GenSigSendType" SG_ 388 FrntRdrObj9RdrObjVyStdDe 0;
BA_ "GenSigStartValue" SG_ 388 FrntRdrObj9RelVx 1780;
BA_ "GenSigSendType" SG_ 388 FrntRdrObj9RelVx 0;
BA_ "GenSigStartValue" SG_ 388 FrntRdrObj9RelVy 1780;
BA_ "GenSigSendType" SG_ 388 FrntRdrObj9RelVy 0;
// Frame: FLRSafetyCANFD2Frame44
BA_ "VFrameFormat" BO_ 390 14;
BA_ "GenMsgSendType" BO_ 390 0;
BA_ "GenMsgCycleTime" BO_ 390 50.000;
BA_ "GenSigStartValue" SG_ 390 FrntRdrObj10Heading 1800;
BA_ "GenSigSendType" SG_ 390 FrntRdrObj10Heading 0;
BA_ "GenSigStartValue" SG_ 390 FrntRdrObj10ObjBoxCenterLat 250;
BA_ "GenSigSendType" SG_ 390 FrntRdrObj10ObjBoxCenterLat 0;
BA_ "GenSigStartValue" SG_ 390 FrntRdrObj10ObjBoxCenterLgt 250;
BA_ "GenSigSendType" SG_ 390 FrntRdrObj10ObjBoxCenterLgt 0;
BA_ "GenSigSendType" SG_ 390 FrntRdrObj10ObservationHist 0;
BA_ "GenSigSendType" SG_ 390 FrntRdrObj10RdrObjAx 0;
BA_ "GenSigSendType" SG_ 390 FrntRdrObj10RdrObjAy 0;
BA_ "GenSigSendType" SG_ 390 FrntRdrObj10RdrObjBoxLength 0;
BA_ "GenSigSendType" SG_ 390 FrntRdrObj10RdrObjBoxWidth 0;
BA_ "GenSigSendType" SG_ 390 FrntRdrObj10RdrObjChks 0;
BA_ "GenSigFuncType" SG_ 390 FrntRdrObj10RdrObjChks 15;
BA_ "GenSigDataID" SG_ 390 FrntRdrObj10RdrObjChks "0x7D9";
BA_ "GenSigSendType" SG_ 390 FrntRdrObj10RdrObjCntr 0;
BA_ "GenSigFuncType" SG_ 390 FrntRdrObj10RdrObjCntr 16;
BA_ "GenSigStartValue" SG_ 390 FrntRdrObj10RdrObjCoastCnt 31;
BA_ "GenSigSendType" SG_ 390 FrntRdrObj10RdrObjCoastCnt 0;
BA_ "GenSigSendType" SG_ 390 FrntRdrObj10RdrObjConf 0;
BA_ "GenSigSendType" SG_ 390 FrntRdrObj10RdrObjDx 0;
BA_ "GenSigSendType" SG_ 390 FrntRdrObj10RdrObjDxStdDe 0;
BA_ "GenSigStartValue" SG_ 390 FrntRdrObj10RdrObjDy 4000;
BA_ "GenSigSendType" SG_ 390 FrntRdrObj10RdrObjDy 0;
BA_ "GenSigSendType" SG_ 390 FrntRdrObj10RdrObjDyStdDe 0;
BA_ "GenSigSendType" SG_ 390 FrntRdrObj10RdrObjElevnConf 0;
BA_ "GenSigSendType" SG_ 390 FrntRdrObj10RdrObjElevnSts 0;
BA_ "GenSigSendType" SG_ 390 FrntRdrObj10RdrObjID 0;
BA_ "GenSigSendType" SG_ 390 FrntRdrObj10RdrObjIsInFreeSpace 0;
BA_ "GenSigSendType" SG_ 390 FrntRdrObj10RdrObjMirrProblty 0;
BA_ "GenSigSendType" SG_ 390 FrntRdrObj10RdrObjMtnPat 0;
BA_ "GenSigSendType" SG_ 390 FrntRdrObj10RdrObjNotRealProblty 0;
BA_ "GenSigSendType" SG_ 390 FrntRdrObj10RdrObjStatyCnt 0;
BA_ "GenSigSendType" SG_ 390 FrntRdrObj10RdrObjTiAlv 0;
BA_ "GenSigSendType" SG_ 390 FrntRdrObj10RdrObjTrackSts 0;
BA_ "GenSigSendType" SG_ 390 FrntRdrObj10RdrObjTyp 0;
BA_ "GenSigSendType" SG_ 390 FrntRdrObj10RdrObjTypConfBike 0;
BA_ "GenSigSendType" SG_ 390 FrntRdrObj10RdrObjTypConfPed 0;
BA_ "GenSigSendType" SG_ 390 FrntRdrObj10RdrObjTypConfVeh 0;
BA_ "GenSigStartValue" SG_ 390 FrntRdrObj10RdrObjVx 6400;
BA_ "GenSigSendType" SG_ 390 FrntRdrObj10RdrObjVx 0;
BA_ "GenSigSendType" SG_ 390 FrntRdrObj10RdrObjVxStdDe 0;
BA_ "GenSigStartValue" SG_ 390 FrntRdrObj10RdrObjVy 6400;
BA_ "GenSigSendType" SG_ 390 FrntRdrObj10RdrObjVy 0;
BA_ "GenSigSendType" SG_ 390 FrntRdrObj10RdrObjVyStdDe 0;
BA_ "GenSigStartValue" SG_ 390 FrntRdrObj10RelVx 1780;
BA_ "GenSigSendType" SG_ 390 FrntRdrObj10RelVx 0;
BA_ "GenSigStartValue" SG_ 390 FrntRdrObj10RelVy 1780;
BA_ "GenSigSendType" SG_ 390 FrntRdrObj10RelVy 0;
// Frame: FLRSafetyCANFD2Frame45
BA_ "VFrameFormat" BO_ 392 14;
BA_ "GenMsgSendType" BO_ 392 0;
BA_ "GenMsgCycleTime" BO_ 392 50.000;
BA_ "GenSigStartValue" SG_ 392 FrntRdrObj11Heading 1800;
BA_ "GenSigSendType" SG_ 392 FrntRdrObj11Heading 0;
BA_ "GenSigStartValue" SG_ 392 FrntRdrObj11ObjBoxCenterLat 250;
BA_ "GenSigSendType" SG_ 392 FrntRdrObj11ObjBoxCenterLat 0;
BA_ "GenSigStartValue" SG_ 392 FrntRdrObj11ObjBoxCenterLgt 250;
BA_ "GenSigSendType" SG_ 392 FrntRdrObj11ObjBoxCenterLgt 0;
BA_ "GenSigSendType" SG_ 392 FrntRdrObj11ObservationHist 0;
BA_ "GenSigSendType" SG_ 392 FrntRdrObj11RdrObjAx 0;
BA_ "GenSigSendType" SG_ 392 FrntRdrObj11RdrObjAy 0;
BA_ "GenSigSendType" SG_ 392 FrntRdrObj11RdrObjBoxLength 0;
BA_ "GenSigSendType" SG_ 392 FrntRdrObj11RdrObjBoxWidth 0;
BA_ "GenSigSendType" SG_ 392 FrntRdrObj11RdrObjChks 0;
BA_ "GenSigFuncType" SG_ 392 FrntRdrObj11RdrObjChks 15;
BA_ "GenSigDataID" SG_ 392 FrntRdrObj11RdrObjChks "0x7DA";
BA_ "GenSigSendType" SG_ 392 FrntRdrObj11RdrObjCntr 0;
BA_ "GenSigFuncType" SG_ 392 FrntRdrObj11RdrObjCntr 16;
BA_ "GenSigStartValue" SG_ 392 FrntRdrObj11RdrObjCoastCnt 31;
BA_ "GenSigSendType" SG_ 392 FrntRdrObj11RdrObjCoastCnt 0;
BA_ "GenSigSendType" SG_ 392 FrntRdrObj11RdrObjConf 0;
BA_ "GenSigSendType" SG_ 392 FrntRdrObj11RdrObjDx 0;
BA_ "GenSigSendType" SG_ 392 FrntRdrObj11RdrObjDxStdDe 0;
BA_ "GenSigStartValue" SG_ 392 FrntRdrObj11RdrObjDy 4000;
BA_ "GenSigSendType" SG_ 392 FrntRdrObj11RdrObjDy 0;
BA_ "GenSigSendType" SG_ 392 FrntRdrObj11RdrObjDyStdDe 0;
BA_ "GenSigSendType" SG_ 392 FrntRdrObj11RdrObjElevnConf 0;
BA_ "GenSigSendType" SG_ 392 FrntRdrObj11RdrObjElevnSts 0;
BA_ "GenSigSendType" SG_ 392 FrntRdrObj11RdrObjID 0;
BA_ "GenSigSendType" SG_ 392 FrntRdrObj11RdrObjIsInFreeSpace 0;
BA_ "GenSigSendType" SG_ 392 FrntRdrObj11RdrObjMirrProblty 0;
BA_ "GenSigSendType" SG_ 392 FrntRdrObj11RdrObjMtnPat 0;
BA_ "GenSigSendType" SG_ 392 FrntRdrObj11RdrObjNotRealProblty 0;
BA_ "GenSigSendType" SG_ 392 FrntRdrObj11RdrObjStatyCnt 0;
BA_ "GenSigSendType" SG_ 392 FrntRdrObj11RdrObjTiAlv 0;
BA_ "GenSigSendType" SG_ 392 FrntRdrObj11RdrObjTrackSts 0;
BA_ "GenSigSendType" SG_ 392 FrntRdrObj11RdrObjTyp 0;
BA_ "GenSigSendType" SG_ 392 FrntRdrObj11RdrObjTypConfBike 0;
BA_ "GenSigSendType" SG_ 392 FrntRdrObj11RdrObjTypConfPed 0;
BA_ "GenSigSendType" SG_ 392 FrntRdrObj11RdrObjTypConfVeh 0;
BA_ "GenSigStartValue" SG_ 392 FrntRdrObj11RdrObjVx 6400;
BA_ "GenSigSendType" SG_ 392 FrntRdrObj11RdrObjVx 0;
BA_ "GenSigSendType" SG_ 392 FrntRdrObj11RdrObjVxStdDe 0;
BA_ "GenSigStartValue" SG_ 392 FrntRdrObj11RdrObjVy 6400;
BA_ "GenSigSendType" SG_ 392 FrntRdrObj11RdrObjVy 0;
BA_ "GenSigSendType" SG_ 392 FrntRdrObj11RdrObjVyStdDe 0;
BA_ "GenSigStartValue" SG_ 392 FrntRdrObj11RelVx 1780;
BA_ "GenSigSendType" SG_ 392 FrntRdrObj11RelVx 0;
BA_ "GenSigStartValue" SG_ 392 FrntRdrObj11RelVy 1780;
BA_ "GenSigSendType" SG_ 392 FrntRdrObj11RelVy 0;
// Frame: FLRSafetyCANFD2Frame46
BA_ "VFrameFormat" BO_ 394 14;
BA_ "GenMsgSendType" BO_ 394 0;
BA_ "GenMsgCycleTime" BO_ 394 50.000;
BA_ "GenSigStartValue" SG_ 394 FrntRdrObj12Heading 1800;
BA_ "GenSigSendType" SG_ 394 FrntRdrObj12Heading 0;
BA_ "GenSigStartValue" SG_ 394 FrntRdrObj12ObjBoxCenterLat 250;
BA_ "GenSigSendType" SG_ 394 FrntRdrObj12ObjBoxCenterLat 0;
BA_ "GenSigStartValue" SG_ 394 FrntRdrObj12ObjBoxCenterLgt 250;
BA_ "GenSigSendType" SG_ 394 FrntRdrObj12ObjBoxCenterLgt 0;
BA_ "GenSigSendType" SG_ 394 FrntRdrObj12ObservationHist 0;
BA_ "GenSigSendType" SG_ 394 FrntRdrObj12RdrObjAx 0;
BA_ "GenSigSendType" SG_ 394 FrntRdrObj12RdrObjAy 0;
BA_ "GenSigSendType" SG_ 394 FrntRdrObj12RdrObjBoxLength 0;
BA_ "GenSigSendType" SG_ 394 FrntRdrObj12RdrObjBoxWidth 0;
BA_ "GenSigSendType" SG_ 394 FrntRdrObj12RdrObjChks 0;
BA_ "GenSigFuncType" SG_ 394 FrntRdrObj12RdrObjChks 15;
BA_ "GenSigDataID" SG_ 394 FrntRdrObj12RdrObjChks "0x7DB";
BA_ "GenSigSendType" SG_ 394 FrntRdrObj12RdrObjCntr 0;
BA_ "GenSigFuncType" SG_ 394 FrntRdrObj12RdrObjCntr 16;
BA_ "GenSigStartValue" SG_ 394 FrntRdrObj12RdrObjCoastCnt 31;
BA_ "GenSigSendType" SG_ 394 FrntRdrObj12RdrObjCoastCnt 0;
BA_ "GenSigSendType" SG_ 394 FrntRdrObj12RdrObjConf 0;
BA_ "GenSigSendType" SG_ 394 FrntRdrObj12RdrObjDx 0;
BA_ "GenSigSendType" SG_ 394 FrntRdrObj12RdrObjDxStdDe 0;
BA_ "GenSigStartValue" SG_ 394 FrntRdrObj12RdrObjDy 4000;
BA_ "GenSigSendType" SG_ 394 FrntRdrObj12RdrObjDy 0;
BA_ "GenSigSendType" SG_ 394 FrntRdrObj12RdrObjDyStdDe 0;
BA_ "GenSigSendType" SG_ 394 FrntRdrObj12RdrObjElevnConf 0;
BA_ "GenSigSendType" SG_ 394 FrntRdrObj12RdrObjElevnSts 0;
BA_ "GenSigSendType" SG_ 394 FrntRdrObj12RdrObjID 0;
BA_ "GenSigSendType" SG_ 394 FrntRdrObj12RdrObjIsInFreeSpace 0;
BA_ "GenSigSendType" SG_ 394 FrntRdrObj12RdrObjMirrProblty 0;
BA_ "GenSigSendType" SG_ 394 FrntRdrObj12RdrObjMtnPat 0;
BA_ "GenSigSendType" SG_ 394 FrntRdrObj12RdrObjNotRealProblty 0;
BA_ "GenSigSendType" SG_ 394 FrntRdrObj12RdrObjStatyCnt 0;
BA_ "GenSigSendType" SG_ 394 FrntRdrObj12RdrObjTiAlv 0;
BA_ "GenSigSendType" SG_ 394 FrntRdrObj12RdrObjTrackSts 0;
BA_ "GenSigSendType" SG_ 394 FrntRdrObj12RdrObjTyp 0;
BA_ "GenSigSendType" SG_ 394 FrntRdrObj12RdrObjTypConfBike 0;
BA_ "GenSigSendType" SG_ 394 FrntRdrObj12RdrObjTypConfPed 0;
BA_ "GenSigSendType" SG_ 394 FrntRdrObj12RdrObjTypConfVeh 0;
BA_ "GenSigStartValue" SG_ 394 FrntRdrObj12RdrObjVx 6400;
BA_ "GenSigSendType" SG_ 394 FrntRdrObj12RdrObjVx 0;
BA_ "GenSigSendType" SG_ 394 FrntRdrObj12RdrObjVxStdDe 0;
BA_ "GenSigStartValue" SG_ 394 FrntRdrObj12RdrObjVy 6400;
BA_ "GenSigSendType" SG_ 394 FrntRdrObj12RdrObjVy 0;
BA_ "GenSigSendType" SG_ 394 FrntRdrObj12RdrObjVyStdDe 0;
BA_ "GenSigStartValue" SG_ 394 FrntRdrObj12RelVx 1780;
BA_ "GenSigSendType" SG_ 394 FrntRdrObj12RelVx 0;
BA_ "GenSigStartValue" SG_ 394 FrntRdrObj12RelVy 1780;
BA_ "GenSigSendType" SG_ 394 FrntRdrObj12RelVy 0;
// Frame: FLRSafetyCANFD2Frame47
BA_ "VFrameFormat" BO_ 396 14;
BA_ "GenMsgSendType" BO_ 396 0;
BA_ "GenMsgCycleTime" BO_ 396 50.000;
BA_ "GenSigStartValue" SG_ 396 FrntRdrObj13Heading 1800;
BA_ "GenSigSendType" SG_ 396 FrntRdrObj13Heading 0;
BA_ "GenSigStartValue" SG_ 396 FrntRdrObj13ObjBoxCenterLat 250;
BA_ "GenSigSendType" SG_ 396 FrntRdrObj13ObjBoxCenterLat 0;
BA_ "GenSigStartValue" SG_ 396 FrntRdrObj13ObjBoxCenterLgt 250;
BA_ "GenSigSendType" SG_ 396 FrntRdrObj13ObjBoxCenterLgt 0;
BA_ "GenSigSendType" SG_ 396 FrntRdrObj13ObservationHist 0;
BA_ "GenSigSendType" SG_ 396 FrntRdrObj13RdrObjAx 0;
BA_ "GenSigSendType" SG_ 396 FrntRdrObj13RdrObjAy 0;
BA_ "GenSigSendType" SG_ 396 FrntRdrObj13RdrObjBoxLength 0;
BA_ "GenSigSendType" SG_ 396 FrntRdrObj13RdrObjBoxWidth 0;
BA_ "GenSigSendType" SG_ 396 FrntRdrObj13RdrObjChks 0;
BA_ "GenSigFuncType" SG_ 396 FrntRdrObj13RdrObjChks 15;
BA_ "GenSigDataID" SG_ 396 FrntRdrObj13RdrObjChks "0x7DC";
BA_ "GenSigSendType" SG_ 396 FrntRdrObj13RdrObjCntr 0;
BA_ "GenSigFuncType" SG_ 396 FrntRdrObj13RdrObjCntr 16;
BA_ "GenSigStartValue" SG_ 396 FrntRdrObj13RdrObjCoastCnt 31;
BA_ "GenSigSendType" SG_ 396 FrntRdrObj13RdrObjCoastCnt 0;
BA_ "GenSigSendType" SG_ 396 FrntRdrObj13RdrObjConf 0;
BA_ "GenSigSendType" SG_ 396 FrntRdrObj13RdrObjDx 0;
BA_ "GenSigSendType" SG_ 396 FrntRdrObj13RdrObjDxStdDe 0;
BA_ "GenSigStartValue" SG_ 396 FrntRdrObj13RdrObjDy 4000;
BA_ "GenSigSendType" SG_ 396 FrntRdrObj13RdrObjDy 0;
BA_ "GenSigSendType" SG_ 396 FrntRdrObj13RdrObjDyStdDe 0;
BA_ "GenSigSendType" SG_ 396 FrntRdrObj13RdrObjElevnConf 0;
BA_ "GenSigSendType" SG_ 396 FrntRdrObj13RdrObjElevnSts 0;
BA_ "GenSigSendType" SG_ 396 FrntRdrObj13RdrObjID 0;
BA_ "GenSigSendType" SG_ 396 FrntRdrObj13RdrObjIsInFreeSpace 0;
BA_ "GenSigSendType" SG_ 396 FrntRdrObj13RdrObjMirrProblty 0;
BA_ "GenSigSendType" SG_ 396 FrntRdrObj13RdrObjMtnPat 0;
BA_ "GenSigSendType" SG_ 396 FrntRdrObj13RdrObjNotRealProblty 0;
BA_ "GenSigSendType" SG_ 396 FrntRdrObj13RdrObjStatyCnt 0;
BA_ "GenSigSendType" SG_ 396 FrntRdrObj13RdrObjTiAlv 0;
BA_ "GenSigSendType" SG_ 396 FrntRdrObj13RdrObjTrackSts 0;
BA_ "GenSigSendType" SG_ 396 FrntRdrObj13RdrObjTyp 0;
BA_ "GenSigSendType" SG_ 396 FrntRdrObj13RdrObjTypConfBike 0;
BA_ "GenSigSendType" SG_ 396 FrntRdrObj13RdrObjTypConfPed 0;
BA_ "GenSigSendType" SG_ 396 FrntRdrObj13RdrObjTypConfVeh 0;
BA_ "GenSigStartValue" SG_ 396 FrntRdrObj13RdrObjVx 6400;
BA_ "GenSigSendType" SG_ 396 FrntRdrObj13RdrObjVx 0;
BA_ "GenSigSendType" SG_ 396 FrntRdrObj13RdrObjVxStdDe 0;
BA_ "GenSigStartValue" SG_ 396 FrntRdrObj13RdrObjVy 6400;
BA_ "GenSigSendType" SG_ 396 FrntRdrObj13RdrObjVy 0;
BA_ "GenSigSendType" SG_ 396 FrntRdrObj13RdrObjVyStdDe 0;
BA_ "GenSigStartValue" SG_ 396 FrntRdrObj13RelVx 1780;
BA_ "GenSigSendType" SG_ 396 FrntRdrObj13RelVx 0;
BA_ "GenSigStartValue" SG_ 396 FrntRdrObj13RelVy 1780;
BA_ "GenSigSendType" SG_ 396 FrntRdrObj13RelVy 0;
// Frame: FLRSafetyCANFD2Frame48
BA_ "VFrameFormat" BO_ 398 14;
BA_ "GenMsgSendType" BO_ 398 0;
BA_ "GenMsgCycleTime" BO_ 398 50.000;
BA_ "GenSigStartValue" SG_ 398 FrntRdrObj14Heading 1800;
BA_ "GenSigSendType" SG_ 398 FrntRdrObj14Heading 0;
BA_ "GenSigStartValue" SG_ 398 FrntRdrObj14ObjBoxCenterLat 250;
BA_ "GenSigSendType" SG_ 398 FrntRdrObj14ObjBoxCenterLat 0;
BA_ "GenSigStartValue" SG_ 398 FrntRdrObj14ObjBoxCenterLgt 250;
BA_ "GenSigSendType" SG_ 398 FrntRdrObj14ObjBoxCenterLgt 0;
BA_ "GenSigSendType" SG_ 398 FrntRdrObj14ObservationHist 0;
BA_ "GenSigSendType" SG_ 398 FrntRdrObj14RdrObjAx 0;
BA_ "GenSigSendType" SG_ 398 FrntRdrObj14RdrObjAy 0;
BA_ "GenSigSendType" SG_ 398 FrntRdrObj14RdrObjBoxLength 0;
BA_ "GenSigSendType" SG_ 398 FrntRdrObj14RdrObjBoxWidth 0;
BA_ "GenSigSendType" SG_ 398 FrntRdrObj14RdrObjChks 0;
BA_ "GenSigFuncType" SG_ 398 FrntRdrObj14RdrObjChks 15;
BA_ "GenSigDataID" SG_ 398 FrntRdrObj14RdrObjChks "0x7DD";
BA_ "GenSigSendType" SG_ 398 FrntRdrObj14RdrObjCntr 0;
BA_ "GenSigFuncType" SG_ 398 FrntRdrObj14RdrObjCntr 16;
BA_ "GenSigStartValue" SG_ 398 FrntRdrObj14RdrObjCoastCnt 31;
BA_ "GenSigSendType" SG_ 398 FrntRdrObj14RdrObjCoastCnt 0;
BA_ "GenSigSendType" SG_ 398 FrntRdrObj14RdrObjConf 0;
BA_ "GenSigSendType" SG_ 398 FrntRdrObj14RdrObjDx 0;
BA_ "GenSigSendType" SG_ 398 FrntRdrObj14RdrObjDxStdDe 0;
BA_ "GenSigStartValue" SG_ 398 FrntRdrObj14RdrObjDy 4000;
BA_ "GenSigSendType" SG_ 398 FrntRdrObj14RdrObjDy 0;
BA_ "GenSigSendType" SG_ 398 FrntRdrObj14RdrObjDyStdDe 0;
BA_ "GenSigSendType" SG_ 398 FrntRdrObj14RdrObjElevnConf 0;
BA_ "GenSigSendType" SG_ 398 FrntRdrObj14RdrObjElevnSts 0;
BA_ "GenSigSendType" SG_ 398 FrntRdrObj14RdrObjID 0;
BA_ "GenSigSendType" SG_ 398 FrntRdrObj14RdrObjIsInFreeSpace 0;
BA_ "GenSigSendType" SG_ 398 FrntRdrObj14RdrObjMirrProblty 0;
BA_ "GenSigSendType" SG_ 398 FrntRdrObj14RdrObjMtnPat 0;
BA_ "GenSigSendType" SG_ 398 FrntRdrObj14RdrObjNotRealProblty 0;
BA_ "GenSigSendType" SG_ 398 FrntRdrObj14RdrObjStatyCnt 0;
BA_ "GenSigSendType" SG_ 398 FrntRdrObj14RdrObjTiAlv 0;
BA_ "GenSigSendType" SG_ 398 FrntRdrObj14RdrObjTrackSts 0;
BA_ "GenSigSendType" SG_ 398 FrntRdrObj14RdrObjTyp 0;
BA_ "GenSigSendType" SG_ 398 FrntRdrObj14RdrObjTypConfBike 0;
BA_ "GenSigSendType" SG_ 398 FrntRdrObj14RdrObjTypConfPed 0;
BA_ "GenSigSendType" SG_ 398 FrntRdrObj14RdrObjTypConfVeh 0;
BA_ "GenSigStartValue" SG_ 398 FrntRdrObj14RdrObjVx 6400;
BA_ "GenSigSendType" SG_ 398 FrntRdrObj14RdrObjVx 0;
BA_ "GenSigSendType" SG_ 398 FrntRdrObj14RdrObjVxStdDe 0;
BA_ "GenSigStartValue" SG_ 398 FrntRdrObj14RdrObjVy 6400;
BA_ "GenSigSendType" SG_ 398 FrntRdrObj14RdrObjVy 0;
BA_ "GenSigSendType" SG_ 398 FrntRdrObj14RdrObjVyStdDe 0;
BA_ "GenSigStartValue" SG_ 398 FrntRdrObj14RelVx 1780;
BA_ "GenSigSendType" SG_ 398 FrntRdrObj14RelVx 0;
BA_ "GenSigStartValue" SG_ 398 FrntRdrObj14RelVy 1780;
BA_ "GenSigSendType" SG_ 398 FrntRdrObj14RelVy 0;
// Frame: FLRSafetyCANFD2Frame49
BA_ "VFrameFormat" BO_ 400 14;
BA_ "GenMsgSendType" BO_ 400 0;
BA_ "GenMsgCycleTime" BO_ 400 50.000;
BA_ "GenSigStartValue" SG_ 400 FrntRdrObj15Heading 1800;
BA_ "GenSigSendType" SG_ 400 FrntRdrObj15Heading 0;
BA_ "GenSigStartValue" SG_ 400 FrntRdrObj15ObjBoxCenterLat 250;
BA_ "GenSigSendType" SG_ 400 FrntRdrObj15ObjBoxCenterLat 0;
BA_ "GenSigStartValue" SG_ 400 FrntRdrObj15ObjBoxCenterLgt 250;
BA_ "GenSigSendType" SG_ 400 FrntRdrObj15ObjBoxCenterLgt 0;
BA_ "GenSigSendType" SG_ 400 FrntRdrObj15ObservationHist 0;
BA_ "GenSigSendType" SG_ 400 FrntRdrObj15RdrObjAx 0;
BA_ "GenSigSendType" SG_ 400 FrntRdrObj15RdrObjAy 0;
BA_ "GenSigSendType" SG_ 400 FrntRdrObj15RdrObjBoxLength 0;
BA_ "GenSigSendType" SG_ 400 FrntRdrObj15RdrObjBoxWidth 0;
BA_ "GenSigSendType" SG_ 400 FrntRdrObj15RdrObjChks 0;
BA_ "GenSigFuncType" SG_ 400 FrntRdrObj15RdrObjChks 15;
BA_ "GenSigDataID" SG_ 400 FrntRdrObj15RdrObjChks "0x7DE";
BA_ "GenSigSendType" SG_ 400 FrntRdrObj15RdrObjCntr 0;
BA_ "GenSigFuncType" SG_ 400 FrntRdrObj15RdrObjCntr 16;
BA_ "GenSigStartValue" SG_ 400 FrntRdrObj15RdrObjCoastCnt 31;
BA_ "GenSigSendType" SG_ 400 FrntRdrObj15RdrObjCoastCnt 0;
BA_ "GenSigSendType" SG_ 400 FrntRdrObj15RdrObjConf 0;
BA_ "GenSigSendType" SG_ 400 FrntRdrObj15RdrObjDx 0;
BA_ "GenSigSendType" SG_ 400 FrntRdrObj15RdrObjDxStdDe 0;
BA_ "GenSigStartValue" SG_ 400 FrntRdrObj15RdrObjDy 4000;
BA_ "GenSigSendType" SG_ 400 FrntRdrObj15RdrObjDy 0;
BA_ "GenSigSendType" SG_ 400 FrntRdrObj15RdrObjDyStdDe 0;
BA_ "GenSigSendType" SG_ 400 FrntRdrObj15RdrObjElevnConf 0;
BA_ "GenSigSendType" SG_ 400 FrntRdrObj15RdrObjElevnSts 0;
BA_ "GenSigSendType" SG_ 400 FrntRdrObj15RdrObjID 0;
BA_ "GenSigSendType" SG_ 400 FrntRdrObj15RdrObjIsInFreeSpace 0;
BA_ "GenSigSendType" SG_ 400 FrntRdrObj15RdrObjMirrProblty 0;
BA_ "GenSigSendType" SG_ 400 FrntRdrObj15RdrObjMtnPat 0;
BA_ "GenSigSendType" SG_ 400 FrntRdrObj15RdrObjNotRealProblty 0;
BA_ "GenSigSendType" SG_ 400 FrntRdrObj15RdrObjStatyCnt 0;
BA_ "GenSigSendType" SG_ 400 FrntRdrObj15RdrObjTiAlv 0;
BA_ "GenSigSendType" SG_ 400 FrntRdrObj15RdrObjTrackSts 0;
BA_ "GenSigSendType" SG_ 400 FrntRdrObj15RdrObjTyp 0;
BA_ "GenSigSendType" SG_ 400 FrntRdrObj15RdrObjTypConfBike 0;
BA_ "GenSigSendType" SG_ 400 FrntRdrObj15RdrObjTypConfPed 0;
BA_ "GenSigSendType" SG_ 400 FrntRdrObj15RdrObjTypConfVeh 0;
BA_ "GenSigStartValue" SG_ 400 FrntRdrObj15RdrObjVx 6400;
BA_ "GenSigSendType" SG_ 400 FrntRdrObj15RdrObjVx 0;
BA_ "GenSigSendType" SG_ 400 FrntRdrObj15RdrObjVxStdDe 0;
BA_ "GenSigStartValue" SG_ 400 FrntRdrObj15RdrObjVy 6400;
BA_ "GenSigSendType" SG_ 400 FrntRdrObj15RdrObjVy 0;
BA_ "GenSigSendType" SG_ 400 FrntRdrObj15RdrObjVyStdDe 0;
BA_ "GenSigStartValue" SG_ 400 FrntRdrObj15RelVx 1780;
BA_ "GenSigSendType" SG_ 400 FrntRdrObj15RelVx 0;
BA_ "GenSigStartValue" SG_ 400 FrntRdrObj15RelVy 1780;
BA_ "GenSigSendType" SG_ 400 FrntRdrObj15RelVy 0;
// Frame: FLRSafetyCANFD2Frame50
BA_ "VFrameFormat" BO_ 402 14;
BA_ "GenMsgSendType" BO_ 402 0;
BA_ "GenMsgCycleTime" BO_ 402 50.000;
BA_ "GenSigStartValue" SG_ 402 FrntRdrObj16Heading 1800;
BA_ "GenSigSendType" SG_ 402 FrntRdrObj16Heading 0;
BA_ "GenSigStartValue" SG_ 402 FrntRdrObj16ObjBoxCenterLat 250;
BA_ "GenSigSendType" SG_ 402 FrntRdrObj16ObjBoxCenterLat 0;
BA_ "GenSigStartValue" SG_ 402 FrntRdrObj16ObjBoxCenterLgt 250;
BA_ "GenSigSendType" SG_ 402 FrntRdrObj16ObjBoxCenterLgt 0;
BA_ "GenSigSendType" SG_ 402 FrntRdrObj16ObservationHist 0;
BA_ "GenSigSendType" SG_ 402 FrntRdrObj16RdrObjAx 0;
BA_ "GenSigSendType" SG_ 402 FrntRdrObj16RdrObjAy 0;
BA_ "GenSigSendType" SG_ 402 FrntRdrObj16RdrObjBoxLength 0;
BA_ "GenSigSendType" SG_ 402 FrntRdrObj16RdrObjBoxWidth 0;
BA_ "GenSigSendType" SG_ 402 FrntRdrObj16RdrObjChks 0;
BA_ "GenSigFuncType" SG_ 402 FrntRdrObj16RdrObjChks 15;
BA_ "GenSigDataID" SG_ 402 FrntRdrObj16RdrObjChks "0x7DF";
BA_ "GenSigSendType" SG_ 402 FrntRdrObj16RdrObjCntr 0;
BA_ "GenSigFuncType" SG_ 402 FrntRdrObj16RdrObjCntr 16;
BA_ "GenSigStartValue" SG_ 402 FrntRdrObj16RdrObjCoastCnt 31;
BA_ "GenSigSendType" SG_ 402 FrntRdrObj16RdrObjCoastCnt 0;
BA_ "GenSigSendType" SG_ 402 FrntRdrObj16RdrObjConf 0;
BA_ "GenSigSendType" SG_ 402 FrntRdrObj16RdrObjDx 0;
BA_ "GenSigSendType" SG_ 402 FrntRdrObj16RdrObjDxStdDe 0;
BA_ "GenSigStartValue" SG_ 402 FrntRdrObj16RdrObjDy 4000;
BA_ "GenSigSendType" SG_ 402 FrntRdrObj16RdrObjDy 0;
BA_ "GenSigSendType" SG_ 402 FrntRdrObj16RdrObjDyStdDe 0;
BA_ "GenSigSendType" SG_ 402 FrntRdrObj16RdrObjElevnConf 0;
BA_ "GenSigSendType" SG_ 402 FrntRdrObj16RdrObjElevnSts 0;
BA_ "GenSigSendType" SG_ 402 FrntRdrObj16RdrObjID 0;
BA_ "GenSigSendType" SG_ 402 FrntRdrObj16RdrObjIsInFreeSpace 0;
BA_ "GenSigSendType" SG_ 402 FrntRdrObj16RdrObjMirrProblty 0;
BA_ "GenSigSendType" SG_ 402 FrntRdrObj16RdrObjMtnPat 0;
BA_ "GenSigSendType" SG_ 402 FrntRdrObj16RdrObjNotRealProblty 0;
BA_ "GenSigSendType" SG_ 402 FrntRdrObj16RdrObjStatyCnt 0;
BA_ "GenSigSendType" SG_ 402 FrntRdrObj16RdrObjTiAlv 0;
BA_ "GenSigSendType" SG_ 402 FrntRdrObj16RdrObjTrackSts 0;
BA_ "GenSigSendType" SG_ 402 FrntRdrObj16RdrObjTyp 0;
BA_ "GenSigSendType" SG_ 402 FrntRdrObj16RdrObjTypConfBike 0;
BA_ "GenSigSendType" SG_ 402 FrntRdrObj16RdrObjTypConfPed 0;
BA_ "GenSigSendType" SG_ 402 FrntRdrObj16RdrObjTypConfVeh 0;
BA_ "GenSigStartValue" SG_ 402 FrntRdrObj16RdrObjVx 6400;
BA_ "GenSigSendType" SG_ 402 FrntRdrObj16RdrObjVx 0;
BA_ "GenSigSendType" SG_ 402 FrntRdrObj16RdrObjVxStdDe 0;
BA_ "GenSigStartValue" SG_ 402 FrntRdrObj16RdrObjVy 6400;
BA_ "GenSigSendType" SG_ 402 FrntRdrObj16RdrObjVy 0;
BA_ "GenSigSendType" SG_ 402 FrntRdrObj16RdrObjVyStdDe 0;
BA_ "GenSigStartValue" SG_ 402 FrntRdrObj16RelVx 1780;
BA_ "GenSigSendType" SG_ 402 FrntRdrObj16RelVx 0;
BA_ "GenSigStartValue" SG_ 402 FrntRdrObj16RelVy 1780;
BA_ "GenSigSendType" SG_ 402 FrntRdrObj16RelVy 0;
// Frame: FLRSafetyCANFD2Frame51
BA_ "VFrameFormat" BO_ 404 14;
BA_ "GenMsgSendType" BO_ 404 0;
BA_ "GenMsgCycleTime" BO_ 404 50.000;
BA_ "GenSigStartValue" SG_ 404 FrntRdrObj17Heading 1800;
BA_ "GenSigSendType" SG_ 404 FrntRdrObj17Heading 0;
BA_ "GenSigStartValue" SG_ 404 FrntRdrObj17ObjBoxCenterLat 250;
BA_ "GenSigSendType" SG_ 404 FrntRdrObj17ObjBoxCenterLat 0;
BA_ "GenSigStartValue" SG_ 404 FrntRdrObj17ObjBoxCenterLgt 250;
BA_ "GenSigSendType" SG_ 404 FrntRdrObj17ObjBoxCenterLgt 0;
BA_ "GenSigSendType" SG_ 404 FrntRdrObj17ObservationHist 0;
BA_ "GenSigSendType" SG_ 404 FrntRdrObj17RdrObjAx 0;
BA_ "GenSigSendType" SG_ 404 FrntRdrObj17RdrObjAy 0;
BA_ "GenSigSendType" SG_ 404 FrntRdrObj17RdrObjBoxLength 0;
BA_ "GenSigSendType" SG_ 404 FrntRdrObj17RdrObjBoxWidth 0;
BA_ "GenSigSendType" SG_ 404 FrntRdrObj17RdrObjChks 0;
BA_ "GenSigFuncType" SG_ 404 FrntRdrObj17RdrObjChks 15;
BA_ "GenSigDataID" SG_ 404 FrntRdrObj17RdrObjChks "0x7E0";
BA_ "GenSigSendType" SG_ 404 FrntRdrObj17RdrObjCntr 0;
BA_ "GenSigFuncType" SG_ 404 FrntRdrObj17RdrObjCntr 16;
BA_ "GenSigStartValue" SG_ 404 FrntRdrObj17RdrObjCoastCnt 31;
BA_ "GenSigSendType" SG_ 404 FrntRdrObj17RdrObjCoastCnt 0;
BA_ "GenSigSendType" SG_ 404 FrntRdrObj17RdrObjConf 0;
BA_ "GenSigSendType" SG_ 404 FrntRdrObj17RdrObjDx 0;
BA_ "GenSigSendType" SG_ 404 FrntRdrObj17RdrObjDxStdDe 0;
BA_ "GenSigStartValue" SG_ 404 FrntRdrObj17RdrObjDy 4000;
BA_ "GenSigSendType" SG_ 404 FrntRdrObj17RdrObjDy 0;
BA_ "GenSigSendType" SG_ 404 FrntRdrObj17RdrObjDyStdDe 0;
BA_ "GenSigSendType" SG_ 404 FrntRdrObj17RdrObjElevnConf 0;
BA_ "GenSigSendType" SG_ 404 FrntRdrObj17RdrObjElevnSts 0;
BA_ "GenSigSendType" SG_ 404 FrntRdrObj17RdrObjID 0;
BA_ "GenSigSendType" SG_ 404 FrntRdrObj17RdrObjIsInFreeSpace 0;
BA_ "GenSigSendType" SG_ 404 FrntRdrObj17RdrObjMirrProblty 0;
BA_ "GenSigSendType" SG_ 404 FrntRdrObj17RdrObjMtnPat 0;
BA_ "GenSigSendType" SG_ 404 FrntRdrObj17RdrObjNotRealProblty 0;
BA_ "GenSigSendType" SG_ 404 FrntRdrObj17RdrObjStatyCnt 0;
BA_ "GenSigSendType" SG_ 404 FrntRdrObj17RdrObjTiAlv 0;
BA_ "GenSigSendType" SG_ 404 FrntRdrObj17RdrObjTrackSts 0;
BA_ "GenSigSendType" SG_ 404 FrntRdrObj17RdrObjTyp 0;
BA_ "GenSigSendType" SG_ 404 FrntRdrObj17RdrObjTypConfBike 0;
BA_ "GenSigSendType" SG_ 404 FrntRdrObj17RdrObjTypConfPed 0;
BA_ "GenSigSendType" SG_ 404 FrntRdrObj17RdrObjTypConfVeh 0;
BA_ "GenSigStartValue" SG_ 404 FrntRdrObj17RdrObjVx 6400;
BA_ "GenSigSendType" SG_ 404 FrntRdrObj17RdrObjVx 0;
BA_ "GenSigSendType" SG_ 404 FrntRdrObj17RdrObjVxStdDe 0;
BA_ "GenSigStartValue" SG_ 404 FrntRdrObj17RdrObjVy 6400;
BA_ "GenSigSendType" SG_ 404 FrntRdrObj17RdrObjVy 0;
BA_ "GenSigSendType" SG_ 404 FrntRdrObj17RdrObjVyStdDe 0;
BA_ "GenSigStartValue" SG_ 404 FrntRdrObj17RelVx 1780;
BA_ "GenSigSendType" SG_ 404 FrntRdrObj17RelVx 0;
BA_ "GenSigStartValue" SG_ 404 FrntRdrObj17RelVy 1780;
BA_ "GenSigSendType" SG_ 404 FrntRdrObj17RelVy 0;
VAL_ 378 FrntRdrObj4RdrObjElevnSts 0 "RdrObjElevnSts_Unknown" 1 "RdrObjElevnSts_OverRidable" 2 "RdrObjElevnSts_Rlv" 3 "RdrObjElevnSts_UnderRidable";
VAL_ 378 FrntRdrObj4RdrObjIsInFreeSpace 0 "YesNo2_No" 1 "YesNo2_Yes";
VAL_ 378 FrntRdrObj4RdrObjMtnPat 0 "RdrObjMtnPat_Ukwn" 1 "RdrObjMtnPat_Staty" 2 "RdrObjMtnPat_StatyFromMovg" 3 "RdrObjMtnPat_Movg" 4 "RdrObjMtnPat_Receding" 5 "RdrObjMtnPat_Oncoming" 6 "RdrObjMtnPat_CrossingFromLe" 7 "RdrObjMtnPat_CrossingFromRi";
VAL_ 378 FrntRdrObj4RdrObjTrackSts 0 "RdrObjTrackSts_Invld" 1 "RdrObjTrackSts_Updated" 2 "RdrObjTrackSts_New" 3 "RdrObjTrackSts_Coasted";
VAL_ 378 FrntRdrObj4RdrObjTyp 0 "RdrObjTyp_Ukwn" 1 "RdrObjTyp_Car" 2 "RdrObjTyp_MotorCycle" 3 "RdrObjTyp_Truck" 4 "RdrObjTyp_Ped" 5 "RdrObjTyp_ObstdVert1" 6 "RdrObjTyp_ObstdVert2" 7 "RdrObjTyp_Anim" 8 "RdrObjTyp_ObjGen" 9 "RdrObjTyp_Bicycle" 10 "RdrObjTyp_VehofUkwnClass" 11 "RdrObjTyp_Reserved";
VAL_ 380 FrntRdrObj5RdrObjElevnSts 0 "RdrObjElevnSts_Unknown" 1 "RdrObjElevnSts_OverRidable" 2 "RdrObjElevnSts_Rlv" 3 "RdrObjElevnSts_UnderRidable";
VAL_ 380 FrntRdrObj5RdrObjIsInFreeSpace 0 "YesNo2_No" 1 "YesNo2_Yes";
VAL_ 380 FrntRdrObj5RdrObjMtnPat 0 "RdrObjMtnPat_Ukwn" 1 "RdrObjMtnPat_Staty" 2 "RdrObjMtnPat_StatyFromMovg" 3 "RdrObjMtnPat_Movg" 4 "RdrObjMtnPat_Receding" 5 "RdrObjMtnPat_Oncoming" 6 "RdrObjMtnPat_CrossingFromLe" 7 "RdrObjMtnPat_CrossingFromRi";
VAL_ 380 FrntRdrObj5RdrObjTrackSts 0 "RdrObjTrackSts_Invld" 1 "RdrObjTrackSts_Updated" 2 "RdrObjTrackSts_New" 3 "RdrObjTrackSts_Coasted";
VAL_ 380 FrntRdrObj5RdrObjTyp 0 "RdrObjTyp_Ukwn" 1 "RdrObjTyp_Car" 2 "RdrObjTyp_MotorCycle" 3 "RdrObjTyp_Truck" 4 "RdrObjTyp_Ped" 5 "RdrObjTyp_ObstdVert1" 6 "RdrObjTyp_ObstdVert2" 7 "RdrObjTyp_Anim" 8 "RdrObjTyp_ObjGen" 9 "RdrObjTyp_Bicycle" 10 "RdrObjTyp_VehofUkwnClass" 11 "RdrObjTyp_Reserved";
VAL_ 382 FrntRdrObj6RdrObjElevnSts 0 "RdrObjElevnSts_Unknown" 1 "RdrObjElevnSts_OverRidable" 2 "RdrObjElevnSts_Rlv" 3 "RdrObjElevnSts_UnderRidable";
VAL_ 382 FrntRdrObj6RdrObjIsInFreeSpace 0 "YesNo2_No" 1 "YesNo2_Yes";
VAL_ 382 FrntRdrObj6RdrObjMtnPat 0 "RdrObjMtnPat_Ukwn" 1 "RdrObjMtnPat_Staty" 2 "RdrObjMtnPat_StatyFromMovg" 3 "RdrObjMtnPat_Movg" 4 "RdrObjMtnPat_Receding" 5 "RdrObjMtnPat_Oncoming" 6 "RdrObjMtnPat_CrossingFromLe" 7 "RdrObjMtnPat_CrossingFromRi";
VAL_ 382 FrntRdrObj6RdrObjTrackSts 0 "RdrObjTrackSts_Invld" 1 "RdrObjTrackSts_Updated" 2 "RdrObjTrackSts_New" 3 "RdrObjTrackSts_Coasted";
VAL_ 382 FrntRdrObj6RdrObjTyp 0 "RdrObjTyp_Ukwn" 1 "RdrObjTyp_Car" 2 "RdrObjTyp_MotorCycle" 3 "RdrObjTyp_Truck" 4 "RdrObjTyp_Ped" 5 "RdrObjTyp_ObstdVert1" 6 "RdrObjTyp_ObstdVert2" 7 "RdrObjTyp_Anim" 8 "RdrObjTyp_ObjGen" 9 "RdrObjTyp_Bicycle" 10 "RdrObjTyp_VehofUkwnClass" 11 "RdrObjTyp_Reserved";
VAL_ 384 FrntRdrObj7RdrObjElevnSts 0 "RdrObjElevnSts_Unknown" 1 "RdrObjElevnSts_OverRidable" 2 "RdrObjElevnSts_Rlv" 3 "RdrObjElevnSts_UnderRidable";
VAL_ 384 FrntRdrObj7RdrObjIsInFreeSpace 0 "YesNo2_No" 1 "YesNo2_Yes";
VAL_ 384 FrntRdrObj7RdrObjMtnPat 0 "RdrObjMtnPat_Ukwn" 1 "RdrObjMtnPat_Staty" 2 "RdrObjMtnPat_StatyFromMovg" 3 "RdrObjMtnPat_Movg" 4 "RdrObjMtnPat_Receding" 5 "RdrObjMtnPat_Oncoming" 6 "RdrObjMtnPat_CrossingFromLe" 7 "RdrObjMtnPat_CrossingFromRi";
VAL_ 384 FrntRdrObj7RdrObjTrackSts 0 "RdrObjTrackSts_Invld" 1 "RdrObjTrackSts_Updated" 2 "RdrObjTrackSts_New" 3 "RdrObjTrackSts_Coasted";
VAL_ 384 FrntRdrObj7RdrObjTyp 0 "RdrObjTyp_Ukwn" 1 "RdrObjTyp_Car" 2 "RdrObjTyp_MotorCycle" 3 "RdrObjTyp_Truck" 4 "RdrObjTyp_Ped" 5 "RdrObjTyp_ObstdVert1" 6 "RdrObjTyp_ObstdVert2" 7 "RdrObjTyp_Anim" 8 "RdrObjTyp_ObjGen" 9 "RdrObjTyp_Bicycle" 10 "RdrObjTyp_VehofUkwnClass" 11 "RdrObjTyp_Reserved";
VAL_ 386 FrntRdrObj8RdrObjElevnSts 0 "RdrObjElevnSts_Unknown" 1 "RdrObjElevnSts_OverRidable" 2 "RdrObjElevnSts_Rlv" 3 "RdrObjElevnSts_UnderRidable";
VAL_ 386 FrntRdrObj8RdrObjIsInFreeSpace 0 "YesNo2_No" 1 "YesNo2_Yes";
VAL_ 386 FrntRdrObj8RdrObjMtnPat 0 "RdrObjMtnPat_Ukwn" 1 "RdrObjMtnPat_Staty" 2 "RdrObjMtnPat_StatyFromMovg" 3 "RdrObjMtnPat_Movg" 4 "RdrObjMtnPat_Receding" 5 "RdrObjMtnPat_Oncoming" 6 "RdrObjMtnPat_CrossingFromLe" 7 "RdrObjMtnPat_CrossingFromRi";
VAL_ 386 FrntRdrObj8RdrObjTrackSts 0 "RdrObjTrackSts_Invld" 1 "RdrObjTrackSts_Updated" 2 "RdrObjTrackSts_New" 3 "RdrObjTrackSts_Coasted";
VAL_ 386 FrntRdrObj8RdrObjTyp 0 "RdrObjTyp_Ukwn" 1 "RdrObjTyp_Car" 2 "RdrObjTyp_MotorCycle" 3 "RdrObjTyp_Truck" 4 "RdrObjTyp_Ped" 5 "RdrObjTyp_ObstdVert1" 6 "RdrObjTyp_ObstdVert2" 7 "RdrObjTyp_Anim" 8 "RdrObjTyp_ObjGen" 9 "RdrObjTyp_Bicycle" 10 "RdrObjTyp_VehofUkwnClass" 11 "RdrObjTyp_Reserved";
VAL_ 388 FrntRdrObj9RdrObjElevnSts 0 "RdrObjElevnSts_Unknown" 1 "RdrObjElevnSts_OverRidable" 2 "RdrObjElevnSts_Rlv" 3 "RdrObjElevnSts_UnderRidable";
VAL_ 388 FrntRdrObj9RdrObjIsInFreeSpace 0 "YesNo2_No" 1 "YesNo2_Yes";
VAL_ 388 FrntRdrObj9RdrObjMtnPat 0 "RdrObjMtnPat_Ukwn" 1 "RdrObjMtnPat_Staty" 2 "RdrObjMtnPat_StatyFromMovg" 3 "RdrObjMtnPat_Movg" 4 "RdrObjMtnPat_Receding" 5 "RdrObjMtnPat_Oncoming" 6 "RdrObjMtnPat_CrossingFromLe" 7 "RdrObjMtnPat_CrossingFromRi";
VAL_ 388 FrntRdrObj9RdrObjTrackSts 0 "RdrObjTrackSts_Invld" 1 "RdrObjTrackSts_Updated" 2 "RdrObjTrackSts_New" 3 "RdrObjTrackSts_Coasted";
VAL_ 388 FrntRdrObj9RdrObjTyp 0 "RdrObjTyp_Ukwn" 1 "RdrObjTyp_Car" 2 "RdrObjTyp_MotorCycle" 3 "RdrObjTyp_Truck" 4 "RdrObjTyp_Ped" 5 "RdrObjTyp_ObstdVert1" 6 "RdrObjTyp_ObstdVert2" 7 "RdrObjTyp_Anim" 8 "RdrObjTyp_ObjGen" 9 "RdrObjTyp_Bicycle" 10 "RdrObjTyp_VehofUkwnClass" 11 "RdrObjTyp_Reserved";
VAL_ 390 FrntRdrObj10RdrObjElevnSts 0 "RdrObjElevnSts_Unknown" 1 "RdrObjElevnSts_OverRidable" 2 "RdrObjElevnSts_Rlv" 3 "RdrObjElevnSts_UnderRidable";
VAL_ 390 FrntRdrObj10RdrObjIsInFreeSpace 0 "YesNo2_No" 1 "YesNo2_Yes";
VAL_ 390 FrntRdrObj10RdrObjMtnPat 0 "RdrObjMtnPat_Ukwn" 1 "RdrObjMtnPat_Staty" 2 "RdrObjMtnPat_StatyFromMovg" 3 "RdrObjMtnPat_Movg" 4 "RdrObjMtnPat_Receding" 5 "RdrObjMtnPat_Oncoming" 6 "RdrObjMtnPat_CrossingFromLe" 7 "RdrObjMtnPat_CrossingFromRi";
VAL_ 390 FrntRdrObj10RdrObjTrackSts 0 "RdrObjTrackSts_Invld" 1 "RdrObjTrackSts_Updated" 2 "RdrObjTrackSts_New" 3 "RdrObjTrackSts_Coasted";
VAL_ 390 FrntRdrObj10RdrObjTyp 0 "RdrObjTyp_Ukwn" 1 "RdrObjTyp_Car" 2 "RdrObjTyp_MotorCycle" 3 "RdrObjTyp_Truck" 4 "RdrObjTyp_Ped" 5 "RdrObjTyp_ObstdVert1" 6 "RdrObjTyp_ObstdVert2" 7 "RdrObjTyp_Anim" 8 "RdrObjTyp_ObjGen" 9 "RdrObjTyp_Bicycle" 10 "RdrObjTyp_VehofUkwnClass" 11 "RdrObjTyp_Reserved";
VAL_ 392 FrntRdrObj11RdrObjElevnSts 0 "RdrObjElevnSts_Unknown" 1 "RdrObjElevnSts_OverRidable" 2 "RdrObjElevnSts_Rlv" 3 "RdrObjElevnSts_UnderRidable";
VAL_ 392 FrntRdrObj11RdrObjIsInFreeSpace 0 "YesNo2_No" 1 "YesNo2_Yes";
VAL_ 392 FrntRdrObj11RdrObjMtnPat 0 "RdrObjMtnPat_Ukwn" 1 "RdrObjMtnPat_Staty" 2 "RdrObjMtnPat_StatyFromMovg" 3 "RdrObjMtnPat_Movg" 4 "RdrObjMtnPat_Receding" 5 "RdrObjMtnPat_Oncoming" 6 "RdrObjMtnPat_CrossingFromLe" 7 "RdrObjMtnPat_CrossingFromRi";
VAL_ 392 FrntRdrObj11RdrObjTrackSts 0 "RdrObjTrackSts_Invld" 1 "RdrObjTrackSts_Updated" 2 "RdrObjTrackSts_New" 3 "RdrObjTrackSts_Coasted";
VAL_ 392 FrntRdrObj11RdrObjTyp 0 "RdrObjTyp_Ukwn" 1 "RdrObjTyp_Car" 2 "RdrObjTyp_MotorCycle" 3 "RdrObjTyp_Truck" 4 "RdrObjTyp_Ped" 5 "RdrObjTyp_ObstdVert1" 6 "RdrObjTyp_ObstdVert2" 7 "RdrObjTyp_Anim" 8 "RdrObjTyp_ObjGen" 9 "RdrObjTyp_Bicycle" 10 "RdrObjTyp_VehofUkwnClass" 11 "RdrObjTyp_Reserved";
VAL_ 394 FrntRdrObj12RdrObjElevnSts 0 "RdrObjElevnSts_Unknown" 1 "RdrObjElevnSts_OverRidable" 2 "RdrObjElevnSts_Rlv" 3 "RdrObjElevnSts_UnderRidable";
VAL_ 394 FrntRdrObj12RdrObjIsInFreeSpace 0 "YesNo2_No" 1 "YesNo2_Yes";
VAL_ 394 FrntRdrObj12RdrObjMtnPat 0 "RdrObjMtnPat_Ukwn" 1 "RdrObjMtnPat_Staty" 2 "RdrObjMtnPat_StatyFromMovg" 3 "RdrObjMtnPat_Movg" 4 "RdrObjMtnPat_Receding" 5 "RdrObjMtnPat_Oncoming" 6 "RdrObjMtnPat_CrossingFromLe" 7 "RdrObjMtnPat_CrossingFromRi";
VAL_ 394 FrntRdrObj12RdrObjTrackSts 0 "RdrObjTrackSts_Invld" 1 "RdrObjTrackSts_Updated" 2 "RdrObjTrackSts_New" 3 "RdrObjTrackSts_Coasted";
VAL_ 394 FrntRdrObj12RdrObjTyp 0 "RdrObjTyp_Ukwn" 1 "RdrObjTyp_Car" 2 "RdrObjTyp_MotorCycle" 3 "RdrObjTyp_Truck" 4 "RdrObjTyp_Ped" 5 "RdrObjTyp_ObstdVert1" 6 "RdrObjTyp_ObstdVert2" 7 "RdrObjTyp_Anim" 8 "RdrObjTyp_ObjGen" 9 "RdrObjTyp_Bicycle" 10 "RdrObjTyp_VehofUkwnClass" 11 "RdrObjTyp_Reserved";
VAL_ 396 FrntRdrObj13RdrObjElevnSts 0 "RdrObjElevnSts_Unknown" 1 "RdrObjElevnSts_OverRidable" 2 "RdrObjElevnSts_Rlv" 3 "RdrObjElevnSts_UnderRidable";
VAL_ 396 FrntRdrObj13RdrObjIsInFreeSpace 0 "YesNo2_No" 1 "YesNo2_Yes";
VAL_ 396 FrntRdrObj13RdrObjMtnPat 0 "RdrObjMtnPat_Ukwn" 1 "RdrObjMtnPat_Staty" 2 "RdrObjMtnPat_StatyFromMovg" 3 "RdrObjMtnPat_Movg" 4 "RdrObjMtnPat_Receding" 5 "RdrObjMtnPat_Oncoming" 6 "RdrObjMtnPat_CrossingFromLe" 7 "RdrObjMtnPat_CrossingFromRi";
VAL_ 396 FrntRdrObj13RdrObjTrackSts 0 "RdrObjTrackSts_Invld" 1 "RdrObjTrackSts_Updated" 2 "RdrObjTrackSts_New" 3 "RdrObjTrackSts_Coasted";
VAL_ 396 FrntRdrObj13RdrObjTyp 0 "RdrObjTyp_Ukwn" 1 "RdrObjTyp_Car" 2 "RdrObjTyp_MotorCycle" 3 "RdrObjTyp_Truck" 4 "RdrObjTyp_Ped" 5 "RdrObjTyp_ObstdVert1" 6 "RdrObjTyp_ObstdVert2" 7 "RdrObjTyp_Anim" 8 "RdrObjTyp_ObjGen" 9 "RdrObjTyp_Bicycle" 10 "RdrObjTyp_VehofUkwnClass" 11 "RdrObjTyp_Reserved";
VAL_ 398 FrntRdrObj14RdrObjElevnSts 0 "RdrObjElevnSts_Unknown" 1 "RdrObjElevnSts_OverRidable" 2 "RdrObjElevnSts_Rlv" 3 "RdrObjElevnSts_UnderRidable";
VAL_ 398 FrntRdrObj14RdrObjIsInFreeSpace 0 "YesNo2_No" 1 "YesNo2_Yes";
VAL_ 398 FrntRdrObj14RdrObjMtnPat 0 "RdrObjMtnPat_Ukwn" 1 "RdrObjMtnPat_Staty" 2 "RdrObjMtnPat_StatyFromMovg" 3 "RdrObjMtnPat_Movg" 4 "RdrObjMtnPat_Receding" 5 "RdrObjMtnPat_Oncoming" 6 "RdrObjMtnPat_CrossingFromLe" 7 "RdrObjMtnPat_CrossingFromRi";
VAL_ 398 FrntRdrObj14RdrObjTrackSts 0 "RdrObjTrackSts_Invld" 1 "RdrObjTrackSts_Updated" 2 "RdrObjTrackSts_New" 3 "RdrObjTrackSts_Coasted";
VAL_ 398 FrntRdrObj14RdrObjTyp 0 "RdrObjTyp_Ukwn" 1 "RdrObjTyp_Car" 2 "RdrObjTyp_MotorCycle" 3 "RdrObjTyp_Truck" 4 "RdrObjTyp_Ped" 5 "RdrObjTyp_ObstdVert1" 6 "RdrObjTyp_ObstdVert2" 7 "RdrObjTyp_Anim" 8 "RdrObjTyp_ObjGen" 9 "RdrObjTyp_Bicycle" 10 "RdrObjTyp_VehofUkwnClass" 11 "RdrObjTyp_Reserved";
VAL_ 400 FrntRdrObj15RdrObjElevnSts 0 "RdrObjElevnSts_Unknown" 1 "RdrObjElevnSts_OverRidable" 2 "RdrObjElevnSts_Rlv" 3 "RdrObjElevnSts_UnderRidable";
VAL_ 400 FrntRdrObj15RdrObjIsInFreeSpace 0 "YesNo2_No" 1 "YesNo2_Yes";
VAL_ 400 FrntRdrObj15RdrObjMtnPat 0 "RdrObjMtnPat_Ukwn" 1 "RdrObjMtnPat_Staty" 2 "RdrObjMtnPat_StatyFromMovg" 3 "RdrObjMtnPat_Movg" 4 "RdrObjMtnPat_Receding" 5 "RdrObjMtnPat_Oncoming" 6 "RdrObjMtnPat_CrossingFromLe" 7 "RdrObjMtnPat_CrossingFromRi";
VAL_ 400 FrntRdrObj15RdrObjTrackSts 0 "RdrObjTrackSts_Invld" 1 "RdrObjTrackSts_Updated" 2 "RdrObjTrackSts_New" 3 "RdrObjTrackSts_Coasted";
VAL_ 400 FrntRdrObj15RdrObjTyp 0 "RdrObjTyp_Ukwn" 1 "RdrObjTyp_Car" 2 "RdrObjTyp_MotorCycle" 3 "RdrObjTyp_Truck" 4 "RdrObjTyp_Ped" 5 "RdrObjTyp_ObstdVert1" 6 "RdrObjTyp_ObstdVert2" 7 "RdrObjTyp_Anim" 8 "RdrObjTyp_ObjGen" 9 "RdrObjTyp_Bicycle" 10 "RdrObjTyp_VehofUkwnClass" 11 "RdrObjTyp_Reserved";
VAL_ 402 FrntRdrObj16RdrObjElevnSts 0 "RdrObjElevnSts_Unknown" 1 "RdrObjElevnSts_OverRidable" 2 "RdrObjElevnSts_Rlv" 3 "RdrObjElevnSts_UnderRidable";
VAL_ 402 FrntRdrObj16RdrObjIsInFreeSpace 0 "YesNo2_No" 1 "YesNo2_Yes";
VAL_ 402 FrntRdrObj16RdrObjMtnPat 0 "RdrObjMtnPat_Ukwn" 1 "RdrObjMtnPat_Staty" 2 "RdrObjMtnPat_StatyFromMovg" 3 "RdrObjMtnPat_Movg" 4 "RdrObjMtnPat_Receding" 5 "RdrObjMtnPat_Oncoming" 6 "RdrObjMtnPat_CrossingFromLe" 7 "RdrObjMtnPat_CrossingFromRi";
VAL_ 402 FrntRdrObj16RdrObjTrackSts 0 "RdrObjTrackSts_Invld" 1 "RdrObjTrackSts_Updated" 2 "RdrObjTrackSts_New" 3 "RdrObjTrackSts_Coasted";
VAL_ 402 FrntRdrObj16RdrObjTyp 0 "RdrObjTyp_Ukwn" 1 "RdrObjTyp_Car" 2 "RdrObjTyp_MotorCycle" 3 "RdrObjTyp_Truck" 4 "RdrObjTyp_Ped" 5 "RdrObjTyp_ObstdVert1" 6 "RdrObjTyp_ObstdVert2" 7 "RdrObjTyp_Anim" 8 "RdrObjTyp_ObjGen" 9 "RdrObjTyp_Bicycle" 10 "RdrObjTyp_VehofUkwnClass" 11 "RdrObjTyp_Reserved";
VAL_ 404 FrntRdrObj17RdrObjElevnSts 0 "RdrObjElevnSts_Unknown" 1 "RdrObjElevnSts_OverRidable" 2 "RdrObjElevnSts_Rlv" 3 "RdrObjElevnSts_UnderRidable";
VAL_ 404 FrntRdrObj17RdrObjIsInFreeSpace 0 "YesNo2_No" 1 "YesNo2_Yes";
VAL_ 404 FrntRdrObj17RdrObjMtnPat 0 "RdrObjMtnPat_Ukwn" 1 "RdrObjMtnPat_Staty" 2 "RdrObjMtnPat_StatyFromMovg" 3 "RdrObjMtnPat_Movg" 4 "RdrObjMtnPat_Receding" 5 "RdrObjMtnPat_Oncoming" 6 "RdrObjMtnPat_CrossingFromLe" 7 "RdrObjMtnPat_CrossingFromRi";
VAL_ 404 FrntRdrObj17RdrObjTrackSts 0 "RdrObjTrackSts_Invld" 1 "RdrObjTrackSts_Updated" 2 "RdrObjTrackSts_New" 3 "RdrObjTrackSts_Coasted";
VAL_ 404 FrntRdrObj17RdrObjTyp 0 "RdrObjTyp_Ukwn" 1 "RdrObjTyp_Car" 2 "RdrObjTyp_MotorCycle" 3 "RdrObjTyp_Truck" 4 "RdrObjTyp_Ped" 5 "RdrObjTyp_ObstdVert1" 6 "RdrObjTyp_ObstdVert2" 7 "RdrObjTyp_Anim" 8 "RdrObjTyp_ObjGen" 9 "RdrObjTyp_Bicycle" 10 "RdrObjTyp_VehofUkwnClass" 11 "RdrObjTyp_Reserved";
SIG_GROUP_ 390 FrntRdrObj10 1 : FrntRdrObj10Heading FrntRdrObj10ObjBoxCenterLat FrntRdrObj10ObjBoxCenterLgt FrntRdrObj10ObservationHist FrntRdrObj10RdrObjAx FrntRdrObj10RdrObjAy FrntRdrObj10RdrObjBoxLength FrntRdrObj10RdrObjBoxWidth FrntRdrObj10RdrObjChks FrntRdrObj10RdrObjCntr FrntRdrObj10RdrObjCoastCnt FrntRdrObj10RdrObjConf FrntRdrObj10RdrObjDx FrntRdrObj10RdrObjDxStdDe FrntRdrObj10RdrObjDy FrntRdrObj10RdrObjDyStdDe FrntRdrObj10RdrObjElevnConf FrntRdrObj10RdrObjElevnSts FrntRdrObj10RdrObjID FrntRdrObj10RdrObjIsInFreeSpace FrntRdrObj10RdrObjMirrProblty FrntRdrObj10RdrObjMtnPat FrntRdrObj10RdrObjNotRealProblty FrntRdrObj10RdrObjStatyCnt FrntRdrObj10RdrObjTiAlv FrntRdrObj10RdrObjTrackSts FrntRdrObj10RdrObjTyp FrntRdrObj10RdrObjTypConfBike FrntRdrObj10RdrObjTypConfPed FrntRdrObj10RdrObjTypConfVeh FrntRdrObj10RdrObjVx FrntRdrObj10RdrObjVxStdDe FrntRdrObj10RdrObjVy FrntRdrObj10RdrObjVyStdDe FrntRdrObj10RelVx FrntRdrObj10RelVy;
SIG_GROUP_ 392 FrntRdrObj11 1 : FrntRdrObj11Heading FrntRdrObj11ObjBoxCenterLat FrntRdrObj11ObjBoxCenterLgt FrntRdrObj11ObservationHist FrntRdrObj11RdrObjAx FrntRdrObj11RdrObjAy FrntRdrObj11RdrObjBoxLength FrntRdrObj11RdrObjBoxWidth FrntRdrObj11RdrObjChks FrntRdrObj11RdrObjCntr FrntRdrObj11RdrObjCoastCnt FrntRdrObj11RdrObjConf FrntRdrObj11RdrObjDx FrntRdrObj11RdrObjDxStdDe FrntRdrObj11RdrObjDy FrntRdrObj11RdrObjDyStdDe FrntRdrObj11RdrObjElevnConf FrntRdrObj11RdrObjElevnSts FrntRdrObj11RdrObjID FrntRdrObj11RdrObjIsInFreeSpace FrntRdrObj11RdrObjMirrProblty FrntRdrObj11RdrObjMtnPat FrntRdrObj11RdrObjNotRealProblty FrntRdrObj11RdrObjStatyCnt FrntRdrObj11RdrObjTiAlv FrntRdrObj11RdrObjTrackSts FrntRdrObj11RdrObjTyp FrntRdrObj11RdrObjTypConfBike FrntRdrObj11RdrObjTypConfPed FrntRdrObj11RdrObjTypConfVeh FrntRdrObj11RdrObjVx FrntRdrObj11RdrObjVxStdDe FrntRdrObj11RdrObjVy FrntRdrObj11RdrObjVyStdDe FrntRdrObj11RelVx FrntRdrObj11RelVy;
SIG_GROUP_ 394 FrntRdrObj12 1 : FrntRdrObj12Heading FrntRdrObj12ObjBoxCenterLat FrntRdrObj12ObjBoxCenterLgt FrntRdrObj12ObservationHist FrntRdrObj12RdrObjAx FrntRdrObj12RdrObjAy FrntRdrObj12RdrObjBoxLength FrntRdrObj12RdrObjBoxWidth FrntRdrObj12RdrObjChks FrntRdrObj12RdrObjCntr FrntRdrObj12RdrObjCoastCnt FrntRdrObj12RdrObjConf FrntRdrObj12RdrObjDx FrntRdrObj12RdrObjDxStdDe FrntRdrObj12RdrObjDy FrntRdrObj12RdrObjDyStdDe FrntRdrObj12RdrObjElevnConf FrntRdrObj12RdrObjElevnSts FrntRdrObj12RdrObjID FrntRdrObj12RdrObjIsInFreeSpace FrntRdrObj12RdrObjMirrProblty FrntRdrObj12RdrObjMtnPat FrntRdrObj12RdrObjNotRealProblty FrntRdrObj12RdrObjStatyCnt FrntRdrObj12RdrObjTiAlv FrntRdrObj12RdrObjTrackSts FrntRdrObj12RdrObjTyp FrntRdrObj12RdrObjTypConfBike FrntRdrObj12RdrObjTypConfPed FrntRdrObj12RdrObjTypConfVeh FrntRdrObj12RdrObjVx FrntRdrObj12RdrObjVxStdDe FrntRdrObj12RdrObjVy FrntRdrObj12RdrObjVyStdDe FrntRdrObj12RelVx FrntRdrObj12RelVy;
SIG_GROUP_ 396 FrntRdrObj13 1 : FrntRdrObj13Heading FrntRdrObj13ObjBoxCenterLat FrntRdrObj13ObjBoxCenterLgt FrntRdrObj13ObservationHist FrntRdrObj13RdrObjAx FrntRdrObj13RdrObjAy FrntRdrObj13RdrObjBoxLength FrntRdrObj13RdrObjBoxWidth FrntRdrObj13RdrObjChks FrntRdrObj13RdrObjCntr FrntRdrObj13RdrObjCoastCnt FrntRdrObj13RdrObjConf FrntRdrObj13RdrObjDx FrntRdrObj13RdrObjDxStdDe FrntRdrObj13RdrObjDy FrntRdrObj13RdrObjDyStdDe FrntRdrObj13RdrObjElevnConf FrntRdrObj13RdrObjElevnSts FrntRdrObj13RdrObjID FrntRdrObj13RdrObjIsInFreeSpace FrntRdrObj13RdrObjMirrProblty FrntRdrObj13RdrObjMtnPat FrntRdrObj13RdrObjNotRealProblty FrntRdrObj13RdrObjStatyCnt FrntRdrObj13RdrObjTiAlv FrntRdrObj13RdrObjTrackSts FrntRdrObj13RdrObjTyp FrntRdrObj13RdrObjTypConfBike FrntRdrObj13RdrObjTypConfPed FrntRdrObj13RdrObjTypConfVeh FrntRdrObj13RdrObjVx FrntRdrObj13RdrObjVxStdDe FrntRdrObj13RdrObjVy FrntRdrObj13RdrObjVyStdDe FrntRdrObj13RelVx FrntRdrObj13RelVy;
SIG_GROUP_ 398 FrntRdrObj14 1 : FrntRdrObj14Heading FrntRdrObj14ObjBoxCenterLat FrntRdrObj14ObjBoxCenterLgt FrntRdrObj14ObservationHist FrntRdrObj14RdrObjAx FrntRdrObj14RdrObjAy FrntRdrObj14RdrObjBoxLength FrntRdrObj14RdrObjBoxWidth FrntRdrObj14RdrObjChks FrntRdrObj14RdrObjCntr FrntRdrObj14RdrObjCoastCnt FrntRdrObj14RdrObjConf FrntRdrObj14RdrObjDx FrntRdrObj14RdrObjDxStdDe FrntRdrObj14RdrObjDy FrntRdrObj14RdrObjDyStdDe FrntRdrObj14RdrObjElevnConf FrntRdrObj14RdrObjElevnSts FrntRdrObj14RdrObjID FrntRdrObj14RdrObjIsInFreeSpace FrntRdrObj14RdrObjMirrProblty FrntRdrObj14RdrObjMtnPat FrntRdrObj14RdrObjNotRealProblty FrntRdrObj14RdrObjStatyCnt FrntRdrObj14RdrObjTiAlv FrntRdrObj14RdrObjTrackSts FrntRdrObj14RdrObjTyp FrntRdrObj14RdrObjTypConfBike FrntRdrObj14RdrObjTypConfPed FrntRdrObj14RdrObjTypConfVeh FrntRdrObj14RdrObjVx FrntRdrObj14RdrObjVxStdDe FrntRdrObj14RdrObjVy FrntRdrObj14RdrObjVyStdDe FrntRdrObj14RelVx FrntRdrObj14RelVy;
SIG_GROUP_ 400 FrntRdrObj15 1 : FrntRdrObj15Heading FrntRdrObj15ObjBoxCenterLat FrntRdrObj15ObjBoxCenterLgt FrntRdrObj15ObservationHist FrntRdrObj15RdrObjAx FrntRdrObj15RdrObjAy FrntRdrObj15RdrObjBoxLength FrntRdrObj15RdrObjBoxWidth FrntRdrObj15RdrObjChks FrntRdrObj15RdrObjCntr FrntRdrObj15RdrObjCoastCnt FrntRdrObj15RdrObjConf FrntRdrObj15RdrObjDx FrntRdrObj15RdrObjDxStdDe FrntRdrObj15RdrObjDy FrntRdrObj15RdrObjDyStdDe FrntRdrObj15RdrObjElevnConf FrntRdrObj15RdrObjElevnSts FrntRdrObj15RdrObjID FrntRdrObj15RdrObjIsInFreeSpace FrntRdrObj15RdrObjMirrProblty FrntRdrObj15RdrObjMtnPat FrntRdrObj15RdrObjNotRealProblty FrntRdrObj15RdrObjStatyCnt FrntRdrObj15RdrObjTiAlv FrntRdrObj15RdrObjTrackSts FrntRdrObj15RdrObjTyp FrntRdrObj15RdrObjTypConfBike FrntRdrObj15RdrObjTypConfPed FrntRdrObj15RdrObjTypConfVeh FrntRdrObj15RdrObjVx FrntRdrObj15RdrObjVxStdDe FrntRdrObj15RdrObjVy FrntRdrObj15RdrObjVyStdDe FrntRdrObj15RelVx FrntRdrObj15RelVy;
SIG_GROUP_ 402 FrntRdrObj16 1 : FrntRdrObj16Heading FrntRdrObj16ObjBoxCenterLat FrntRdrObj16ObjBoxCenterLgt FrntRdrObj16ObservationHist FrntRdrObj16RdrObjAx FrntRdrObj16RdrObjAy FrntRdrObj16RdrObjBoxLength FrntRdrObj16RdrObjBoxWidth FrntRdrObj16RdrObjChks FrntRdrObj16RdrObjCntr FrntRdrObj16RdrObjCoastCnt FrntRdrObj16RdrObjConf FrntRdrObj16RdrObjDx FrntRdrObj16RdrObjDxStdDe FrntRdrObj16RdrObjDy FrntRdrObj16RdrObjDyStdDe FrntRdrObj16RdrObjElevnConf FrntRdrObj16RdrObjElevnSts FrntRdrObj16RdrObjID FrntRdrObj16RdrObjIsInFreeSpace FrntRdrObj16RdrObjMirrProblty FrntRdrObj16RdrObjMtnPat FrntRdrObj16RdrObjNotRealProblty FrntRdrObj16RdrObjStatyCnt FrntRdrObj16RdrObjTiAlv FrntRdrObj16RdrObjTrackSts FrntRdrObj16RdrObjTyp FrntRdrObj16RdrObjTypConfBike FrntRdrObj16RdrObjTypConfPed FrntRdrObj16RdrObjTypConfVeh FrntRdrObj16RdrObjVx FrntRdrObj16RdrObjVxStdDe FrntRdrObj16RdrObjVy FrntRdrObj16RdrObjVyStdDe FrntRdrObj16RelVx FrntRdrObj16RelVy;
SIG_GROUP_ 404 FrntRdrObj17 1 : FrntRdrObj17Heading FrntRdrObj17ObjBoxCenterLat FrntRdrObj17ObjBoxCenterLgt FrntRdrObj17ObservationHist FrntRdrObj17RdrObjAx FrntRdrObj17RdrObjAy FrntRdrObj17RdrObjBoxLength FrntRdrObj17RdrObjBoxWidth FrntRdrObj17RdrObjChks FrntRdrObj17RdrObjCntr FrntRdrObj17RdrObjCoastCnt FrntRdrObj17RdrObjConf FrntRdrObj17RdrObjDx FrntRdrObj17RdrObjDxStdDe FrntRdrObj17RdrObjDy FrntRdrObj17RdrObjDyStdDe FrntRdrObj17RdrObjElevnConf FrntRdrObj17RdrObjElevnSts FrntRdrObj17RdrObjID FrntRdrObj17RdrObjIsInFreeSpace FrntRdrObj17RdrObjMirrProblty FrntRdrObj17RdrObjMtnPat FrntRdrObj17RdrObjNotRealProblty FrntRdrObj17RdrObjStatyCnt FrntRdrObj17RdrObjTiAlv FrntRdrObj17RdrObjTrackSts FrntRdrObj17RdrObjTyp FrntRdrObj17RdrObjTypConfBike FrntRdrObj17RdrObjTypConfPed FrntRdrObj17RdrObjTypConfVeh FrntRdrObj17RdrObjVx FrntRdrObj17RdrObjVxStdDe FrntRdrObj17RdrObjVy FrntRdrObj17RdrObjVyStdDe FrntRdrObj17RelVx FrntRdrObj17RelVy;
SIG_GROUP_ 378 FrntRdrObj4 1 : FrntRdrObj4Heading FrntRdrObj4ObjBoxCenterLat FrntRdrObj4ObjBoxCenterLgt FrntRdrObj4ObservationHist FrntRdrObj4RdrObjAx FrntRdrObj4RdrObjAy FrntRdrObj4RdrObjBoxLength FrntRdrObj4RdrObjBoxWidth FrntRdrObj4RdrObjChks FrntRdrObj4RdrObjCntr FrntRdrObj4RdrObjCoastCnt FrntRdrObj4RdrObjConf FrntRdrObj4RdrObjDx FrntRdrObj4RdrObjDxStdDe FrntRdrObj4RdrObjDy FrntRdrObj4RdrObjDyStdDe FrntRdrObj4RdrObjElevnConf FrntRdrObj4RdrObjElevnSts FrntRdrObj4RdrObjID FrntRdrObj4RdrObjIsInFreeSpace FrntRdrObj4RdrObjMirrProblty FrntRdrObj4RdrObjMtnPat FrntRdrObj4RdrObjNotRealProblty FrntRdrObj4RdrObjStatyCnt FrntRdrObj4RdrObjTiAlv FrntRdrObj4RdrObjTrackSts FrntRdrObj4RdrObjTyp FrntRdrObj4RdrObjTypConfBike FrntRdrObj4RdrObjTypConfPed FrntRdrObj4RdrObjTypConfVeh FrntRdrObj4RdrObjVx FrntRdrObj4RdrObjVxStdDe FrntRdrObj4RdrObjVy FrntRdrObj4RdrObjVyStdDe FrntRdrObj4RelVx FrntRdrObj4RelVy;
SIG_GROUP_ 380 FrntRdrObj5 1 : FrntRdrObj5Heading FrntRdrObj5ObjBoxCenterLat FrntRdrObj5ObjBoxCenterLgt FrntRdrObj5ObservationHist FrntRdrObj5RdrObjAx FrntRdrObj5RdrObjAy FrntRdrObj5RdrObjBoxLength FrntRdrObj5RdrObjBoxWidth FrntRdrObj5RdrObjChks FrntRdrObj5RdrObjCntr FrntRdrObj5RdrObjCoastCnt FrntRdrObj5RdrObjConf FrntRdrObj5RdrObjDx FrntRdrObj5RdrObjDxStdDe FrntRdrObj5RdrObjDy FrntRdrObj5RdrObjDyStdDe FrntRdrObj5RdrObjElevnConf FrntRdrObj5RdrObjElevnSts FrntRdrObj5RdrObjID FrntRdrObj5RdrObjIsInFreeSpace FrntRdrObj5RdrObjMirrProblty FrntRdrObj5RdrObjMtnPat FrntRdrObj5RdrObjNotRealProblty FrntRdrObj5RdrObjStatyCnt FrntRdrObj5RdrObjTiAlv FrntRdrObj5RdrObjTrackSts FrntRdrObj5RdrObjTyp FrntRdrObj5RdrObjTypConfBike FrntRdrObj5RdrObjTypConfPed FrntRdrObj5RdrObjTypConfVeh FrntRdrObj5RdrObjVx FrntRdrObj5RdrObjVxStdDe FrntRdrObj5RdrObjVy FrntRdrObj5RdrObjVyStdDe FrntRdrObj5RelVx FrntRdrObj5RelVy;
SIG_GROUP_ 382 FrntRdrObj6 1 : FrntRdrObj6Heading FrntRdrObj6ObjBoxCenterLat FrntRdrObj6ObjBoxCenterLgt FrntRdrObj6ObservationHist FrntRdrObj6RdrObjAx FrntRdrObj6RdrObjAy FrntRdrObj6RdrObjBoxLength FrntRdrObj6RdrObjBoxWidth FrntRdrObj6RdrObjChks FrntRdrObj6RdrObjCntr FrntRdrObj6RdrObjCoastCnt FrntRdrObj6RdrObjConf FrntRdrObj6RdrObjDx FrntRdrObj6RdrObjDxStdDe FrntRdrObj6RdrObjDy FrntRdrObj6RdrObjDyStdDe FrntRdrObj6RdrObjElevnConf FrntRdrObj6RdrObjElevnSts FrntRdrObj6RdrObjID FrntRdrObj6RdrObjIsInFreeSpace FrntRdrObj6RdrObjMirrProblty FrntRdrObj6RdrObjMtnPat FrntRdrObj6RdrObjNotRealProblty FrntRdrObj6RdrObjStatyCnt FrntRdrObj6RdrObjTiAlv FrntRdrObj6RdrObjTrackSts FrntRdrObj6RdrObjTyp FrntRdrObj6RdrObjTypConfBike FrntRdrObj6RdrObjTypConfPed FrntRdrObj6RdrObjTypConfVeh FrntRdrObj6RdrObjVx FrntRdrObj6RdrObjVxStdDe FrntRdrObj6RdrObjVy FrntRdrObj6RdrObjVyStdDe FrntRdrObj6RelVx FrntRdrObj6RelVy;
SIG_GROUP_ 384 FrntRdrObj7 1 : FrntRdrObj7Heading FrntRdrObj7ObjBoxCenterLat FrntRdrObj7ObjBoxCenterLgt FrntRdrObj7ObservationHist FrntRdrObj7RdrObjAx FrntRdrObj7RdrObjAy FrntRdrObj7RdrObjBoxLength FrntRdrObj7RdrObjBoxWidth FrntRdrObj7RdrObjChks FrntRdrObj7RdrObjCntr FrntRdrObj7RdrObjCoastCnt FrntRdrObj7RdrObjConf FrntRdrObj7RdrObjDx FrntRdrObj7RdrObjDxStdDe FrntRdrObj7RdrObjDy FrntRdrObj7RdrObjDyStdDe FrntRdrObj7RdrObjElevnConf FrntRdrObj7RdrObjElevnSts FrntRdrObj7RdrObjID FrntRdrObj7RdrObjIsInFreeSpace FrntRdrObj7RdrObjMirrProblty FrntRdrObj7RdrObjMtnPat FrntRdrObj7RdrObjNotRealProblty FrntRdrObj7RdrObjStatyCnt FrntRdrObj7RdrObjTiAlv FrntRdrObj7RdrObjTrackSts FrntRdrObj7RdrObjTyp FrntRdrObj7RdrObjTypConfBike FrntRdrObj7RdrObjTypConfPed FrntRdrObj7RdrObjTypConfVeh FrntRdrObj7RdrObjVx FrntRdrObj7RdrObjVxStdDe FrntRdrObj7RdrObjVy FrntRdrObj7RdrObjVyStdDe FrntRdrObj7RelVx FrntRdrObj7RelVy;
SIG_GROUP_ 386 FrntRdrObj8 1 : FrntRdrObj8Heading FrntRdrObj8ObjBoxCenterLat FrntRdrObj8ObjBoxCenterLgt FrntRdrObj8ObservationHist FrntRdrObj8RdrObjAx FrntRdrObj8RdrObjAy FrntRdrObj8RdrObjBoxLength FrntRdrObj8RdrObjBoxWidth FrntRdrObj8RdrObjChks FrntRdrObj8RdrObjCntr FrntRdrObj8RdrObjCoastCnt FrntRdrObj8RdrObjConf FrntRdrObj8RdrObjDx FrntRdrObj8RdrObjDxStdDe FrntRdrObj8RdrObjDy FrntRdrObj8RdrObjDyStdDe FrntRdrObj8RdrObjElevnConf FrntRdrObj8RdrObjElevnSts FrntRdrObj8RdrObjID FrntRdrObj8RdrObjIsInFreeSpace FrntRdrObj8RdrObjMirrProblty FrntRdrObj8RdrObjMtnPat FrntRdrObj8RdrObjNotRealProblty FrntRdrObj8RdrObjStatyCnt FrntRdrObj8RdrObjTiAlv FrntRdrObj8RdrObjTrackSts FrntRdrObj8RdrObjTyp FrntRdrObj8RdrObjTypConfBike FrntRdrObj8RdrObjTypConfPed FrntRdrObj8RdrObjTypConfVeh FrntRdrObj8RdrObjVx FrntRdrObj8RdrObjVxStdDe FrntRdrObj8RdrObjVy FrntRdrObj8RdrObjVyStdDe FrntRdrObj8RelVx FrntRdrObj8RelVy;
SIG_GROUP_ 388 FrntRdrObj9 1 : FrntRdrObj9Heading FrntRdrObj9ObjBoxCenterLat FrntRdrObj9ObjBoxCenterLgt FrntRdrObj9ObservationHist FrntRdrObj9RdrObjAx FrntRdrObj9RdrObjAy FrntRdrObj9RdrObjBoxLength FrntRdrObj9RdrObjBoxWidth FrntRdrObj9RdrObjChks FrntRdrObj9RdrObjCntr FrntRdrObj9RdrObjCoastCnt FrntRdrObj9RdrObjConf FrntRdrObj9RdrObjDx FrntRdrObj9RdrObjDxStdDe FrntRdrObj9RdrObjDy FrntRdrObj9RdrObjDyStdDe FrntRdrObj9RdrObjElevnConf FrntRdrObj9RdrObjElevnSts FrntRdrObj9RdrObjID FrntRdrObj9RdrObjIsInFreeSpace FrntRdrObj9RdrObjMirrProblty FrntRdrObj9RdrObjMtnPat FrntRdrObj9RdrObjNotRealProblty FrntRdrObj9RdrObjStatyCnt FrntRdrObj9RdrObjTiAlv FrntRdrObj9RdrObjTrackSts FrntRdrObj9RdrObjTyp FrntRdrObj9RdrObjTypConfBike FrntRdrObj9RdrObjTypConfPed FrntRdrObj9RdrObjTypConfVeh FrntRdrObj9RdrObjVx FrntRdrObj9RdrObjVxStdDe FrntRdrObj9RdrObjVy FrntRdrObj9RdrObjVyStdDe FrntRdrObj9RelVx FrntRdrObj9RelVy;
