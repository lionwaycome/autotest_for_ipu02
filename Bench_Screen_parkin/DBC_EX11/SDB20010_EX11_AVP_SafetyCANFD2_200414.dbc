// *************************************************************************** *
// *                                                                           *
// *                      Mentor Graphics Corporation                          *
// *                          All rights reserved                              *
// *                                                                           *
// *************************************************************************** *
// *                                                                           *
// * Description:         CANDB File                                           *
// * Generated at:        2020-04-14 13:13:01                                  *
// * System:              SDB20010                                             *
// * Variant:             EX11_AVP                                             *
// * Network:             SafetyCANFD2                                         *
// *                                                                           *
// *************************************************************************** *
// *                                                                           *
// *             THIS CONFIGURATION MIGHT CONTAIN SOME ERRORS                  *
// *              IF THE INPUT MODEL WAS NOT PROPERLY FORMED!                  *
// *                    Do Not Use this File directly!                         *
// *                                                                           *
// *************************************************************************** *
VERSION "SafetyCANFD2"

NS_ :

BS_:

BU_:  ASDM ETC FLC FLR PAS

BO_ 406 FLRSafetyCANFD2Frame52: 64 FLR
 SG_ FrntRdrObj18_UB : 291|1@0+ (1,0) [0|1] "" ASDM,PAS
 SG_ FrntRdrObj18Heading : 287|12@0+ (0.1,-180.0) [-180.0|180.0] "Deg" ASDM,PAS
 SG_ FrntRdrObj18ObjBoxCenterLat : 23|9@0+ (0.1,-25.0) [-25.0|25.0] "m" ASDM,PAS
 SG_ FrntRdrObj18ObjBoxCenterLgt : 30|9@0+ (0.1,-25.0) [-25.0|25.0] "m" ASDM,PAS
 SG_ FrntRdrObj18ObservationHist : 63|32@0+ (1.0,0.0) [0.0|4294967295.0] "Unitless" ASDM,PAS
 SG_ FrntRdrObj18RdrObjAx : 7|8@0- (0.1,0.0) [-12.8|12.700000000000001] "m/s^2" ASDM,PAS
 SG_ FrntRdrObj18RdrObjAy : 15|8@0- (0.1,0.0) [-12.8|12.700000000000001] "m/s^2" ASDM,PAS
 SG_ FrntRdrObj18RdrObjBoxLength : 37|9@0+ (0.1,0.0) [0.0|50.0] "m" ASDM,PAS
 SG_ FrntRdrObj18RdrObjBoxWidth : 44|9@0+ (0.1,0.0) [0.0|50.0] "m" ASDM,PAS
 SG_ FrntRdrObj18RdrObjChks : 95|8@0+ (1.0,0.0) [0.0|255.0] "Unitless" ASDM,PAS
 SG_ FrntRdrObj18RdrObjCntr : 103|4@0+ (1.0,0.0) [0.0|15.0] "Unitless" ASDM,PAS
 SG_ FrntRdrObj18RdrObjCoastCnt : 279|5@0+ (1.0,0.0) [0.0|31.0] "Unitless" ASDM,PAS
 SG_ FrntRdrObj18RdrObjConf : 99|4@0+ (7.0,0.0) [0.0|105.0] "%" ASDM,PAS
 SG_ FrntRdrObj18RdrObjDx : 191|13@0+ (0.05,-200.0) [-200.0|200.0] "m" ASDM,PAS
 SG_ FrntRdrObj18RdrObjDxStdDe : 111|8@0+ (0.05,0.0) [0.0|12.700000000000001] "m" ASDM,PAS
 SG_ FrntRdrObj18RdrObjDy : 119|13@0+ (0.05,-200.0) [-200.0|200.0] "m" ASDM,PAS
 SG_ FrntRdrObj18RdrObjDyStdDe : 183|8@0+ (0.05,0.0) [0.0|12.700000000000001] "m" ASDM,PAS
 SG_ FrntRdrObj18RdrObjElevnConf : 223|4@0+ (7.0,0.0) [0.0|105.0] "%" ASDM,PAS
 SG_ FrntRdrObj18RdrObjElevnSts : 153|2@0+ (1,0) [0|3] "" ASDM,PAS
 SG_ FrntRdrObj18RdrObjID : 167|8@0+ (1.0,0.0) [0.0|255.0] "Unitless" ASDM,PAS
 SG_ FrntRdrObj18RdrObjIsInFreeSpace : 192|1@0+ (1,0) [0|1] "" ASDM,PAS
 SG_ FrntRdrObj18RdrObjMirrProblty : 219|4@0+ (7.0,0.0) [0.0|105.0] "%" ASDM,PAS
 SG_ FrntRdrObj18RdrObjMtnPat : 122|3@0+ (1,0) [0|7] "" ASDM,PAS
 SG_ FrntRdrObj18RdrObjNotRealProblty : 231|4@0+ (7.0,0.0) [0.0|105.0] "%" ASDM,PAS
 SG_ FrntRdrObj18RdrObjStatyCnt : 239|7@0+ (1.0,0.0) [0.0|127.0] "Unitless" ASDM,PAS
 SG_ FrntRdrObj18RdrObjTiAlv : 247|7@0+ (1.0,0.0) [0.0|127.0] "Unitless" ASDM,PAS
 SG_ FrntRdrObj18RdrObjTrackSts : 194|2@0+ (1,0) [0|3] "" ASDM,PAS
 SG_ FrntRdrObj18RdrObjTyp : 51|4@0+ (1,0) [0|15] "" ASDM,PAS
 SG_ FrntRdrObj18RdrObjTypConfBike : 175|4@0+ (7.0,0.0) [0.0|105.0] "%" ASDM,PAS
 SG_ FrntRdrObj18RdrObjTypConfPed : 171|4@0+ (7.0,0.0) [0.0|105.0] "%" ASDM,PAS
 SG_ FrntRdrObj18RdrObjTypConfVeh : 227|4@0+ (7.0,0.0) [0.0|105.0] "%" ASDM,PAS
 SG_ FrntRdrObj18RdrObjVx : 255|14@0+ (0.02,-128.0) [-128.0|128.0] "m/s" ASDM,PAS
 SG_ FrntRdrObj18RdrObjVxStdDe : 271|6@0+ (0.05,0.0) [0.0|2.0] "m/s" ASDM,PAS
 SG_ FrntRdrObj18RdrObjVy : 207|14@0+ (0.02,-128.0) [-128.0|128.0] "m/s" ASDM,PAS
 SG_ FrntRdrObj18RdrObjVyStdDe : 159|6@0+ (0.05,0.0) [0.0|2.0] "m/s" ASDM,PAS
 SG_ FrntRdrObj18RelVx : 135|12@0+ (0.02,-35.6) [-35.6|35.6] "m/s" ASDM,PAS
 SG_ FrntRdrObj18RelVy : 139|12@0+ (0.02,-35.6) [-35.6|35.6] "m/s" ASDM,PAS

BO_ 408 FLRSafetyCANFD2Frame53: 64 FLR
 SG_ FrntRdrObj19_UB : 291|1@0+ (1,0) [0|1] "" ASDM,PAS
 SG_ FrntRdrObj19Heading : 287|12@0+ (0.1,-180.0) [-180.0|180.0] "Deg" ASDM,PAS
 SG_ FrntRdrObj19ObjBoxCenterLat : 23|9@0+ (0.1,-25.0) [-25.0|25.0] "m" ASDM,PAS
 SG_ FrntRdrObj19ObjBoxCenterLgt : 30|9@0+ (0.1,-25.0) [-25.0|25.0] "m" ASDM,PAS
 SG_ FrntRdrObj19ObservationHist : 63|32@0+ (1.0,0.0) [0.0|4294967295.0] "Unitless" ASDM,PAS
 SG_ FrntRdrObj19RdrObjAx : 7|8@0- (0.1,0.0) [-12.8|12.700000000000001] "m/s^2" ASDM,PAS
 SG_ FrntRdrObj19RdrObjAy : 15|8@0- (0.1,0.0) [-12.8|12.700000000000001] "m/s^2" ASDM,PAS
 SG_ FrntRdrObj19RdrObjBoxLength : 37|9@0+ (0.1,0.0) [0.0|50.0] "m" ASDM,PAS
 SG_ FrntRdrObj19RdrObjBoxWidth : 44|9@0+ (0.1,0.0) [0.0|50.0] "m" ASDM,PAS
 SG_ FrntRdrObj19RdrObjChks : 95|8@0+ (1.0,0.0) [0.0|255.0] "Unitless" ASDM,PAS
 SG_ FrntRdrObj19RdrObjCntr : 103|4@0+ (1.0,0.0) [0.0|15.0] "Unitless" ASDM,PAS
 SG_ FrntRdrObj19RdrObjCoastCnt : 279|5@0+ (1.0,0.0) [0.0|31.0] "Unitless" ASDM,PAS
 SG_ FrntRdrObj19RdrObjConf : 99|4@0+ (7.0,0.0) [0.0|105.0] "%" ASDM,PAS
 SG_ FrntRdrObj19RdrObjDx : 191|13@0+ (0.05,-200.0) [-200.0|200.0] "m" ASDM,PAS
 SG_ FrntRdrObj19RdrObjDxStdDe : 111|8@0+ (0.05,0.0) [0.0|12.700000000000001] "m" ASDM,PAS
 SG_ FrntRdrObj19RdrObjDy : 119|13@0+ (0.05,-200.0) [-200.0|200.0] "m" ASDM,PAS
 SG_ FrntRdrObj19RdrObjDyStdDe : 183|8@0+ (0.05,0.0) [0.0|12.700000000000001] "m" ASDM,PAS
 SG_ FrntRdrObj19RdrObjElevnConf : 223|4@0+ (7.0,0.0) [0.0|105.0] "%" ASDM,PAS
 SG_ FrntRdrObj19RdrObjElevnSts : 153|2@0+ (1,0) [0|3] "" ASDM,PAS
 SG_ FrntRdrObj19RdrObjID : 167|8@0+ (1.0,0.0) [0.0|255.0] "Unitless" ASDM,PAS
 SG_ FrntRdrObj19RdrObjIsInFreeSpace : 192|1@0+ (1,0) [0|1] "" ASDM,PAS
 SG_ FrntRdrObj19RdrObjMirrProblty : 219|4@0+ (7.0,0.0) [0.0|105.0] "%" ASDM,PAS
 SG_ FrntRdrObj19RdrObjMtnPat : 122|3@0+ (1,0) [0|7] "" ASDM,PAS
 SG_ FrntRdrObj19RdrObjNotRealProblty : 231|4@0+ (7.0,0.0) [0.0|105.0] "%" ASDM,PAS
 SG_ FrntRdrObj19RdrObjStatyCnt : 239|7@0+ (1.0,0.0) [0.0|127.0] "Unitless" ASDM,PAS
 SG_ FrntRdrObj19RdrObjTiAlv : 247|7@0+ (1.0,0.0) [0.0|127.0] "Unitless" ASDM,PAS
 SG_ FrntRdrObj19RdrObjTrackSts : 194|2@0+ (1,0) [0|3] "" ASDM,PAS
 SG_ FrntRdrObj19RdrObjTyp : 51|4@0+ (1,0) [0|15] "" ASDM,PAS
 SG_ FrntRdrObj19RdrObjTypConfBike : 175|4@0+ (7.0,0.0) [0.0|105.0] "%" ASDM,PAS
 SG_ FrntRdrObj19RdrObjTypConfPed : 171|4@0+ (7.0,0.0) [0.0|105.0] "%" ASDM,PAS
 SG_ FrntRdrObj19RdrObjTypConfVeh : 227|4@0+ (7.0,0.0) [0.0|105.0] "%" ASDM,PAS
 SG_ FrntRdrObj19RdrObjVx : 255|14@0+ (0.02,-128.0) [-128.0|128.0] "m/s" ASDM,PAS
 SG_ FrntRdrObj19RdrObjVxStdDe : 271|6@0+ (0.05,0.0) [0.0|2.0] "m/s" ASDM,PAS
 SG_ FrntRdrObj19RdrObjVy : 207|14@0+ (0.02,-128.0) [-128.0|128.0] "m/s" ASDM,PAS
 SG_ FrntRdrObj19RdrObjVyStdDe : 159|6@0+ (0.05,0.0) [0.0|2.0] "m/s" ASDM,PAS
 SG_ FrntRdrObj19RelVx : 135|12@0+ (0.02,-35.6) [-35.6|35.6] "m/s" ASDM,PAS
 SG_ FrntRdrObj19RelVy : 139|12@0+ (0.02,-35.6) [-35.6|35.6] "m/s" ASDM,PAS

BO_ 410 FLRSafetyCANFD2Frame54: 64 FLR
 SG_ FrntRdrObj20_UB : 291|1@0+ (1,0) [0|1] "" ASDM,PAS
 SG_ FrntRdrObj20Heading : 287|12@0+ (0.1,-180.0) [-180.0|180.0] "Deg" ASDM,PAS
 SG_ FrntRdrObj20ObjBoxCenterLat : 23|9@0+ (0.1,-25.0) [-25.0|25.0] "m" ASDM,PAS
 SG_ FrntRdrObj20ObjBoxCenterLgt : 30|9@0+ (0.1,-25.0) [-25.0|25.0] "m" ASDM,PAS
 SG_ FrntRdrObj20ObservationHist : 63|32@0+ (1.0,0.0) [0.0|4294967295.0] "Unitless" ASDM,PAS
 SG_ FrntRdrObj20RdrObjAx : 7|8@0- (0.1,0.0) [-12.8|12.700000000000001] "m/s^2" ASDM,PAS
 SG_ FrntRdrObj20RdrObjAy : 15|8@0- (0.1,0.0) [-12.8|12.700000000000001] "m/s^2" ASDM,PAS
 SG_ FrntRdrObj20RdrObjBoxLength : 37|9@0+ (0.1,0.0) [0.0|50.0] "m" ASDM,PAS
 SG_ FrntRdrObj20RdrObjBoxWidth : 44|9@0+ (0.1,0.0) [0.0|50.0] "m" ASDM,PAS
 SG_ FrntRdrObj20RdrObjChks : 95|8@0+ (1.0,0.0) [0.0|255.0] "Unitless" ASDM,PAS
 SG_ FrntRdrObj20RdrObjCntr : 103|4@0+ (1.0,0.0) [0.0|15.0] "Unitless" ASDM,PAS
 SG_ FrntRdrObj20RdrObjCoastCnt : 279|5@0+ (1.0,0.0) [0.0|31.0] "Unitless" ASDM,PAS
 SG_ FrntRdrObj20RdrObjConf : 99|4@0+ (7.0,0.0) [0.0|105.0] "%" ASDM,PAS
 SG_ FrntRdrObj20RdrObjDx : 191|13@0+ (0.05,-200.0) [-200.0|200.0] "m" ASDM,PAS
 SG_ FrntRdrObj20RdrObjDxStdDe : 111|8@0+ (0.05,0.0) [0.0|12.700000000000001] "m" ASDM,PAS
 SG_ FrntRdrObj20RdrObjDy : 119|13@0+ (0.05,-200.0) [-200.0|200.0] "m" ASDM,PAS
 SG_ FrntRdrObj20RdrObjDyStdDe : 183|8@0+ (0.05,0.0) [0.0|12.700000000000001] "m" ASDM,PAS
 SG_ FrntRdrObj20RdrObjElevnConf : 223|4@0+ (7.0,0.0) [0.0|105.0] "%" ASDM,PAS
 SG_ FrntRdrObj20RdrObjElevnSts : 153|2@0+ (1,0) [0|3] "" ASDM,PAS
 SG_ FrntRdrObj20RdrObjID : 167|8@0+ (1.0,0.0) [0.0|255.0] "Unitless" ASDM,PAS
 SG_ FrntRdrObj20RdrObjIsInFreeSpace : 192|1@0+ (1,0) [0|1] "" ASDM,PAS
 SG_ FrntRdrObj20RdrObjMirrProblty : 219|4@0+ (7.0,0.0) [0.0|105.0] "%" ASDM,PAS
 SG_ FrntRdrObj20RdrObjMtnPat : 122|3@0+ (1,0) [0|7] "" ASDM,PAS
 SG_ FrntRdrObj20RdrObjNotRealProblty : 231|4@0+ (7.0,0.0) [0.0|105.0] "%" ASDM,PAS
 SG_ FrntRdrObj20RdrObjStatyCnt : 239|7@0+ (1.0,0.0) [0.0|127.0] "Unitless" ASDM,PAS
 SG_ FrntRdrObj20RdrObjTiAlv : 247|7@0+ (1.0,0.0) [0.0|127.0] "Unitless" ASDM,PAS
 SG_ FrntRdrObj20RdrObjTrackSts : 194|2@0+ (1,0) [0|3] "" ASDM,PAS
 SG_ FrntRdrObj20RdrObjTyp : 51|4@0+ (1,0) [0|15] "" ASDM,PAS
 SG_ FrntRdrObj20RdrObjTypConfBike : 175|4@0+ (7.0,0.0) [0.0|105.0] "%" ASDM,PAS
 SG_ FrntRdrObj20RdrObjTypConfPed : 171|4@0+ (7.0,0.0) [0.0|105.0] "%" ASDM,PAS
 SG_ FrntRdrObj20RdrObjTypConfVeh : 227|4@0+ (7.0,0.0) [0.0|105.0] "%" ASDM,PAS
 SG_ FrntRdrObj20RdrObjVx : 255|14@0+ (0.02,-128.0) [-128.0|128.0] "m/s" ASDM,PAS
 SG_ FrntRdrObj20RdrObjVxStdDe : 271|6@0+ (0.05,0.0) [0.0|2.0] "m/s" ASDM,PAS
 SG_ FrntRdrObj20RdrObjVy : 207|14@0+ (0.02,-128.0) [-128.0|128.0] "m/s" ASDM,PAS
 SG_ FrntRdrObj20RdrObjVyStdDe : 159|6@0+ (0.05,0.0) [0.0|2.0] "m/s" ASDM,PAS
 SG_ FrntRdrObj20RelVx : 135|12@0+ (0.02,-35.6) [-35.6|35.6] "m/s" ASDM,PAS
 SG_ FrntRdrObj20RelVy : 139|12@0+ (0.02,-35.6) [-35.6|35.6] "m/s" ASDM,PAS

BO_ 412 FLRSafetyCANFD2Frame55: 64 FLR
 SG_ FrntRdrObj21_UB : 291|1@0+ (1,0) [0|1] "" ASDM,PAS
 SG_ FrntRdrObj21Heading : 287|12@0+ (0.1,-180.0) [-180.0|180.0] "Deg" ASDM,PAS
 SG_ FrntRdrObj21ObjBoxCenterLat : 23|9@0+ (0.1,-25.0) [-25.0|25.0] "m" ASDM,PAS
 SG_ FrntRdrObj21ObjBoxCenterLgt : 30|9@0+ (0.1,-25.0) [-25.0|25.0] "m" ASDM,PAS
 SG_ FrntRdrObj21ObservationHist : 63|32@0+ (1.0,0.0) [0.0|4294967295.0] "Unitless" ASDM,PAS
 SG_ FrntRdrObj21RdrObjAx : 7|8@0- (0.1,0.0) [-12.8|12.700000000000001] "m/s^2" ASDM,PAS
 SG_ FrntRdrObj21RdrObjAy : 15|8@0- (0.1,0.0) [-12.8|12.700000000000001] "m/s^2" ASDM,PAS
 SG_ FrntRdrObj21RdrObjBoxLength : 37|9@0+ (0.1,0.0) [0.0|50.0] "m" ASDM,PAS
 SG_ FrntRdrObj21RdrObjBoxWidth : 44|9@0+ (0.1,0.0) [0.0|50.0] "m" ASDM,PAS
 SG_ FrntRdrObj21RdrObjChks : 95|8@0+ (1.0,0.0) [0.0|255.0] "Unitless" ASDM,PAS
 SG_ FrntRdrObj21RdrObjCntr : 103|4@0+ (1.0,0.0) [0.0|15.0] "Unitless" ASDM,PAS
 SG_ FrntRdrObj21RdrObjCoastCnt : 279|5@0+ (1.0,0.0) [0.0|31.0] "Unitless" ASDM,PAS
 SG_ FrntRdrObj21RdrObjConf : 99|4@0+ (7.0,0.0) [0.0|105.0] "%" ASDM,PAS
 SG_ FrntRdrObj21RdrObjDx : 191|13@0+ (0.05,-200.0) [-200.0|200.0] "m" ASDM,PAS
 SG_ FrntRdrObj21RdrObjDxStdDe : 111|8@0+ (0.05,0.0) [0.0|12.700000000000001] "m" ASDM,PAS
 SG_ FrntRdrObj21RdrObjDy : 119|13@0+ (0.05,-200.0) [-200.0|200.0] "m" ASDM,PAS
 SG_ FrntRdrObj21RdrObjDyStdDe : 183|8@0+ (0.05,0.0) [0.0|12.700000000000001] "m" ASDM,PAS
 SG_ FrntRdrObj21RdrObjElevnConf : 223|4@0+ (7.0,0.0) [0.0|105.0] "%" ASDM,PAS
 SG_ FrntRdrObj21RdrObjElevnSts : 153|2@0+ (1,0) [0|3] "" ASDM,PAS
 SG_ FrntRdrObj21RdrObjID : 167|8@0+ (1.0,0.0) [0.0|255.0] "Unitless" ASDM,PAS
 SG_ FrntRdrObj21RdrObjIsInFreeSpace : 192|1@0+ (1,0) [0|1] "" ASDM,PAS
 SG_ FrntRdrObj21RdrObjMirrProblty : 219|4@0+ (7.0,0.0) [0.0|105.0] "%" ASDM,PAS
 SG_ FrntRdrObj21RdrObjMtnPat : 122|3@0+ (1,0) [0|7] "" ASDM,PAS
 SG_ FrntRdrObj21RdrObjNotRealProblty : 231|4@0+ (7.0,0.0) [0.0|105.0] "%" ASDM,PAS
 SG_ FrntRdrObj21RdrObjStatyCnt : 239|7@0+ (1.0,0.0) [0.0|127.0] "Unitless" ASDM,PAS
 SG_ FrntRdrObj21RdrObjTiAlv : 247|7@0+ (1.0,0.0) [0.0|127.0] "Unitless" ASDM,PAS
 SG_ FrntRdrObj21RdrObjTrackSts : 194|2@0+ (1,0) [0|3] "" ASDM,PAS
 SG_ FrntRdrObj21RdrObjTyp : 51|4@0+ (1,0) [0|15] "" ASDM,PAS
 SG_ FrntRdrObj21RdrObjTypConfBike : 175|4@0+ (7.0,0.0) [0.0|105.0] "%" ASDM,PAS
 SG_ FrntRdrObj21RdrObjTypConfPed : 171|4@0+ (7.0,0.0) [0.0|105.0] "%" ASDM,PAS
 SG_ FrntRdrObj21RdrObjTypConfVeh : 227|4@0+ (7.0,0.0) [0.0|105.0] "%" ASDM,PAS
 SG_ FrntRdrObj21RdrObjVx : 255|14@0+ (0.02,-128.0) [-128.0|128.0] "m/s" ASDM,PAS
 SG_ FrntRdrObj21RdrObjVxStdDe : 271|6@0+ (0.05,0.0) [0.0|2.0] "m/s" ASDM,PAS
 SG_ FrntRdrObj21RdrObjVy : 207|14@0+ (0.02,-128.0) [-128.0|128.0] "m/s" ASDM,PAS
 SG_ FrntRdrObj21RdrObjVyStdDe : 159|6@0+ (0.05,0.0) [0.0|2.0] "m/s" ASDM,PAS
 SG_ FrntRdrObj21RelVx : 135|12@0+ (0.02,-35.6) [-35.6|35.6] "m/s" ASDM,PAS
 SG_ FrntRdrObj21RelVy : 139|12@0+ (0.02,-35.6) [-35.6|35.6] "m/s" ASDM,PAS

BO_ 414 FLRSafetyCANFD2Frame56: 64 FLR
 SG_ FrntRdrObj22_UB : 291|1@0+ (1,0) [0|1] "" ASDM,PAS
 SG_ FrntRdrObj22Heading : 287|12@0+ (0.1,-180.0) [-180.0|180.0] "Deg" ASDM,PAS
 SG_ FrntRdrObj22ObjBoxCenterLat : 23|9@0+ (0.1,-25.0) [-25.0|25.0] "m" ASDM,PAS
 SG_ FrntRdrObj22ObjBoxCenterLgt : 30|9@0+ (0.1,-25.0) [-25.0|25.0] "m" ASDM,PAS
 SG_ FrntRdrObj22ObservationHist : 63|32@0+ (1.0,0.0) [0.0|4294967295.0] "Unitless" ASDM,PAS
 SG_ FrntRdrObj22RdrObjAx : 7|8@0- (0.1,0.0) [-12.8|12.700000000000001] "m/s^2" ASDM,PAS
 SG_ FrntRdrObj22RdrObjAy : 15|8@0- (0.1,0.0) [-12.8|12.700000000000001] "m/s^2" ASDM,PAS
 SG_ FrntRdrObj22RdrObjBoxLength : 37|9@0+ (0.1,0.0) [0.0|50.0] "m" ASDM,PAS
 SG_ FrntRdrObj22RdrObjBoxWidth : 44|9@0+ (0.1,0.0) [0.0|50.0] "m" ASDM,PAS
 SG_ FrntRdrObj22RdrObjChks : 95|8@0+ (1.0,0.0) [0.0|255.0] "Unitless" ASDM,PAS
 SG_ FrntRdrObj22RdrObjCntr : 103|4@0+ (1.0,0.0) [0.0|15.0] "Unitless" ASDM,PAS
 SG_ FrntRdrObj22RdrObjCoastCnt : 279|5@0+ (1.0,0.0) [0.0|31.0] "Unitless" ASDM,PAS
 SG_ FrntRdrObj22RdrObjConf : 99|4@0+ (7.0,0.0) [0.0|105.0] "%" ASDM,PAS
 SG_ FrntRdrObj22RdrObjDx : 191|13@0+ (0.05,-200.0) [-200.0|200.0] "m" ASDM,PAS
 SG_ FrntRdrObj22RdrObjDxStdDe : 111|8@0+ (0.05,0.0) [0.0|12.700000000000001] "m" ASDM,PAS
 SG_ FrntRdrObj22RdrObjDy : 119|13@0+ (0.05,-200.0) [-200.0|200.0] "m" ASDM,PAS
 SG_ FrntRdrObj22RdrObjDyStdDe : 183|8@0+ (0.05,0.0) [0.0|12.700000000000001] "m" ASDM,PAS
 SG_ FrntRdrObj22RdrObjElevnConf : 223|4@0+ (7.0,0.0) [0.0|105.0] "%" ASDM,PAS
 SG_ FrntRdrObj22RdrObjElevnSts : 153|2@0+ (1,0) [0|3] "" ASDM,PAS
 SG_ FrntRdrObj22RdrObjID : 167|8@0+ (1.0,0.0) [0.0|255.0] "Unitless" ASDM,PAS
 SG_ FrntRdrObj22RdrObjIsInFreeSpace : 192|1@0+ (1,0) [0|1] "" ASDM,PAS
 SG_ FrntRdrObj22RdrObjMirrProblty : 219|4@0+ (7.0,0.0) [0.0|105.0] "%" ASDM,PAS
 SG_ FrntRdrObj22RdrObjMtnPat : 122|3@0+ (1,0) [0|7] "" ASDM,PAS
 SG_ FrntRdrObj22RdrObjNotRealProblty : 231|4@0+ (7.0,0.0) [0.0|105.0] "%" ASDM,PAS
 SG_ FrntRdrObj22RdrObjStatyCnt : 239|7@0+ (1.0,0.0) [0.0|127.0] "Unitless" ASDM,PAS
 SG_ FrntRdrObj22RdrObjTiAlv : 247|7@0+ (1.0,0.0) [0.0|127.0] "Unitless" ASDM,PAS
 SG_ FrntRdrObj22RdrObjTrackSts : 194|2@0+ (1,0) [0|3] "" ASDM,PAS
 SG_ FrntRdrObj22RdrObjTyp : 51|4@0+ (1,0) [0|15] "" ASDM,PAS
 SG_ FrntRdrObj22RdrObjTypConfBike : 175|4@0+ (7.0,0.0) [0.0|105.0] "%" ASDM,PAS
 SG_ FrntRdrObj22RdrObjTypConfPed : 171|4@0+ (7.0,0.0) [0.0|105.0] "%" ASDM,PAS
 SG_ FrntRdrObj22RdrObjTypConfVeh : 227|4@0+ (7.0,0.0) [0.0|105.0] "%" ASDM,PAS
 SG_ FrntRdrObj22RdrObjVx : 255|14@0+ (0.02,-128.0) [-128.0|128.0] "m/s" ASDM,PAS
 SG_ FrntRdrObj22RdrObjVxStdDe : 271|6@0+ (0.05,0.0) [0.0|2.0] "m/s" ASDM,PAS
 SG_ FrntRdrObj22RdrObjVy : 207|14@0+ (0.02,-128.0) [-128.0|128.0] "m/s" ASDM,PAS
 SG_ FrntRdrObj22RdrObjVyStdDe : 159|6@0+ (0.05,0.0) [0.0|2.0] "m/s" ASDM,PAS
 SG_ FrntRdrObj22RelVx : 135|12@0+ (0.02,-35.6) [-35.6|35.6] "m/s" ASDM,PAS
 SG_ FrntRdrObj22RelVy : 139|12@0+ (0.02,-35.6) [-35.6|35.6] "m/s" ASDM,PAS

BO_ 512 FLRSafetyCANFD2Frame57: 64 FLR
 SG_ FrntRdrObj23_UB : 291|1@0+ (1,0) [0|1] "" ASDM,PAS
 SG_ FrntRdrObj23Heading : 287|12@0+ (0.1,-180.0) [-180.0|180.0] "Deg" ASDM,PAS
 SG_ FrntRdrObj23ObjBoxCenterLat : 23|9@0+ (0.1,-25.0) [-25.0|25.0] "m" ASDM,PAS
 SG_ FrntRdrObj23ObjBoxCenterLgt : 30|9@0+ (0.1,-25.0) [-25.0|25.0] "m" ASDM,PAS
 SG_ FrntRdrObj23ObservationHist : 63|32@0+ (1.0,0.0) [0.0|4294967295.0] "Unitless" ASDM,PAS
 SG_ FrntRdrObj23RdrObjAx : 7|8@0- (0.1,0.0) [-12.8|12.700000000000001] "m/s^2" ASDM,PAS
 SG_ FrntRdrObj23RdrObjAy : 15|8@0- (0.1,0.0) [-12.8|12.700000000000001] "m/s^2" ASDM,PAS
 SG_ FrntRdrObj23RdrObjBoxLength : 37|9@0+ (0.1,0.0) [0.0|50.0] "m" ASDM,PAS
 SG_ FrntRdrObj23RdrObjBoxWidth : 44|9@0+ (0.1,0.0) [0.0|50.0] "m" ASDM,PAS
 SG_ FrntRdrObj23RdrObjChks : 95|8@0+ (1.0,0.0) [0.0|255.0] "Unitless" ASDM,PAS
 SG_ FrntRdrObj23RdrObjCntr : 103|4@0+ (1.0,0.0) [0.0|15.0] "Unitless" ASDM,PAS
 SG_ FrntRdrObj23RdrObjCoastCnt : 279|5@0+ (1.0,0.0) [0.0|31.0] "Unitless" ASDM,PAS
 SG_ FrntRdrObj23RdrObjConf : 99|4@0+ (7.0,0.0) [0.0|105.0] "%" ASDM,PAS
 SG_ FrntRdrObj23RdrObjDx : 191|13@0+ (0.05,-200.0) [-200.0|200.0] "m" ASDM,PAS
 SG_ FrntRdrObj23RdrObjDxStdDe : 111|8@0+ (0.05,0.0) [0.0|12.700000000000001] "m" ASDM,PAS
 SG_ FrntRdrObj23RdrObjDy : 119|13@0+ (0.05,-200.0) [-200.0|200.0] "m" ASDM,PAS
 SG_ FrntRdrObj23RdrObjDyStdDe : 183|8@0+ (0.05,0.0) [0.0|12.700000000000001] "m" ASDM,PAS
 SG_ FrntRdrObj23RdrObjElevnConf : 223|4@0+ (7.0,0.0) [0.0|105.0] "%" ASDM,PAS
 SG_ FrntRdrObj23RdrObjElevnSts : 153|2@0+ (1,0) [0|3] "" ASDM,PAS
 SG_ FrntRdrObj23RdrObjID : 167|8@0+ (1.0,0.0) [0.0|255.0] "Unitless" ASDM,PAS
 SG_ FrntRdrObj23RdrObjIsInFreeSpace : 192|1@0+ (1,0) [0|1] "" ASDM,PAS
 SG_ FrntRdrObj23RdrObjMirrProblty : 219|4@0+ (7.0,0.0) [0.0|105.0] "%" ASDM,PAS
 SG_ FrntRdrObj23RdrObjMtnPat : 122|3@0+ (1,0) [0|7] "" ASDM,PAS
 SG_ FrntRdrObj23RdrObjNotRealProblty : 231|4@0+ (7.0,0.0) [0.0|105.0] "%" ASDM,PAS
 SG_ FrntRdrObj23RdrObjStatyCnt : 239|7@0+ (1.0,0.0) [0.0|127.0] "Unitless" ASDM,PAS
 SG_ FrntRdrObj23RdrObjTiAlv : 247|7@0+ (1.0,0.0) [0.0|127.0] "Unitless" ASDM,PAS
 SG_ FrntRdrObj23RdrObjTrackSts : 194|2@0+ (1,0) [0|3] "" ASDM,PAS
 SG_ FrntRdrObj23RdrObjTyp : 51|4@0+ (1,0) [0|15] "" ASDM,PAS
 SG_ FrntRdrObj23RdrObjTypConfBike : 175|4@0+ (7.0,0.0) [0.0|105.0] "%" ASDM,PAS
 SG_ FrntRdrObj23RdrObjTypConfPed : 171|4@0+ (7.0,0.0) [0.0|105.0] "%" ASDM,PAS
 SG_ FrntRdrObj23RdrObjTypConfVeh : 227|4@0+ (7.0,0.0) [0.0|105.0] "%" ASDM,PAS
 SG_ FrntRdrObj23RdrObjVx : 255|14@0+ (0.02,-128.0) [-128.0|128.0] "m/s" ASDM,PAS
 SG_ FrntRdrObj23RdrObjVxStdDe : 271|6@0+ (0.05,0.0) [0.0|2.0] "m/s" ASDM,PAS
 SG_ FrntRdrObj23RdrObjVy : 207|14@0+ (0.02,-128.0) [-128.0|128.0] "m/s" ASDM,PAS
 SG_ FrntRdrObj23RdrObjVyStdDe : 159|6@0+ (0.05,0.0) [0.0|2.0] "m/s" ASDM,PAS
 SG_ FrntRdrObj23RelVx : 135|12@0+ (0.02,-35.6) [-35.6|35.6] "m/s" ASDM,PAS
 SG_ FrntRdrObj23RelVy : 139|12@0+ (0.02,-35.6) [-35.6|35.6] "m/s" ASDM,PAS

BO_ 514 FLRSafetyCANFD2Frame58: 64 FLR
 SG_ FrntRdrObj24_UB : 291|1@0+ (1,0) [0|1] "" ASDM,PAS
 SG_ FrntRdrObj24Heading : 287|12@0+ (0.1,-180.0) [-180.0|180.0] "Deg" ASDM,PAS
 SG_ FrntRdrObj24ObjBoxCenterLat : 23|9@0+ (0.1,-25.0) [-25.0|25.0] "m" ASDM,PAS
 SG_ FrntRdrObj24ObjBoxCenterLgt : 30|9@0+ (0.1,-25.0) [-25.0|25.0] "m" ASDM,PAS
 SG_ FrntRdrObj24ObservationHist : 63|32@0+ (1.0,0.0) [0.0|4294967295.0] "Unitless" ASDM,PAS
 SG_ FrntRdrObj24RdrObjAx : 7|8@0- (0.1,0.0) [-12.8|12.700000000000001] "m/s^2" ASDM,PAS
 SG_ FrntRdrObj24RdrObjAy : 15|8@0- (0.1,0.0) [-12.8|12.700000000000001] "m/s^2" ASDM,PAS
 SG_ FrntRdrObj24RdrObjBoxLength : 37|9@0+ (0.1,0.0) [0.0|50.0] "m" ASDM,PAS
 SG_ FrntRdrObj24RdrObjBoxWidth : 44|9@0+ (0.1,0.0) [0.0|50.0] "m" ASDM,PAS
 SG_ FrntRdrObj24RdrObjChks : 95|8@0+ (1.0,0.0) [0.0|255.0] "Unitless" ASDM,PAS
 SG_ FrntRdrObj24RdrObjCntr : 103|4@0+ (1.0,0.0) [0.0|15.0] "Unitless" ASDM,PAS
 SG_ FrntRdrObj24RdrObjCoastCnt : 279|5@0+ (1.0,0.0) [0.0|31.0] "Unitless" ASDM,PAS
 SG_ FrntRdrObj24RdrObjConf : 99|4@0+ (7.0,0.0) [0.0|105.0] "%" ASDM,PAS
 SG_ FrntRdrObj24RdrObjDx : 191|13@0+ (0.05,-200.0) [-200.0|200.0] "m" ASDM,PAS
 SG_ FrntRdrObj24RdrObjDxStdDe : 111|8@0+ (0.05,0.0) [0.0|12.700000000000001] "m" ASDM,PAS
 SG_ FrntRdrObj24RdrObjDy : 119|13@0+ (0.05,-200.0) [-200.0|200.0] "m" ASDM,PAS
 SG_ FrntRdrObj24RdrObjDyStdDe : 183|8@0+ (0.05,0.0) [0.0|12.700000000000001] "m" ASDM,PAS
 SG_ FrntRdrObj24RdrObjElevnConf : 223|4@0+ (7.0,0.0) [0.0|105.0] "%" ASDM,PAS
 SG_ FrntRdrObj24RdrObjElevnSts : 153|2@0+ (1,0) [0|3] "" ASDM,PAS
 SG_ FrntRdrObj24RdrObjID : 167|8@0+ (1.0,0.0) [0.0|255.0] "Unitless" ASDM,PAS
 SG_ FrntRdrObj24RdrObjIsInFreeSpace : 192|1@0+ (1,0) [0|1] "" ASDM,PAS
 SG_ FrntRdrObj24RdrObjMirrProblty : 219|4@0+ (7.0,0.0) [0.0|105.0] "%" ASDM,PAS
 SG_ FrntRdrObj24RdrObjMtnPat : 122|3@0+ (1,0) [0|7] "" ASDM,PAS
 SG_ FrntRdrObj24RdrObjNotRealProblty : 231|4@0+ (7.0,0.0) [0.0|105.0] "%" ASDM,PAS
 SG_ FrntRdrObj24RdrObjStatyCnt : 239|7@0+ (1.0,0.0) [0.0|127.0] "Unitless" ASDM,PAS
 SG_ FrntRdrObj24RdrObjTiAlv : 247|7@0+ (1.0,0.0) [0.0|127.0] "Unitless" ASDM,PAS
 SG_ FrntRdrObj24RdrObjTrackSts : 194|2@0+ (1,0) [0|3] "" ASDM,PAS
 SG_ FrntRdrObj24RdrObjTyp : 51|4@0+ (1,0) [0|15] "" ASDM,PAS
 SG_ FrntRdrObj24RdrObjTypConfBike : 175|4@0+ (7.0,0.0) [0.0|105.0] "%" ASDM,PAS
 SG_ FrntRdrObj24RdrObjTypConfPed : 171|4@0+ (7.0,0.0) [0.0|105.0] "%" ASDM,PAS
 SG_ FrntRdrObj24RdrObjTypConfVeh : 227|4@0+ (7.0,0.0) [0.0|105.0] "%" ASDM,PAS
 SG_ FrntRdrObj24RdrObjVx : 255|14@0+ (0.02,-128.0) [-128.0|128.0] "m/s" ASDM,PAS
 SG_ FrntRdrObj24RdrObjVxStdDe : 271|6@0+ (0.05,0.0) [0.0|2.0] "m/s" ASDM,PAS
 SG_ FrntRdrObj24RdrObjVy : 207|14@0+ (0.02,-128.0) [-128.0|128.0] "m/s" ASDM,PAS
 SG_ FrntRdrObj24RdrObjVyStdDe : 159|6@0+ (0.05,0.0) [0.0|2.0] "m/s" ASDM,PAS
 SG_ FrntRdrObj24RelVx : 135|12@0+ (0.02,-35.6) [-35.6|35.6] "m/s" ASDM,PAS
 SG_ FrntRdrObj24RelVy : 139|12@0+ (0.02,-35.6) [-35.6|35.6] "m/s" ASDM,PAS

BO_ 516 FLRSafetyCANFD2Frame59: 64 FLR
 SG_ FrntRdrObj25_UB : 291|1@0+ (1,0) [0|1] "" ASDM,PAS
 SG_ FrntRdrObj25Heading : 287|12@0+ (0.1,-180.0) [-180.0|180.0] "Deg" ASDM,PAS
 SG_ FrntRdrObj25ObjBoxCenterLat : 23|9@0+ (0.1,-25.0) [-25.0|25.0] "m" ASDM,PAS
 SG_ FrntRdrObj25ObjBoxCenterLgt : 30|9@0+ (0.1,-25.0) [-25.0|25.0] "m" ASDM,PAS
 SG_ FrntRdrObj25ObservationHist : 63|32@0+ (1.0,0.0) [0.0|4294967295.0] "Unitless" ASDM,PAS
 SG_ FrntRdrObj25RdrObjAx : 7|8@0- (0.1,0.0) [-12.8|12.700000000000001] "m/s^2" ASDM,PAS
 SG_ FrntRdrObj25RdrObjAy : 15|8@0- (0.1,0.0) [-12.8|12.700000000000001] "m/s^2" ASDM,PAS
 SG_ FrntRdrObj25RdrObjBoxLength : 37|9@0+ (0.1,0.0) [0.0|50.0] "m" ASDM,PAS
 SG_ FrntRdrObj25RdrObjBoxWidth : 44|9@0+ (0.1,0.0) [0.0|50.0] "m" ASDM,PAS
 SG_ FrntRdrObj25RdrObjChks : 95|8@0+ (1.0,0.0) [0.0|255.0] "Unitless" ASDM,PAS
 SG_ FrntRdrObj25RdrObjCntr : 103|4@0+ (1.0,0.0) [0.0|15.0] "Unitless" ASDM,PAS
 SG_ FrntRdrObj25RdrObjCoastCnt : 279|5@0+ (1.0,0.0) [0.0|31.0] "Unitless" ASDM,PAS
 SG_ FrntRdrObj25RdrObjConf : 99|4@0+ (7.0,0.0) [0.0|105.0] "%" ASDM,PAS
 SG_ FrntRdrObj25RdrObjDx : 191|13@0+ (0.05,-200.0) [-200.0|200.0] "m" ASDM,PAS
 SG_ FrntRdrObj25RdrObjDxStdDe : 111|8@0+ (0.05,0.0) [0.0|12.700000000000001] "m" ASDM,PAS
 SG_ FrntRdrObj25RdrObjDy : 119|13@0+ (0.05,-200.0) [-200.0|200.0] "m" ASDM,PAS
 SG_ FrntRdrObj25RdrObjDyStdDe : 183|8@0+ (0.05,0.0) [0.0|12.700000000000001] "m" ASDM,PAS
 SG_ FrntRdrObj25RdrObjElevnConf : 223|4@0+ (7.0,0.0) [0.0|105.0] "%" ASDM,PAS
 SG_ FrntRdrObj25RdrObjElevnSts : 153|2@0+ (1,0) [0|3] "" ASDM,PAS
 SG_ FrntRdrObj25RdrObjID : 167|8@0+ (1.0,0.0) [0.0|255.0] "Unitless" ASDM,PAS
 SG_ FrntRdrObj25RdrObjIsInFreeSpace : 192|1@0+ (1,0) [0|1] "" ASDM,PAS
 SG_ FrntRdrObj25RdrObjMirrProblty : 219|4@0+ (7.0,0.0) [0.0|105.0] "%" ASDM,PAS
 SG_ FrntRdrObj25RdrObjMtnPat : 122|3@0+ (1,0) [0|7] "" ASDM,PAS
 SG_ FrntRdrObj25RdrObjNotRealProblty : 231|4@0+ (7.0,0.0) [0.0|105.0] "%" ASDM,PAS
 SG_ FrntRdrObj25RdrObjStatyCnt : 239|7@0+ (1.0,0.0) [0.0|127.0] "Unitless" ASDM,PAS
 SG_ FrntRdrObj25RdrObjTiAlv : 247|7@0+ (1.0,0.0) [0.0|127.0] "Unitless" ASDM,PAS
 SG_ FrntRdrObj25RdrObjTrackSts : 194|2@0+ (1,0) [0|3] "" ASDM,PAS
 SG_ FrntRdrObj25RdrObjTyp : 51|4@0+ (1,0) [0|15] "" ASDM,PAS
 SG_ FrntRdrObj25RdrObjTypConfBike : 175|4@0+ (7.0,0.0) [0.0|105.0] "%" ASDM,PAS
 SG_ FrntRdrObj25RdrObjTypConfPed : 171|4@0+ (7.0,0.0) [0.0|105.0] "%" ASDM,PAS
 SG_ FrntRdrObj25RdrObjTypConfVeh : 227|4@0+ (7.0,0.0) [0.0|105.0] "%" ASDM,PAS
 SG_ FrntRdrObj25RdrObjVx : 255|14@0+ (0.02,-128.0) [-128.0|128.0] "m/s" ASDM,PAS
 SG_ FrntRdrObj25RdrObjVxStdDe : 271|6@0+ (0.05,0.0) [0.0|2.0] "m/s" ASDM,PAS
 SG_ FrntRdrObj25RdrObjVy : 207|14@0+ (0.02,-128.0) [-128.0|128.0] "m/s" ASDM,PAS
 SG_ FrntRdrObj25RdrObjVyStdDe : 159|6@0+ (0.05,0.0) [0.0|2.0] "m/s" ASDM,PAS
 SG_ FrntRdrObj25RelVx : 135|12@0+ (0.02,-35.6) [-35.6|35.6] "m/s" ASDM,PAS
 SG_ FrntRdrObj25RelVy : 139|12@0+ (0.02,-35.6) [-35.6|35.6] "m/s" ASDM,PAS

BO_ 518 FLRSafetyCANFD2Frame60: 64 FLR
 SG_ FrntRdrObj26_UB : 291|1@0+ (1,0) [0|1] "" ASDM,PAS
 SG_ FrntRdrObj26Heading : 287|12@0+ (0.1,-180.0) [-180.0|180.0] "Deg" ASDM,PAS
 SG_ FrntRdrObj26ObjBoxCenterLat : 23|9@0+ (0.1,-25.0) [-25.0|25.0] "m" ASDM,PAS
 SG_ FrntRdrObj26ObjBoxCenterLgt : 30|9@0+ (0.1,-25.0) [-25.0|25.0] "m" ASDM,PAS
 SG_ FrntRdrObj26ObservationHist : 63|32@0+ (1.0,0.0) [0.0|4294967295.0] "Unitless" ASDM,PAS
 SG_ FrntRdrObj26RdrObjAx : 7|8@0- (0.1,0.0) [-12.8|12.700000000000001] "m/s^2" ASDM,PAS
 SG_ FrntRdrObj26RdrObjAy : 15|8@0- (0.1,0.0) [-12.8|12.700000000000001] "m/s^2" ASDM,PAS
 SG_ FrntRdrObj26RdrObjBoxLength : 37|9@0+ (0.1,0.0) [0.0|50.0] "m" ASDM,PAS
 SG_ FrntRdrObj26RdrObjBoxWidth : 44|9@0+ (0.1,0.0) [0.0|50.0] "m" ASDM,PAS
 SG_ FrntRdrObj26RdrObjChks : 95|8@0+ (1.0,0.0) [0.0|255.0] "Unitless" ASDM,PAS
 SG_ FrntRdrObj26RdrObjCntr : 103|4@0+ (1.0,0.0) [0.0|15.0] "Unitless" ASDM,PAS
 SG_ FrntRdrObj26RdrObjCoastCnt : 279|5@0+ (1.0,0.0) [0.0|31.0] "Unitless" ASDM,PAS
 SG_ FrntRdrObj26RdrObjConf : 99|4@0+ (7.0,0.0) [0.0|105.0] "%" ASDM,PAS
 SG_ FrntRdrObj26RdrObjDx : 191|13@0+ (0.05,-200.0) [-200.0|200.0] "m" ASDM,PAS
 SG_ FrntRdrObj26RdrObjDxStdDe : 111|8@0+ (0.05,0.0) [0.0|12.700000000000001] "m" ASDM,PAS
 SG_ FrntRdrObj26RdrObjDy : 119|13@0+ (0.05,-200.0) [-200.0|200.0] "m" ASDM,PAS
 SG_ FrntRdrObj26RdrObjDyStdDe : 183|8@0+ (0.05,0.0) [0.0|12.700000000000001] "m" ASDM,PAS
 SG_ FrntRdrObj26RdrObjElevnConf : 223|4@0+ (7.0,0.0) [0.0|105.0] "%" ASDM,PAS
 SG_ FrntRdrObj26RdrObjElevnSts : 153|2@0+ (1,0) [0|3] "" ASDM,PAS
 SG_ FrntRdrObj26RdrObjID : 167|8@0+ (1.0,0.0) [0.0|255.0] "Unitless" ASDM,PAS
 SG_ FrntRdrObj26RdrObjIsInFreeSpace : 192|1@0+ (1,0) [0|1] "" ASDM,PAS
 SG_ FrntRdrObj26RdrObjMirrProblty : 219|4@0+ (7.0,0.0) [0.0|105.0] "%" ASDM,PAS
 SG_ FrntRdrObj26RdrObjMtnPat : 122|3@0+ (1,0) [0|7] "" ASDM,PAS
 SG_ FrntRdrObj26RdrObjNotRealProblty : 231|4@0+ (7.0,0.0) [0.0|105.0] "%" ASDM,PAS
 SG_ FrntRdrObj26RdrObjStatyCnt : 239|7@0+ (1.0,0.0) [0.0|127.0] "Unitless" ASDM,PAS
 SG_ FrntRdrObj26RdrObjTiAlv : 247|7@0+ (1.0,0.0) [0.0|127.0] "Unitless" ASDM,PAS
 SG_ FrntRdrObj26RdrObjTrackSts : 194|2@0+ (1,0) [0|3] "" ASDM,PAS
 SG_ FrntRdrObj26RdrObjTyp : 51|4@0+ (1,0) [0|15] "" ASDM,PAS
 SG_ FrntRdrObj26RdrObjTypConfBike : 175|4@0+ (7.0,0.0) [0.0|105.0] "%" ASDM,PAS
 SG_ FrntRdrObj26RdrObjTypConfPed : 171|4@0+ (7.0,0.0) [0.0|105.0] "%" ASDM,PAS
 SG_ FrntRdrObj26RdrObjTypConfVeh : 227|4@0+ (7.0,0.0) [0.0|105.0] "%" ASDM,PAS
 SG_ FrntRdrObj26RdrObjVx : 255|14@0+ (0.02,-128.0) [-128.0|128.0] "m/s" ASDM,PAS
 SG_ FrntRdrObj26RdrObjVxStdDe : 271|6@0+ (0.05,0.0) [0.0|2.0] "m/s" ASDM,PAS
 SG_ FrntRdrObj26RdrObjVy : 207|14@0+ (0.02,-128.0) [-128.0|128.0] "m/s" ASDM,PAS
 SG_ FrntRdrObj26RdrObjVyStdDe : 159|6@0+ (0.05,0.0) [0.0|2.0] "m/s" ASDM,PAS
 SG_ FrntRdrObj26RelVx : 135|12@0+ (0.02,-35.6) [-35.6|35.6] "m/s" ASDM,PAS
 SG_ FrntRdrObj26RelVy : 139|12@0+ (0.02,-35.6) [-35.6|35.6] "m/s" ASDM,PAS

BO_ 520 FLRSafetyCANFD2Frame61: 64 FLR
 SG_ FrntRdrObj27_UB : 291|1@0+ (1,0) [0|1] "" ASDM,PAS
 SG_ FrntRdrObj27Heading : 287|12@0+ (0.1,-180.0) [-180.0|180.0] "Deg" ASDM,PAS
 SG_ FrntRdrObj27ObjBoxCenterLat : 23|9@0+ (0.1,-25.0) [-25.0|25.0] "m" ASDM,PAS
 SG_ FrntRdrObj27ObjBoxCenterLgt : 30|9@0+ (0.1,-25.0) [-25.0|25.0] "m" ASDM,PAS
 SG_ FrntRdrObj27ObservationHist : 63|32@0+ (1.0,0.0) [0.0|4294967295.0] "Unitless" ASDM,PAS
 SG_ FrntRdrObj27RdrObjAx : 7|8@0- (0.1,0.0) [-12.8|12.700000000000001] "m/s^2" ASDM,PAS
 SG_ FrntRdrObj27RdrObjAy : 15|8@0- (0.1,0.0) [-12.8|12.700000000000001] "m/s^2" ASDM,PAS
 SG_ FrntRdrObj27RdrObjBoxLength : 37|9@0+ (0.1,0.0) [0.0|50.0] "m" ASDM,PAS
 SG_ FrntRdrObj27RdrObjBoxWidth : 44|9@0+ (0.1,0.0) [0.0|50.0] "m" ASDM,PAS
 SG_ FrntRdrObj27RdrObjChks : 95|8@0+ (1.0,0.0) [0.0|255.0] "Unitless" ASDM,PAS
 SG_ FrntRdrObj27RdrObjCntr : 103|4@0+ (1.0,0.0) [0.0|15.0] "Unitless" ASDM,PAS
 SG_ FrntRdrObj27RdrObjCoastCnt : 279|5@0+ (1.0,0.0) [0.0|31.0] "Unitless" ASDM,PAS
 SG_ FrntRdrObj27RdrObjConf : 99|4@0+ (7.0,0.0) [0.0|105.0] "%" ASDM,PAS
 SG_ FrntRdrObj27RdrObjDx : 191|13@0+ (0.05,-200.0) [-200.0|200.0] "m" ASDM,PAS
 SG_ FrntRdrObj27RdrObjDxStdDe : 111|8@0+ (0.05,0.0) [0.0|12.700000000000001] "m" ASDM,PAS
 SG_ FrntRdrObj27RdrObjDy : 119|13@0+ (0.05,-200.0) [-200.0|200.0] "m" ASDM,PAS
 SG_ FrntRdrObj27RdrObjDyStdDe : 183|8@0+ (0.05,0.0) [0.0|12.700000000000001] "m" ASDM,PAS
 SG_ FrntRdrObj27RdrObjElevnConf : 223|4@0+ (7.0,0.0) [0.0|105.0] "%" ASDM,PAS
 SG_ FrntRdrObj27RdrObjElevnSts : 153|2@0+ (1,0) [0|3] "" ASDM,PAS
 SG_ FrntRdrObj27RdrObjID : 167|8@0+ (1.0,0.0) [0.0|255.0] "Unitless" ASDM,PAS
 SG_ FrntRdrObj27RdrObjIsInFreeSpace : 192|1@0+ (1,0) [0|1] "" ASDM,PAS
 SG_ FrntRdrObj27RdrObjMirrProblty : 219|4@0+ (7.0,0.0) [0.0|105.0] "%" ASDM,PAS
 SG_ FrntRdrObj27RdrObjMtnPat : 122|3@0+ (1,0) [0|7] "" ASDM,PAS
 SG_ FrntRdrObj27RdrObjNotRealProblty : 231|4@0+ (7.0,0.0) [0.0|105.0] "%" ASDM,PAS
 SG_ FrntRdrObj27RdrObjStatyCnt : 239|7@0+ (1.0,0.0) [0.0|127.0] "Unitless" ASDM,PAS
 SG_ FrntRdrObj27RdrObjTiAlv : 247|7@0+ (1.0,0.0) [0.0|127.0] "Unitless" ASDM,PAS
 SG_ FrntRdrObj27RdrObjTrackSts : 194|2@0+ (1,0) [0|3] "" ASDM,PAS
 SG_ FrntRdrObj27RdrObjTyp : 51|4@0+ (1,0) [0|15] "" ASDM,PAS
 SG_ FrntRdrObj27RdrObjTypConfBike : 175|4@0+ (7.0,0.0) [0.0|105.0] "%" ASDM,PAS
 SG_ FrntRdrObj27RdrObjTypConfPed : 171|4@0+ (7.0,0.0) [0.0|105.0] "%" ASDM,PAS
 SG_ FrntRdrObj27RdrObjTypConfVeh : 227|4@0+ (7.0,0.0) [0.0|105.0] "%" ASDM,PAS
 SG_ FrntRdrObj27RdrObjVx : 255|14@0+ (0.02,-128.0) [-128.0|128.0] "m/s" ASDM,PAS
 SG_ FrntRdrObj27RdrObjVxStdDe : 271|6@0+ (0.05,0.0) [0.0|2.0] "m/s" ASDM,PAS
 SG_ FrntRdrObj27RdrObjVy : 207|14@0+ (0.02,-128.0) [-128.0|128.0] "m/s" ASDM,PAS
 SG_ FrntRdrObj27RdrObjVyStdDe : 159|6@0+ (0.05,0.0) [0.0|2.0] "m/s" ASDM,PAS
 SG_ FrntRdrObj27RelVx : 135|12@0+ (0.02,-35.6) [-35.6|35.6] "m/s" ASDM,PAS
 SG_ FrntRdrObj27RelVy : 139|12@0+ (0.02,-35.6) [-35.6|35.6] "m/s" ASDM,PAS

BO_ 522 FLRSafetyCANFD2Frame62: 64 FLR
 SG_ FrntRdrObj28_UB : 291|1@0+ (1,0) [0|1] "" ASDM,PAS
 SG_ FrntRdrObj28Heading : 287|12@0+ (0.1,-180.0) [-180.0|180.0] "Deg" ASDM,PAS
 SG_ FrntRdrObj28ObjBoxCenterLat : 23|9@0+ (0.1,-25.0) [-25.0|25.0] "m" ASDM,PAS
 SG_ FrntRdrObj28ObjBoxCenterLgt : 30|9@0+ (0.1,-25.0) [-25.0|25.0] "m" ASDM,PAS
 SG_ FrntRdrObj28ObservationHist : 63|32@0+ (1.0,0.0) [0.0|4294967295.0] "Unitless" ASDM,PAS
 SG_ FrntRdrObj28RdrObjAx : 7|8@0- (0.1,0.0) [-12.8|12.700000000000001] "m/s^2" ASDM,PAS
 SG_ FrntRdrObj28RdrObjAy : 15|8@0- (0.1,0.0) [-12.8|12.700000000000001] "m/s^2" ASDM,PAS
 SG_ FrntRdrObj28RdrObjBoxLength : 37|9@0+ (0.1,0.0) [0.0|50.0] "m" ASDM,PAS
 SG_ FrntRdrObj28RdrObjBoxWidth : 44|9@0+ (0.1,0.0) [0.0|50.0] "m" ASDM,PAS
 SG_ FrntRdrObj28RdrObjChks : 95|8@0+ (1.0,0.0) [0.0|255.0] "Unitless" ASDM,PAS
 SG_ FrntRdrObj28RdrObjCntr : 103|4@0+ (1.0,0.0) [0.0|15.0] "Unitless" ASDM,PAS
 SG_ FrntRdrObj28RdrObjCoastCnt : 279|5@0+ (1.0,0.0) [0.0|31.0] "Unitless" ASDM,PAS
 SG_ FrntRdrObj28RdrObjConf : 99|4@0+ (7.0,0.0) [0.0|105.0] "%" ASDM,PAS
 SG_ FrntRdrObj28RdrObjDx : 191|13@0+ (0.05,-200.0) [-200.0|200.0] "m" ASDM,PAS
 SG_ FrntRdrObj28RdrObjDxStdDe : 111|8@0+ (0.05,0.0) [0.0|12.700000000000001] "m" ASDM,PAS
 SG_ FrntRdrObj28RdrObjDy : 119|13@0+ (0.05,-200.0) [-200.0|200.0] "m" ASDM,PAS
 SG_ FrntRdrObj28RdrObjDyStdDe : 183|8@0+ (0.05,0.0) [0.0|12.700000000000001] "m" ASDM,PAS
 SG_ FrntRdrObj28RdrObjElevnConf : 223|4@0+ (7.0,0.0) [0.0|105.0] "%" ASDM,PAS
 SG_ FrntRdrObj28RdrObjElevnSts : 153|2@0+ (1,0) [0|3] "" ASDM,PAS
 SG_ FrntRdrObj28RdrObjID : 167|8@0+ (1.0,0.0) [0.0|255.0] "Unitless" ASDM,PAS
 SG_ FrntRdrObj28RdrObjIsInFreeSpace : 192|1@0+ (1,0) [0|1] "" ASDM,PAS
 SG_ FrntRdrObj28RdrObjMirrProblty : 219|4@0+ (7.0,0.0) [0.0|105.0] "%" ASDM,PAS
 SG_ FrntRdrObj28RdrObjMtnPat : 122|3@0+ (1,0) [0|7] "" ASDM,PAS
 SG_ FrntRdrObj28RdrObjNotRealProblty : 231|4@0+ (7.0,0.0) [0.0|105.0] "%" ASDM,PAS
 SG_ FrntRdrObj28RdrObjStatyCnt : 239|7@0+ (1.0,0.0) [0.0|127.0] "Unitless" ASDM,PAS
 SG_ FrntRdrObj28RdrObjTiAlv : 247|7@0+ (1.0,0.0) [0.0|127.0] "Unitless" ASDM,PAS
 SG_ FrntRdrObj28RdrObjTrackSts : 194|2@0+ (1,0) [0|3] "" ASDM,PAS
 SG_ FrntRdrObj28RdrObjTyp : 51|4@0+ (1,0) [0|15] "" ASDM,PAS
 SG_ FrntRdrObj28RdrObjTypConfBike : 175|4@0+ (7.0,0.0) [0.0|105.0] "%" ASDM,PAS
 SG_ FrntRdrObj28RdrObjTypConfPed : 171|4@0+ (7.0,0.0) [0.0|105.0] "%" ASDM,PAS
 SG_ FrntRdrObj28RdrObjTypConfVeh : 227|4@0+ (7.0,0.0) [0.0|105.0] "%" ASDM,PAS
 SG_ FrntRdrObj28RdrObjVx : 255|14@0+ (0.02,-128.0) [-128.0|128.0] "m/s" ASDM,PAS
 SG_ FrntRdrObj28RdrObjVxStdDe : 271|6@0+ (0.05,0.0) [0.0|2.0] "m/s" ASDM,PAS
 SG_ FrntRdrObj28RdrObjVy : 207|14@0+ (0.02,-128.0) [-128.0|128.0] "m/s" ASDM,PAS
 SG_ FrntRdrObj28RdrObjVyStdDe : 159|6@0+ (0.05,0.0) [0.0|2.0] "m/s" ASDM,PAS
 SG_ FrntRdrObj28RelVx : 135|12@0+ (0.02,-35.6) [-35.6|35.6] "m/s" ASDM,PAS
 SG_ FrntRdrObj28RelVy : 139|12@0+ (0.02,-35.6) [-35.6|35.6] "m/s" ASDM,PAS

BO_ 524 FLRSafetyCANFD2Frame63: 64 FLR
 SG_ FrntRdrObj29_UB : 291|1@0+ (1,0) [0|1] "" ASDM,PAS
 SG_ FrntRdrObj29Heading : 287|12@0+ (0.1,-180.0) [-180.0|180.0] "Deg" ASDM,PAS
 SG_ FrntRdrObj29ObjBoxCenterLat : 23|9@0+ (0.1,-25.0) [-25.0|25.0] "m" ASDM,PAS
 SG_ FrntRdrObj29ObjBoxCenterLgt : 30|9@0+ (0.1,-25.0) [-25.0|25.0] "m" ASDM,PAS
 SG_ FrntRdrObj29ObservationHist : 63|32@0+ (1.0,0.0) [0.0|4294967295.0] "Unitless" ASDM,PAS
 SG_ FrntRdrObj29RdrObjAx : 7|8@0- (0.1,0.0) [-12.8|12.700000000000001] "m/s^2" ASDM,PAS
 SG_ FrntRdrObj29RdrObjAy : 15|8@0- (0.1,0.0) [-12.8|12.700000000000001] "m/s^2" ASDM,PAS
 SG_ FrntRdrObj29RdrObjBoxLength : 37|9@0+ (0.1,0.0) [0.0|50.0] "m" ASDM,PAS
 SG_ FrntRdrObj29RdrObjBoxWidth : 44|9@0+ (0.1,0.0) [0.0|50.0] "m" ASDM,PAS
 SG_ FrntRdrObj29RdrObjChks : 95|8@0+ (1.0,0.0) [0.0|255.0] "Unitless" ASDM,PAS
 SG_ FrntRdrObj29RdrObjCntr : 103|4@0+ (1.0,0.0) [0.0|15.0] "Unitless" ASDM,PAS
 SG_ FrntRdrObj29RdrObjCoastCnt : 279|5@0+ (1.0,0.0) [0.0|31.0] "Unitless" ASDM,PAS
 SG_ FrntRdrObj29RdrObjConf : 99|4@0+ (7.0,0.0) [0.0|105.0] "%" ASDM,PAS
 SG_ FrntRdrObj29RdrObjDx : 191|13@0+ (0.05,-200.0) [-200.0|200.0] "m" ASDM,PAS
 SG_ FrntRdrObj29RdrObjDxStdDe : 111|8@0+ (0.05,0.0) [0.0|12.700000000000001] "m" ASDM,PAS
 SG_ FrntRdrObj29RdrObjDy : 119|13@0+ (0.05,-200.0) [-200.0|200.0] "m" ASDM,PAS
 SG_ FrntRdrObj29RdrObjDyStdDe : 183|8@0+ (0.05,0.0) [0.0|12.700000000000001] "m" ASDM,PAS
 SG_ FrntRdrObj29RdrObjElevnConf : 223|4@0+ (7.0,0.0) [0.0|105.0] "%" ASDM,PAS
 SG_ FrntRdrObj29RdrObjElevnSts : 153|2@0+ (1,0) [0|3] "" ASDM,PAS
 SG_ FrntRdrObj29RdrObjID : 167|8@0+ (1.0,0.0) [0.0|255.0] "Unitless" ASDM,PAS
 SG_ FrntRdrObj29RdrObjIsInFreeSpace : 192|1@0+ (1,0) [0|1] "" ASDM,PAS
 SG_ FrntRdrObj29RdrObjMirrProblty : 219|4@0+ (7.0,0.0) [0.0|105.0] "%" ASDM,PAS
 SG_ FrntRdrObj29RdrObjMtnPat : 122|3@0+ (1,0) [0|7] "" ASDM,PAS
 SG_ FrntRdrObj29RdrObjNotRealProblty : 231|4@0+ (7.0,0.0) [0.0|105.0] "%" ASDM,PAS
 SG_ FrntRdrObj29RdrObjStatyCnt : 239|7@0+ (1.0,0.0) [0.0|127.0] "Unitless" ASDM,PAS
 SG_ FrntRdrObj29RdrObjTiAlv : 247|7@0+ (1.0,0.0) [0.0|127.0] "Unitless" ASDM,PAS
 SG_ FrntRdrObj29RdrObjTrackSts : 194|2@0+ (1,0) [0|3] "" ASDM,PAS
 SG_ FrntRdrObj29RdrObjTyp : 51|4@0+ (1,0) [0|15] "" ASDM,PAS
 SG_ FrntRdrObj29RdrObjTypConfBike : 175|4@0+ (7.0,0.0) [0.0|105.0] "%" ASDM,PAS
 SG_ FrntRdrObj29RdrObjTypConfPed : 171|4@0+ (7.0,0.0) [0.0|105.0] "%" ASDM,PAS
 SG_ FrntRdrObj29RdrObjTypConfVeh : 227|4@0+ (7.0,0.0) [0.0|105.0] "%" ASDM,PAS
 SG_ FrntRdrObj29RdrObjVx : 255|14@0+ (0.02,-128.0) [-128.0|128.0] "m/s" ASDM,PAS
 SG_ FrntRdrObj29RdrObjVxStdDe : 271|6@0+ (0.05,0.0) [0.0|2.0] "m/s" ASDM,PAS
 SG_ FrntRdrObj29RdrObjVy : 207|14@0+ (0.02,-128.0) [-128.0|128.0] "m/s" ASDM,PAS
 SG_ FrntRdrObj29RdrObjVyStdDe : 159|6@0+ (0.05,0.0) [0.0|2.0] "m/s" ASDM,PAS
 SG_ FrntRdrObj29RelVx : 135|12@0+ (0.02,-35.6) [-35.6|35.6] "m/s" ASDM,PAS
 SG_ FrntRdrObj29RelVy : 139|12@0+ (0.02,-35.6) [-35.6|35.6] "m/s" ASDM,PAS

BO_ 526 FLRSafetyCANFD2Frame64: 64 FLR
 SG_ FrntRdrObj30_UB : 291|1@0+ (1,0) [0|1] "" ASDM,PAS
 SG_ FrntRdrObj30Heading : 287|12@0+ (0.1,-180.0) [-180.0|180.0] "Deg" ASDM,PAS
 SG_ FrntRdrObj30ObjBoxCenterLat : 23|9@0+ (0.1,-25.0) [-25.0|25.0] "m" ASDM,PAS
 SG_ FrntRdrObj30ObjBoxCenterLgt : 30|9@0+ (0.1,-25.0) [-25.0|25.0] "m" ASDM,PAS
 SG_ FrntRdrObj30ObservationHist : 63|32@0+ (1.0,0.0) [0.0|4294967295.0] "Unitless" ASDM,PAS
 SG_ FrntRdrObj30RdrObjAx : 7|8@0- (0.1,0.0) [-12.8|12.700000000000001] "m/s^2" ASDM,PAS
 SG_ FrntRdrObj30RdrObjAy : 15|8@0- (0.1,0.0) [-12.8|12.700000000000001] "m/s^2" ASDM,PAS
 SG_ FrntRdrObj30RdrObjBoxLength : 37|9@0+ (0.1,0.0) [0.0|50.0] "m" ASDM,PAS
 SG_ FrntRdrObj30RdrObjBoxWidth : 44|9@0+ (0.1,0.0) [0.0|50.0] "m" ASDM,PAS
 SG_ FrntRdrObj30RdrObjChks : 95|8@0+ (1.0,0.0) [0.0|255.0] "Unitless" ASDM,PAS
 SG_ FrntRdrObj30RdrObjCntr : 103|4@0+ (1.0,0.0) [0.0|15.0] "Unitless" ASDM,PAS
 SG_ FrntRdrObj30RdrObjCoastCnt : 279|5@0+ (1.0,0.0) [0.0|31.0] "Unitless" ASDM,PAS
 SG_ FrntRdrObj30RdrObjConf : 99|4@0+ (7.0,0.0) [0.0|105.0] "%" ASDM,PAS
 SG_ FrntRdrObj30RdrObjDx : 191|13@0+ (0.05,-200.0) [-200.0|200.0] "m" ASDM,PAS
 SG_ FrntRdrObj30RdrObjDxStdDe : 111|8@0+ (0.05,0.0) [0.0|12.700000000000001] "m" ASDM,PAS
 SG_ FrntRdrObj30RdrObjDy : 119|13@0+ (0.05,-200.0) [-200.0|200.0] "m" ASDM,PAS
 SG_ FrntRdrObj30RdrObjDyStdDe : 183|8@0+ (0.05,0.0) [0.0|12.700000000000001] "m" ASDM,PAS
 SG_ FrntRdrObj30RdrObjElevnConf : 223|4@0+ (7.0,0.0) [0.0|105.0] "%" ASDM,PAS
 SG_ FrntRdrObj30RdrObjElevnSts : 153|2@0+ (1,0) [0|3] "" ASDM,PAS
 SG_ FrntRdrObj30RdrObjID : 167|8@0+ (1.0,0.0) [0.0|255.0] "Unitless" ASDM,PAS
 SG_ FrntRdrObj30RdrObjIsInFreeSpace : 192|1@0+ (1,0) [0|1] "" ASDM,PAS
 SG_ FrntRdrObj30RdrObjMirrProblty : 219|4@0+ (7.0,0.0) [0.0|105.0] "%" ASDM,PAS
 SG_ FrntRdrObj30RdrObjMtnPat : 122|3@0+ (1,0) [0|7] "" ASDM,PAS
 SG_ FrntRdrObj30RdrObjNotRealProblty : 231|4@0+ (7.0,0.0) [0.0|105.0] "%" ASDM,PAS
 SG_ FrntRdrObj30RdrObjStatyCnt : 239|7@0+ (1.0,0.0) [0.0|127.0] "Unitless" ASDM,PAS
 SG_ FrntRdrObj30RdrObjTiAlv : 247|7@0+ (1.0,0.0) [0.0|127.0] "Unitless" ASDM,PAS
 SG_ FrntRdrObj30RdrObjTrackSts : 194|2@0+ (1,0) [0|3] "" ASDM,PAS
 SG_ FrntRdrObj30RdrObjTyp : 51|4@0+ (1,0) [0|15] "" ASDM,PAS
 SG_ FrntRdrObj30RdrObjTypConfBike : 175|4@0+ (7.0,0.0) [0.0|105.0] "%" ASDM,PAS
 SG_ FrntRdrObj30RdrObjTypConfPed : 171|4@0+ (7.0,0.0) [0.0|105.0] "%" ASDM,PAS
 SG_ FrntRdrObj30RdrObjTypConfVeh : 227|4@0+ (7.0,0.0) [0.0|105.0] "%" ASDM,PAS
 SG_ FrntRdrObj30RdrObjVx : 255|14@0+ (0.02,-128.0) [-128.0|128.0] "m/s" ASDM,PAS
 SG_ FrntRdrObj30RdrObjVxStdDe : 271|6@0+ (0.05,0.0) [0.0|2.0] "m/s" ASDM,PAS
 SG_ FrntRdrObj30RdrObjVy : 207|14@0+ (0.02,-128.0) [-128.0|128.0] "m/s" ASDM,PAS
 SG_ FrntRdrObj30RdrObjVyStdDe : 159|6@0+ (0.05,0.0) [0.0|2.0] "m/s" ASDM,PAS
 SG_ FrntRdrObj30RelVx : 135|12@0+ (0.02,-35.6) [-35.6|35.6] "m/s" ASDM,PAS
 SG_ FrntRdrObj30RelVy : 139|12@0+ (0.02,-35.6) [-35.6|35.6] "m/s" ASDM,PAS

BO_ 1282 FlrSafetyCanFD2NmFr: 8 FLR
 SG_ PNC16_FLR : 16|1@0+ (1,0) [0|0] "" FLC
 SG_ PNC17_FLR : 17|1@0+ (1,0) [0|0] "" FLC
 SG_ PNC18_FLR : 18|1@0+ (1,0) [0|0] "" FLC
 SG_ PNC19_FLR : 19|1@0+ (1,0) [0|0] "" FLC
 SG_ PNC20_FLR : 20|1@0+ (1,0) [0|0] "" FLC
 SG_ PNC21_FLR : 21|1@0+ (1,0) [0|0] "" FLC
 SG_ PNC22_FLR : 22|1@0+ (1,0) [0|0] "" FLC
 SG_ PNC23_FLR : 23|1@0+ (1,0) [0|0] "" FLC
 SG_ PNC24_FLR : 24|1@0+ (1,0) [0|0] "" FLC
 SG_ PNC25_FLR : 25|1@0+ (1,0) [0|0] "" FLC
 SG_ PNC26_FLR : 26|1@0+ (1,0) [0|0] "" FLC
 SG_ PNC27_FLR : 27|1@0+ (1,0) [0|0] "" FLC
 SG_ PNC28_FLR : 28|1@0+ (1,0) [0|0] "" FLC
 SG_ PNC29_FLR : 29|1@0+ (1,0) [0|0] "" FLC
 SG_ PNC30_FLR : 30|1@0+ (1,0) [0|0] "" FLC
 SG_ PNC31_FLR : 31|1@0+ (1,0) [0|0] "" FLC
 SG_ PNC32_FLR : 32|1@0+ (1,0) [0|0] "" FLC
 SG_ PNC33_FLR : 33|1@0+ (1,0) [0|0] "" FLC
 SG_ PNC34_FLR : 34|1@0+ (1,0) [0|0] "" FLC
 SG_ PNC35_FLR : 35|1@0+ (1,0) [0|0] "" FLC
 SG_ PNC36_FLR : 36|1@0+ (1,0) [0|0] "" FLC
 SG_ PNC37_FLR : 37|1@0+ (1,0) [0|0] "" FLC
 SG_ PNC38_FLR : 38|1@0+ (1,0) [0|0] "" FLC
 SG_ PNC39_FLR : 39|1@0+ (1,0) [0|0] "" FLC
 SG_ NM_PNI_FLR : 14|1@0+ (1,0) [0|0] "" FLC
 SG_ NM_AW_FLR : 12|1@0+ (1,0) [0|0] "" FLC
 SG_ NM_CS_FLR : 11|1@0+ (1,0) [0|0] "" FLC
 SG_ NM_RMR_FLR : 8|1@0+ (1,0) [0|0] "" FLC
 SG_ NM_NodeID_FLR : 7|8@0+ (1,0) [0|0] "" FLC

BO_ 1604 FlrToAsdmSafetyCanFD2DiagResFrame1: 64 FLR
 SG_ FlrToAsdmSafetyCanFD2DiagResNpdu : 7|512@0+ (1,0) [0|0] "" ASDM

BO_ 1409 FlrToEtcXcpFr01: 8 FLR

CM_ SG_ 406 FrntRdrObj18Heading "Refer to the data element description in FrntRdrObj1 with the same data element name.";
CM_ SG_ 406 FrntRdrObj18ObjBoxCenterLat "Refer to the data element description in FrntRdrObj1 with the same data element name.";
CM_ SG_ 406 FrntRdrObj18ObjBoxCenterLgt "Refer to the data element description in FrntRdrObj1 with the same data element name.";
CM_ SG_ 406 FrntRdrObj18ObservationHist "Refer to the data element description in FrntRdrObj1 with the same data element name.";
CM_ SG_ 406 FrntRdrObj18RdrObjAx "Refer to the data element description in FrntRdrObj1 with the same data element name.";
CM_ SG_ 406 FrntRdrObj18RdrObjAy "Refer to the data element description in FrntRdrObj1 with the same data element name.";
CM_ SG_ 406 FrntRdrObj18RdrObjBoxLength "Refer to the data element description in FrntRdrObj1 with the same data element name.";
CM_ SG_ 406 FrntRdrObj18RdrObjBoxWidth "Refer to the data element description in FrntRdrObj1 with the same data element name.";
CM_ SG_ 406 FrntRdrObj18RdrObjChks "Refer to the data element description in FrntRdrObj1 with the same data element name.";
CM_ SG_ 406 FrntRdrObj18RdrObjCntr "Refer to the data element description in FrntRdrObj1 with the same data element name.";
CM_ SG_ 406 FrntRdrObj18RdrObjCoastCnt "Refer to the data element description in FrntRdrObj1 with the same data element name.";
CM_ SG_ 406 FrntRdrObj18RdrObjConf "Refer to the data element description in FrntRdrObj1 with the same data element name.";
CM_ SG_ 406 FrntRdrObj18RdrObjDx "Refer to the data element description in FrntRdrObj1 with the same data element name.";
CM_ SG_ 406 FrntRdrObj18RdrObjDxStdDe "Refer to the data element description in FrntRdrObj1 with the same data element name.";
CM_ SG_ 406 FrntRdrObj18RdrObjDy "Refer to the data element description in FrntRdrObj1 with the same data element name.";
CM_ SG_ 406 FrntRdrObj18RdrObjDyStdDe "Refer to the data element description in FrntRdrObj1 with the same data element name.";
CM_ SG_ 406 FrntRdrObj18RdrObjElevnConf "Refer to the data element description in FrntRdrObj1 with the same data element name.";
CM_ SG_ 406 FrntRdrObj18RdrObjElevnSts "Refer to the data element description in FrntRdrObj1 with the same data element name.";
CM_ SG_ 406 FrntRdrObj18RdrObjID "Refer to the data element description in FrntRdrObj1 with the same data element name.";
CM_ SG_ 406 FrntRdrObj18RdrObjIsInFreeSpace "Refer to the data element description in FrntRdrObj1 with the same data element name.";
CM_ SG_ 406 FrntRdrObj18RdrObjMirrProblty "Refer to the data element description in FrntRdrObj1 with the same data element name.";
CM_ SG_ 406 FrntRdrObj18RdrObjMtnPat "Refer to the data element description in FrntRdrObj1 with the same data element name.";
CM_ SG_ 406 FrntRdrObj18RdrObjNotRealProblty "Refer to the data element description in FrntRdrObj1 with the same data element name.";
CM_ SG_ 406 FrntRdrObj18RdrObjStatyCnt "Refer to the data element description in FrntRdrObj1 with the same data element name.";
CM_ SG_ 406 FrntRdrObj18RdrObjTiAlv "Refer to the data element description in FrntRdrObj1 with the same data element name.";
CM_ SG_ 406 FrntRdrObj18RdrObjTrackSts "Refer to the data element description in FrntRdrObj1 with the same data element name.";
CM_ SG_ 406 FrntRdrObj18RdrObjTyp "Refer to the data element description in FrntRdrObj1 with the same data element name.";
CM_ SG_ 406 FrntRdrObj18RdrObjTypConfBike "Refer to the data element description in FrntRdrObj1 with the same data element name.";
CM_ SG_ 406 FrntRdrObj18RdrObjTypConfPed "Refer to the data element description in FrntRdrObj1 with the same data element name.";
CM_ SG_ 406 FrntRdrObj18RdrObjTypConfVeh "Refer to the data element description in FrntRdrObj1 with the same data element name.";
CM_ SG_ 406 FrntRdrObj18RdrObjVx "Refer to the data element description in FrntRdrObj1 with the same data element name.";
CM_ SG_ 406 FrntRdrObj18RdrObjVxStdDe "Refer to the data element description in FrntRdrObj1 with the same data element name.";
CM_ SG_ 406 FrntRdrObj18RdrObjVy "Refer to the data element description in FrntRdrObj1 with the same data element name.";
CM_ SG_ 406 FrntRdrObj18RdrObjVyStdDe "Refer to the data element description in FrntRdrObj1 with the same data element name.";
CM_ SG_ 406 FrntRdrObj18RelVx "Refer to the data element description in FrntRdrObj1 with the same data element name.";
CM_ SG_ 406 FrntRdrObj18RelVy "Refer to the data element description in FrntRdrObj1 with the same data element name.";
CM_ SG_ 408 FrntRdrObj19Heading "Refer to the data element description in FrntRdrObj1 with the same data element name.";
CM_ SG_ 408 FrntRdrObj19ObjBoxCenterLat "Refer to the data element description in FrntRdrObj1 with the same data element name.";
CM_ SG_ 408 FrntRdrObj19ObjBoxCenterLgt "Refer to the data element description in FrntRdrObj1 with the same data element name.";
CM_ SG_ 408 FrntRdrObj19ObservationHist "Refer to the data element description in FrntRdrObj1 with the same data element name.";
CM_ SG_ 408 FrntRdrObj19RdrObjAx "Refer to the data element description in FrntRdrObj1 with the same data element name.";
CM_ SG_ 408 FrntRdrObj19RdrObjAy "Refer to the data element description in FrntRdrObj1 with the same data element name.";
CM_ SG_ 408 FrntRdrObj19RdrObjBoxLength "Refer to the data element description in FrntRdrObj1 with the same data element name.";
CM_ SG_ 408 FrntRdrObj19RdrObjBoxWidth "Refer to the data element description in FrntRdrObj1 with the same data element name.";
CM_ SG_ 408 FrntRdrObj19RdrObjChks "Refer to the data element description in FrntRdrObj1 with the same data element name.";
CM_ SG_ 408 FrntRdrObj19RdrObjCntr "Refer to the data element description in FrntRdrObj1 with the same data element name.";
CM_ SG_ 408 FrntRdrObj19RdrObjCoastCnt "Refer to the data element description in FrntRdrObj1 with the same data element name.";
CM_ SG_ 408 FrntRdrObj19RdrObjConf "Refer to the data element description in FrntRdrObj1 with the same data element name.";
CM_ SG_ 408 FrntRdrObj19RdrObjDx "Refer to the data element description in FrntRdrObj1 with the same data element name.";
CM_ SG_ 408 FrntRdrObj19RdrObjDxStdDe "Refer to the data element description in FrntRdrObj1 with the same data element name.";
CM_ SG_ 408 FrntRdrObj19RdrObjDy "Refer to the data element description in FrntRdrObj1 with the same data element name.";
CM_ SG_ 408 FrntRdrObj19RdrObjDyStdDe "Refer to the data element description in FrntRdrObj1 with the same data element name.";
CM_ SG_ 408 FrntRdrObj19RdrObjElevnConf "Refer to the data element description in FrntRdrObj1 with the same data element name.";
CM_ SG_ 408 FrntRdrObj19RdrObjElevnSts "Refer to the data element description in FrntRdrObj1 with the same data element name.";
CM_ SG_ 408 FrntRdrObj19RdrObjID "Refer to the data element description in FrntRdrObj1 with the same data element name.";
CM_ SG_ 408 FrntRdrObj19RdrObjIsInFreeSpace "Refer to the data element description in FrntRdrObj1 with the same data element name.";
CM_ SG_ 408 FrntRdrObj19RdrObjMirrProblty "Refer to the data element description in FrntRdrObj1 with the same data element name.";
CM_ SG_ 408 FrntRdrObj19RdrObjMtnPat "Refer to the data element description in FrntRdrObj1 with the same data element name.";
CM_ SG_ 408 FrntRdrObj19RdrObjNotRealProblty "Refer to the data element description in FrntRdrObj1 with the same data element name.";
CM_ SG_ 408 FrntRdrObj19RdrObjStatyCnt "Refer to the data element description in FrntRdrObj1 with the same data element name.";
CM_ SG_ 408 FrntRdrObj19RdrObjTiAlv "Refer to the data element description in FrntRdrObj1 with the same data element name.";
CM_ SG_ 408 FrntRdrObj19RdrObjTrackSts "Refer to the data element description in FrntRdrObj1 with the same data element name.";
CM_ SG_ 408 FrntRdrObj19RdrObjTyp "Refer to the data element description in FrntRdrObj1 with the same data element name.";
CM_ SG_ 408 FrntRdrObj19RdrObjTypConfBike "Refer to the data element description in FrntRdrObj1 with the same data element name.";
CM_ SG_ 408 FrntRdrObj19RdrObjTypConfPed "Refer to the data element description in FrntRdrObj1 with the same data element name.";
CM_ SG_ 408 FrntRdrObj19RdrObjTypConfVeh "Refer to the data element description in FrntRdrObj1 with the same data element name.";
CM_ SG_ 408 FrntRdrObj19RdrObjVx "Refer to the data element description in FrntRdrObj1 with the same data element name.";
CM_ SG_ 408 FrntRdrObj19RdrObjVxStdDe "Refer to the data element description in FrntRdrObj1 with the same data element name.";
CM_ SG_ 408 FrntRdrObj19RdrObjVy "Refer to the data element description in FrntRdrObj1 with the same data element name.";
CM_ SG_ 408 FrntRdrObj19RdrObjVyStdDe "Refer to the data element description in FrntRdrObj1 with the same data element name.";
CM_ SG_ 408 FrntRdrObj19RelVx "Refer to the data element description in FrntRdrObj1 with the same data element name.";
CM_ SG_ 408 FrntRdrObj19RelVy "Refer to the data element description in FrntRdrObj1 with the same data element name.";
CM_ SG_ 410 FrntRdrObj20Heading "Refer to the data element description in FrntRdrObj1 with the same data element name.";
CM_ SG_ 410 FrntRdrObj20ObjBoxCenterLat "Refer to the data element description in FrntRdrObj1 with the same data element name.";
CM_ SG_ 410 FrntRdrObj20ObjBoxCenterLgt "Refer to the data element description in FrntRdrObj1 with the same data element name.";
CM_ SG_ 410 FrntRdrObj20ObservationHist "Refer to the data element description in FrntRdrObj1 with the same data element name.";
CM_ SG_ 410 FrntRdrObj20RdrObjAx "Refer to the data element description in FrntRdrObj1 with the same data element name.";
CM_ SG_ 410 FrntRdrObj20RdrObjAy "Refer to the data element description in FrntRdrObj1 with the same data element name.";
CM_ SG_ 410 FrntRdrObj20RdrObjBoxLength "Refer to the data element description in FrntRdrObj1 with the same data element name.";
CM_ SG_ 410 FrntRdrObj20RdrObjBoxWidth "Refer to the data element description in FrntRdrObj1 with the same data element name.";
CM_ SG_ 410 FrntRdrObj20RdrObjChks "Refer to the data element description in FrntRdrObj1 with the same data element name.";
CM_ SG_ 410 FrntRdrObj20RdrObjCntr "Refer to the data element description in FrntRdrObj1 with the same data element name.";
CM_ SG_ 410 FrntRdrObj20RdrObjCoastCnt "Refer to the data element description in FrntRdrObj1 with the same data element name.";
CM_ SG_ 410 FrntRdrObj20RdrObjConf "Refer to the data element description in FrntRdrObj1 with the same data element name.";
CM_ SG_ 410 FrntRdrObj20RdrObjDx "Refer to the data element description in FrntRdrObj1 with the same data element name.";
CM_ SG_ 410 FrntRdrObj20RdrObjDxStdDe "Refer to the data element description in FrntRdrObj1 with the same data element name.";
CM_ SG_ 410 FrntRdrObj20RdrObjDy "Refer to the data element description in FrntRdrObj1 with the same data element name.";
CM_ SG_ 410 FrntRdrObj20RdrObjDyStdDe "Refer to the data element description in FrntRdrObj1 with the same data element name.";
CM_ SG_ 410 FrntRdrObj20RdrObjElevnConf "Refer to the data element description in FrntRdrObj1 with the same data element name.";
CM_ SG_ 410 FrntRdrObj20RdrObjElevnSts "Refer to the data element description in FrntRdrObj1 with the same data element name.";
CM_ SG_ 410 FrntRdrObj20RdrObjID "Refer to the data element description in FrntRdrObj1 with the same data element name.";
CM_ SG_ 410 FrntRdrObj20RdrObjIsInFreeSpace "Refer to the data element description in FrntRdrObj1 with the same data element name.";
CM_ SG_ 410 FrntRdrObj20RdrObjMirrProblty "Refer to the data element description in FrntRdrObj1 with the same data element name.";
CM_ SG_ 410 FrntRdrObj20RdrObjMtnPat "Refer to the data element description in FrntRdrObj1 with the same data element name.";
CM_ SG_ 410 FrntRdrObj20RdrObjNotRealProblty "Refer to the data element description in FrntRdrObj1 with the same data element name.";
CM_ SG_ 410 FrntRdrObj20RdrObjStatyCnt "Refer to the data element description in FrntRdrObj1 with the same data element name.";
CM_ SG_ 410 FrntRdrObj20RdrObjTiAlv "Refer to the data element description in FrntRdrObj1 with the same data element name.";
CM_ SG_ 410 FrntRdrObj20RdrObjTrackSts "Refer to the data element description in FrntRdrObj1 with the same data element name.";
CM_ SG_ 410 FrntRdrObj20RdrObjTyp "Refer to the data element description in FrntRdrObj1 with the same data element name.";
CM_ SG_ 410 FrntRdrObj20RdrObjTypConfBike "Refer to the data element description in FrntRdrObj1 with the same data element name.";
CM_ SG_ 410 FrntRdrObj20RdrObjTypConfPed "Refer to the data element description in FrntRdrObj1 with the same data element name.";
CM_ SG_ 410 FrntRdrObj20RdrObjTypConfVeh "Refer to the data element description in FrntRdrObj1 with the same data element name.";
CM_ SG_ 410 FrntRdrObj20RdrObjVx "Refer to the data element description in FrntRdrObj1 with the same data element name.";
CM_ SG_ 410 FrntRdrObj20RdrObjVxStdDe "Refer to the data element description in FrntRdrObj1 with the same data element name.";
CM_ SG_ 410 FrntRdrObj20RdrObjVy "Refer to the data element description in FrntRdrObj1 with the same data element name.";
CM_ SG_ 410 FrntRdrObj20RdrObjVyStdDe "Refer to the data element description in FrntRdrObj1 with the same data element name.";
CM_ SG_ 410 FrntRdrObj20RelVx "Refer to the data element description in FrntRdrObj1 with the same data element name.";
CM_ SG_ 410 FrntRdrObj20RelVy "Refer to the data element description in FrntRdrObj1 with the same data element name.";
CM_ SG_ 412 FrntRdrObj21Heading "Refer to the data element description in FrntRdrObj1 with the same data element name.";
CM_ SG_ 412 FrntRdrObj21ObjBoxCenterLat "Refer to the data element description in FrntRdrObj1 with the same data element name.";
CM_ SG_ 412 FrntRdrObj21ObjBoxCenterLgt "Refer to the data element description in FrntRdrObj1 with the same data element name.";
CM_ SG_ 412 FrntRdrObj21ObservationHist "Refer to the data element description in FrntRdrObj1 with the same data element name.";
CM_ SG_ 412 FrntRdrObj21RdrObjAx "Refer to the data element description in FrntRdrObj1 with the same data element name.";
CM_ SG_ 412 FrntRdrObj21RdrObjAy "Refer to the data element description in FrntRdrObj1 with the same data element name.";
CM_ SG_ 412 FrntRdrObj21RdrObjBoxLength "Refer to the data element description in FrntRdrObj1 with the same data element name.";
CM_ SG_ 412 FrntRdrObj21RdrObjBoxWidth "Refer to the data element description in FrntRdrObj1 with the same data element name.";
CM_ SG_ 412 FrntRdrObj21RdrObjChks "Refer to the data element description in FrntRdrObj1 with the same data element name.";
CM_ SG_ 412 FrntRdrObj21RdrObjCntr "Refer to the data element description in FrntRdrObj1 with the same data element name.";
CM_ SG_ 412 FrntRdrObj21RdrObjCoastCnt "Refer to the data element description in FrntRdrObj1 with the same data element name.";
CM_ SG_ 412 FrntRdrObj21RdrObjConf "Refer to the data element description in FrntRdrObj1 with the same data element name.";
CM_ SG_ 412 FrntRdrObj21RdrObjDx "Refer to the data element description in FrntRdrObj1 with the same data element name.";
CM_ SG_ 412 FrntRdrObj21RdrObjDxStdDe "Refer to the data element description in FrntRdrObj1 with the same data element name.";
CM_ SG_ 412 FrntRdrObj21RdrObjDy "Refer to the data element description in FrntRdrObj1 with the same data element name.";
CM_ SG_ 412 FrntRdrObj21RdrObjDyStdDe "Refer to the data element description in FrntRdrObj1 with the same data element name.";
CM_ SG_ 412 FrntRdrObj21RdrObjElevnConf "Refer to the data element description in FrntRdrObj1 with the same data element name.";
CM_ SG_ 412 FrntRdrObj21RdrObjElevnSts "Refer to the data element description in FrntRdrObj1 with the same data element name.";
CM_ SG_ 412 FrntRdrObj21RdrObjID "Refer to the data element description in FrntRdrObj1 with the same data element name.";
CM_ SG_ 412 FrntRdrObj21RdrObjIsInFreeSpace "Refer to the data element description in FrntRdrObj1 with the same data element name.";
CM_ SG_ 412 FrntRdrObj21RdrObjMirrProblty "Refer to the data element description in FrntRdrObj1 with the same data element name.";
CM_ SG_ 412 FrntRdrObj21RdrObjMtnPat "Refer to the data element description in FrntRdrObj1 with the same data element name.";
CM_ SG_ 412 FrntRdrObj21RdrObjNotRealProblty "Refer to the data element description in FrntRdrObj1 with the same data element name.";
CM_ SG_ 412 FrntRdrObj21RdrObjStatyCnt "Refer to the data element description in FrntRdrObj1 with the same data element name.";
CM_ SG_ 412 FrntRdrObj21RdrObjTiAlv "Refer to the data element description in FrntRdrObj1 with the same data element name.";
CM_ SG_ 412 FrntRdrObj21RdrObjTrackSts "Refer to the data element description in FrntRdrObj1 with the same data element name.";
CM_ SG_ 412 FrntRdrObj21RdrObjTyp "Refer to the data element description in FrntRdrObj1 with the same data element name.";
CM_ SG_ 412 FrntRdrObj21RdrObjTypConfBike "Refer to the data element description in FrntRdrObj1 with the same data element name.";
CM_ SG_ 412 FrntRdrObj21RdrObjTypConfPed "Refer to the data element description in FrntRdrObj1 with the same data element name.";
CM_ SG_ 412 FrntRdrObj21RdrObjTypConfVeh "Refer to the data element description in FrntRdrObj1 with the same data element name.";
CM_ SG_ 412 FrntRdrObj21RdrObjVx "Refer to the data element description in FrntRdrObj1 with the same data element name.";
CM_ SG_ 412 FrntRdrObj21RdrObjVxStdDe "Refer to the data element description in FrntRdrObj1 with the same data element name.";
CM_ SG_ 412 FrntRdrObj21RdrObjVy "Refer to the data element description in FrntRdrObj1 with the same data element name.";
CM_ SG_ 412 FrntRdrObj21RdrObjVyStdDe "Refer to the data element description in FrntRdrObj1 with the same data element name.";
CM_ SG_ 412 FrntRdrObj21RelVx "Refer to the data element description in FrntRdrObj1 with the same data element name.";
CM_ SG_ 412 FrntRdrObj21RelVy "Refer to the data element description in FrntRdrObj1 with the same data element name.";
CM_ SG_ 414 FrntRdrObj22Heading "Refer to the data element description in FrntRdrObj1 with the same data element name.";
CM_ SG_ 414 FrntRdrObj22ObjBoxCenterLat "Refer to the data element description in FrntRdrObj1 with the same data element name.";
CM_ SG_ 414 FrntRdrObj22ObjBoxCenterLgt "Refer to the data element description in FrntRdrObj1 with the same data element name.";
CM_ SG_ 414 FrntRdrObj22ObservationHist "Refer to the data element description in FrntRdrObj1 with the same data element name.";
CM_ SG_ 414 FrntRdrObj22RdrObjAx "Refer to the data element description in FrntRdrObj1 with the same data element name.";
CM_ SG_ 414 FrntRdrObj22RdrObjAy "Refer to the data element description in FrntRdrObj1 with the same data element name.";
CM_ SG_ 414 FrntRdrObj22RdrObjBoxLength "Refer to the data element description in FrntRdrObj1 with the same data element name.";
CM_ SG_ 414 FrntRdrObj22RdrObjBoxWidth "Refer to the data element description in FrntRdrObj1 with the same data element name.";
CM_ SG_ 414 FrntRdrObj22RdrObjChks "Refer to the data element description in FrntRdrObj1 with the same data element name.";
CM_ SG_ 414 FrntRdrObj22RdrObjCntr "Refer to the data element description in FrntRdrObj1 with the same data element name.";
CM_ SG_ 414 FrntRdrObj22RdrObjCoastCnt "Refer to the data element description in FrntRdrObj1 with the same data element name.";
CM_ SG_ 414 FrntRdrObj22RdrObjConf "Refer to the data element description in FrntRdrObj1 with the same data element name.";
CM_ SG_ 414 FrntRdrObj22RdrObjDx "Refer to the data element description in FrntRdrObj1 with the same data element name.";
CM_ SG_ 414 FrntRdrObj22RdrObjDxStdDe "Refer to the data element description in FrntRdrObj1 with the same data element name.";
CM_ SG_ 414 FrntRdrObj22RdrObjDy "Refer to the data element description in FrntRdrObj1 with the same data element name.";
CM_ SG_ 414 FrntRdrObj22RdrObjDyStdDe "Refer to the data element description in FrntRdrObj1 with the same data element name.";
CM_ SG_ 414 FrntRdrObj22RdrObjElevnConf "Refer to the data element description in FrntRdrObj1 with the same data element name.";
CM_ SG_ 414 FrntRdrObj22RdrObjElevnSts "Refer to the data element description in FrntRdrObj1 with the same data element name.";
CM_ SG_ 414 FrntRdrObj22RdrObjID "Refer to the data element description in FrntRdrObj1 with the same data element name.";
CM_ SG_ 414 FrntRdrObj22RdrObjIsInFreeSpace "Refer to the data element description in FrntRdrObj1 with the same data element name.";
CM_ SG_ 414 FrntRdrObj22RdrObjMirrProblty "Refer to the data element description in FrntRdrObj1 with the same data element name.";
CM_ SG_ 414 FrntRdrObj22RdrObjMtnPat "Refer to the data element description in FrntRdrObj1 with the same data element name.";
CM_ SG_ 414 FrntRdrObj22RdrObjNotRealProblty "Refer to the data element description in FrntRdrObj1 with the same data element name.";
CM_ SG_ 414 FrntRdrObj22RdrObjStatyCnt "Refer to the data element description in FrntRdrObj1 with the same data element name.";
CM_ SG_ 414 FrntRdrObj22RdrObjTiAlv "Refer to the data element description in FrntRdrObj1 with the same data element name.";
CM_ SG_ 414 FrntRdrObj22RdrObjTrackSts "Refer to the data element description in FrntRdrObj1 with the same data element name.";
CM_ SG_ 414 FrntRdrObj22RdrObjTyp "Refer to the data element description in FrntRdrObj1 with the same data element name.";
CM_ SG_ 414 FrntRdrObj22RdrObjTypConfBike "Refer to the data element description in FrntRdrObj1 with the same data element name.";
CM_ SG_ 414 FrntRdrObj22RdrObjTypConfPed "Refer to the data element description in FrntRdrObj1 with the same data element name.";
CM_ SG_ 414 FrntRdrObj22RdrObjTypConfVeh "Refer to the data element description in FrntRdrObj1 with the same data element name.";
CM_ SG_ 414 FrntRdrObj22RdrObjVx "Refer to the data element description in FrntRdrObj1 with the same data element name.";
CM_ SG_ 414 FrntRdrObj22RdrObjVxStdDe "Refer to the data element description in FrntRdrObj1 with the same data element name.";
CM_ SG_ 414 FrntRdrObj22RdrObjVy "Refer to the data element description in FrntRdrObj1 with the same data element name.";
CM_ SG_ 414 FrntRdrObj22RdrObjVyStdDe "Refer to the data element description in FrntRdrObj1 with the same data element name.";
CM_ SG_ 414 FrntRdrObj22RelVx "Refer to the data element description in FrntRdrObj1 with the same data element name.";
CM_ SG_ 414 FrntRdrObj22RelVy "Refer to the data element description in FrntRdrObj1 with the same data element name.";
CM_ SG_ 512 FrntRdrObj23Heading "Refer to the data element description in FrntRdrObj1 with the same data element name.";
CM_ SG_ 512 FrntRdrObj23ObjBoxCenterLat "Refer to the data element description in FrntRdrObj1 with the same data element name.";
CM_ SG_ 512 FrntRdrObj23ObjBoxCenterLgt "Refer to the data element description in FrntRdrObj1 with the same data element name.";
CM_ SG_ 512 FrntRdrObj23ObservationHist "Refer to the data element description in FrntRdrObj1 with the same data element name.";
CM_ SG_ 512 FrntRdrObj23RdrObjAx "Refer to the data element description in FrntRdrObj1 with the same data element name.";
CM_ SG_ 512 FrntRdrObj23RdrObjAy "Refer to the data element description in FrntRdrObj1 with the same data element name.";
CM_ SG_ 512 FrntRdrObj23RdrObjBoxLength "Refer to the data element description in FrntRdrObj1 with the same data element name.";
CM_ SG_ 512 FrntRdrObj23RdrObjBoxWidth "Refer to the data element description in FrntRdrObj1 with the same data element name.";
CM_ SG_ 512 FrntRdrObj23RdrObjChks "Refer to the data element description in FrntRdrObj1 with the same data element name.";
CM_ SG_ 512 FrntRdrObj23RdrObjCntr "Refer to the data element description in FrntRdrObj1 with the same data element name.";
CM_ SG_ 512 FrntRdrObj23RdrObjCoastCnt "Refer to the data element description in FrntRdrObj1 with the same data element name.";
CM_ SG_ 512 FrntRdrObj23RdrObjConf "Refer to the data element description in FrntRdrObj1 with the same data element name.";
CM_ SG_ 512 FrntRdrObj23RdrObjDx "Refer to the data element description in FrntRdrObj1 with the same data element name.";
CM_ SG_ 512 FrntRdrObj23RdrObjDxStdDe "Refer to the data element description in FrntRdrObj1 with the same data element name.";
CM_ SG_ 512 FrntRdrObj23RdrObjDy "Refer to the data element description in FrntRdrObj1 with the same data element name.";
CM_ SG_ 512 FrntRdrObj23RdrObjDyStdDe "Refer to the data element description in FrntRdrObj1 with the same data element name.";
CM_ SG_ 512 FrntRdrObj23RdrObjElevnConf "Refer to the data element description in FrntRdrObj1 with the same data element name.";
CM_ SG_ 512 FrntRdrObj23RdrObjElevnSts "Refer to the data element description in FrntRdrObj1 with the same data element name.";
CM_ SG_ 512 FrntRdrObj23RdrObjID "Refer to the data element description in FrntRdrObj1 with the same data element name.";
CM_ SG_ 512 FrntRdrObj23RdrObjIsInFreeSpace "Refer to the data element description in FrntRdrObj1 with the same data element name.";
CM_ SG_ 512 FrntRdrObj23RdrObjMirrProblty "Refer to the data element description in FrntRdrObj1 with the same data element name.";
CM_ SG_ 512 FrntRdrObj23RdrObjMtnPat "Refer to the data element description in FrntRdrObj1 with the same data element name.";
CM_ SG_ 512 FrntRdrObj23RdrObjNotRealProblty "Refer to the data element description in FrntRdrObj1 with the same data element name.";
CM_ SG_ 512 FrntRdrObj23RdrObjStatyCnt "Refer to the data element description in FrntRdrObj1 with the same data element name.";
CM_ SG_ 512 FrntRdrObj23RdrObjTiAlv "Refer to the data element description in FrntRdrObj1 with the same data element name.";
CM_ SG_ 512 FrntRdrObj23RdrObjTrackSts "Refer to the data element description in FrntRdrObj1 with the same data element name.";
CM_ SG_ 512 FrntRdrObj23RdrObjTyp "Refer to the data element description in FrntRdrObj1 with the same data element name.";
CM_ SG_ 512 FrntRdrObj23RdrObjTypConfBike "Refer to the data element description in FrntRdrObj1 with the same data element name.";
CM_ SG_ 512 FrntRdrObj23RdrObjTypConfPed "Refer to the data element description in FrntRdrObj1 with the same data element name.";
CM_ SG_ 512 FrntRdrObj23RdrObjTypConfVeh "Refer to the data element description in FrntRdrObj1 with the same data element name.";
CM_ SG_ 512 FrntRdrObj23RdrObjVx "Refer to the data element description in FrntRdrObj1 with the same data element name.";
CM_ SG_ 512 FrntRdrObj23RdrObjVxStdDe "Refer to the data element description in FrntRdrObj1 with the same data element name.";
CM_ SG_ 512 FrntRdrObj23RdrObjVy "Refer to the data element description in FrntRdrObj1 with the same data element name.";
CM_ SG_ 512 FrntRdrObj23RdrObjVyStdDe "Refer to the data element description in FrntRdrObj1 with the same data element name.";
CM_ SG_ 512 FrntRdrObj23RelVx "Refer to the data element description in FrntRdrObj1 with the same data element name.";
CM_ SG_ 512 FrntRdrObj23RelVy "Refer to the data element description in FrntRdrObj1 with the same data element name.";
CM_ SG_ 514 FrntRdrObj24Heading "Refer to the data element description in FrntRdrObj1 with the same data element name.";
CM_ SG_ 514 FrntRdrObj24ObjBoxCenterLat "Refer to the data element description in FrntRdrObj1 with the same data element name.";
CM_ SG_ 514 FrntRdrObj24ObjBoxCenterLgt "Refer to the data element description in FrntRdrObj1 with the same data element name.";
CM_ SG_ 514 FrntRdrObj24ObservationHist "Refer to the data element description in FrntRdrObj1 with the same data element name.";
CM_ SG_ 514 FrntRdrObj24RdrObjAx "Refer to the data element description in FrntRdrObj1 with the same data element name.";
CM_ SG_ 514 FrntRdrObj24RdrObjAy "Refer to the data element description in FrntRdrObj1 with the same data element name.";
CM_ SG_ 514 FrntRdrObj24RdrObjBoxLength "Refer to the data element description in FrntRdrObj1 with the same data element name.";
CM_ SG_ 514 FrntRdrObj24RdrObjBoxWidth "Refer to the data element description in FrntRdrObj1 with the same data element name.";
CM_ SG_ 514 FrntRdrObj24RdrObjChks "Refer to the data element description in FrntRdrObj1 with the same data element name.";
CM_ SG_ 514 FrntRdrObj24RdrObjCntr "Refer to the data element description in FrntRdrObj1 with the same data element name.";
CM_ SG_ 514 FrntRdrObj24RdrObjCoastCnt "Refer to the data element description in FrntRdrObj1 with the same data element name.";
CM_ SG_ 514 FrntRdrObj24RdrObjConf "Refer to the data element description in FrntRdrObj1 with the same data element name.";
CM_ SG_ 514 FrntRdrObj24RdrObjDx "Refer to the data element description in FrntRdrObj1 with the same data element name.";
CM_ SG_ 514 FrntRdrObj24RdrObjDxStdDe "Refer to the data element description in FrntRdrObj1 with the same data element name.";
CM_ SG_ 514 FrntRdrObj24RdrObjDy "Refer to the data element description in FrntRdrObj1 with the same data element name.";
CM_ SG_ 514 FrntRdrObj24RdrObjDyStdDe "Refer to the data element description in FrntRdrObj1 with the same data element name.";
CM_ SG_ 514 FrntRdrObj24RdrObjElevnConf "Refer to the data element description in FrntRdrObj1 with the same data element name.";
CM_ SG_ 514 FrntRdrObj24RdrObjElevnSts "Refer to the data element description in FrntRdrObj1 with the same data element name.";
CM_ SG_ 514 FrntRdrObj24RdrObjID "Refer to the data element description in FrntRdrObj1 with the same data element name.";
CM_ SG_ 514 FrntRdrObj24RdrObjIsInFreeSpace "Refer to the data element description in FrntRdrObj1 with the same data element name.";
CM_ SG_ 514 FrntRdrObj24RdrObjMirrProblty "Refer to the data element description in FrntRdrObj1 with the same data element name.";
CM_ SG_ 514 FrntRdrObj24RdrObjMtnPat "Refer to the data element description in FrntRdrObj1 with the same data element name.";
CM_ SG_ 514 FrntRdrObj24RdrObjNotRealProblty "Refer to the data element description in FrntRdrObj1 with the same data element name.";
CM_ SG_ 514 FrntRdrObj24RdrObjStatyCnt "Refer to the data element description in FrntRdrObj1 with the same data element name.";
CM_ SG_ 514 FrntRdrObj24RdrObjTiAlv "Refer to the data element description in FrntRdrObj1 with the same data element name.";
CM_ SG_ 514 FrntRdrObj24RdrObjTrackSts "Refer to the data element description in FrntRdrObj1 with the same data element name.";
CM_ SG_ 514 FrntRdrObj24RdrObjTyp "Refer to the data element description in FrntRdrObj1 with the same data element name.";
CM_ SG_ 514 FrntRdrObj24RdrObjTypConfBike "Refer to the data element description in FrntRdrObj1 with the same data element name.";
CM_ SG_ 514 FrntRdrObj24RdrObjTypConfPed "Refer to the data element description in FrntRdrObj1 with the same data element name.";
CM_ SG_ 514 FrntRdrObj24RdrObjTypConfVeh "Refer to the data element description in FrntRdrObj1 with the same data element name.";
CM_ SG_ 514 FrntRdrObj24RdrObjVx "Refer to the data element description in FrntRdrObj1 with the same data element name.";
CM_ SG_ 514 FrntRdrObj24RdrObjVxStdDe "Refer to the data element description in FrntRdrObj1 with the same data element name.";
CM_ SG_ 514 FrntRdrObj24RdrObjVy "Refer to the data element description in FrntRdrObj1 with the same data element name.";
CM_ SG_ 514 FrntRdrObj24RdrObjVyStdDe "Refer to the data element description in FrntRdrObj1 with the same data element name.";
CM_ SG_ 514 FrntRdrObj24RelVx "Refer to the data element description in FrntRdrObj1 with the same data element name.";
CM_ SG_ 514 FrntRdrObj24RelVy "Refer to the data element description in FrntRdrObj1 with the same data element name.";
CM_ SG_ 516 FrntRdrObj25Heading "Refer to the data element description in FrntRdrObj1 with the same data element name.";
CM_ SG_ 516 FrntRdrObj25ObjBoxCenterLat "Refer to the data element description in FrntRdrObj1 with the same data element name.";
CM_ SG_ 516 FrntRdrObj25ObjBoxCenterLgt "Refer to the data element description in FrntRdrObj1 with the same data element name.";
CM_ SG_ 516 FrntRdrObj25ObservationHist "Refer to the data element description in FrntRdrObj1 with the same data element name.";
CM_ SG_ 516 FrntRdrObj25RdrObjAx "Refer to the data element description in FrntRdrObj1 with the same data element name.";
CM_ SG_ 516 FrntRdrObj25RdrObjAy "Refer to the data element description in FrntRdrObj1 with the same data element name.";
CM_ SG_ 516 FrntRdrObj25RdrObjBoxLength "Refer to the data element description in FrntRdrObj1 with the same data element name.";
CM_ SG_ 516 FrntRdrObj25RdrObjBoxWidth "Refer to the data element description in FrntRdrObj1 with the same data element name.";
CM_ SG_ 516 FrntRdrObj25RdrObjChks "Refer to the data element description in FrntRdrObj1 with the same data element name.";
CM_ SG_ 516 FrntRdrObj25RdrObjCntr "Refer to the data element description in FrntRdrObj1 with the same data element name.";
CM_ SG_ 516 FrntRdrObj25RdrObjCoastCnt "Refer to the data element description in FrntRdrObj1 with the same data element name.";
CM_ SG_ 516 FrntRdrObj25RdrObjConf "Refer to the data element description in FrntRdrObj1 with the same data element name.";
CM_ SG_ 516 FrntRdrObj25RdrObjDx "Refer to the data element description in FrntRdrObj1 with the same data element name.";
CM_ SG_ 516 FrntRdrObj25RdrObjDxStdDe "Refer to the data element description in FrntRdrObj1 with the same data element name.";
CM_ SG_ 516 FrntRdrObj25RdrObjDy "Refer to the data element description in FrntRdrObj1 with the same data element name.";
CM_ SG_ 516 FrntRdrObj25RdrObjDyStdDe "Refer to the data element description in FrntRdrObj1 with the same data element name.";
CM_ SG_ 516 FrntRdrObj25RdrObjElevnConf "Refer to the data element description in FrntRdrObj1 with the same data element name.";
CM_ SG_ 516 FrntRdrObj25RdrObjElevnSts "Refer to the data element description in FrntRdrObj1 with the same data element name.";
CM_ SG_ 516 FrntRdrObj25RdrObjID "Refer to the data element description in FrntRdrObj1 with the same data element name.";
CM_ SG_ 516 FrntRdrObj25RdrObjIsInFreeSpace "Refer to the data element description in FrntRdrObj1 with the same data element name.";
CM_ SG_ 516 FrntRdrObj25RdrObjMirrProblty "Refer to the data element description in FrntRdrObj1 with the same data element name.";
CM_ SG_ 516 FrntRdrObj25RdrObjMtnPat "Refer to the data element description in FrntRdrObj1 with the same data element name.";
CM_ SG_ 516 FrntRdrObj25RdrObjNotRealProblty "Refer to the data element description in FrntRdrObj1 with the same data element name.";
CM_ SG_ 516 FrntRdrObj25RdrObjStatyCnt "Refer to the data element description in FrntRdrObj1 with the same data element name.";
CM_ SG_ 516 FrntRdrObj25RdrObjTiAlv "Refer to the data element description in FrntRdrObj1 with the same data element name.";
CM_ SG_ 516 FrntRdrObj25RdrObjTrackSts "Refer to the data element description in FrntRdrObj1 with the same data element name.";
CM_ SG_ 516 FrntRdrObj25RdrObjTyp "Refer to the data element description in FrntRdrObj1 with the same data element name.";
CM_ SG_ 516 FrntRdrObj25RdrObjTypConfBike "Refer to the data element description in FrntRdrObj1 with the same data element name.";
CM_ SG_ 516 FrntRdrObj25RdrObjTypConfPed "Refer to the data element description in FrntRdrObj1 with the same data element name.";
CM_ SG_ 516 FrntRdrObj25RdrObjTypConfVeh "Refer to the data element description in FrntRdrObj1 with the same data element name.";
CM_ SG_ 516 FrntRdrObj25RdrObjVx "Refer to the data element description in FrntRdrObj1 with the same data element name.";
CM_ SG_ 516 FrntRdrObj25RdrObjVxStdDe "Refer to the data element description in FrntRdrObj1 with the same data element name.";
CM_ SG_ 516 FrntRdrObj25RdrObjVy "Refer to the data element description in FrntRdrObj1 with the same data element name.";
CM_ SG_ 516 FrntRdrObj25RdrObjVyStdDe "Refer to the data element description in FrntRdrObj1 with the same data element name.";
CM_ SG_ 516 FrntRdrObj25RelVx "Refer to the data element description in FrntRdrObj1 with the same data element name.";
CM_ SG_ 516 FrntRdrObj25RelVy "Refer to the data element description in FrntRdrObj1 with the same data element name.";
CM_ SG_ 518 FrntRdrObj26Heading "Refer to the data element description in FrntRdrObj1 with the same data element name.";
CM_ SG_ 518 FrntRdrObj26ObjBoxCenterLat "Refer to the data element description in FrntRdrObj1 with the same data element name.";
CM_ SG_ 518 FrntRdrObj26ObjBoxCenterLgt "Refer to the data element description in FrntRdrObj1 with the same data element name.";
CM_ SG_ 518 FrntRdrObj26ObservationHist "Refer to the data element description in FrntRdrObj1 with the same data element name.";
CM_ SG_ 518 FrntRdrObj26RdrObjAx "Refer to the data element description in FrntRdrObj1 with the same data element name.";
CM_ SG_ 518 FrntRdrObj26RdrObjAy "Refer to the data element description in FrntRdrObj1 with the same data element name.";
CM_ SG_ 518 FrntRdrObj26RdrObjBoxLength "Refer to the data element description in FrntRdrObj1 with the same data element name.";
CM_ SG_ 518 FrntRdrObj26RdrObjBoxWidth "Refer to the data element description in FrntRdrObj1 with the same data element name.";
CM_ SG_ 518 FrntRdrObj26RdrObjChks "Refer to the data element description in FrntRdrObj1 with the same data element name.";
CM_ SG_ 518 FrntRdrObj26RdrObjCntr "Refer to the data element description in FrntRdrObj1 with the same data element name.";
CM_ SG_ 518 FrntRdrObj26RdrObjCoastCnt "Refer to the data element description in FrntRdrObj1 with the same data element name.";
CM_ SG_ 518 FrntRdrObj26RdrObjConf "Refer to the data element description in FrntRdrObj1 with the same data element name.";
CM_ SG_ 518 FrntRdrObj26RdrObjDx "Refer to the data element description in FrntRdrObj1 with the same data element name.";
CM_ SG_ 518 FrntRdrObj26RdrObjDxStdDe "Refer to the data element description in FrntRdrObj1 with the same data element name.";
CM_ SG_ 518 FrntRdrObj26RdrObjDy "Refer to the data element description in FrntRdrObj1 with the same data element name.";
CM_ SG_ 518 FrntRdrObj26RdrObjDyStdDe "Refer to the data element description in FrntRdrObj1 with the same data element name.";
CM_ SG_ 518 FrntRdrObj26RdrObjElevnConf "Refer to the data element description in FrntRdrObj1 with the same data element name.";
CM_ SG_ 518 FrntRdrObj26RdrObjElevnSts "Refer to the data element description in FrntRdrObj1 with the same data element name.";
CM_ SG_ 518 FrntRdrObj26RdrObjID "Refer to the data element description in FrntRdrObj1 with the same data element name.";
CM_ SG_ 518 FrntRdrObj26RdrObjIsInFreeSpace "Refer to the data element description in FrntRdrObj1 with the same data element name.";
CM_ SG_ 518 FrntRdrObj26RdrObjMirrProblty "Refer to the data element description in FrntRdrObj1 with the same data element name.";
CM_ SG_ 518 FrntRdrObj26RdrObjMtnPat "Refer to the data element description in FrntRdrObj1 with the same data element name.";
CM_ SG_ 518 FrntRdrObj26RdrObjNotRealProblty "Refer to the data element description in FrntRdrObj1 with the same data element name.";
CM_ SG_ 518 FrntRdrObj26RdrObjStatyCnt "Refer to the data element description in FrntRdrObj1 with the same data element name.";
CM_ SG_ 518 FrntRdrObj26RdrObjTiAlv "Refer to the data element description in FrntRdrObj1 with the same data element name.";
CM_ SG_ 518 FrntRdrObj26RdrObjTrackSts "Refer to the data element description in FrntRdrObj1 with the same data element name.";
CM_ SG_ 518 FrntRdrObj26RdrObjTyp "Refer to the data element description in FrntRdrObj1 with the same data element name.";
CM_ SG_ 518 FrntRdrObj26RdrObjTypConfBike "Refer to the data element description in FrntRdrObj1 with the same data element name.";
CM_ SG_ 518 FrntRdrObj26RdrObjTypConfPed "Refer to the data element description in FrntRdrObj1 with the same data element name.";
CM_ SG_ 518 FrntRdrObj26RdrObjTypConfVeh "Refer to the data element description in FrntRdrObj1 with the same data element name.";
CM_ SG_ 518 FrntRdrObj26RdrObjVx "Refer to the data element description in FrntRdrObj1 with the same data element name.";
CM_ SG_ 518 FrntRdrObj26RdrObjVxStdDe "Refer to the data element description in FrntRdrObj1 with the same data element name.";
CM_ SG_ 518 FrntRdrObj26RdrObjVy "Refer to the data element description in FrntRdrObj1 with the same data element name.";
CM_ SG_ 518 FrntRdrObj26RdrObjVyStdDe "Refer to the data element description in FrntRdrObj1 with the same data element name.";
CM_ SG_ 518 FrntRdrObj26RelVx "Refer to the data element description in FrntRdrObj1 with the same data element name.";
CM_ SG_ 518 FrntRdrObj26RelVy "Refer to the data element description in FrntRdrObj1 with the same data element name.";
CM_ SG_ 520 FrntRdrObj27Heading "Refer to the data element description in FrntRdrObj1 with the same data element name.";
CM_ SG_ 520 FrntRdrObj27ObjBoxCenterLat "Refer to the data element description in FrntRdrObj1 with the same data element name.";
CM_ SG_ 520 FrntRdrObj27ObjBoxCenterLgt "Refer to the data element description in FrntRdrObj1 with the same data element name.";
CM_ SG_ 520 FrntRdrObj27ObservationHist "Refer to the data element description in FrntRdrObj1 with the same data element name.";
CM_ SG_ 520 FrntRdrObj27RdrObjAx "Refer to the data element description in FrntRdrObj1 with the same data element name.";
CM_ SG_ 520 FrntRdrObj27RdrObjAy "Refer to the data element description in FrntRdrObj1 with the same data element name.";
CM_ SG_ 520 FrntRdrObj27RdrObjBoxLength "Refer to the data element description in FrntRdrObj1 with the same data element name.";
CM_ SG_ 520 FrntRdrObj27RdrObjBoxWidth "Refer to the data element description in FrntRdrObj1 with the same data element name.";
CM_ SG_ 520 FrntRdrObj27RdrObjChks "Refer to the data element description in FrntRdrObj1 with the same data element name.";
CM_ SG_ 520 FrntRdrObj27RdrObjCntr "Refer to the data element description in FrntRdrObj1 with the same data element name.";
CM_ SG_ 520 FrntRdrObj27RdrObjCoastCnt "Refer to the data element description in FrntRdrObj1 with the same data element name.";
CM_ SG_ 520 FrntRdrObj27RdrObjConf "Refer to the data element description in FrntRdrObj1 with the same data element name.";
CM_ SG_ 520 FrntRdrObj27RdrObjDx "Refer to the data element description in FrntRdrObj1 with the same data element name.";
CM_ SG_ 520 FrntRdrObj27RdrObjDxStdDe "Refer to the data element description in FrntRdrObj1 with the same data element name.";
CM_ SG_ 520 FrntRdrObj27RdrObjDy "Refer to the data element description in FrntRdrObj1 with the same data element name.";
CM_ SG_ 520 FrntRdrObj27RdrObjDyStdDe "Refer to the data element description in FrntRdrObj1 with the same data element name.";
CM_ SG_ 520 FrntRdrObj27RdrObjElevnConf "Refer to the data element description in FrntRdrObj1 with the same data element name.";
CM_ SG_ 520 FrntRdrObj27RdrObjElevnSts "Refer to the data element description in FrntRdrObj1 with the same data element name.";
CM_ SG_ 520 FrntRdrObj27RdrObjID "Refer to the data element description in FrntRdrObj1 with the same data element name.";
CM_ SG_ 520 FrntRdrObj27RdrObjIsInFreeSpace "Refer to the data element description in FrntRdrObj1 with the same data element name.";
CM_ SG_ 520 FrntRdrObj27RdrObjMirrProblty "Refer to the data element description in FrntRdrObj1 with the same data element name.";
CM_ SG_ 520 FrntRdrObj27RdrObjMtnPat "Refer to the data element description in FrntRdrObj1 with the same data element name.";
CM_ SG_ 520 FrntRdrObj27RdrObjNotRealProblty "Refer to the data element description in FrntRdrObj1 with the same data element name.";
CM_ SG_ 520 FrntRdrObj27RdrObjStatyCnt "Refer to the data element description in FrntRdrObj1 with the same data element name.";
CM_ SG_ 520 FrntRdrObj27RdrObjTiAlv "Refer to the data element description in FrntRdrObj1 with the same data element name.";
CM_ SG_ 520 FrntRdrObj27RdrObjTrackSts "Refer to the data element description in FrntRdrObj1 with the same data element name.";
CM_ SG_ 520 FrntRdrObj27RdrObjTyp "Refer to the data element description in FrntRdrObj1 with the same data element name.";
CM_ SG_ 520 FrntRdrObj27RdrObjTypConfBike "Refer to the data element description in FrntRdrObj1 with the same data element name.";
CM_ SG_ 520 FrntRdrObj27RdrObjTypConfPed "Refer to the data element description in FrntRdrObj1 with the same data element name.";
CM_ SG_ 520 FrntRdrObj27RdrObjTypConfVeh "Refer to the data element description in FrntRdrObj1 with the same data element name.";
CM_ SG_ 520 FrntRdrObj27RdrObjVx "Refer to the data element description in FrntRdrObj1 with the same data element name.";
CM_ SG_ 520 FrntRdrObj27RdrObjVxStdDe "Refer to the data element description in FrntRdrObj1 with the same data element name.";
CM_ SG_ 520 FrntRdrObj27RdrObjVy "Refer to the data element description in FrntRdrObj1 with the same data element name.";
CM_ SG_ 520 FrntRdrObj27RdrObjVyStdDe "Refer to the data element description in FrntRdrObj1 with the same data element name.";
CM_ SG_ 520 FrntRdrObj27RelVx "Refer to the data element description in FrntRdrObj1 with the same data element name.";
CM_ SG_ 520 FrntRdrObj27RelVy "Refer to the data element description in FrntRdrObj1 with the same data element name.";
CM_ SG_ 522 FrntRdrObj28Heading "Refer to the data element description in FrntRdrObj1 with the same data element name.";
CM_ SG_ 522 FrntRdrObj28ObjBoxCenterLat "Refer to the data element description in FrntRdrObj1 with the same data element name.";
CM_ SG_ 522 FrntRdrObj28ObjBoxCenterLgt "Refer to the data element description in FrntRdrObj1 with the same data element name.";
CM_ SG_ 522 FrntRdrObj28ObservationHist "Refer to the data element description in FrntRdrObj1 with the same data element name.";
CM_ SG_ 522 FrntRdrObj28RdrObjAx "Refer to the data element description in FrntRdrObj1 with the same data element name.";
CM_ SG_ 522 FrntRdrObj28RdrObjAy "Refer to the data element description in FrntRdrObj1 with the same data element name.";
CM_ SG_ 522 FrntRdrObj28RdrObjBoxLength "Refer to the data element description in FrntRdrObj1 with the same data element name.";
CM_ SG_ 522 FrntRdrObj28RdrObjBoxWidth "Refer to the data element description in FrntRdrObj1 with the same data element name.";
CM_ SG_ 522 FrntRdrObj28RdrObjChks "Refer to the data element description in FrntRdrObj1 with the same data element name.";
CM_ SG_ 522 FrntRdrObj28RdrObjCntr "Refer to the data element description in FrntRdrObj1 with the same data element name.";
CM_ SG_ 522 FrntRdrObj28RdrObjCoastCnt "Refer to the data element description in FrntRdrObj1 with the same data element name.";
CM_ SG_ 522 FrntRdrObj28RdrObjConf "Refer to the data element description in FrntRdrObj1 with the same data element name.";
CM_ SG_ 522 FrntRdrObj28RdrObjDx "Refer to the data element description in FrntRdrObj1 with the same data element name.";
CM_ SG_ 522 FrntRdrObj28RdrObjDxStdDe "Refer to the data element description in FrntRdrObj1 with the same data element name.";
CM_ SG_ 522 FrntRdrObj28RdrObjDy "Refer to the data element description in FrntRdrObj1 with the same data element name.";
CM_ SG_ 522 FrntRdrObj28RdrObjDyStdDe "Refer to the data element description in FrntRdrObj1 with the same data element name.";
CM_ SG_ 522 FrntRdrObj28RdrObjElevnConf "Refer to the data element description in FrntRdrObj1 with the same data element name.";
CM_ SG_ 522 FrntRdrObj28RdrObjElevnSts "Refer to the data element description in FrntRdrObj1 with the same data element name.";
CM_ SG_ 522 FrntRdrObj28RdrObjID "Refer to the data element description in FrntRdrObj1 with the same data element name.";
CM_ SG_ 522 FrntRdrObj28RdrObjIsInFreeSpace "Refer to the data element description in FrntRdrObj1 with the same data element name.";
CM_ SG_ 522 FrntRdrObj28RdrObjMirrProblty "Refer to the data element description in FrntRdrObj1 with the same data element name.";
CM_ SG_ 522 FrntRdrObj28RdrObjMtnPat "Refer to the data element description in FrntRdrObj1 with the same data element name.";
CM_ SG_ 522 FrntRdrObj28RdrObjNotRealProblty "Refer to the data element description in FrntRdrObj1 with the same data element name.";
CM_ SG_ 522 FrntRdrObj28RdrObjStatyCnt "Refer to the data element description in FrntRdrObj1 with the same data element name.";
CM_ SG_ 522 FrntRdrObj28RdrObjTiAlv "Refer to the data element description in FrntRdrObj1 with the same data element name.";
CM_ SG_ 522 FrntRdrObj28RdrObjTrackSts "Refer to the data element description in FrntRdrObj1 with the same data element name.";
CM_ SG_ 522 FrntRdrObj28RdrObjTyp "Refer to the data element description in FrntRdrObj1 with the same data element name.";
CM_ SG_ 522 FrntRdrObj28RdrObjTypConfBike "Refer to the data element description in FrntRdrObj1 with the same data element name.";
CM_ SG_ 522 FrntRdrObj28RdrObjTypConfPed "Refer to the data element description in FrntRdrObj1 with the same data element name.";
CM_ SG_ 522 FrntRdrObj28RdrObjTypConfVeh "Refer to the data element description in FrntRdrObj1 with the same data element name.";
CM_ SG_ 522 FrntRdrObj28RdrObjVx "Refer to the data element description in FrntRdrObj1 with the same data element name.";
CM_ SG_ 522 FrntRdrObj28RdrObjVxStdDe "Refer to the data element description in FrntRdrObj1 with the same data element name.";
CM_ SG_ 522 FrntRdrObj28RdrObjVy "Refer to the data element description in FrntRdrObj1 with the same data element name.";
CM_ SG_ 522 FrntRdrObj28RdrObjVyStdDe "Refer to the data element description in FrntRdrObj1 with the same data element name.";
CM_ SG_ 522 FrntRdrObj28RelVx "Refer to the data element description in FrntRdrObj1 with the same data element name.";
CM_ SG_ 522 FrntRdrObj28RelVy "Refer to the data element description in FrntRdrObj1 with the same data element name.";
CM_ SG_ 524 FrntRdrObj29Heading "Refer to the data element description in FrntRdrObj1 with the same data element name.";
CM_ SG_ 524 FrntRdrObj29ObjBoxCenterLat "Refer to the data element description in FrntRdrObj1 with the same data element name.";
CM_ SG_ 524 FrntRdrObj29ObjBoxCenterLgt "Refer to the data element description in FrntRdrObj1 with the same data element name.";
CM_ SG_ 524 FrntRdrObj29ObservationHist "Refer to the data element description in FrntRdrObj1 with the same data element name.";
CM_ SG_ 524 FrntRdrObj29RdrObjAx "Refer to the data element description in FrntRdrObj1 with the same data element name.";
CM_ SG_ 524 FrntRdrObj29RdrObjAy "Refer to the data element description in FrntRdrObj1 with the same data element name.";
CM_ SG_ 524 FrntRdrObj29RdrObjBoxLength "Refer to the data element description in FrntRdrObj1 with the same data element name.";
CM_ SG_ 524 FrntRdrObj29RdrObjBoxWidth "Refer to the data element description in FrntRdrObj1 with the same data element name.";
CM_ SG_ 524 FrntRdrObj29RdrObjChks "Refer to the data element description in FrntRdrObj1 with the same data element name.";
CM_ SG_ 524 FrntRdrObj29RdrObjCntr "Refer to the data element description in FrntRdrObj1 with the same data element name.";
CM_ SG_ 524 FrntRdrObj29RdrObjCoastCnt "Refer to the data element description in FrntRdrObj1 with the same data element name.";
CM_ SG_ 524 FrntRdrObj29RdrObjConf "Refer to the data element description in FrntRdrObj1 with the same data element name.";
CM_ SG_ 524 FrntRdrObj29RdrObjDx "Refer to the data element description in FrntRdrObj1 with the same data element name.";
CM_ SG_ 524 FrntRdrObj29RdrObjDxStdDe "Refer to the data element description in FrntRdrObj1 with the same data element name.";
CM_ SG_ 524 FrntRdrObj29RdrObjDy "Refer to the data element description in FrntRdrObj1 with the same data element name.";
CM_ SG_ 524 FrntRdrObj29RdrObjDyStdDe "Refer to the data element description in FrntRdrObj1 with the same data element name.";
CM_ SG_ 524 FrntRdrObj29RdrObjElevnConf "Refer to the data element description in FrntRdrObj1 with the same data element name.";
CM_ SG_ 524 FrntRdrObj29RdrObjElevnSts "Refer to the data element description in FrntRdrObj1 with the same data element name.";
CM_ SG_ 524 FrntRdrObj29RdrObjID "Refer to the data element description in FrntRdrObj1 with the same data element name.";
CM_ SG_ 524 FrntRdrObj29RdrObjIsInFreeSpace "Refer to the data element description in FrntRdrObj1 with the same data element name.";
CM_ SG_ 524 FrntRdrObj29RdrObjMirrProblty "Refer to the data element description in FrntRdrObj1 with the same data element name.";
CM_ SG_ 524 FrntRdrObj29RdrObjMtnPat "Refer to the data element description in FrntRdrObj1 with the same data element name.";
CM_ SG_ 524 FrntRdrObj29RdrObjNotRealProblty "Refer to the data element description in FrntRdrObj1 with the same data element name.";
CM_ SG_ 524 FrntRdrObj29RdrObjStatyCnt "Refer to the data element description in FrntRdrObj1 with the same data element name.";
CM_ SG_ 524 FrntRdrObj29RdrObjTiAlv "Refer to the data element description in FrntRdrObj1 with the same data element name.";
CM_ SG_ 524 FrntRdrObj29RdrObjTrackSts "Refer to the data element description in FrntRdrObj1 with the same data element name.";
CM_ SG_ 524 FrntRdrObj29RdrObjTyp "Refer to the data element description in FrntRdrObj1 with the same data element name.";
CM_ SG_ 524 FrntRdrObj29RdrObjTypConfBike "Refer to the data element description in FrntRdrObj1 with the same data element name.";
CM_ SG_ 524 FrntRdrObj29RdrObjTypConfPed "Refer to the data element description in FrntRdrObj1 with the same data element name.";
CM_ SG_ 524 FrntRdrObj29RdrObjTypConfVeh "Refer to the data element description in FrntRdrObj1 with the same data element name.";
CM_ SG_ 524 FrntRdrObj29RdrObjVx "Refer to the data element description in FrntRdrObj1 with the same data element name.";
CM_ SG_ 524 FrntRdrObj29RdrObjVxStdDe "Refer to the data element description in FrntRdrObj1 with the same data element name.";
CM_ SG_ 524 FrntRdrObj29RdrObjVy "Refer to the data element description in FrntRdrObj1 with the same data element name.";
CM_ SG_ 524 FrntRdrObj29RdrObjVyStdDe "Refer to the data element description in FrntRdrObj1 with the same data element name.";
CM_ SG_ 524 FrntRdrObj29RelVx "Refer to the data element description in FrntRdrObj1 with the same data element name.";
CM_ SG_ 524 FrntRdrObj29RelVy "Refer to the data element description in FrntRdrObj1 with the same data element name.";
CM_ SG_ 526 FrntRdrObj30Heading "Refer to the data element description in FrntRdrObj1 with the same data element name.";
CM_ SG_ 526 FrntRdrObj30ObjBoxCenterLat "Refer to the data element description in FrntRdrObj1 with the same data element name.";
CM_ SG_ 526 FrntRdrObj30ObjBoxCenterLgt "Refer to the data element description in FrntRdrObj1 with the same data element name.";
CM_ SG_ 526 FrntRdrObj30ObservationHist "Refer to the data element description in FrntRdrObj1 with the same data element name.";
CM_ SG_ 526 FrntRdrObj30RdrObjAx "Refer to the data element description in FrntRdrObj1 with the same data element name.";
CM_ SG_ 526 FrntRdrObj30RdrObjAy "Refer to the data element description in FrntRdrObj1 with the same data element name.";
CM_ SG_ 526 FrntRdrObj30RdrObjBoxLength "Refer to the data element description in FrntRdrObj1 with the same data element name.";
CM_ SG_ 526 FrntRdrObj30RdrObjBoxWidth "Refer to the data element description in FrntRdrObj1 with the same data element name.";
CM_ SG_ 526 FrntRdrObj30RdrObjChks "Refer to the data element description in FrntRdrObj1 with the same data element name.";
CM_ SG_ 526 FrntRdrObj30RdrObjCntr "Refer to the data element description in FrntRdrObj1 with the same data element name.";
CM_ SG_ 526 FrntRdrObj30RdrObjCoastCnt "Refer to the data element description in FrntRdrObj1 with the same data element name.";
CM_ SG_ 526 FrntRdrObj30RdrObjConf "Refer to the data element description in FrntRdrObj1 with the same data element name.";
CM_ SG_ 526 FrntRdrObj30RdrObjDx "Refer to the data element description in FrntRdrObj1 with the same data element name.";
CM_ SG_ 526 FrntRdrObj30RdrObjDxStdDe "Refer to the data element description in FrntRdrObj1 with the same data element name.";
CM_ SG_ 526 FrntRdrObj30RdrObjDy "Refer to the data element description in FrntRdrObj1 with the same data element name.";
CM_ SG_ 526 FrntRdrObj30RdrObjDyStdDe "Refer to the data element description in FrntRdrObj1 with the same data element name.";
CM_ SG_ 526 FrntRdrObj30RdrObjElevnConf "Refer to the data element description in FrntRdrObj1 with the same data element name.";
CM_ SG_ 526 FrntRdrObj30RdrObjElevnSts "Refer to the data element description in FrntRdrObj1 with the same data element name.";
CM_ SG_ 526 FrntRdrObj30RdrObjID "Refer to the data element description in FrntRdrObj1 with the same data element name.";
CM_ SG_ 526 FrntRdrObj30RdrObjIsInFreeSpace "Refer to the data element description in FrntRdrObj1 with the same data element name.";
CM_ SG_ 526 FrntRdrObj30RdrObjMirrProblty "Refer to the data element description in FrntRdrObj1 with the same data element name.";
CM_ SG_ 526 FrntRdrObj30RdrObjMtnPat "Refer to the data element description in FrntRdrObj1 with the same data element name.";
CM_ SG_ 526 FrntRdrObj30RdrObjNotRealProblty "Refer to the data element description in FrntRdrObj1 with the same data element name.";
CM_ SG_ 526 FrntRdrObj30RdrObjStatyCnt "Refer to the data element description in FrntRdrObj1 with the same data element name.";
CM_ SG_ 526 FrntRdrObj30RdrObjTiAlv "Refer to the data element description in FrntRdrObj1 with the same data element name.";
CM_ SG_ 526 FrntRdrObj30RdrObjTrackSts "Refer to the data element description in FrntRdrObj1 with the same data element name.";
CM_ SG_ 526 FrntRdrObj30RdrObjTyp "Refer to the data element description in FrntRdrObj1 with the same data element name.";
CM_ SG_ 526 FrntRdrObj30RdrObjTypConfBike "Refer to the data element description in FrntRdrObj1 with the same data element name.";
CM_ SG_ 526 FrntRdrObj30RdrObjTypConfPed "Refer to the data element description in FrntRdrObj1 with the same data element name.";
CM_ SG_ 526 FrntRdrObj30RdrObjTypConfVeh "Refer to the data element description in FrntRdrObj1 with the same data element name.";
CM_ SG_ 526 FrntRdrObj30RdrObjVx "Refer to the data element description in FrntRdrObj1 with the same data element name.";
CM_ SG_ 526 FrntRdrObj30RdrObjVxStdDe "Refer to the data element description in FrntRdrObj1 with the same data element name.";
CM_ SG_ 526 FrntRdrObj30RdrObjVy "Refer to the data element description in FrntRdrObj1 with the same data element name.";
CM_ SG_ 526 FrntRdrObj30RdrObjVyStdDe "Refer to the data element description in FrntRdrObj1 with the same data element name.";
CM_ SG_ 526 FrntRdrObj30RelVx "Refer to the data element description in FrntRdrObj1 with the same data element name.";
CM_ SG_ 526 FrntRdrObj30RelVy "Refer to the data element description in FrntRdrObj1 with the same data element name.";
BA_DEF_ BO_ "VFrameFormat" ENUM "StandardCAN","ExtendedCAN","reserved","J1939PG","reserved","reserved","reserved","reserved","reserved","reserved","reserved","reserved","reserved","reserved","StandardCAN_FD","ExtendedCAN_FD";
BA_DEF_ BO_ "CANFD_BRS" ENUM "0","1";
BA_DEF_ BO_ "GenMsgSendType" ENUM "cyclic", "spontaneous", "not-used", "not-used", "not-used", "cyclicAndSpontaneous", "not-used", "cyclicIfActive", "NoMsgSendType"; // [us]
BA_DEF_ BO_ "GenMsgCycleTime" INT 0 65536; // [ms]
BA_DEF_ BO_ "GenMsgStartDelayTime" INT 0 65536; // [ms]
BA_DEF_ BO_ "GenMsgDelayTime" INT 0 65536; // [ms]
BA_DEF_ SG_ "GenSigSendType" ENUM "Cyclic","OnWrite","OnWriteWithRepetition","OnChange","OnChangeWithRepetition","IfActive","IfActiveWithRepetition","NoSigSendType";
BA_DEF_ SG_ "GenSigStartValue" HEX 0 80000000;
BA_DEF_ BO_ "GenMsgILSupport" ENUM "No","Yes";
BA_DEF_ BO_ "NmAsrMessage" ENUM "No","Yes";
BA_DEF_ SG_ "GenSigFuncType" ENUM "NoFunction","n/a","n/a","n/a","n/a","n/a","n/a","n/a","n/a","n/a","n/a","n/a","n/a","n/a","n/a","CHK","CNTR","n/a","n/a","n/a","CNTR_AR_01","CRC_AR_01_BOTH","CRC_AR_01_ALT","CRC_AR_01_LOW","CRC_AR_01_NIBBLE","CNTR_AR_04","CRC_AR_04A","CNTR_AR_05","CRC_AR_05";
BA_DEF_ SG_ "GenSigDataID" STRING;

BA_DEF_DEF_ "VFrameFormat" "J1939PG";
BA_DEF_DEF_ "CANFD_BRS" "1";
BA_DEF_DEF_ "GenSigStartValue" 0;
BA_DEF_DEF_ "GenSigSendType" "NoSigSendType";
BA_DEF_DEF_ "GenMsgCycleTime" 0;
BA_DEF_DEF_ "GenMsgDelayTime" 0;
BA_DEF_DEF_ "GenMsgStartDelayTime" 0;
BA_DEF_DEF_ "GenMsgSendType" "NoMsgSendType";
BA_DEF_DEF_ "GenMsgILSupport" "Yes";
BA_DEF_DEF_ "NmAsrMessage" "No";
BA_DEF_DEF_ "GenSigFuncType" "NoFunction";
BA_DEF_DEF_ "GenSigDataID" "";
// Frame: FLRSafetyCANFD2Frame52
BA_ "VFrameFormat" BO_ 406 14;
BA_ "GenMsgSendType" BO_ 406 0;
BA_ "GenMsgCycleTime" BO_ 406 50.000;
BA_ "GenSigStartValue" SG_ 406 FrntRdrObj18Heading 1800;
BA_ "GenSigSendType" SG_ 406 FrntRdrObj18Heading 0;
BA_ "GenSigStartValue" SG_ 406 FrntRdrObj18ObjBoxCenterLat 250;
BA_ "GenSigSendType" SG_ 406 FrntRdrObj18ObjBoxCenterLat 0;
BA_ "GenSigStartValue" SG_ 406 FrntRdrObj18ObjBoxCenterLgt 250;
BA_ "GenSigSendType" SG_ 406 FrntRdrObj18ObjBoxCenterLgt 0;
BA_ "GenSigSendType" SG_ 406 FrntRdrObj18ObservationHist 0;
BA_ "GenSigSendType" SG_ 406 FrntRdrObj18RdrObjAx 0;
BA_ "GenSigSendType" SG_ 406 FrntRdrObj18RdrObjAy 0;
BA_ "GenSigSendType" SG_ 406 FrntRdrObj18RdrObjBoxLength 0;
BA_ "GenSigSendType" SG_ 406 FrntRdrObj18RdrObjBoxWidth 0;
BA_ "GenSigSendType" SG_ 406 FrntRdrObj18RdrObjChks 0;
BA_ "GenSigFuncType" SG_ 406 FrntRdrObj18RdrObjChks 15;
BA_ "GenSigDataID" SG_ 406 FrntRdrObj18RdrObjChks "0x7E1";
BA_ "GenSigSendType" SG_ 406 FrntRdrObj18RdrObjCntr 0;
BA_ "GenSigFuncType" SG_ 406 FrntRdrObj18RdrObjCntr 16;
BA_ "GenSigStartValue" SG_ 406 FrntRdrObj18RdrObjCoastCnt 31;
BA_ "GenSigSendType" SG_ 406 FrntRdrObj18RdrObjCoastCnt 0;
BA_ "GenSigSendType" SG_ 406 FrntRdrObj18RdrObjConf 0;
BA_ "GenSigSendType" SG_ 406 FrntRdrObj18RdrObjDx 0;
BA_ "GenSigSendType" SG_ 406 FrntRdrObj18RdrObjDxStdDe 0;
BA_ "GenSigStartValue" SG_ 406 FrntRdrObj18RdrObjDy 4000;
BA_ "GenSigSendType" SG_ 406 FrntRdrObj18RdrObjDy 0;
BA_ "GenSigSendType" SG_ 406 FrntRdrObj18RdrObjDyStdDe 0;
BA_ "GenSigSendType" SG_ 406 FrntRdrObj18RdrObjElevnConf 0;
BA_ "GenSigSendType" SG_ 406 FrntRdrObj18RdrObjElevnSts 0;
BA_ "GenSigSendType" SG_ 406 FrntRdrObj18RdrObjID 0;
BA_ "GenSigSendType" SG_ 406 FrntRdrObj18RdrObjIsInFreeSpace 0;
BA_ "GenSigSendType" SG_ 406 FrntRdrObj18RdrObjMirrProblty 0;
BA_ "GenSigSendType" SG_ 406 FrntRdrObj18RdrObjMtnPat 0;
BA_ "GenSigSendType" SG_ 406 FrntRdrObj18RdrObjNotRealProblty 0;
BA_ "GenSigSendType" SG_ 406 FrntRdrObj18RdrObjStatyCnt 0;
BA_ "GenSigSendType" SG_ 406 FrntRdrObj18RdrObjTiAlv 0;
BA_ "GenSigSendType" SG_ 406 FrntRdrObj18RdrObjTrackSts 0;
BA_ "GenSigSendType" SG_ 406 FrntRdrObj18RdrObjTyp 0;
BA_ "GenSigSendType" SG_ 406 FrntRdrObj18RdrObjTypConfBike 0;
BA_ "GenSigSendType" SG_ 406 FrntRdrObj18RdrObjTypConfPed 0;
BA_ "GenSigSendType" SG_ 406 FrntRdrObj18RdrObjTypConfVeh 0;
BA_ "GenSigStartValue" SG_ 406 FrntRdrObj18RdrObjVx 6400;
BA_ "GenSigSendType" SG_ 406 FrntRdrObj18RdrObjVx 0;
BA_ "GenSigSendType" SG_ 406 FrntRdrObj18RdrObjVxStdDe 0;
BA_ "GenSigStartValue" SG_ 406 FrntRdrObj18RdrObjVy 6400;
BA_ "GenSigSendType" SG_ 406 FrntRdrObj18RdrObjVy 0;
BA_ "GenSigSendType" SG_ 406 FrntRdrObj18RdrObjVyStdDe 0;
BA_ "GenSigStartValue" SG_ 406 FrntRdrObj18RelVx 1780;
BA_ "GenSigSendType" SG_ 406 FrntRdrObj18RelVx 0;
BA_ "GenSigStartValue" SG_ 406 FrntRdrObj18RelVy 1780;
BA_ "GenSigSendType" SG_ 406 FrntRdrObj18RelVy 0;
// Frame: FLRSafetyCANFD2Frame53
BA_ "VFrameFormat" BO_ 408 14;
BA_ "GenMsgSendType" BO_ 408 0;
BA_ "GenMsgCycleTime" BO_ 408 50.000;
BA_ "GenSigStartValue" SG_ 408 FrntRdrObj19Heading 1800;
BA_ "GenSigSendType" SG_ 408 FrntRdrObj19Heading 0;
BA_ "GenSigStartValue" SG_ 408 FrntRdrObj19ObjBoxCenterLat 250;
BA_ "GenSigSendType" SG_ 408 FrntRdrObj19ObjBoxCenterLat 0;
BA_ "GenSigStartValue" SG_ 408 FrntRdrObj19ObjBoxCenterLgt 250;
BA_ "GenSigSendType" SG_ 408 FrntRdrObj19ObjBoxCenterLgt 0;
BA_ "GenSigSendType" SG_ 408 FrntRdrObj19ObservationHist 0;
BA_ "GenSigSendType" SG_ 408 FrntRdrObj19RdrObjAx 0;
BA_ "GenSigSendType" SG_ 408 FrntRdrObj19RdrObjAy 0;
BA_ "GenSigSendType" SG_ 408 FrntRdrObj19RdrObjBoxLength 0;
BA_ "GenSigSendType" SG_ 408 FrntRdrObj19RdrObjBoxWidth 0;
BA_ "GenSigSendType" SG_ 408 FrntRdrObj19RdrObjChks 0;
BA_ "GenSigFuncType" SG_ 408 FrntRdrObj19RdrObjChks 15;
BA_ "GenSigDataID" SG_ 408 FrntRdrObj19RdrObjChks "0x7E2";
BA_ "GenSigSendType" SG_ 408 FrntRdrObj19RdrObjCntr 0;
BA_ "GenSigFuncType" SG_ 408 FrntRdrObj19RdrObjCntr 16;
BA_ "GenSigStartValue" SG_ 408 FrntRdrObj19RdrObjCoastCnt 31;
BA_ "GenSigSendType" SG_ 408 FrntRdrObj19RdrObjCoastCnt 0;
BA_ "GenSigSendType" SG_ 408 FrntRdrObj19RdrObjConf 0;
BA_ "GenSigSendType" SG_ 408 FrntRdrObj19RdrObjDx 0;
BA_ "GenSigSendType" SG_ 408 FrntRdrObj19RdrObjDxStdDe 0;
BA_ "GenSigStartValue" SG_ 408 FrntRdrObj19RdrObjDy 4000;
BA_ "GenSigSendType" SG_ 408 FrntRdrObj19RdrObjDy 0;
BA_ "GenSigSendType" SG_ 408 FrntRdrObj19RdrObjDyStdDe 0;
BA_ "GenSigSendType" SG_ 408 FrntRdrObj19RdrObjElevnConf 0;
BA_ "GenSigSendType" SG_ 408 FrntRdrObj19RdrObjElevnSts 0;
BA_ "GenSigSendType" SG_ 408 FrntRdrObj19RdrObjID 0;
BA_ "GenSigSendType" SG_ 408 FrntRdrObj19RdrObjIsInFreeSpace 0;
BA_ "GenSigSendType" SG_ 408 FrntRdrObj19RdrObjMirrProblty 0;
BA_ "GenSigSendType" SG_ 408 FrntRdrObj19RdrObjMtnPat 0;
BA_ "GenSigSendType" SG_ 408 FrntRdrObj19RdrObjNotRealProblty 0;
BA_ "GenSigSendType" SG_ 408 FrntRdrObj19RdrObjStatyCnt 0;
BA_ "GenSigSendType" SG_ 408 FrntRdrObj19RdrObjTiAlv 0;
BA_ "GenSigSendType" SG_ 408 FrntRdrObj19RdrObjTrackSts 0;
BA_ "GenSigSendType" SG_ 408 FrntRdrObj19RdrObjTyp 0;
BA_ "GenSigSendType" SG_ 408 FrntRdrObj19RdrObjTypConfBike 0;
BA_ "GenSigSendType" SG_ 408 FrntRdrObj19RdrObjTypConfPed 0;
BA_ "GenSigSendType" SG_ 408 FrntRdrObj19RdrObjTypConfVeh 0;
BA_ "GenSigStartValue" SG_ 408 FrntRdrObj19RdrObjVx 6400;
BA_ "GenSigSendType" SG_ 408 FrntRdrObj19RdrObjVx 0;
BA_ "GenSigSendType" SG_ 408 FrntRdrObj19RdrObjVxStdDe 0;
BA_ "GenSigStartValue" SG_ 408 FrntRdrObj19RdrObjVy 6400;
BA_ "GenSigSendType" SG_ 408 FrntRdrObj19RdrObjVy 0;
BA_ "GenSigSendType" SG_ 408 FrntRdrObj19RdrObjVyStdDe 0;
BA_ "GenSigStartValue" SG_ 408 FrntRdrObj19RelVx 1780;
BA_ "GenSigSendType" SG_ 408 FrntRdrObj19RelVx 0;
BA_ "GenSigStartValue" SG_ 408 FrntRdrObj19RelVy 1780;
BA_ "GenSigSendType" SG_ 408 FrntRdrObj19RelVy 0;
// Frame: FLRSafetyCANFD2Frame54
BA_ "VFrameFormat" BO_ 410 14;
BA_ "GenMsgSendType" BO_ 410 0;
BA_ "GenMsgCycleTime" BO_ 410 50.000;
BA_ "GenSigStartValue" SG_ 410 FrntRdrObj20Heading 1800;
BA_ "GenSigSendType" SG_ 410 FrntRdrObj20Heading 0;
BA_ "GenSigStartValue" SG_ 410 FrntRdrObj20ObjBoxCenterLat 250;
BA_ "GenSigSendType" SG_ 410 FrntRdrObj20ObjBoxCenterLat 0;
BA_ "GenSigStartValue" SG_ 410 FrntRdrObj20ObjBoxCenterLgt 250;
BA_ "GenSigSendType" SG_ 410 FrntRdrObj20ObjBoxCenterLgt 0;
BA_ "GenSigSendType" SG_ 410 FrntRdrObj20ObservationHist 0;
BA_ "GenSigSendType" SG_ 410 FrntRdrObj20RdrObjAx 0;
BA_ "GenSigSendType" SG_ 410 FrntRdrObj20RdrObjAy 0;
BA_ "GenSigSendType" SG_ 410 FrntRdrObj20RdrObjBoxLength 0;
BA_ "GenSigSendType" SG_ 410 FrntRdrObj20RdrObjBoxWidth 0;
BA_ "GenSigSendType" SG_ 410 FrntRdrObj20RdrObjChks 0;
BA_ "GenSigFuncType" SG_ 410 FrntRdrObj20RdrObjChks 15;
BA_ "GenSigDataID" SG_ 410 FrntRdrObj20RdrObjChks "0x7E3";
BA_ "GenSigSendType" SG_ 410 FrntRdrObj20RdrObjCntr 0;
BA_ "GenSigFuncType" SG_ 410 FrntRdrObj20RdrObjCntr 16;
BA_ "GenSigStartValue" SG_ 410 FrntRdrObj20RdrObjCoastCnt 31;
BA_ "GenSigSendType" SG_ 410 FrntRdrObj20RdrObjCoastCnt 0;
BA_ "GenSigSendType" SG_ 410 FrntRdrObj20RdrObjConf 0;
BA_ "GenSigSendType" SG_ 410 FrntRdrObj20RdrObjDx 0;
BA_ "GenSigSendType" SG_ 410 FrntRdrObj20RdrObjDxStdDe 0;
BA_ "GenSigStartValue" SG_ 410 FrntRdrObj20RdrObjDy 4000;
BA_ "GenSigSendType" SG_ 410 FrntRdrObj20RdrObjDy 0;
BA_ "GenSigSendType" SG_ 410 FrntRdrObj20RdrObjDyStdDe 0;
BA_ "GenSigSendType" SG_ 410 FrntRdrObj20RdrObjElevnConf 0;
BA_ "GenSigSendType" SG_ 410 FrntRdrObj20RdrObjElevnSts 0;
BA_ "GenSigSendType" SG_ 410 FrntRdrObj20RdrObjID 0;
BA_ "GenSigSendType" SG_ 410 FrntRdrObj20RdrObjIsInFreeSpace 0;
BA_ "GenSigSendType" SG_ 410 FrntRdrObj20RdrObjMirrProblty 0;
BA_ "GenSigSendType" SG_ 410 FrntRdrObj20RdrObjMtnPat 0;
BA_ "GenSigSendType" SG_ 410 FrntRdrObj20RdrObjNotRealProblty 0;
BA_ "GenSigSendType" SG_ 410 FrntRdrObj20RdrObjStatyCnt 0;
BA_ "GenSigSendType" SG_ 410 FrntRdrObj20RdrObjTiAlv 0;
BA_ "GenSigSendType" SG_ 410 FrntRdrObj20RdrObjTrackSts 0;
BA_ "GenSigSendType" SG_ 410 FrntRdrObj20RdrObjTyp 0;
BA_ "GenSigSendType" SG_ 410 FrntRdrObj20RdrObjTypConfBike 0;
BA_ "GenSigSendType" SG_ 410 FrntRdrObj20RdrObjTypConfPed 0;
BA_ "GenSigSendType" SG_ 410 FrntRdrObj20RdrObjTypConfVeh 0;
BA_ "GenSigStartValue" SG_ 410 FrntRdrObj20RdrObjVx 6400;
BA_ "GenSigSendType" SG_ 410 FrntRdrObj20RdrObjVx 0;
BA_ "GenSigSendType" SG_ 410 FrntRdrObj20RdrObjVxStdDe 0;
BA_ "GenSigStartValue" SG_ 410 FrntRdrObj20RdrObjVy 6400;
BA_ "GenSigSendType" SG_ 410 FrntRdrObj20RdrObjVy 0;
BA_ "GenSigSendType" SG_ 410 FrntRdrObj20RdrObjVyStdDe 0;
BA_ "GenSigStartValue" SG_ 410 FrntRdrObj20RelVx 1780;
BA_ "GenSigSendType" SG_ 410 FrntRdrObj20RelVx 0;
BA_ "GenSigStartValue" SG_ 410 FrntRdrObj20RelVy 1780;
BA_ "GenSigSendType" SG_ 410 FrntRdrObj20RelVy 0;
// Frame: FLRSafetyCANFD2Frame55
BA_ "VFrameFormat" BO_ 412 14;
BA_ "GenMsgSendType" BO_ 412 0;
BA_ "GenMsgCycleTime" BO_ 412 50.000;
BA_ "GenSigStartValue" SG_ 412 FrntRdrObj21Heading 1800;
BA_ "GenSigSendType" SG_ 412 FrntRdrObj21Heading 0;
BA_ "GenSigStartValue" SG_ 412 FrntRdrObj21ObjBoxCenterLat 250;
BA_ "GenSigSendType" SG_ 412 FrntRdrObj21ObjBoxCenterLat 0;
BA_ "GenSigStartValue" SG_ 412 FrntRdrObj21ObjBoxCenterLgt 250;
BA_ "GenSigSendType" SG_ 412 FrntRdrObj21ObjBoxCenterLgt 0;
BA_ "GenSigSendType" SG_ 412 FrntRdrObj21ObservationHist 0;
BA_ "GenSigSendType" SG_ 412 FrntRdrObj21RdrObjAx 0;
BA_ "GenSigSendType" SG_ 412 FrntRdrObj21RdrObjAy 0;
BA_ "GenSigSendType" SG_ 412 FrntRdrObj21RdrObjBoxLength 0;
BA_ "GenSigSendType" SG_ 412 FrntRdrObj21RdrObjBoxWidth 0;
BA_ "GenSigSendType" SG_ 412 FrntRdrObj21RdrObjChks 0;
BA_ "GenSigFuncType" SG_ 412 FrntRdrObj21RdrObjChks 15;
BA_ "GenSigDataID" SG_ 412 FrntRdrObj21RdrObjChks "0x7E4";
BA_ "GenSigSendType" SG_ 412 FrntRdrObj21RdrObjCntr 0;
BA_ "GenSigFuncType" SG_ 412 FrntRdrObj21RdrObjCntr 16;
BA_ "GenSigStartValue" SG_ 412 FrntRdrObj21RdrObjCoastCnt 31;
BA_ "GenSigSendType" SG_ 412 FrntRdrObj21RdrObjCoastCnt 0;
BA_ "GenSigSendType" SG_ 412 FrntRdrObj21RdrObjConf 0;
BA_ "GenSigSendType" SG_ 412 FrntRdrObj21RdrObjDx 0;
BA_ "GenSigSendType" SG_ 412 FrntRdrObj21RdrObjDxStdDe 0;
BA_ "GenSigStartValue" SG_ 412 FrntRdrObj21RdrObjDy 4000;
BA_ "GenSigSendType" SG_ 412 FrntRdrObj21RdrObjDy 0;
BA_ "GenSigSendType" SG_ 412 FrntRdrObj21RdrObjDyStdDe 0;
BA_ "GenSigSendType" SG_ 412 FrntRdrObj21RdrObjElevnConf 0;
BA_ "GenSigSendType" SG_ 412 FrntRdrObj21RdrObjElevnSts 0;
BA_ "GenSigSendType" SG_ 412 FrntRdrObj21RdrObjID 0;
BA_ "GenSigSendType" SG_ 412 FrntRdrObj21RdrObjIsInFreeSpace 0;
BA_ "GenSigSendType" SG_ 412 FrntRdrObj21RdrObjMirrProblty 0;
BA_ "GenSigSendType" SG_ 412 FrntRdrObj21RdrObjMtnPat 0;
BA_ "GenSigSendType" SG_ 412 FrntRdrObj21RdrObjNotRealProblty 0;
BA_ "GenSigSendType" SG_ 412 FrntRdrObj21RdrObjStatyCnt 0;
BA_ "GenSigSendType" SG_ 412 FrntRdrObj21RdrObjTiAlv 0;
BA_ "GenSigSendType" SG_ 412 FrntRdrObj21RdrObjTrackSts 0;
BA_ "GenSigSendType" SG_ 412 FrntRdrObj21RdrObjTyp 0;
BA_ "GenSigSendType" SG_ 412 FrntRdrObj21RdrObjTypConfBike 0;
BA_ "GenSigSendType" SG_ 412 FrntRdrObj21RdrObjTypConfPed 0;
BA_ "GenSigSendType" SG_ 412 FrntRdrObj21RdrObjTypConfVeh 0;
BA_ "GenSigStartValue" SG_ 412 FrntRdrObj21RdrObjVx 6400;
BA_ "GenSigSendType" SG_ 412 FrntRdrObj21RdrObjVx 0;
BA_ "GenSigSendType" SG_ 412 FrntRdrObj21RdrObjVxStdDe 0;
BA_ "GenSigStartValue" SG_ 412 FrntRdrObj21RdrObjVy 6400;
BA_ "GenSigSendType" SG_ 412 FrntRdrObj21RdrObjVy 0;
BA_ "GenSigSendType" SG_ 412 FrntRdrObj21RdrObjVyStdDe 0;
BA_ "GenSigStartValue" SG_ 412 FrntRdrObj21RelVx 1780;
BA_ "GenSigSendType" SG_ 412 FrntRdrObj21RelVx 0;
BA_ "GenSigStartValue" SG_ 412 FrntRdrObj21RelVy 1780;
BA_ "GenSigSendType" SG_ 412 FrntRdrObj21RelVy 0;
// Frame: FLRSafetyCANFD2Frame56
BA_ "VFrameFormat" BO_ 414 14;
BA_ "GenMsgSendType" BO_ 414 0;
BA_ "GenMsgCycleTime" BO_ 414 50.000;
BA_ "GenSigStartValue" SG_ 414 FrntRdrObj22Heading 1800;
BA_ "GenSigSendType" SG_ 414 FrntRdrObj22Heading 0;
BA_ "GenSigStartValue" SG_ 414 FrntRdrObj22ObjBoxCenterLat 250;
BA_ "GenSigSendType" SG_ 414 FrntRdrObj22ObjBoxCenterLat 0;
BA_ "GenSigStartValue" SG_ 414 FrntRdrObj22ObjBoxCenterLgt 250;
BA_ "GenSigSendType" SG_ 414 FrntRdrObj22ObjBoxCenterLgt 0;
BA_ "GenSigSendType" SG_ 414 FrntRdrObj22ObservationHist 0;
BA_ "GenSigSendType" SG_ 414 FrntRdrObj22RdrObjAx 0;
BA_ "GenSigSendType" SG_ 414 FrntRdrObj22RdrObjAy 0;
BA_ "GenSigSendType" SG_ 414 FrntRdrObj22RdrObjBoxLength 0;
BA_ "GenSigSendType" SG_ 414 FrntRdrObj22RdrObjBoxWidth 0;
BA_ "GenSigSendType" SG_ 414 FrntRdrObj22RdrObjChks 0;
BA_ "GenSigFuncType" SG_ 414 FrntRdrObj22RdrObjChks 15;
BA_ "GenSigDataID" SG_ 414 FrntRdrObj22RdrObjChks "0x7E5";
BA_ "GenSigSendType" SG_ 414 FrntRdrObj22RdrObjCntr 0;
BA_ "GenSigFuncType" SG_ 414 FrntRdrObj22RdrObjCntr 16;
BA_ "GenSigStartValue" SG_ 414 FrntRdrObj22RdrObjCoastCnt 31;
BA_ "GenSigSendType" SG_ 414 FrntRdrObj22RdrObjCoastCnt 0;
BA_ "GenSigSendType" SG_ 414 FrntRdrObj22RdrObjConf 0;
BA_ "GenSigSendType" SG_ 414 FrntRdrObj22RdrObjDx 0;
BA_ "GenSigSendType" SG_ 414 FrntRdrObj22RdrObjDxStdDe 0;
BA_ "GenSigStartValue" SG_ 414 FrntRdrObj22RdrObjDy 4000;
BA_ "GenSigSendType" SG_ 414 FrntRdrObj22RdrObjDy 0;
BA_ "GenSigSendType" SG_ 414 FrntRdrObj22RdrObjDyStdDe 0;
BA_ "GenSigSendType" SG_ 414 FrntRdrObj22RdrObjElevnConf 0;
BA_ "GenSigSendType" SG_ 414 FrntRdrObj22RdrObjElevnSts 0;
BA_ "GenSigSendType" SG_ 414 FrntRdrObj22RdrObjID 0;
BA_ "GenSigSendType" SG_ 414 FrntRdrObj22RdrObjIsInFreeSpace 0;
BA_ "GenSigSendType" SG_ 414 FrntRdrObj22RdrObjMirrProblty 0;
BA_ "GenSigSendType" SG_ 414 FrntRdrObj22RdrObjMtnPat 0;
BA_ "GenSigSendType" SG_ 414 FrntRdrObj22RdrObjNotRealProblty 0;
BA_ "GenSigSendType" SG_ 414 FrntRdrObj22RdrObjStatyCnt 0;
BA_ "GenSigSendType" SG_ 414 FrntRdrObj22RdrObjTiAlv 0;
BA_ "GenSigSendType" SG_ 414 FrntRdrObj22RdrObjTrackSts 0;
BA_ "GenSigSendType" SG_ 414 FrntRdrObj22RdrObjTyp 0;
BA_ "GenSigSendType" SG_ 414 FrntRdrObj22RdrObjTypConfBike 0;
BA_ "GenSigSendType" SG_ 414 FrntRdrObj22RdrObjTypConfPed 0;
BA_ "GenSigSendType" SG_ 414 FrntRdrObj22RdrObjTypConfVeh 0;
BA_ "GenSigStartValue" SG_ 414 FrntRdrObj22RdrObjVx 6400;
BA_ "GenSigSendType" SG_ 414 FrntRdrObj22RdrObjVx 0;
BA_ "GenSigSendType" SG_ 414 FrntRdrObj22RdrObjVxStdDe 0;
BA_ "GenSigStartValue" SG_ 414 FrntRdrObj22RdrObjVy 6400;
BA_ "GenSigSendType" SG_ 414 FrntRdrObj22RdrObjVy 0;
BA_ "GenSigSendType" SG_ 414 FrntRdrObj22RdrObjVyStdDe 0;
BA_ "GenSigStartValue" SG_ 414 FrntRdrObj22RelVx 1780;
BA_ "GenSigSendType" SG_ 414 FrntRdrObj22RelVx 0;
BA_ "GenSigStartValue" SG_ 414 FrntRdrObj22RelVy 1780;
BA_ "GenSigSendType" SG_ 414 FrntRdrObj22RelVy 0;
// Frame: FLRSafetyCANFD2Frame57
BA_ "VFrameFormat" BO_ 512 14;
BA_ "GenMsgSendType" BO_ 512 0;
BA_ "GenMsgCycleTime" BO_ 512 50.000;
BA_ "GenSigStartValue" SG_ 512 FrntRdrObj23Heading 1800;
BA_ "GenSigSendType" SG_ 512 FrntRdrObj23Heading 0;
BA_ "GenSigStartValue" SG_ 512 FrntRdrObj23ObjBoxCenterLat 250;
BA_ "GenSigSendType" SG_ 512 FrntRdrObj23ObjBoxCenterLat 0;
BA_ "GenSigStartValue" SG_ 512 FrntRdrObj23ObjBoxCenterLgt 250;
BA_ "GenSigSendType" SG_ 512 FrntRdrObj23ObjBoxCenterLgt 0;
BA_ "GenSigSendType" SG_ 512 FrntRdrObj23ObservationHist 0;
BA_ "GenSigSendType" SG_ 512 FrntRdrObj23RdrObjAx 0;
BA_ "GenSigSendType" SG_ 512 FrntRdrObj23RdrObjAy 0;
BA_ "GenSigSendType" SG_ 512 FrntRdrObj23RdrObjBoxLength 0;
BA_ "GenSigSendType" SG_ 512 FrntRdrObj23RdrObjBoxWidth 0;
BA_ "GenSigSendType" SG_ 512 FrntRdrObj23RdrObjChks 0;
BA_ "GenSigFuncType" SG_ 512 FrntRdrObj23RdrObjChks 15;
BA_ "GenSigDataID" SG_ 512 FrntRdrObj23RdrObjChks "0x7E6";
BA_ "GenSigSendType" SG_ 512 FrntRdrObj23RdrObjCntr 0;
BA_ "GenSigFuncType" SG_ 512 FrntRdrObj23RdrObjCntr 16;
BA_ "GenSigStartValue" SG_ 512 FrntRdrObj23RdrObjCoastCnt 31;
BA_ "GenSigSendType" SG_ 512 FrntRdrObj23RdrObjCoastCnt 0;
BA_ "GenSigSendType" SG_ 512 FrntRdrObj23RdrObjConf 0;
BA_ "GenSigSendType" SG_ 512 FrntRdrObj23RdrObjDx 0;
BA_ "GenSigSendType" SG_ 512 FrntRdrObj23RdrObjDxStdDe 0;
BA_ "GenSigStartValue" SG_ 512 FrntRdrObj23RdrObjDy 4000;
BA_ "GenSigSendType" SG_ 512 FrntRdrObj23RdrObjDy 0;
BA_ "GenSigSendType" SG_ 512 FrntRdrObj23RdrObjDyStdDe 0;
BA_ "GenSigSendType" SG_ 512 FrntRdrObj23RdrObjElevnConf 0;
BA_ "GenSigSendType" SG_ 512 FrntRdrObj23RdrObjElevnSts 0;
BA_ "GenSigSendType" SG_ 512 FrntRdrObj23RdrObjID 0;
BA_ "GenSigSendType" SG_ 512 FrntRdrObj23RdrObjIsInFreeSpace 0;
BA_ "GenSigSendType" SG_ 512 FrntRdrObj23RdrObjMirrProblty 0;
BA_ "GenSigSendType" SG_ 512 FrntRdrObj23RdrObjMtnPat 0;
BA_ "GenSigSendType" SG_ 512 FrntRdrObj23RdrObjNotRealProblty 0;
BA_ "GenSigSendType" SG_ 512 FrntRdrObj23RdrObjStatyCnt 0;
BA_ "GenSigSendType" SG_ 512 FrntRdrObj23RdrObjTiAlv 0;
BA_ "GenSigSendType" SG_ 512 FrntRdrObj23RdrObjTrackSts 0;
BA_ "GenSigSendType" SG_ 512 FrntRdrObj23RdrObjTyp 0;
BA_ "GenSigSendType" SG_ 512 FrntRdrObj23RdrObjTypConfBike 0;
BA_ "GenSigSendType" SG_ 512 FrntRdrObj23RdrObjTypConfPed 0;
BA_ "GenSigSendType" SG_ 512 FrntRdrObj23RdrObjTypConfVeh 0;
BA_ "GenSigStartValue" SG_ 512 FrntRdrObj23RdrObjVx 6400;
BA_ "GenSigSendType" SG_ 512 FrntRdrObj23RdrObjVx 0;
BA_ "GenSigSendType" SG_ 512 FrntRdrObj23RdrObjVxStdDe 0;
BA_ "GenSigStartValue" SG_ 512 FrntRdrObj23RdrObjVy 6400;
BA_ "GenSigSendType" SG_ 512 FrntRdrObj23RdrObjVy 0;
BA_ "GenSigSendType" SG_ 512 FrntRdrObj23RdrObjVyStdDe 0;
BA_ "GenSigStartValue" SG_ 512 FrntRdrObj23RelVx 1780;
BA_ "GenSigSendType" SG_ 512 FrntRdrObj23RelVx 0;
BA_ "GenSigStartValue" SG_ 512 FrntRdrObj23RelVy 1780;
BA_ "GenSigSendType" SG_ 512 FrntRdrObj23RelVy 0;
// Frame: FLRSafetyCANFD2Frame58
BA_ "VFrameFormat" BO_ 514 14;
BA_ "GenMsgSendType" BO_ 514 0;
BA_ "GenMsgCycleTime" BO_ 514 50.000;
BA_ "GenSigStartValue" SG_ 514 FrntRdrObj24Heading 1800;
BA_ "GenSigSendType" SG_ 514 FrntRdrObj24Heading 0;
BA_ "GenSigStartValue" SG_ 514 FrntRdrObj24ObjBoxCenterLat 250;
BA_ "GenSigSendType" SG_ 514 FrntRdrObj24ObjBoxCenterLat 0;
BA_ "GenSigStartValue" SG_ 514 FrntRdrObj24ObjBoxCenterLgt 250;
BA_ "GenSigSendType" SG_ 514 FrntRdrObj24ObjBoxCenterLgt 0;
BA_ "GenSigSendType" SG_ 514 FrntRdrObj24ObservationHist 0;
BA_ "GenSigSendType" SG_ 514 FrntRdrObj24RdrObjAx 0;
BA_ "GenSigSendType" SG_ 514 FrntRdrObj24RdrObjAy 0;
BA_ "GenSigSendType" SG_ 514 FrntRdrObj24RdrObjBoxLength 0;
BA_ "GenSigSendType" SG_ 514 FrntRdrObj24RdrObjBoxWidth 0;
BA_ "GenSigSendType" SG_ 514 FrntRdrObj24RdrObjChks 0;
BA_ "GenSigFuncType" SG_ 514 FrntRdrObj24RdrObjChks 15;
BA_ "GenSigDataID" SG_ 514 FrntRdrObj24RdrObjChks "0x7E7";
BA_ "GenSigSendType" SG_ 514 FrntRdrObj24RdrObjCntr 0;
BA_ "GenSigFuncType" SG_ 514 FrntRdrObj24RdrObjCntr 16;
BA_ "GenSigStartValue" SG_ 514 FrntRdrObj24RdrObjCoastCnt 31;
BA_ "GenSigSendType" SG_ 514 FrntRdrObj24RdrObjCoastCnt 0;
BA_ "GenSigSendType" SG_ 514 FrntRdrObj24RdrObjConf 0;
BA_ "GenSigSendType" SG_ 514 FrntRdrObj24RdrObjDx 0;
BA_ "GenSigSendType" SG_ 514 FrntRdrObj24RdrObjDxStdDe 0;
BA_ "GenSigStartValue" SG_ 514 FrntRdrObj24RdrObjDy 4000;
BA_ "GenSigSendType" SG_ 514 FrntRdrObj24RdrObjDy 0;
BA_ "GenSigSendType" SG_ 514 FrntRdrObj24RdrObjDyStdDe 0;
BA_ "GenSigSendType" SG_ 514 FrntRdrObj24RdrObjElevnConf 0;
BA_ "GenSigSendType" SG_ 514 FrntRdrObj24RdrObjElevnSts 0;
BA_ "GenSigSendType" SG_ 514 FrntRdrObj24RdrObjID 0;
BA_ "GenSigSendType" SG_ 514 FrntRdrObj24RdrObjIsInFreeSpace 0;
BA_ "GenSigSendType" SG_ 514 FrntRdrObj24RdrObjMirrProblty 0;
BA_ "GenSigSendType" SG_ 514 FrntRdrObj24RdrObjMtnPat 0;
BA_ "GenSigSendType" SG_ 514 FrntRdrObj24RdrObjNotRealProblty 0;
BA_ "GenSigSendType" SG_ 514 FrntRdrObj24RdrObjStatyCnt 0;
BA_ "GenSigSendType" SG_ 514 FrntRdrObj24RdrObjTiAlv 0;
BA_ "GenSigSendType" SG_ 514 FrntRdrObj24RdrObjTrackSts 0;
BA_ "GenSigSendType" SG_ 514 FrntRdrObj24RdrObjTyp 0;
BA_ "GenSigSendType" SG_ 514 FrntRdrObj24RdrObjTypConfBike 0;
BA_ "GenSigSendType" SG_ 514 FrntRdrObj24RdrObjTypConfPed 0;
BA_ "GenSigSendType" SG_ 514 FrntRdrObj24RdrObjTypConfVeh 0;
BA_ "GenSigStartValue" SG_ 514 FrntRdrObj24RdrObjVx 6400;
BA_ "GenSigSendType" SG_ 514 FrntRdrObj24RdrObjVx 0;
BA_ "GenSigSendType" SG_ 514 FrntRdrObj24RdrObjVxStdDe 0;
BA_ "GenSigStartValue" SG_ 514 FrntRdrObj24RdrObjVy 6400;
BA_ "GenSigSendType" SG_ 514 FrntRdrObj24RdrObjVy 0;
BA_ "GenSigSendType" SG_ 514 FrntRdrObj24RdrObjVyStdDe 0;
BA_ "GenSigStartValue" SG_ 514 FrntRdrObj24RelVx 1780;
BA_ "GenSigSendType" SG_ 514 FrntRdrObj24RelVx 0;
BA_ "GenSigStartValue" SG_ 514 FrntRdrObj24RelVy 1780;
BA_ "GenSigSendType" SG_ 514 FrntRdrObj24RelVy 0;
// Frame: FLRSafetyCANFD2Frame59
BA_ "VFrameFormat" BO_ 516 14;
BA_ "GenMsgSendType" BO_ 516 0;
BA_ "GenMsgCycleTime" BO_ 516 50.000;
BA_ "GenSigStartValue" SG_ 516 FrntRdrObj25Heading 1800;
BA_ "GenSigSendType" SG_ 516 FrntRdrObj25Heading 0;
BA_ "GenSigStartValue" SG_ 516 FrntRdrObj25ObjBoxCenterLat 250;
BA_ "GenSigSendType" SG_ 516 FrntRdrObj25ObjBoxCenterLat 0;
BA_ "GenSigStartValue" SG_ 516 FrntRdrObj25ObjBoxCenterLgt 250;
BA_ "GenSigSendType" SG_ 516 FrntRdrObj25ObjBoxCenterLgt 0;
BA_ "GenSigSendType" SG_ 516 FrntRdrObj25ObservationHist 0;
BA_ "GenSigSendType" SG_ 516 FrntRdrObj25RdrObjAx 0;
BA_ "GenSigSendType" SG_ 516 FrntRdrObj25RdrObjAy 0;
BA_ "GenSigSendType" SG_ 516 FrntRdrObj25RdrObjBoxLength 0;
BA_ "GenSigSendType" SG_ 516 FrntRdrObj25RdrObjBoxWidth 0;
BA_ "GenSigSendType" SG_ 516 FrntRdrObj25RdrObjChks 0;
BA_ "GenSigFuncType" SG_ 516 FrntRdrObj25RdrObjChks 15;
BA_ "GenSigDataID" SG_ 516 FrntRdrObj25RdrObjChks "0x7E8";
BA_ "GenSigSendType" SG_ 516 FrntRdrObj25RdrObjCntr 0;
BA_ "GenSigFuncType" SG_ 516 FrntRdrObj25RdrObjCntr 16;
BA_ "GenSigStartValue" SG_ 516 FrntRdrObj25RdrObjCoastCnt 31;
BA_ "GenSigSendType" SG_ 516 FrntRdrObj25RdrObjCoastCnt 0;
BA_ "GenSigSendType" SG_ 516 FrntRdrObj25RdrObjConf 0;
BA_ "GenSigSendType" SG_ 516 FrntRdrObj25RdrObjDx 0;
BA_ "GenSigSendType" SG_ 516 FrntRdrObj25RdrObjDxStdDe 0;
BA_ "GenSigStartValue" SG_ 516 FrntRdrObj25RdrObjDy 4000;
BA_ "GenSigSendType" SG_ 516 FrntRdrObj25RdrObjDy 0;
BA_ "GenSigSendType" SG_ 516 FrntRdrObj25RdrObjDyStdDe 0;
BA_ "GenSigSendType" SG_ 516 FrntRdrObj25RdrObjElevnConf 0;
BA_ "GenSigSendType" SG_ 516 FrntRdrObj25RdrObjElevnSts 0;
BA_ "GenSigSendType" SG_ 516 FrntRdrObj25RdrObjID 0;
BA_ "GenSigSendType" SG_ 516 FrntRdrObj25RdrObjIsInFreeSpace 0;
BA_ "GenSigSendType" SG_ 516 FrntRdrObj25RdrObjMirrProblty 0;
BA_ "GenSigSendType" SG_ 516 FrntRdrObj25RdrObjMtnPat 0;
BA_ "GenSigSendType" SG_ 516 FrntRdrObj25RdrObjNotRealProblty 0;
BA_ "GenSigSendType" SG_ 516 FrntRdrObj25RdrObjStatyCnt 0;
BA_ "GenSigSendType" SG_ 516 FrntRdrObj25RdrObjTiAlv 0;
BA_ "GenSigSendType" SG_ 516 FrntRdrObj25RdrObjTrackSts 0;
BA_ "GenSigSendType" SG_ 516 FrntRdrObj25RdrObjTyp 0;
BA_ "GenSigSendType" SG_ 516 FrntRdrObj25RdrObjTypConfBike 0;
BA_ "GenSigSendType" SG_ 516 FrntRdrObj25RdrObjTypConfPed 0;
BA_ "GenSigSendType" SG_ 516 FrntRdrObj25RdrObjTypConfVeh 0;
BA_ "GenSigStartValue" SG_ 516 FrntRdrObj25RdrObjVx 6400;
BA_ "GenSigSendType" SG_ 516 FrntRdrObj25RdrObjVx 0;
BA_ "GenSigSendType" SG_ 516 FrntRdrObj25RdrObjVxStdDe 0;
BA_ "GenSigStartValue" SG_ 516 FrntRdrObj25RdrObjVy 6400;
BA_ "GenSigSendType" SG_ 516 FrntRdrObj25RdrObjVy 0;
BA_ "GenSigSendType" SG_ 516 FrntRdrObj25RdrObjVyStdDe 0;
BA_ "GenSigStartValue" SG_ 516 FrntRdrObj25RelVx 1780;
BA_ "GenSigSendType" SG_ 516 FrntRdrObj25RelVx 0;
BA_ "GenSigStartValue" SG_ 516 FrntRdrObj25RelVy 1780;
BA_ "GenSigSendType" SG_ 516 FrntRdrObj25RelVy 0;
// Frame: FLRSafetyCANFD2Frame60
BA_ "VFrameFormat" BO_ 518 14;
BA_ "GenMsgSendType" BO_ 518 0;
BA_ "GenMsgCycleTime" BO_ 518 50.000;
BA_ "GenSigStartValue" SG_ 518 FrntRdrObj26Heading 1800;
BA_ "GenSigSendType" SG_ 518 FrntRdrObj26Heading 0;
BA_ "GenSigStartValue" SG_ 518 FrntRdrObj26ObjBoxCenterLat 250;
BA_ "GenSigSendType" SG_ 518 FrntRdrObj26ObjBoxCenterLat 0;
BA_ "GenSigStartValue" SG_ 518 FrntRdrObj26ObjBoxCenterLgt 250;
BA_ "GenSigSendType" SG_ 518 FrntRdrObj26ObjBoxCenterLgt 0;
BA_ "GenSigSendType" SG_ 518 FrntRdrObj26ObservationHist 0;
BA_ "GenSigSendType" SG_ 518 FrntRdrObj26RdrObjAx 0;
BA_ "GenSigSendType" SG_ 518 FrntRdrObj26RdrObjAy 0;
BA_ "GenSigSendType" SG_ 518 FrntRdrObj26RdrObjBoxLength 0;
BA_ "GenSigSendType" SG_ 518 FrntRdrObj26RdrObjBoxWidth 0;
BA_ "GenSigSendType" SG_ 518 FrntRdrObj26RdrObjChks 0;
BA_ "GenSigFuncType" SG_ 518 FrntRdrObj26RdrObjChks 15;
BA_ "GenSigDataID" SG_ 518 FrntRdrObj26RdrObjChks "0x7E9";
BA_ "GenSigSendType" SG_ 518 FrntRdrObj26RdrObjCntr 0;
BA_ "GenSigFuncType" SG_ 518 FrntRdrObj26RdrObjCntr 16;
BA_ "GenSigStartValue" SG_ 518 FrntRdrObj26RdrObjCoastCnt 31;
BA_ "GenSigSendType" SG_ 518 FrntRdrObj26RdrObjCoastCnt 0;
BA_ "GenSigSendType" SG_ 518 FrntRdrObj26RdrObjConf 0;
BA_ "GenSigSendType" SG_ 518 FrntRdrObj26RdrObjDx 0;
BA_ "GenSigSendType" SG_ 518 FrntRdrObj26RdrObjDxStdDe 0;
BA_ "GenSigStartValue" SG_ 518 FrntRdrObj26RdrObjDy 4000;
BA_ "GenSigSendType" SG_ 518 FrntRdrObj26RdrObjDy 0;
BA_ "GenSigSendType" SG_ 518 FrntRdrObj26RdrObjDyStdDe 0;
BA_ "GenSigSendType" SG_ 518 FrntRdrObj26RdrObjElevnConf 0;
BA_ "GenSigSendType" SG_ 518 FrntRdrObj26RdrObjElevnSts 0;
BA_ "GenSigSendType" SG_ 518 FrntRdrObj26RdrObjID 0;
BA_ "GenSigSendType" SG_ 518 FrntRdrObj26RdrObjIsInFreeSpace 0;
BA_ "GenSigSendType" SG_ 518 FrntRdrObj26RdrObjMirrProblty 0;
BA_ "GenSigSendType" SG_ 518 FrntRdrObj26RdrObjMtnPat 0;
BA_ "GenSigSendType" SG_ 518 FrntRdrObj26RdrObjNotRealProblty 0;
BA_ "GenSigSendType" SG_ 518 FrntRdrObj26RdrObjStatyCnt 0;
BA_ "GenSigSendType" SG_ 518 FrntRdrObj26RdrObjTiAlv 0;
BA_ "GenSigSendType" SG_ 518 FrntRdrObj26RdrObjTrackSts 0;
BA_ "GenSigSendType" SG_ 518 FrntRdrObj26RdrObjTyp 0;
BA_ "GenSigSendType" SG_ 518 FrntRdrObj26RdrObjTypConfBike 0;
BA_ "GenSigSendType" SG_ 518 FrntRdrObj26RdrObjTypConfPed 0;
BA_ "GenSigSendType" SG_ 518 FrntRdrObj26RdrObjTypConfVeh 0;
BA_ "GenSigStartValue" SG_ 518 FrntRdrObj26RdrObjVx 6400;
BA_ "GenSigSendType" SG_ 518 FrntRdrObj26RdrObjVx 0;
BA_ "GenSigSendType" SG_ 518 FrntRdrObj26RdrObjVxStdDe 0;
BA_ "GenSigStartValue" SG_ 518 FrntRdrObj26RdrObjVy 6400;
BA_ "GenSigSendType" SG_ 518 FrntRdrObj26RdrObjVy 0;
BA_ "GenSigSendType" SG_ 518 FrntRdrObj26RdrObjVyStdDe 0;
BA_ "GenSigStartValue" SG_ 518 FrntRdrObj26RelVx 1780;
BA_ "GenSigSendType" SG_ 518 FrntRdrObj26RelVx 0;
BA_ "GenSigStartValue" SG_ 518 FrntRdrObj26RelVy 1780;
BA_ "GenSigSendType" SG_ 518 FrntRdrObj26RelVy 0;
// Frame: FLRSafetyCANFD2Frame61
BA_ "VFrameFormat" BO_ 520 14;
BA_ "GenMsgSendType" BO_ 520 0;
BA_ "GenMsgCycleTime" BO_ 520 50.000;
BA_ "GenSigStartValue" SG_ 520 FrntRdrObj27Heading 1800;
BA_ "GenSigSendType" SG_ 520 FrntRdrObj27Heading 0;
BA_ "GenSigStartValue" SG_ 520 FrntRdrObj27ObjBoxCenterLat 250;
BA_ "GenSigSendType" SG_ 520 FrntRdrObj27ObjBoxCenterLat 0;
BA_ "GenSigStartValue" SG_ 520 FrntRdrObj27ObjBoxCenterLgt 250;
BA_ "GenSigSendType" SG_ 520 FrntRdrObj27ObjBoxCenterLgt 0;
BA_ "GenSigSendType" SG_ 520 FrntRdrObj27ObservationHist 0;
BA_ "GenSigSendType" SG_ 520 FrntRdrObj27RdrObjAx 0;
BA_ "GenSigSendType" SG_ 520 FrntRdrObj27RdrObjAy 0;
BA_ "GenSigSendType" SG_ 520 FrntRdrObj27RdrObjBoxLength 0;
BA_ "GenSigSendType" SG_ 520 FrntRdrObj27RdrObjBoxWidth 0;
BA_ "GenSigSendType" SG_ 520 FrntRdrObj27RdrObjChks 0;
BA_ "GenSigFuncType" SG_ 520 FrntRdrObj27RdrObjChks 15;
BA_ "GenSigDataID" SG_ 520 FrntRdrObj27RdrObjChks "0x7EA";
BA_ "GenSigSendType" SG_ 520 FrntRdrObj27RdrObjCntr 0;
BA_ "GenSigFuncType" SG_ 520 FrntRdrObj27RdrObjCntr 16;
BA_ "GenSigStartValue" SG_ 520 FrntRdrObj27RdrObjCoastCnt 31;
BA_ "GenSigSendType" SG_ 520 FrntRdrObj27RdrObjCoastCnt 0;
BA_ "GenSigSendType" SG_ 520 FrntRdrObj27RdrObjConf 0;
BA_ "GenSigSendType" SG_ 520 FrntRdrObj27RdrObjDx 0;
BA_ "GenSigSendType" SG_ 520 FrntRdrObj27RdrObjDxStdDe 0;
BA_ "GenSigStartValue" SG_ 520 FrntRdrObj27RdrObjDy 4000;
BA_ "GenSigSendType" SG_ 520 FrntRdrObj27RdrObjDy 0;
BA_ "GenSigSendType" SG_ 520 FrntRdrObj27RdrObjDyStdDe 0;
BA_ "GenSigSendType" SG_ 520 FrntRdrObj27RdrObjElevnConf 0;
BA_ "GenSigSendType" SG_ 520 FrntRdrObj27RdrObjElevnSts 0;
BA_ "GenSigSendType" SG_ 520 FrntRdrObj27RdrObjID 0;
BA_ "GenSigSendType" SG_ 520 FrntRdrObj27RdrObjIsInFreeSpace 0;
BA_ "GenSigSendType" SG_ 520 FrntRdrObj27RdrObjMirrProblty 0;
BA_ "GenSigSendType" SG_ 520 FrntRdrObj27RdrObjMtnPat 0;
BA_ "GenSigSendType" SG_ 520 FrntRdrObj27RdrObjNotRealProblty 0;
BA_ "GenSigSendType" SG_ 520 FrntRdrObj27RdrObjStatyCnt 0;
BA_ "GenSigSendType" SG_ 520 FrntRdrObj27RdrObjTiAlv 0;
BA_ "GenSigSendType" SG_ 520 FrntRdrObj27RdrObjTrackSts 0;
BA_ "GenSigSendType" SG_ 520 FrntRdrObj27RdrObjTyp 0;
BA_ "GenSigSendType" SG_ 520 FrntRdrObj27RdrObjTypConfBike 0;
BA_ "GenSigSendType" SG_ 520 FrntRdrObj27RdrObjTypConfPed 0;
BA_ "GenSigSendType" SG_ 520 FrntRdrObj27RdrObjTypConfVeh 0;
BA_ "GenSigStartValue" SG_ 520 FrntRdrObj27RdrObjVx 6400;
BA_ "GenSigSendType" SG_ 520 FrntRdrObj27RdrObjVx 0;
BA_ "GenSigSendType" SG_ 520 FrntRdrObj27RdrObjVxStdDe 0;
BA_ "GenSigStartValue" SG_ 520 FrntRdrObj27RdrObjVy 6400;
BA_ "GenSigSendType" SG_ 520 FrntRdrObj27RdrObjVy 0;
BA_ "GenSigSendType" SG_ 520 FrntRdrObj27RdrObjVyStdDe 0;
BA_ "GenSigStartValue" SG_ 520 FrntRdrObj27RelVx 1780;
BA_ "GenSigSendType" SG_ 520 FrntRdrObj27RelVx 0;
BA_ "GenSigStartValue" SG_ 520 FrntRdrObj27RelVy 1780;
BA_ "GenSigSendType" SG_ 520 FrntRdrObj27RelVy 0;
// Frame: FLRSafetyCANFD2Frame62
BA_ "VFrameFormat" BO_ 522 14;
BA_ "GenMsgSendType" BO_ 522 0;
BA_ "GenMsgCycleTime" BO_ 522 50.000;
BA_ "GenSigStartValue" SG_ 522 FrntRdrObj28Heading 1800;
BA_ "GenSigSendType" SG_ 522 FrntRdrObj28Heading 0;
BA_ "GenSigStartValue" SG_ 522 FrntRdrObj28ObjBoxCenterLat 250;
BA_ "GenSigSendType" SG_ 522 FrntRdrObj28ObjBoxCenterLat 0;
BA_ "GenSigStartValue" SG_ 522 FrntRdrObj28ObjBoxCenterLgt 250;
BA_ "GenSigSendType" SG_ 522 FrntRdrObj28ObjBoxCenterLgt 0;
BA_ "GenSigSendType" SG_ 522 FrntRdrObj28ObservationHist 0;
BA_ "GenSigSendType" SG_ 522 FrntRdrObj28RdrObjAx 0;
BA_ "GenSigSendType" SG_ 522 FrntRdrObj28RdrObjAy 0;
BA_ "GenSigSendType" SG_ 522 FrntRdrObj28RdrObjBoxLength 0;
BA_ "GenSigSendType" SG_ 522 FrntRdrObj28RdrObjBoxWidth 0;
BA_ "GenSigSendType" SG_ 522 FrntRdrObj28RdrObjChks 0;
BA_ "GenSigFuncType" SG_ 522 FrntRdrObj28RdrObjChks 15;
BA_ "GenSigDataID" SG_ 522 FrntRdrObj28RdrObjChks "0x7EB";
BA_ "GenSigSendType" SG_ 522 FrntRdrObj28RdrObjCntr 0;
BA_ "GenSigFuncType" SG_ 522 FrntRdrObj28RdrObjCntr 16;
BA_ "GenSigStartValue" SG_ 522 FrntRdrObj28RdrObjCoastCnt 31;
BA_ "GenSigSendType" SG_ 522 FrntRdrObj28RdrObjCoastCnt 0;
BA_ "GenSigSendType" SG_ 522 FrntRdrObj28RdrObjConf 0;
BA_ "GenSigSendType" SG_ 522 FrntRdrObj28RdrObjDx 0;
BA_ "GenSigSendType" SG_ 522 FrntRdrObj28RdrObjDxStdDe 0;
BA_ "GenSigStartValue" SG_ 522 FrntRdrObj28RdrObjDy 4000;
BA_ "GenSigSendType" SG_ 522 FrntRdrObj28RdrObjDy 0;
BA_ "GenSigSendType" SG_ 522 FrntRdrObj28RdrObjDyStdDe 0;
BA_ "GenSigSendType" SG_ 522 FrntRdrObj28RdrObjElevnConf 0;
BA_ "GenSigSendType" SG_ 522 FrntRdrObj28RdrObjElevnSts 0;
BA_ "GenSigSendType" SG_ 522 FrntRdrObj28RdrObjID 0;
BA_ "GenSigSendType" SG_ 522 FrntRdrObj28RdrObjIsInFreeSpace 0;
BA_ "GenSigSendType" SG_ 522 FrntRdrObj28RdrObjMirrProblty 0;
BA_ "GenSigSendType" SG_ 522 FrntRdrObj28RdrObjMtnPat 0;
BA_ "GenSigSendType" SG_ 522 FrntRdrObj28RdrObjNotRealProblty 0;
BA_ "GenSigSendType" SG_ 522 FrntRdrObj28RdrObjStatyCnt 0;
BA_ "GenSigSendType" SG_ 522 FrntRdrObj28RdrObjTiAlv 0;
BA_ "GenSigSendType" SG_ 522 FrntRdrObj28RdrObjTrackSts 0;
BA_ "GenSigSendType" SG_ 522 FrntRdrObj28RdrObjTyp 0;
BA_ "GenSigSendType" SG_ 522 FrntRdrObj28RdrObjTypConfBike 0;
BA_ "GenSigSendType" SG_ 522 FrntRdrObj28RdrObjTypConfPed 0;
BA_ "GenSigSendType" SG_ 522 FrntRdrObj28RdrObjTypConfVeh 0;
BA_ "GenSigStartValue" SG_ 522 FrntRdrObj28RdrObjVx 6400;
BA_ "GenSigSendType" SG_ 522 FrntRdrObj28RdrObjVx 0;
BA_ "GenSigSendType" SG_ 522 FrntRdrObj28RdrObjVxStdDe 0;
BA_ "GenSigStartValue" SG_ 522 FrntRdrObj28RdrObjVy 6400;
BA_ "GenSigSendType" SG_ 522 FrntRdrObj28RdrObjVy 0;
BA_ "GenSigSendType" SG_ 522 FrntRdrObj28RdrObjVyStdDe 0;
BA_ "GenSigStartValue" SG_ 522 FrntRdrObj28RelVx 1780;
BA_ "GenSigSendType" SG_ 522 FrntRdrObj28RelVx 0;
BA_ "GenSigStartValue" SG_ 522 FrntRdrObj28RelVy 1780;
BA_ "GenSigSendType" SG_ 522 FrntRdrObj28RelVy 0;
// Frame: FLRSafetyCANFD2Frame63
BA_ "VFrameFormat" BO_ 524 14;
BA_ "GenMsgSendType" BO_ 524 0;
BA_ "GenMsgCycleTime" BO_ 524 50.000;
BA_ "GenSigStartValue" SG_ 524 FrntRdrObj29Heading 1800;
BA_ "GenSigSendType" SG_ 524 FrntRdrObj29Heading 0;
BA_ "GenSigStartValue" SG_ 524 FrntRdrObj29ObjBoxCenterLat 250;
BA_ "GenSigSendType" SG_ 524 FrntRdrObj29ObjBoxCenterLat 0;
BA_ "GenSigStartValue" SG_ 524 FrntRdrObj29ObjBoxCenterLgt 250;
BA_ "GenSigSendType" SG_ 524 FrntRdrObj29ObjBoxCenterLgt 0;
BA_ "GenSigSendType" SG_ 524 FrntRdrObj29ObservationHist 0;
BA_ "GenSigSendType" SG_ 524 FrntRdrObj29RdrObjAx 0;
BA_ "GenSigSendType" SG_ 524 FrntRdrObj29RdrObjAy 0;
BA_ "GenSigSendType" SG_ 524 FrntRdrObj29RdrObjBoxLength 0;
BA_ "GenSigSendType" SG_ 524 FrntRdrObj29RdrObjBoxWidth 0;
BA_ "GenSigSendType" SG_ 524 FrntRdrObj29RdrObjChks 0;
BA_ "GenSigFuncType" SG_ 524 FrntRdrObj29RdrObjChks 15;
BA_ "GenSigDataID" SG_ 524 FrntRdrObj29RdrObjChks "0x7EC";
BA_ "GenSigSendType" SG_ 524 FrntRdrObj29RdrObjCntr 0;
BA_ "GenSigFuncType" SG_ 524 FrntRdrObj29RdrObjCntr 16;
BA_ "GenSigStartValue" SG_ 524 FrntRdrObj29RdrObjCoastCnt 31;
BA_ "GenSigSendType" SG_ 524 FrntRdrObj29RdrObjCoastCnt 0;
BA_ "GenSigSendType" SG_ 524 FrntRdrObj29RdrObjConf 0;
BA_ "GenSigSendType" SG_ 524 FrntRdrObj29RdrObjDx 0;
BA_ "GenSigSendType" SG_ 524 FrntRdrObj29RdrObjDxStdDe 0;
BA_ "GenSigStartValue" SG_ 524 FrntRdrObj29RdrObjDy 4000;
BA_ "GenSigSendType" SG_ 524 FrntRdrObj29RdrObjDy 0;
BA_ "GenSigSendType" SG_ 524 FrntRdrObj29RdrObjDyStdDe 0;
BA_ "GenSigSendType" SG_ 524 FrntRdrObj29RdrObjElevnConf 0;
BA_ "GenSigSendType" SG_ 524 FrntRdrObj29RdrObjElevnSts 0;
BA_ "GenSigSendType" SG_ 524 FrntRdrObj29RdrObjID 0;
BA_ "GenSigSendType" SG_ 524 FrntRdrObj29RdrObjIsInFreeSpace 0;
BA_ "GenSigSendType" SG_ 524 FrntRdrObj29RdrObjMirrProblty 0;
BA_ "GenSigSendType" SG_ 524 FrntRdrObj29RdrObjMtnPat 0;
BA_ "GenSigSendType" SG_ 524 FrntRdrObj29RdrObjNotRealProblty 0;
BA_ "GenSigSendType" SG_ 524 FrntRdrObj29RdrObjStatyCnt 0;
BA_ "GenSigSendType" SG_ 524 FrntRdrObj29RdrObjTiAlv 0;
BA_ "GenSigSendType" SG_ 524 FrntRdrObj29RdrObjTrackSts 0;
BA_ "GenSigSendType" SG_ 524 FrntRdrObj29RdrObjTyp 0;
BA_ "GenSigSendType" SG_ 524 FrntRdrObj29RdrObjTypConfBike 0;
BA_ "GenSigSendType" SG_ 524 FrntRdrObj29RdrObjTypConfPed 0;
BA_ "GenSigSendType" SG_ 524 FrntRdrObj29RdrObjTypConfVeh 0;
BA_ "GenSigStartValue" SG_ 524 FrntRdrObj29RdrObjVx 6400;
BA_ "GenSigSendType" SG_ 524 FrntRdrObj29RdrObjVx 0;
BA_ "GenSigSendType" SG_ 524 FrntRdrObj29RdrObjVxStdDe 0;
BA_ "GenSigStartValue" SG_ 524 FrntRdrObj29RdrObjVy 6400;
BA_ "GenSigSendType" SG_ 524 FrntRdrObj29RdrObjVy 0;
BA_ "GenSigSendType" SG_ 524 FrntRdrObj29RdrObjVyStdDe 0;
BA_ "GenSigStartValue" SG_ 524 FrntRdrObj29RelVx 1780;
BA_ "GenSigSendType" SG_ 524 FrntRdrObj29RelVx 0;
BA_ "GenSigStartValue" SG_ 524 FrntRdrObj29RelVy 1780;
BA_ "GenSigSendType" SG_ 524 FrntRdrObj29RelVy 0;
// Frame: FLRSafetyCANFD2Frame64
BA_ "VFrameFormat" BO_ 526 14;
BA_ "GenMsgSendType" BO_ 526 0;
BA_ "GenMsgCycleTime" BO_ 526 50.000;
BA_ "GenSigStartValue" SG_ 526 FrntRdrObj30Heading 1800;
BA_ "GenSigSendType" SG_ 526 FrntRdrObj30Heading 0;
BA_ "GenSigStartValue" SG_ 526 FrntRdrObj30ObjBoxCenterLat 250;
BA_ "GenSigSendType" SG_ 526 FrntRdrObj30ObjBoxCenterLat 0;
BA_ "GenSigStartValue" SG_ 526 FrntRdrObj30ObjBoxCenterLgt 250;
BA_ "GenSigSendType" SG_ 526 FrntRdrObj30ObjBoxCenterLgt 0;
BA_ "GenSigSendType" SG_ 526 FrntRdrObj30ObservationHist 0;
BA_ "GenSigSendType" SG_ 526 FrntRdrObj30RdrObjAx 0;
BA_ "GenSigSendType" SG_ 526 FrntRdrObj30RdrObjAy 0;
BA_ "GenSigSendType" SG_ 526 FrntRdrObj30RdrObjBoxLength 0;
BA_ "GenSigSendType" SG_ 526 FrntRdrObj30RdrObjBoxWidth 0;
BA_ "GenSigSendType" SG_ 526 FrntRdrObj30RdrObjChks 0;
BA_ "GenSigFuncType" SG_ 526 FrntRdrObj30RdrObjChks 15;
BA_ "GenSigDataID" SG_ 526 FrntRdrObj30RdrObjChks "0x7ED";
BA_ "GenSigSendType" SG_ 526 FrntRdrObj30RdrObjCntr 0;
BA_ "GenSigFuncType" SG_ 526 FrntRdrObj30RdrObjCntr 16;
BA_ "GenSigStartValue" SG_ 526 FrntRdrObj30RdrObjCoastCnt 31;
BA_ "GenSigSendType" SG_ 526 FrntRdrObj30RdrObjCoastCnt 0;
BA_ "GenSigSendType" SG_ 526 FrntRdrObj30RdrObjConf 0;
BA_ "GenSigSendType" SG_ 526 FrntRdrObj30RdrObjDx 0;
BA_ "GenSigSendType" SG_ 526 FrntRdrObj30RdrObjDxStdDe 0;
BA_ "GenSigStartValue" SG_ 526 FrntRdrObj30RdrObjDy 4000;
BA_ "GenSigSendType" SG_ 526 FrntRdrObj30RdrObjDy 0;
BA_ "GenSigSendType" SG_ 526 FrntRdrObj30RdrObjDyStdDe 0;
BA_ "GenSigSendType" SG_ 526 FrntRdrObj30RdrObjElevnConf 0;
BA_ "GenSigSendType" SG_ 526 FrntRdrObj30RdrObjElevnSts 0;
BA_ "GenSigSendType" SG_ 526 FrntRdrObj30RdrObjID 0;
BA_ "GenSigSendType" SG_ 526 FrntRdrObj30RdrObjIsInFreeSpace 0;
BA_ "GenSigSendType" SG_ 526 FrntRdrObj30RdrObjMirrProblty 0;
BA_ "GenSigSendType" SG_ 526 FrntRdrObj30RdrObjMtnPat 0;
BA_ "GenSigSendType" SG_ 526 FrntRdrObj30RdrObjNotRealProblty 0;
BA_ "GenSigSendType" SG_ 526 FrntRdrObj30RdrObjStatyCnt 0;
BA_ "GenSigSendType" SG_ 526 FrntRdrObj30RdrObjTiAlv 0;
BA_ "GenSigSendType" SG_ 526 FrntRdrObj30RdrObjTrackSts 0;
BA_ "GenSigSendType" SG_ 526 FrntRdrObj30RdrObjTyp 0;
BA_ "GenSigSendType" SG_ 526 FrntRdrObj30RdrObjTypConfBike 0;
BA_ "GenSigSendType" SG_ 526 FrntRdrObj30RdrObjTypConfPed 0;
BA_ "GenSigSendType" SG_ 526 FrntRdrObj30RdrObjTypConfVeh 0;
BA_ "GenSigStartValue" SG_ 526 FrntRdrObj30RdrObjVx 6400;
BA_ "GenSigSendType" SG_ 526 FrntRdrObj30RdrObjVx 0;
BA_ "GenSigSendType" SG_ 526 FrntRdrObj30RdrObjVxStdDe 0;
BA_ "GenSigStartValue" SG_ 526 FrntRdrObj30RdrObjVy 6400;
BA_ "GenSigSendType" SG_ 526 FrntRdrObj30RdrObjVy 0;
BA_ "GenSigSendType" SG_ 526 FrntRdrObj30RdrObjVyStdDe 0;
BA_ "GenSigStartValue" SG_ 526 FrntRdrObj30RelVx 1780;
BA_ "GenSigSendType" SG_ 526 FrntRdrObj30RelVx 0;
BA_ "GenSigStartValue" SG_ 526 FrntRdrObj30RelVy 1780;
BA_ "GenSigSendType" SG_ 526 FrntRdrObj30RelVy 0;
// Frame: FlrSafetyCanFD2NmFr
BA_ "VFrameFormat" BO_ 1282 0;
BA_ "GenMsgSendType" BO_ 1282 1;
BA_ "GenMsgDelayTime" BO_ 1282 20.000;
BA_ "GenMsgILSupport" BO_ 1282 0;
BA_ "NmAsrMessage" BO_ 1282 1;
// Frame: FlrToAsdmSafetyCanFD2DiagResFrame1
BA_ "VFrameFormat" BO_ 1604 14;
BA_ "GenMsgSendType" BO_ 1604 1;
BA_ "GenMsgDelayTime" BO_ 1604 5.000;
// Frame: FlrToEtcXcpFr01
BA_ "VFrameFormat" BO_ 1409 0;
BA_ "GenMsgSendType" BO_ 1409 1;
BA_ "GenMsgDelayTime" BO_ 1409 5.000;
VAL_ 406 FrntRdrObj18RdrObjElevnSts 0 "RdrObjElevnSts_Unknown" 1 "RdrObjElevnSts_OverRidable" 2 "RdrObjElevnSts_Rlv" 3 "RdrObjElevnSts_UnderRidable";
VAL_ 406 FrntRdrObj18RdrObjIsInFreeSpace 0 "YesNo2_No" 1 "YesNo2_Yes";
VAL_ 406 FrntRdrObj18RdrObjMtnPat 0 "RdrObjMtnPat_Ukwn" 1 "RdrObjMtnPat_Staty" 2 "RdrObjMtnPat_StatyFromMovg" 3 "RdrObjMtnPat_Movg" 4 "RdrObjMtnPat_Receding" 5 "RdrObjMtnPat_Oncoming" 6 "RdrObjMtnPat_CrossingFromLe" 7 "RdrObjMtnPat_CrossingFromRi";
VAL_ 406 FrntRdrObj18RdrObjTrackSts 0 "RdrObjTrackSts_Invld" 1 "RdrObjTrackSts_Updated" 2 "RdrObjTrackSts_New" 3 "RdrObjTrackSts_Coasted";
VAL_ 406 FrntRdrObj18RdrObjTyp 0 "RdrObjTyp_Ukwn" 1 "RdrObjTyp_Car" 2 "RdrObjTyp_MotorCycle" 3 "RdrObjTyp_Truck" 4 "RdrObjTyp_Ped" 5 "RdrObjTyp_ObstdVert1" 6 "RdrObjTyp_ObstdVert2" 7 "RdrObjTyp_Anim" 8 "RdrObjTyp_ObjGen" 9 "RdrObjTyp_Bicycle" 10 "RdrObjTyp_VehofUkwnClass" 11 "RdrObjTyp_Reserved";
VAL_ 408 FrntRdrObj19RdrObjElevnSts 0 "RdrObjElevnSts_Unknown" 1 "RdrObjElevnSts_OverRidable" 2 "RdrObjElevnSts_Rlv" 3 "RdrObjElevnSts_UnderRidable";
VAL_ 408 FrntRdrObj19RdrObjIsInFreeSpace 0 "YesNo2_No" 1 "YesNo2_Yes";
VAL_ 408 FrntRdrObj19RdrObjMtnPat 0 "RdrObjMtnPat_Ukwn" 1 "RdrObjMtnPat_Staty" 2 "RdrObjMtnPat_StatyFromMovg" 3 "RdrObjMtnPat_Movg" 4 "RdrObjMtnPat_Receding" 5 "RdrObjMtnPat_Oncoming" 6 "RdrObjMtnPat_CrossingFromLe" 7 "RdrObjMtnPat_CrossingFromRi";
VAL_ 408 FrntRdrObj19RdrObjTrackSts 0 "RdrObjTrackSts_Invld" 1 "RdrObjTrackSts_Updated" 2 "RdrObjTrackSts_New" 3 "RdrObjTrackSts_Coasted";
VAL_ 408 FrntRdrObj19RdrObjTyp 0 "RdrObjTyp_Ukwn" 1 "RdrObjTyp_Car" 2 "RdrObjTyp_MotorCycle" 3 "RdrObjTyp_Truck" 4 "RdrObjTyp_Ped" 5 "RdrObjTyp_ObstdVert1" 6 "RdrObjTyp_ObstdVert2" 7 "RdrObjTyp_Anim" 8 "RdrObjTyp_ObjGen" 9 "RdrObjTyp_Bicycle" 10 "RdrObjTyp_VehofUkwnClass" 11 "RdrObjTyp_Reserved";
VAL_ 410 FrntRdrObj20RdrObjElevnSts 0 "RdrObjElevnSts_Unknown" 1 "RdrObjElevnSts_OverRidable" 2 "RdrObjElevnSts_Rlv" 3 "RdrObjElevnSts_UnderRidable";
VAL_ 410 FrntRdrObj20RdrObjIsInFreeSpace 0 "YesNo2_No" 1 "YesNo2_Yes";
VAL_ 410 FrntRdrObj20RdrObjMtnPat 0 "RdrObjMtnPat_Ukwn" 1 "RdrObjMtnPat_Staty" 2 "RdrObjMtnPat_StatyFromMovg" 3 "RdrObjMtnPat_Movg" 4 "RdrObjMtnPat_Receding" 5 "RdrObjMtnPat_Oncoming" 6 "RdrObjMtnPat_CrossingFromLe" 7 "RdrObjMtnPat_CrossingFromRi";
VAL_ 410 FrntRdrObj20RdrObjTrackSts 0 "RdrObjTrackSts_Invld" 1 "RdrObjTrackSts_Updated" 2 "RdrObjTrackSts_New" 3 "RdrObjTrackSts_Coasted";
VAL_ 410 FrntRdrObj20RdrObjTyp 0 "RdrObjTyp_Ukwn" 1 "RdrObjTyp_Car" 2 "RdrObjTyp_MotorCycle" 3 "RdrObjTyp_Truck" 4 "RdrObjTyp_Ped" 5 "RdrObjTyp_ObstdVert1" 6 "RdrObjTyp_ObstdVert2" 7 "RdrObjTyp_Anim" 8 "RdrObjTyp_ObjGen" 9 "RdrObjTyp_Bicycle" 10 "RdrObjTyp_VehofUkwnClass" 11 "RdrObjTyp_Reserved";
VAL_ 412 FrntRdrObj21RdrObjElevnSts 0 "RdrObjElevnSts_Unknown" 1 "RdrObjElevnSts_OverRidable" 2 "RdrObjElevnSts_Rlv" 3 "RdrObjElevnSts_UnderRidable";
VAL_ 412 FrntRdrObj21RdrObjIsInFreeSpace 0 "YesNo2_No" 1 "YesNo2_Yes";
VAL_ 412 FrntRdrObj21RdrObjMtnPat 0 "RdrObjMtnPat_Ukwn" 1 "RdrObjMtnPat_Staty" 2 "RdrObjMtnPat_StatyFromMovg" 3 "RdrObjMtnPat_Movg" 4 "RdrObjMtnPat_Receding" 5 "RdrObjMtnPat_Oncoming" 6 "RdrObjMtnPat_CrossingFromLe" 7 "RdrObjMtnPat_CrossingFromRi";
VAL_ 412 FrntRdrObj21RdrObjTrackSts 0 "RdrObjTrackSts_Invld" 1 "RdrObjTrackSts_Updated" 2 "RdrObjTrackSts_New" 3 "RdrObjTrackSts_Coasted";
VAL_ 412 FrntRdrObj21RdrObjTyp 0 "RdrObjTyp_Ukwn" 1 "RdrObjTyp_Car" 2 "RdrObjTyp_MotorCycle" 3 "RdrObjTyp_Truck" 4 "RdrObjTyp_Ped" 5 "RdrObjTyp_ObstdVert1" 6 "RdrObjTyp_ObstdVert2" 7 "RdrObjTyp_Anim" 8 "RdrObjTyp_ObjGen" 9 "RdrObjTyp_Bicycle" 10 "RdrObjTyp_VehofUkwnClass" 11 "RdrObjTyp_Reserved";
VAL_ 414 FrntRdrObj22RdrObjElevnSts 0 "RdrObjElevnSts_Unknown" 1 "RdrObjElevnSts_OverRidable" 2 "RdrObjElevnSts_Rlv" 3 "RdrObjElevnSts_UnderRidable";
VAL_ 414 FrntRdrObj22RdrObjIsInFreeSpace 0 "YesNo2_No" 1 "YesNo2_Yes";
VAL_ 414 FrntRdrObj22RdrObjMtnPat 0 "RdrObjMtnPat_Ukwn" 1 "RdrObjMtnPat_Staty" 2 "RdrObjMtnPat_StatyFromMovg" 3 "RdrObjMtnPat_Movg" 4 "RdrObjMtnPat_Receding" 5 "RdrObjMtnPat_Oncoming" 6 "RdrObjMtnPat_CrossingFromLe" 7 "RdrObjMtnPat_CrossingFromRi";
VAL_ 414 FrntRdrObj22RdrObjTrackSts 0 "RdrObjTrackSts_Invld" 1 "RdrObjTrackSts_Updated" 2 "RdrObjTrackSts_New" 3 "RdrObjTrackSts_Coasted";
VAL_ 414 FrntRdrObj22RdrObjTyp 0 "RdrObjTyp_Ukwn" 1 "RdrObjTyp_Car" 2 "RdrObjTyp_MotorCycle" 3 "RdrObjTyp_Truck" 4 "RdrObjTyp_Ped" 5 "RdrObjTyp_ObstdVert1" 6 "RdrObjTyp_ObstdVert2" 7 "RdrObjTyp_Anim" 8 "RdrObjTyp_ObjGen" 9 "RdrObjTyp_Bicycle" 10 "RdrObjTyp_VehofUkwnClass" 11 "RdrObjTyp_Reserved";
VAL_ 512 FrntRdrObj23RdrObjElevnSts 0 "RdrObjElevnSts_Unknown" 1 "RdrObjElevnSts_OverRidable" 2 "RdrObjElevnSts_Rlv" 3 "RdrObjElevnSts_UnderRidable";
VAL_ 512 FrntRdrObj23RdrObjIsInFreeSpace 0 "YesNo2_No" 1 "YesNo2_Yes";
VAL_ 512 FrntRdrObj23RdrObjMtnPat 0 "RdrObjMtnPat_Ukwn" 1 "RdrObjMtnPat_Staty" 2 "RdrObjMtnPat_StatyFromMovg" 3 "RdrObjMtnPat_Movg" 4 "RdrObjMtnPat_Receding" 5 "RdrObjMtnPat_Oncoming" 6 "RdrObjMtnPat_CrossingFromLe" 7 "RdrObjMtnPat_CrossingFromRi";
VAL_ 512 FrntRdrObj23RdrObjTrackSts 0 "RdrObjTrackSts_Invld" 1 "RdrObjTrackSts_Updated" 2 "RdrObjTrackSts_New" 3 "RdrObjTrackSts_Coasted";
VAL_ 512 FrntRdrObj23RdrObjTyp 0 "RdrObjTyp_Ukwn" 1 "RdrObjTyp_Car" 2 "RdrObjTyp_MotorCycle" 3 "RdrObjTyp_Truck" 4 "RdrObjTyp_Ped" 5 "RdrObjTyp_ObstdVert1" 6 "RdrObjTyp_ObstdVert2" 7 "RdrObjTyp_Anim" 8 "RdrObjTyp_ObjGen" 9 "RdrObjTyp_Bicycle" 10 "RdrObjTyp_VehofUkwnClass" 11 "RdrObjTyp_Reserved";
VAL_ 514 FrntRdrObj24RdrObjElevnSts 0 "RdrObjElevnSts_Unknown" 1 "RdrObjElevnSts_OverRidable" 2 "RdrObjElevnSts_Rlv" 3 "RdrObjElevnSts_UnderRidable";
VAL_ 514 FrntRdrObj24RdrObjIsInFreeSpace 0 "YesNo2_No" 1 "YesNo2_Yes";
VAL_ 514 FrntRdrObj24RdrObjMtnPat 0 "RdrObjMtnPat_Ukwn" 1 "RdrObjMtnPat_Staty" 2 "RdrObjMtnPat_StatyFromMovg" 3 "RdrObjMtnPat_Movg" 4 "RdrObjMtnPat_Receding" 5 "RdrObjMtnPat_Oncoming" 6 "RdrObjMtnPat_CrossingFromLe" 7 "RdrObjMtnPat_CrossingFromRi";
VAL_ 514 FrntRdrObj24RdrObjTrackSts 0 "RdrObjTrackSts_Invld" 1 "RdrObjTrackSts_Updated" 2 "RdrObjTrackSts_New" 3 "RdrObjTrackSts_Coasted";
VAL_ 514 FrntRdrObj24RdrObjTyp 0 "RdrObjTyp_Ukwn" 1 "RdrObjTyp_Car" 2 "RdrObjTyp_MotorCycle" 3 "RdrObjTyp_Truck" 4 "RdrObjTyp_Ped" 5 "RdrObjTyp_ObstdVert1" 6 "RdrObjTyp_ObstdVert2" 7 "RdrObjTyp_Anim" 8 "RdrObjTyp_ObjGen" 9 "RdrObjTyp_Bicycle" 10 "RdrObjTyp_VehofUkwnClass" 11 "RdrObjTyp_Reserved";
VAL_ 516 FrntRdrObj25RdrObjElevnSts 0 "RdrObjElevnSts_Unknown" 1 "RdrObjElevnSts_OverRidable" 2 "RdrObjElevnSts_Rlv" 3 "RdrObjElevnSts_UnderRidable";
VAL_ 516 FrntRdrObj25RdrObjIsInFreeSpace 0 "YesNo2_No" 1 "YesNo2_Yes";
VAL_ 516 FrntRdrObj25RdrObjMtnPat 0 "RdrObjMtnPat_Ukwn" 1 "RdrObjMtnPat_Staty" 2 "RdrObjMtnPat_StatyFromMovg" 3 "RdrObjMtnPat_Movg" 4 "RdrObjMtnPat_Receding" 5 "RdrObjMtnPat_Oncoming" 6 "RdrObjMtnPat_CrossingFromLe" 7 "RdrObjMtnPat_CrossingFromRi";
VAL_ 516 FrntRdrObj25RdrObjTrackSts 0 "RdrObjTrackSts_Invld" 1 "RdrObjTrackSts_Updated" 2 "RdrObjTrackSts_New" 3 "RdrObjTrackSts_Coasted";
VAL_ 516 FrntRdrObj25RdrObjTyp 0 "RdrObjTyp_Ukwn" 1 "RdrObjTyp_Car" 2 "RdrObjTyp_MotorCycle" 3 "RdrObjTyp_Truck" 4 "RdrObjTyp_Ped" 5 "RdrObjTyp_ObstdVert1" 6 "RdrObjTyp_ObstdVert2" 7 "RdrObjTyp_Anim" 8 "RdrObjTyp_ObjGen" 9 "RdrObjTyp_Bicycle" 10 "RdrObjTyp_VehofUkwnClass" 11 "RdrObjTyp_Reserved";
VAL_ 518 FrntRdrObj26RdrObjElevnSts 0 "RdrObjElevnSts_Unknown" 1 "RdrObjElevnSts_OverRidable" 2 "RdrObjElevnSts_Rlv" 3 "RdrObjElevnSts_UnderRidable";
VAL_ 518 FrntRdrObj26RdrObjIsInFreeSpace 0 "YesNo2_No" 1 "YesNo2_Yes";
VAL_ 518 FrntRdrObj26RdrObjMtnPat 0 "RdrObjMtnPat_Ukwn" 1 "RdrObjMtnPat_Staty" 2 "RdrObjMtnPat_StatyFromMovg" 3 "RdrObjMtnPat_Movg" 4 "RdrObjMtnPat_Receding" 5 "RdrObjMtnPat_Oncoming" 6 "RdrObjMtnPat_CrossingFromLe" 7 "RdrObjMtnPat_CrossingFromRi";
VAL_ 518 FrntRdrObj26RdrObjTrackSts 0 "RdrObjTrackSts_Invld" 1 "RdrObjTrackSts_Updated" 2 "RdrObjTrackSts_New" 3 "RdrObjTrackSts_Coasted";
VAL_ 518 FrntRdrObj26RdrObjTyp 0 "RdrObjTyp_Ukwn" 1 "RdrObjTyp_Car" 2 "RdrObjTyp_MotorCycle" 3 "RdrObjTyp_Truck" 4 "RdrObjTyp_Ped" 5 "RdrObjTyp_ObstdVert1" 6 "RdrObjTyp_ObstdVert2" 7 "RdrObjTyp_Anim" 8 "RdrObjTyp_ObjGen" 9 "RdrObjTyp_Bicycle" 10 "RdrObjTyp_VehofUkwnClass" 11 "RdrObjTyp_Reserved";
VAL_ 520 FrntRdrObj27RdrObjElevnSts 0 "RdrObjElevnSts_Unknown" 1 "RdrObjElevnSts_OverRidable" 2 "RdrObjElevnSts_Rlv" 3 "RdrObjElevnSts_UnderRidable";
VAL_ 520 FrntRdrObj27RdrObjIsInFreeSpace 0 "YesNo2_No" 1 "YesNo2_Yes";
VAL_ 520 FrntRdrObj27RdrObjMtnPat 0 "RdrObjMtnPat_Ukwn" 1 "RdrObjMtnPat_Staty" 2 "RdrObjMtnPat_StatyFromMovg" 3 "RdrObjMtnPat_Movg" 4 "RdrObjMtnPat_Receding" 5 "RdrObjMtnPat_Oncoming" 6 "RdrObjMtnPat_CrossingFromLe" 7 "RdrObjMtnPat_CrossingFromRi";
VAL_ 520 FrntRdrObj27RdrObjTrackSts 0 "RdrObjTrackSts_Invld" 1 "RdrObjTrackSts_Updated" 2 "RdrObjTrackSts_New" 3 "RdrObjTrackSts_Coasted";
VAL_ 520 FrntRdrObj27RdrObjTyp 0 "RdrObjTyp_Ukwn" 1 "RdrObjTyp_Car" 2 "RdrObjTyp_MotorCycle" 3 "RdrObjTyp_Truck" 4 "RdrObjTyp_Ped" 5 "RdrObjTyp_ObstdVert1" 6 "RdrObjTyp_ObstdVert2" 7 "RdrObjTyp_Anim" 8 "RdrObjTyp_ObjGen" 9 "RdrObjTyp_Bicycle" 10 "RdrObjTyp_VehofUkwnClass" 11 "RdrObjTyp_Reserved";
VAL_ 522 FrntRdrObj28RdrObjElevnSts 0 "RdrObjElevnSts_Unknown" 1 "RdrObjElevnSts_OverRidable" 2 "RdrObjElevnSts_Rlv" 3 "RdrObjElevnSts_UnderRidable";
VAL_ 522 FrntRdrObj28RdrObjIsInFreeSpace 0 "YesNo2_No" 1 "YesNo2_Yes";
VAL_ 522 FrntRdrObj28RdrObjMtnPat 0 "RdrObjMtnPat_Ukwn" 1 "RdrObjMtnPat_Staty" 2 "RdrObjMtnPat_StatyFromMovg" 3 "RdrObjMtnPat_Movg" 4 "RdrObjMtnPat_Receding" 5 "RdrObjMtnPat_Oncoming" 6 "RdrObjMtnPat_CrossingFromLe" 7 "RdrObjMtnPat_CrossingFromRi";
VAL_ 522 FrntRdrObj28RdrObjTrackSts 0 "RdrObjTrackSts_Invld" 1 "RdrObjTrackSts_Updated" 2 "RdrObjTrackSts_New" 3 "RdrObjTrackSts_Coasted";
VAL_ 522 FrntRdrObj28RdrObjTyp 0 "RdrObjTyp_Ukwn" 1 "RdrObjTyp_Car" 2 "RdrObjTyp_MotorCycle" 3 "RdrObjTyp_Truck" 4 "RdrObjTyp_Ped" 5 "RdrObjTyp_ObstdVert1" 6 "RdrObjTyp_ObstdVert2" 7 "RdrObjTyp_Anim" 8 "RdrObjTyp_ObjGen" 9 "RdrObjTyp_Bicycle" 10 "RdrObjTyp_VehofUkwnClass" 11 "RdrObjTyp_Reserved";
VAL_ 524 FrntRdrObj29RdrObjElevnSts 0 "RdrObjElevnSts_Unknown" 1 "RdrObjElevnSts_OverRidable" 2 "RdrObjElevnSts_Rlv" 3 "RdrObjElevnSts_UnderRidable";
VAL_ 524 FrntRdrObj29RdrObjIsInFreeSpace 0 "YesNo2_No" 1 "YesNo2_Yes";
VAL_ 524 FrntRdrObj29RdrObjMtnPat 0 "RdrObjMtnPat_Ukwn" 1 "RdrObjMtnPat_Staty" 2 "RdrObjMtnPat_StatyFromMovg" 3 "RdrObjMtnPat_Movg" 4 "RdrObjMtnPat_Receding" 5 "RdrObjMtnPat_Oncoming" 6 "RdrObjMtnPat_CrossingFromLe" 7 "RdrObjMtnPat_CrossingFromRi";
VAL_ 524 FrntRdrObj29RdrObjTrackSts 0 "RdrObjTrackSts_Invld" 1 "RdrObjTrackSts_Updated" 2 "RdrObjTrackSts_New" 3 "RdrObjTrackSts_Coasted";
VAL_ 524 FrntRdrObj29RdrObjTyp 0 "RdrObjTyp_Ukwn" 1 "RdrObjTyp_Car" 2 "RdrObjTyp_MotorCycle" 3 "RdrObjTyp_Truck" 4 "RdrObjTyp_Ped" 5 "RdrObjTyp_ObstdVert1" 6 "RdrObjTyp_ObstdVert2" 7 "RdrObjTyp_Anim" 8 "RdrObjTyp_ObjGen" 9 "RdrObjTyp_Bicycle" 10 "RdrObjTyp_VehofUkwnClass" 11 "RdrObjTyp_Reserved";
VAL_ 526 FrntRdrObj30RdrObjElevnSts 0 "RdrObjElevnSts_Unknown" 1 "RdrObjElevnSts_OverRidable" 2 "RdrObjElevnSts_Rlv" 3 "RdrObjElevnSts_UnderRidable";
VAL_ 526 FrntRdrObj30RdrObjIsInFreeSpace 0 "YesNo2_No" 1 "YesNo2_Yes";
VAL_ 526 FrntRdrObj30RdrObjMtnPat 0 "RdrObjMtnPat_Ukwn" 1 "RdrObjMtnPat_Staty" 2 "RdrObjMtnPat_StatyFromMovg" 3 "RdrObjMtnPat_Movg" 4 "RdrObjMtnPat_Receding" 5 "RdrObjMtnPat_Oncoming" 6 "RdrObjMtnPat_CrossingFromLe" 7 "RdrObjMtnPat_CrossingFromRi";
VAL_ 526 FrntRdrObj30RdrObjTrackSts 0 "RdrObjTrackSts_Invld" 1 "RdrObjTrackSts_Updated" 2 "RdrObjTrackSts_New" 3 "RdrObjTrackSts_Coasted";
VAL_ 526 FrntRdrObj30RdrObjTyp 0 "RdrObjTyp_Ukwn" 1 "RdrObjTyp_Car" 2 "RdrObjTyp_MotorCycle" 3 "RdrObjTyp_Truck" 4 "RdrObjTyp_Ped" 5 "RdrObjTyp_ObstdVert1" 6 "RdrObjTyp_ObstdVert2" 7 "RdrObjTyp_Anim" 8 "RdrObjTyp_ObjGen" 9 "RdrObjTyp_Bicycle" 10 "RdrObjTyp_VehofUkwnClass" 11 "RdrObjTyp_Reserved";
SIG_GROUP_ 406 FrntRdrObj18 1 : FrntRdrObj18Heading FrntRdrObj18ObjBoxCenterLat FrntRdrObj18ObjBoxCenterLgt FrntRdrObj18ObservationHist FrntRdrObj18RdrObjAx FrntRdrObj18RdrObjAy FrntRdrObj18RdrObjBoxLength FrntRdrObj18RdrObjBoxWidth FrntRdrObj18RdrObjChks FrntRdrObj18RdrObjCntr FrntRdrObj18RdrObjCoastCnt FrntRdrObj18RdrObjConf FrntRdrObj18RdrObjDx FrntRdrObj18RdrObjDxStdDe FrntRdrObj18RdrObjDy FrntRdrObj18RdrObjDyStdDe FrntRdrObj18RdrObjElevnConf FrntRdrObj18RdrObjElevnSts FrntRdrObj18RdrObjID FrntRdrObj18RdrObjIsInFreeSpace FrntRdrObj18RdrObjMirrProblty FrntRdrObj18RdrObjMtnPat FrntRdrObj18RdrObjNotRealProblty FrntRdrObj18RdrObjStatyCnt FrntRdrObj18RdrObjTiAlv FrntRdrObj18RdrObjTrackSts FrntRdrObj18RdrObjTyp FrntRdrObj18RdrObjTypConfBike FrntRdrObj18RdrObjTypConfPed FrntRdrObj18RdrObjTypConfVeh FrntRdrObj18RdrObjVx FrntRdrObj18RdrObjVxStdDe FrntRdrObj18RdrObjVy FrntRdrObj18RdrObjVyStdDe FrntRdrObj18RelVx FrntRdrObj18RelVy;
SIG_GROUP_ 408 FrntRdrObj19 1 : FrntRdrObj19Heading FrntRdrObj19ObjBoxCenterLat FrntRdrObj19ObjBoxCenterLgt FrntRdrObj19ObservationHist FrntRdrObj19RdrObjAx FrntRdrObj19RdrObjAy FrntRdrObj19RdrObjBoxLength FrntRdrObj19RdrObjBoxWidth FrntRdrObj19RdrObjChks FrntRdrObj19RdrObjCntr FrntRdrObj19RdrObjCoastCnt FrntRdrObj19RdrObjConf FrntRdrObj19RdrObjDx FrntRdrObj19RdrObjDxStdDe FrntRdrObj19RdrObjDy FrntRdrObj19RdrObjDyStdDe FrntRdrObj19RdrObjElevnConf FrntRdrObj19RdrObjElevnSts FrntRdrObj19RdrObjID FrntRdrObj19RdrObjIsInFreeSpace FrntRdrObj19RdrObjMirrProblty FrntRdrObj19RdrObjMtnPat FrntRdrObj19RdrObjNotRealProblty FrntRdrObj19RdrObjStatyCnt FrntRdrObj19RdrObjTiAlv FrntRdrObj19RdrObjTrackSts FrntRdrObj19RdrObjTyp FrntRdrObj19RdrObjTypConfBike FrntRdrObj19RdrObjTypConfPed FrntRdrObj19RdrObjTypConfVeh FrntRdrObj19RdrObjVx FrntRdrObj19RdrObjVxStdDe FrntRdrObj19RdrObjVy FrntRdrObj19RdrObjVyStdDe FrntRdrObj19RelVx FrntRdrObj19RelVy;
SIG_GROUP_ 410 FrntRdrObj20 1 : FrntRdrObj20Heading FrntRdrObj20ObjBoxCenterLat FrntRdrObj20ObjBoxCenterLgt FrntRdrObj20ObservationHist FrntRdrObj20RdrObjAx FrntRdrObj20RdrObjAy FrntRdrObj20RdrObjBoxLength FrntRdrObj20RdrObjBoxWidth FrntRdrObj20RdrObjChks FrntRdrObj20RdrObjCntr FrntRdrObj20RdrObjCoastCnt FrntRdrObj20RdrObjConf FrntRdrObj20RdrObjDx FrntRdrObj20RdrObjDxStdDe FrntRdrObj20RdrObjDy FrntRdrObj20RdrObjDyStdDe FrntRdrObj20RdrObjElevnConf FrntRdrObj20RdrObjElevnSts FrntRdrObj20RdrObjID FrntRdrObj20RdrObjIsInFreeSpace FrntRdrObj20RdrObjMirrProblty FrntRdrObj20RdrObjMtnPat FrntRdrObj20RdrObjNotRealProblty FrntRdrObj20RdrObjStatyCnt FrntRdrObj20RdrObjTiAlv FrntRdrObj20RdrObjTrackSts FrntRdrObj20RdrObjTyp FrntRdrObj20RdrObjTypConfBike FrntRdrObj20RdrObjTypConfPed FrntRdrObj20RdrObjTypConfVeh FrntRdrObj20RdrObjVx FrntRdrObj20RdrObjVxStdDe FrntRdrObj20RdrObjVy FrntRdrObj20RdrObjVyStdDe FrntRdrObj20RelVx FrntRdrObj20RelVy;
SIG_GROUP_ 412 FrntRdrObj21 1 : FrntRdrObj21Heading FrntRdrObj21ObjBoxCenterLat FrntRdrObj21ObjBoxCenterLgt FrntRdrObj21ObservationHist FrntRdrObj21RdrObjAx FrntRdrObj21RdrObjAy FrntRdrObj21RdrObjBoxLength FrntRdrObj21RdrObjBoxWidth FrntRdrObj21RdrObjChks FrntRdrObj21RdrObjCntr FrntRdrObj21RdrObjCoastCnt FrntRdrObj21RdrObjConf FrntRdrObj21RdrObjDx FrntRdrObj21RdrObjDxStdDe FrntRdrObj21RdrObjDy FrntRdrObj21RdrObjDyStdDe FrntRdrObj21RdrObjElevnConf FrntRdrObj21RdrObjElevnSts FrntRdrObj21RdrObjID FrntRdrObj21RdrObjIsInFreeSpace FrntRdrObj21RdrObjMirrProblty FrntRdrObj21RdrObjMtnPat FrntRdrObj21RdrObjNotRealProblty FrntRdrObj21RdrObjStatyCnt FrntRdrObj21RdrObjTiAlv FrntRdrObj21RdrObjTrackSts FrntRdrObj21RdrObjTyp FrntRdrObj21RdrObjTypConfBike FrntRdrObj21RdrObjTypConfPed FrntRdrObj21RdrObjTypConfVeh FrntRdrObj21RdrObjVx FrntRdrObj21RdrObjVxStdDe FrntRdrObj21RdrObjVy FrntRdrObj21RdrObjVyStdDe FrntRdrObj21RelVx FrntRdrObj21RelVy;
SIG_GROUP_ 414 FrntRdrObj22 1 : FrntRdrObj22Heading FrntRdrObj22ObjBoxCenterLat FrntRdrObj22ObjBoxCenterLgt FrntRdrObj22ObservationHist FrntRdrObj22RdrObjAx FrntRdrObj22RdrObjAy FrntRdrObj22RdrObjBoxLength FrntRdrObj22RdrObjBoxWidth FrntRdrObj22RdrObjChks FrntRdrObj22RdrObjCntr FrntRdrObj22RdrObjCoastCnt FrntRdrObj22RdrObjConf FrntRdrObj22RdrObjDx FrntRdrObj22RdrObjDxStdDe FrntRdrObj22RdrObjDy FrntRdrObj22RdrObjDyStdDe FrntRdrObj22RdrObjElevnConf FrntRdrObj22RdrObjElevnSts FrntRdrObj22RdrObjID FrntRdrObj22RdrObjIsInFreeSpace FrntRdrObj22RdrObjMirrProblty FrntRdrObj22RdrObjMtnPat FrntRdrObj22RdrObjNotRealProblty FrntRdrObj22RdrObjStatyCnt FrntRdrObj22RdrObjTiAlv FrntRdrObj22RdrObjTrackSts FrntRdrObj22RdrObjTyp FrntRdrObj22RdrObjTypConfBike FrntRdrObj22RdrObjTypConfPed FrntRdrObj22RdrObjTypConfVeh FrntRdrObj22RdrObjVx FrntRdrObj22RdrObjVxStdDe FrntRdrObj22RdrObjVy FrntRdrObj22RdrObjVyStdDe FrntRdrObj22RelVx FrntRdrObj22RelVy;
SIG_GROUP_ 512 FrntRdrObj23 1 : FrntRdrObj23Heading FrntRdrObj23ObjBoxCenterLat FrntRdrObj23ObjBoxCenterLgt FrntRdrObj23ObservationHist FrntRdrObj23RdrObjAx FrntRdrObj23RdrObjAy FrntRdrObj23RdrObjBoxLength FrntRdrObj23RdrObjBoxWidth FrntRdrObj23RdrObjChks FrntRdrObj23RdrObjCntr FrntRdrObj23RdrObjCoastCnt FrntRdrObj23RdrObjConf FrntRdrObj23RdrObjDx FrntRdrObj23RdrObjDxStdDe FrntRdrObj23RdrObjDy FrntRdrObj23RdrObjDyStdDe FrntRdrObj23RdrObjElevnConf FrntRdrObj23RdrObjElevnSts FrntRdrObj23RdrObjID FrntRdrObj23RdrObjIsInFreeSpace FrntRdrObj23RdrObjMirrProblty FrntRdrObj23RdrObjMtnPat FrntRdrObj23RdrObjNotRealProblty FrntRdrObj23RdrObjStatyCnt FrntRdrObj23RdrObjTiAlv FrntRdrObj23RdrObjTrackSts FrntRdrObj23RdrObjTyp FrntRdrObj23RdrObjTypConfBike FrntRdrObj23RdrObjTypConfPed FrntRdrObj23RdrObjTypConfVeh FrntRdrObj23RdrObjVx FrntRdrObj23RdrObjVxStdDe FrntRdrObj23RdrObjVy FrntRdrObj23RdrObjVyStdDe FrntRdrObj23RelVx FrntRdrObj23RelVy;
SIG_GROUP_ 514 FrntRdrObj24 1 : FrntRdrObj24Heading FrntRdrObj24ObjBoxCenterLat FrntRdrObj24ObjBoxCenterLgt FrntRdrObj24ObservationHist FrntRdrObj24RdrObjAx FrntRdrObj24RdrObjAy FrntRdrObj24RdrObjBoxLength FrntRdrObj24RdrObjBoxWidth FrntRdrObj24RdrObjChks FrntRdrObj24RdrObjCntr FrntRdrObj24RdrObjCoastCnt FrntRdrObj24RdrObjConf FrntRdrObj24RdrObjDx FrntRdrObj24RdrObjDxStdDe FrntRdrObj24RdrObjDy FrntRdrObj24RdrObjDyStdDe FrntRdrObj24RdrObjElevnConf FrntRdrObj24RdrObjElevnSts FrntRdrObj24RdrObjID FrntRdrObj24RdrObjIsInFreeSpace FrntRdrObj24RdrObjMirrProblty FrntRdrObj24RdrObjMtnPat FrntRdrObj24RdrObjNotRealProblty FrntRdrObj24RdrObjStatyCnt FrntRdrObj24RdrObjTiAlv FrntRdrObj24RdrObjTrackSts FrntRdrObj24RdrObjTyp FrntRdrObj24RdrObjTypConfBike FrntRdrObj24RdrObjTypConfPed FrntRdrObj24RdrObjTypConfVeh FrntRdrObj24RdrObjVx FrntRdrObj24RdrObjVxStdDe FrntRdrObj24RdrObjVy FrntRdrObj24RdrObjVyStdDe FrntRdrObj24RelVx FrntRdrObj24RelVy;
SIG_GROUP_ 516 FrntRdrObj25 1 : FrntRdrObj25Heading FrntRdrObj25ObjBoxCenterLat FrntRdrObj25ObjBoxCenterLgt FrntRdrObj25ObservationHist FrntRdrObj25RdrObjAx FrntRdrObj25RdrObjAy FrntRdrObj25RdrObjBoxLength FrntRdrObj25RdrObjBoxWidth FrntRdrObj25RdrObjChks FrntRdrObj25RdrObjCntr FrntRdrObj25RdrObjCoastCnt FrntRdrObj25RdrObjConf FrntRdrObj25RdrObjDx FrntRdrObj25RdrObjDxStdDe FrntRdrObj25RdrObjDy FrntRdrObj25RdrObjDyStdDe FrntRdrObj25RdrObjElevnConf FrntRdrObj25RdrObjElevnSts FrntRdrObj25RdrObjID FrntRdrObj25RdrObjIsInFreeSpace FrntRdrObj25RdrObjMirrProblty FrntRdrObj25RdrObjMtnPat FrntRdrObj25RdrObjNotRealProblty FrntRdrObj25RdrObjStatyCnt FrntRdrObj25RdrObjTiAlv FrntRdrObj25RdrObjTrackSts FrntRdrObj25RdrObjTyp FrntRdrObj25RdrObjTypConfBike FrntRdrObj25RdrObjTypConfPed FrntRdrObj25RdrObjTypConfVeh FrntRdrObj25RdrObjVx FrntRdrObj25RdrObjVxStdDe FrntRdrObj25RdrObjVy FrntRdrObj25RdrObjVyStdDe FrntRdrObj25RelVx FrntRdrObj25RelVy;
SIG_GROUP_ 518 FrntRdrObj26 1 : FrntRdrObj26Heading FrntRdrObj26ObjBoxCenterLat FrntRdrObj26ObjBoxCenterLgt FrntRdrObj26ObservationHist FrntRdrObj26RdrObjAx FrntRdrObj26RdrObjAy FrntRdrObj26RdrObjBoxLength FrntRdrObj26RdrObjBoxWidth FrntRdrObj26RdrObjChks FrntRdrObj26RdrObjCntr FrntRdrObj26RdrObjCoastCnt FrntRdrObj26RdrObjConf FrntRdrObj26RdrObjDx FrntRdrObj26RdrObjDxStdDe FrntRdrObj26RdrObjDy FrntRdrObj26RdrObjDyStdDe FrntRdrObj26RdrObjElevnConf FrntRdrObj26RdrObjElevnSts FrntRdrObj26RdrObjID FrntRdrObj26RdrObjIsInFreeSpace FrntRdrObj26RdrObjMirrProblty FrntRdrObj26RdrObjMtnPat FrntRdrObj26RdrObjNotRealProblty FrntRdrObj26RdrObjStatyCnt FrntRdrObj26RdrObjTiAlv FrntRdrObj26RdrObjTrackSts FrntRdrObj26RdrObjTyp FrntRdrObj26RdrObjTypConfBike FrntRdrObj26RdrObjTypConfPed FrntRdrObj26RdrObjTypConfVeh FrntRdrObj26RdrObjVx FrntRdrObj26RdrObjVxStdDe FrntRdrObj26RdrObjVy FrntRdrObj26RdrObjVyStdDe FrntRdrObj26RelVx FrntRdrObj26RelVy;
SIG_GROUP_ 520 FrntRdrObj27 1 : FrntRdrObj27Heading FrntRdrObj27ObjBoxCenterLat FrntRdrObj27ObjBoxCenterLgt FrntRdrObj27ObservationHist FrntRdrObj27RdrObjAx FrntRdrObj27RdrObjAy FrntRdrObj27RdrObjBoxLength FrntRdrObj27RdrObjBoxWidth FrntRdrObj27RdrObjChks FrntRdrObj27RdrObjCntr FrntRdrObj27RdrObjCoastCnt FrntRdrObj27RdrObjConf FrntRdrObj27RdrObjDx FrntRdrObj27RdrObjDxStdDe FrntRdrObj27RdrObjDy FrntRdrObj27RdrObjDyStdDe FrntRdrObj27RdrObjElevnConf FrntRdrObj27RdrObjElevnSts FrntRdrObj27RdrObjID FrntRdrObj27RdrObjIsInFreeSpace FrntRdrObj27RdrObjMirrProblty FrntRdrObj27RdrObjMtnPat FrntRdrObj27RdrObjNotRealProblty FrntRdrObj27RdrObjStatyCnt FrntRdrObj27RdrObjTiAlv FrntRdrObj27RdrObjTrackSts FrntRdrObj27RdrObjTyp FrntRdrObj27RdrObjTypConfBike FrntRdrObj27RdrObjTypConfPed FrntRdrObj27RdrObjTypConfVeh FrntRdrObj27RdrObjVx FrntRdrObj27RdrObjVxStdDe FrntRdrObj27RdrObjVy FrntRdrObj27RdrObjVyStdDe FrntRdrObj27RelVx FrntRdrObj27RelVy;
SIG_GROUP_ 522 FrntRdrObj28 1 : FrntRdrObj28Heading FrntRdrObj28ObjBoxCenterLat FrntRdrObj28ObjBoxCenterLgt FrntRdrObj28ObservationHist FrntRdrObj28RdrObjAx FrntRdrObj28RdrObjAy FrntRdrObj28RdrObjBoxLength FrntRdrObj28RdrObjBoxWidth FrntRdrObj28RdrObjChks FrntRdrObj28RdrObjCntr FrntRdrObj28RdrObjCoastCnt FrntRdrObj28RdrObjConf FrntRdrObj28RdrObjDx FrntRdrObj28RdrObjDxStdDe FrntRdrObj28RdrObjDy FrntRdrObj28RdrObjDyStdDe FrntRdrObj28RdrObjElevnConf FrntRdrObj28RdrObjElevnSts FrntRdrObj28RdrObjID FrntRdrObj28RdrObjIsInFreeSpace FrntRdrObj28RdrObjMirrProblty FrntRdrObj28RdrObjMtnPat FrntRdrObj28RdrObjNotRealProblty FrntRdrObj28RdrObjStatyCnt FrntRdrObj28RdrObjTiAlv FrntRdrObj28RdrObjTrackSts FrntRdrObj28RdrObjTyp FrntRdrObj28RdrObjTypConfBike FrntRdrObj28RdrObjTypConfPed FrntRdrObj28RdrObjTypConfVeh FrntRdrObj28RdrObjVx FrntRdrObj28RdrObjVxStdDe FrntRdrObj28RdrObjVy FrntRdrObj28RdrObjVyStdDe FrntRdrObj28RelVx FrntRdrObj28RelVy;
SIG_GROUP_ 524 FrntRdrObj29 1 : FrntRdrObj29Heading FrntRdrObj29ObjBoxCenterLat FrntRdrObj29ObjBoxCenterLgt FrntRdrObj29ObservationHist FrntRdrObj29RdrObjAx FrntRdrObj29RdrObjAy FrntRdrObj29RdrObjBoxLength FrntRdrObj29RdrObjBoxWidth FrntRdrObj29RdrObjChks FrntRdrObj29RdrObjCntr FrntRdrObj29RdrObjCoastCnt FrntRdrObj29RdrObjConf FrntRdrObj29RdrObjDx FrntRdrObj29RdrObjDxStdDe FrntRdrObj29RdrObjDy FrntRdrObj29RdrObjDyStdDe FrntRdrObj29RdrObjElevnConf FrntRdrObj29RdrObjElevnSts FrntRdrObj29RdrObjID FrntRdrObj29RdrObjIsInFreeSpace FrntRdrObj29RdrObjMirrProblty FrntRdrObj29RdrObjMtnPat FrntRdrObj29RdrObjNotRealProblty FrntRdrObj29RdrObjStatyCnt FrntRdrObj29RdrObjTiAlv FrntRdrObj29RdrObjTrackSts FrntRdrObj29RdrObjTyp FrntRdrObj29RdrObjTypConfBike FrntRdrObj29RdrObjTypConfPed FrntRdrObj29RdrObjTypConfVeh FrntRdrObj29RdrObjVx FrntRdrObj29RdrObjVxStdDe FrntRdrObj29RdrObjVy FrntRdrObj29RdrObjVyStdDe FrntRdrObj29RelVx FrntRdrObj29RelVy;
SIG_GROUP_ 526 FrntRdrObj30 1 : FrntRdrObj30Heading FrntRdrObj30ObjBoxCenterLat FrntRdrObj30ObjBoxCenterLgt FrntRdrObj30ObservationHist FrntRdrObj30RdrObjAx FrntRdrObj30RdrObjAy FrntRdrObj30RdrObjBoxLength FrntRdrObj30RdrObjBoxWidth FrntRdrObj30RdrObjChks FrntRdrObj30RdrObjCntr FrntRdrObj30RdrObjCoastCnt FrntRdrObj30RdrObjConf FrntRdrObj30RdrObjDx FrntRdrObj30RdrObjDxStdDe FrntRdrObj30RdrObjDy FrntRdrObj30RdrObjDyStdDe FrntRdrObj30RdrObjElevnConf FrntRdrObj30RdrObjElevnSts FrntRdrObj30RdrObjID FrntRdrObj30RdrObjIsInFreeSpace FrntRdrObj30RdrObjMirrProblty FrntRdrObj30RdrObjMtnPat FrntRdrObj30RdrObjNotRealProblty FrntRdrObj30RdrObjStatyCnt FrntRdrObj30RdrObjTiAlv FrntRdrObj30RdrObjTrackSts FrntRdrObj30RdrObjTyp FrntRdrObj30RdrObjTypConfBike FrntRdrObj30RdrObjTypConfPed FrntRdrObj30RdrObjTypConfVeh FrntRdrObj30RdrObjVx FrntRdrObj30RdrObjVxStdDe FrntRdrObj30RdrObjVy FrntRdrObj30RdrObjVyStdDe FrntRdrObj30RelVx FrntRdrObj30RelVy;
