// *************************************************************************** *
// *                                                                           *
// *                      Mentor Graphics Corporation                          *
// *                          All rights reserved                              *
// *                                                                           *
// *************************************************************************** *
// *                                                                           *
// * Description:         CANDB File                                           *
// * Generated at:        2020-04-14 13:13:01                                  *
// * System:              SDB20010                                             *
// * Variant:             EX11_AVP                                             *
// * Network:             SafetyCANFD2                                         *
// *                                                                           *
// *************************************************************************** *
// *                                                                           *
// *             THIS CONFIGURATION MIGHT CONTAIN SOME ERRORS                  *
// *              IF THE INPUT MODEL WAS NOT PROPERLY FORMED!                  *
// *                    Do Not Use this File directly!                         *
// *                                                                           *
// *************************************************************************** *
VERSION "SafetyCANFD2"

NS_ :

BS_:

BU_:  ASDM ETC FLC FLR PAS

BO_ 326 FLRSafetyCANFD2Frame12: 64 FLR
 SG_ FrntRdrDetn67_UB : 74|1@0+ (1,0) [0|1] "" ASDM,PAS
 SG_ FrntRdrDetn67RdrDetnAzi : 31|11@0+ (0.1,-90.0) [-90.0|90.0] "Deg" ASDM,PAS
 SG_ FrntRdrDetn67RdrDetnChks : 7|8@0+ (1.0,0.0) [0.0|255.0] "Unitless" ASDM,PAS
 SG_ FrntRdrDetn67RdrDetnCntr : 15|4@0+ (1.0,0.0) [0.0|15.0] "Unitless" ASDM,PAS
 SG_ FrntRdrDetn67RdrDetnConf : 71|7@0+ (1.0,0.0) [0.0|100.0] "%" ASDM,PAS
 SG_ FrntRdrDetn67RdrDetnElevn : 79|5@0+ (1.0,-15.0) [-15.0|15.0] "Deg" ASDM,PAS
 SG_ FrntRdrDetn67RdrDetnPwr : 8|9@0+ (0.1,0.0) [0.0|51.1] "dB" ASDM,PAS
 SG_ FrntRdrDetn67RdrDetnRng : 55|14@0+ (0.02,-1.0) [-1.0|200.0] "m" ASDM,PAS
 SG_ FrntRdrDetn67RdrDetnRngV : 36|13@0+ (0.02,-80.0) [-80.0|80.0] "m/s" ASDM,PAS
 SG_ FrntRdrDetn67RdrDetnSts : 11|2@0+ (1,0) [0|3] "" ASDM,PAS
 SG_ FrntRdrDetn68_UB : 154|1@0+ (1,0) [0|1] "" ASDM,PAS
 SG_ FrntRdrDetn68RdrDetnAzi : 119|11@0+ (0.1,-90.0) [-90.0|90.0] "Deg" ASDM,PAS
 SG_ FrntRdrDetn68RdrDetnChks : 87|8@0+ (1.0,0.0) [0.0|255.0] "Unitless" ASDM,PAS
 SG_ FrntRdrDetn68RdrDetnCntr : 95|4@0+ (1.0,0.0) [0.0|15.0] "Unitless" ASDM,PAS
 SG_ FrntRdrDetn68RdrDetnConf : 111|7@0+ (1.0,0.0) [0.0|100.0] "%" ASDM,PAS
 SG_ FrntRdrDetn68RdrDetnElevn : 159|5@0+ (1.0,-15.0) [-15.0|15.0] "Deg" ASDM,PAS
 SG_ FrntRdrDetn68RdrDetnPwr : 89|9@0+ (0.1,0.0) [0.0|51.1] "dB" ASDM,PAS
 SG_ FrntRdrDetn68RdrDetnRng : 143|14@0+ (0.02,-1.0) [-1.0|200.0] "m" ASDM,PAS
 SG_ FrntRdrDetn68RdrDetnRngV : 124|13@0+ (0.02,-80.0) [-80.0|80.0] "m/s" ASDM,PAS
 SG_ FrntRdrDetn68RdrDetnSts : 91|2@0+ (1,0) [0|3] "" ASDM,PAS
 SG_ FrntRdrDetn69_UB : 234|1@0+ (1,0) [0|1] "" ASDM,PAS
 SG_ FrntRdrDetn69RdrDetnAzi : 199|11@0+ (0.1,-90.0) [-90.0|90.0] "Deg" ASDM,PAS
 SG_ FrntRdrDetn69RdrDetnChks : 167|8@0+ (1.0,0.0) [0.0|255.0] "Unitless" ASDM,PAS
 SG_ FrntRdrDetn69RdrDetnCntr : 175|4@0+ (1.0,0.0) [0.0|15.0] "Unitless" ASDM,PAS
 SG_ FrntRdrDetn69RdrDetnConf : 191|7@0+ (1.0,0.0) [0.0|100.0] "%" ASDM,PAS
 SG_ FrntRdrDetn69RdrDetnElevn : 239|5@0+ (1.0,-15.0) [-15.0|15.0] "Deg" ASDM,PAS
 SG_ FrntRdrDetn69RdrDetnPwr : 169|9@0+ (0.1,0.0) [0.0|51.1] "dB" ASDM,PAS
 SG_ FrntRdrDetn69RdrDetnRng : 223|14@0+ (0.02,-1.0) [-1.0|200.0] "m" ASDM,PAS
 SG_ FrntRdrDetn69RdrDetnRngV : 204|13@0+ (0.02,-80.0) [-80.0|80.0] "m/s" ASDM,PAS
 SG_ FrntRdrDetn69RdrDetnSts : 171|2@0+ (1,0) [0|3] "" ASDM,PAS
 SG_ FrntRdrDetn70_UB : 314|1@0+ (1,0) [0|1] "" ASDM,PAS
 SG_ FrntRdrDetn70RdrDetnAzi : 287|11@0+ (0.1,-90.0) [-90.0|90.0] "Deg" ASDM,PAS
 SG_ FrntRdrDetn70RdrDetnChks : 247|8@0+ (1.0,0.0) [0.0|255.0] "Unitless" ASDM,PAS
 SG_ FrntRdrDetn70RdrDetnCntr : 255|4@0+ (1.0,0.0) [0.0|15.0] "Unitless" ASDM,PAS
 SG_ FrntRdrDetn70RdrDetnConf : 311|7@0+ (1.0,0.0) [0.0|100.0] "%" ASDM,PAS
 SG_ FrntRdrDetn70RdrDetnElevn : 319|5@0+ (1.0,-15.0) [-15.0|15.0] "Deg" ASDM,PAS
 SG_ FrntRdrDetn70RdrDetnPwr : 249|9@0+ (0.1,0.0) [0.0|51.1] "dB" ASDM,PAS
 SG_ FrntRdrDetn70RdrDetnRng : 271|14@0+ (0.02,-1.0) [-1.0|200.0] "m" ASDM,PAS
 SG_ FrntRdrDetn70RdrDetnRngV : 292|13@0+ (0.02,-80.0) [-80.0|80.0] "m/s" ASDM,PAS
 SG_ FrntRdrDetn70RdrDetnSts : 251|2@0+ (1,0) [0|3] "" ASDM,PAS
 SG_ FrntRdrDetn71_UB : 394|1@0+ (1,0) [0|1] "" ASDM,PAS
 SG_ FrntRdrDetn71RdrDetnAzi : 351|11@0+ (0.1,-90.0) [-90.0|90.0] "Deg" ASDM,PAS
 SG_ FrntRdrDetn71RdrDetnChks : 327|8@0+ (1.0,0.0) [0.0|255.0] "Unitless" ASDM,PAS
 SG_ FrntRdrDetn71RdrDetnCntr : 335|4@0+ (1.0,0.0) [0.0|15.0] "Unitless" ASDM,PAS
 SG_ FrntRdrDetn71RdrDetnConf : 391|7@0+ (1.0,0.0) [0.0|100.0] "%" ASDM,PAS
 SG_ FrntRdrDetn71RdrDetnElevn : 399|5@0+ (1.0,-15.0) [-15.0|15.0] "Deg" ASDM,PAS
 SG_ FrntRdrDetn71RdrDetnPwr : 329|9@0+ (0.1,0.0) [0.0|51.1] "dB" ASDM,PAS
 SG_ FrntRdrDetn71RdrDetnRng : 375|14@0+ (0.02,-1.0) [-1.0|200.0] "m" ASDM,PAS
 SG_ FrntRdrDetn71RdrDetnRngV : 356|13@0+ (0.02,-80.0) [-80.0|80.0] "m/s" ASDM,PAS
 SG_ FrntRdrDetn71RdrDetnSts : 331|2@0+ (1,0) [0|3] "" ASDM,PAS
 SG_ FrntRdrDetn72_UB : 474|1@0+ (1,0) [0|1] "" ASDM,PAS
 SG_ FrntRdrDetn72RdrDetnAzi : 447|11@0+ (0.1,-90.0) [-90.0|90.0] "Deg" ASDM,PAS
 SG_ FrntRdrDetn72RdrDetnChks : 407|8@0+ (1.0,0.0) [0.0|255.0] "Unitless" ASDM,PAS
 SG_ FrntRdrDetn72RdrDetnCntr : 415|4@0+ (1.0,0.0) [0.0|15.0] "Unitless" ASDM,PAS
 SG_ FrntRdrDetn72RdrDetnConf : 471|7@0+ (1.0,0.0) [0.0|100.0] "%" ASDM,PAS
 SG_ FrntRdrDetn72RdrDetnElevn : 479|5@0+ (1.0,-15.0) [-15.0|15.0] "Deg" ASDM,PAS
 SG_ FrntRdrDetn72RdrDetnPwr : 409|9@0+ (0.1,0.0) [0.0|51.1] "dB" ASDM,PAS
 SG_ FrntRdrDetn72RdrDetnRng : 431|14@0+ (0.02,-1.0) [-1.0|200.0] "m" ASDM,PAS
 SG_ FrntRdrDetn72RdrDetnRngV : 452|13@0+ (0.02,-80.0) [-80.0|80.0] "m/s" ASDM,PAS
 SG_ FrntRdrDetn72RdrDetnSts : 411|2@0+ (1,0) [0|3] "" ASDM,PAS

BO_ 328 FLRSafetyCANFD2Frame13: 64 FLR
 SG_ FrntRdrDetn73_UB : 74|1@0+ (1,0) [0|1] "" ASDM,PAS
 SG_ FrntRdrDetn73RdrDetnAzi : 31|11@0+ (0.1,-90.0) [-90.0|90.0] "Deg" ASDM,PAS
 SG_ FrntRdrDetn73RdrDetnChks : 7|8@0+ (1.0,0.0) [0.0|255.0] "Unitless" ASDM,PAS
 SG_ FrntRdrDetn73RdrDetnCntr : 15|4@0+ (1.0,0.0) [0.0|15.0] "Unitless" ASDM,PAS
 SG_ FrntRdrDetn73RdrDetnConf : 71|7@0+ (1.0,0.0) [0.0|100.0] "%" ASDM,PAS
 SG_ FrntRdrDetn73RdrDetnElevn : 79|5@0+ (1.0,-15.0) [-15.0|15.0] "Deg" ASDM,PAS
 SG_ FrntRdrDetn73RdrDetnPwr : 8|9@0+ (0.1,0.0) [0.0|51.1] "dB" ASDM,PAS
 SG_ FrntRdrDetn73RdrDetnRng : 55|14@0+ (0.02,-1.0) [-1.0|200.0] "m" ASDM,PAS
 SG_ FrntRdrDetn73RdrDetnRngV : 36|13@0+ (0.02,-80.0) [-80.0|80.0] "m/s" ASDM,PAS
 SG_ FrntRdrDetn73RdrDetnSts : 11|2@0+ (1,0) [0|3] "" ASDM,PAS
 SG_ FrntRdrDetn74_UB : 154|1@0+ (1,0) [0|1] "" ASDM,PAS
 SG_ FrntRdrDetn74RdrDetnAzi : 119|11@0+ (0.1,-90.0) [-90.0|90.0] "Deg" ASDM,PAS
 SG_ FrntRdrDetn74RdrDetnChks : 87|8@0+ (1.0,0.0) [0.0|255.0] "Unitless" ASDM,PAS
 SG_ FrntRdrDetn74RdrDetnCntr : 95|4@0+ (1.0,0.0) [0.0|15.0] "Unitless" ASDM,PAS
 SG_ FrntRdrDetn74RdrDetnConf : 111|7@0+ (1.0,0.0) [0.0|100.0] "%" ASDM,PAS
 SG_ FrntRdrDetn74RdrDetnElevn : 159|5@0+ (1.0,-15.0) [-15.0|15.0] "Deg" ASDM,PAS
 SG_ FrntRdrDetn74RdrDetnPwr : 89|9@0+ (0.1,0.0) [0.0|51.1] "dB" ASDM,PAS
 SG_ FrntRdrDetn74RdrDetnRng : 143|14@0+ (0.02,-1.0) [-1.0|200.0] "m" ASDM,PAS
 SG_ FrntRdrDetn74RdrDetnRngV : 124|13@0+ (0.02,-80.0) [-80.0|80.0] "m/s" ASDM,PAS
 SG_ FrntRdrDetn74RdrDetnSts : 91|2@0+ (1,0) [0|3] "" ASDM,PAS
 SG_ FrntRdrDetn75_UB : 234|1@0+ (1,0) [0|1] "" ASDM,PAS
 SG_ FrntRdrDetn75RdrDetnAzi : 199|11@0+ (0.1,-90.0) [-90.0|90.0] "Deg" ASDM,PAS
 SG_ FrntRdrDetn75RdrDetnChks : 167|8@0+ (1.0,0.0) [0.0|255.0] "Unitless" ASDM,PAS
 SG_ FrntRdrDetn75RdrDetnCntr : 175|4@0+ (1.0,0.0) [0.0|15.0] "Unitless" ASDM,PAS
 SG_ FrntRdrDetn75RdrDetnConf : 191|7@0+ (1.0,0.0) [0.0|100.0] "%" ASDM,PAS
 SG_ FrntRdrDetn75RdrDetnElevn : 239|5@0+ (1.0,-15.0) [-15.0|15.0] "Deg" ASDM,PAS
 SG_ FrntRdrDetn75RdrDetnPwr : 169|9@0+ (0.1,0.0) [0.0|51.1] "dB" ASDM,PAS
 SG_ FrntRdrDetn75RdrDetnRng : 223|14@0+ (0.02,-1.0) [-1.0|200.0] "m" ASDM,PAS
 SG_ FrntRdrDetn75RdrDetnRngV : 204|13@0+ (0.02,-80.0) [-80.0|80.0] "m/s" ASDM,PAS
 SG_ FrntRdrDetn75RdrDetnSts : 171|2@0+ (1,0) [0|3] "" ASDM,PAS
 SG_ FrntRdrDetn76_UB : 314|1@0+ (1,0) [0|1] "" ASDM,PAS
 SG_ FrntRdrDetn76RdrDetnAzi : 287|11@0+ (0.1,-90.0) [-90.0|90.0] "Deg" ASDM,PAS
 SG_ FrntRdrDetn76RdrDetnChks : 247|8@0+ (1.0,0.0) [0.0|255.0] "Unitless" ASDM,PAS
 SG_ FrntRdrDetn76RdrDetnCntr : 255|4@0+ (1.0,0.0) [0.0|15.0] "Unitless" ASDM,PAS
 SG_ FrntRdrDetn76RdrDetnConf : 311|7@0+ (1.0,0.0) [0.0|100.0] "%" ASDM,PAS
 SG_ FrntRdrDetn76RdrDetnElevn : 319|5@0+ (1.0,-15.0) [-15.0|15.0] "Deg" ASDM,PAS
 SG_ FrntRdrDetn76RdrDetnPwr : 249|9@0+ (0.1,0.0) [0.0|51.1] "dB" ASDM,PAS
 SG_ FrntRdrDetn76RdrDetnRng : 271|14@0+ (0.02,-1.0) [-1.0|200.0] "m" ASDM,PAS
 SG_ FrntRdrDetn76RdrDetnRngV : 292|13@0+ (0.02,-80.0) [-80.0|80.0] "m/s" ASDM,PAS
 SG_ FrntRdrDetn76RdrDetnSts : 251|2@0+ (1,0) [0|3] "" ASDM,PAS
 SG_ FrntRdrDetn77_UB : 394|1@0+ (1,0) [0|1] "" ASDM,PAS
 SG_ FrntRdrDetn77RdrDetnAzi : 351|11@0+ (0.1,-90.0) [-90.0|90.0] "Deg" ASDM,PAS
 SG_ FrntRdrDetn77RdrDetnChks : 327|8@0+ (1.0,0.0) [0.0|255.0] "Unitless" ASDM,PAS
 SG_ FrntRdrDetn77RdrDetnCntr : 335|4@0+ (1.0,0.0) [0.0|15.0] "Unitless" ASDM,PAS
 SG_ FrntRdrDetn77RdrDetnConf : 391|7@0+ (1.0,0.0) [0.0|100.0] "%" ASDM,PAS
 SG_ FrntRdrDetn77RdrDetnElevn : 399|5@0+ (1.0,-15.0) [-15.0|15.0] "Deg" ASDM,PAS
 SG_ FrntRdrDetn77RdrDetnPwr : 329|9@0+ (0.1,0.0) [0.0|51.1] "dB" ASDM,PAS
 SG_ FrntRdrDetn77RdrDetnRng : 375|14@0+ (0.02,-1.0) [-1.0|200.0] "m" ASDM,PAS
 SG_ FrntRdrDetn77RdrDetnRngV : 356|13@0+ (0.02,-80.0) [-80.0|80.0] "m/s" ASDM,PAS
 SG_ FrntRdrDetn77RdrDetnSts : 331|2@0+ (1,0) [0|3] "" ASDM,PAS
 SG_ FrntRdrDetn78_UB : 474|1@0+ (1,0) [0|1] "" ASDM,PAS
 SG_ FrntRdrDetn78RdrDetnAzi : 447|11@0+ (0.1,-90.0) [-90.0|90.0] "Deg" ASDM,PAS
 SG_ FrntRdrDetn78RdrDetnChks : 407|8@0+ (1.0,0.0) [0.0|255.0] "Unitless" ASDM,PAS
 SG_ FrntRdrDetn78RdrDetnCntr : 415|4@0+ (1.0,0.0) [0.0|15.0] "Unitless" ASDM,PAS
 SG_ FrntRdrDetn78RdrDetnConf : 471|7@0+ (1.0,0.0) [0.0|100.0] "%" ASDM,PAS
 SG_ FrntRdrDetn78RdrDetnElevn : 479|5@0+ (1.0,-15.0) [-15.0|15.0] "Deg" ASDM,PAS
 SG_ FrntRdrDetn78RdrDetnPwr : 409|9@0+ (0.1,0.0) [0.0|51.1] "dB" ASDM,PAS
 SG_ FrntRdrDetn78RdrDetnRng : 431|14@0+ (0.02,-1.0) [-1.0|200.0] "m" ASDM,PAS
 SG_ FrntRdrDetn78RdrDetnRngV : 452|13@0+ (0.02,-80.0) [-80.0|80.0] "m/s" ASDM,PAS
 SG_ FrntRdrDetn78RdrDetnSts : 411|2@0+ (1,0) [0|3] "" ASDM,PAS

BO_ 330 FLRSafetyCANFD2Frame14: 64 FLR
 SG_ FrntRdrDetn79_UB : 74|1@0+ (1,0) [0|1] "" ASDM,PAS
 SG_ FrntRdrDetn79RdrDetnAzi : 31|11@0+ (0.1,-90.0) [-90.0|90.0] "Deg" ASDM,PAS
 SG_ FrntRdrDetn79RdrDetnChks : 7|8@0+ (1.0,0.0) [0.0|255.0] "Unitless" ASDM,PAS
 SG_ FrntRdrDetn79RdrDetnCntr : 15|4@0+ (1.0,0.0) [0.0|15.0] "Unitless" ASDM,PAS
 SG_ FrntRdrDetn79RdrDetnConf : 71|7@0+ (1.0,0.0) [0.0|100.0] "%" ASDM,PAS
 SG_ FrntRdrDetn79RdrDetnElevn : 79|5@0+ (1.0,-15.0) [-15.0|15.0] "Deg" ASDM,PAS
 SG_ FrntRdrDetn79RdrDetnPwr : 8|9@0+ (0.1,0.0) [0.0|51.1] "dB" ASDM,PAS
 SG_ FrntRdrDetn79RdrDetnRng : 55|14@0+ (0.02,-1.0) [-1.0|200.0] "m" ASDM,PAS
 SG_ FrntRdrDetn79RdrDetnRngV : 36|13@0+ (0.02,-80.0) [-80.0|80.0] "m/s" ASDM,PAS
 SG_ FrntRdrDetn79RdrDetnSts : 11|2@0+ (1,0) [0|3] "" ASDM,PAS
 SG_ FrntRdrDetn80_UB : 154|1@0+ (1,0) [0|1] "" ASDM,PAS
 SG_ FrntRdrDetn80RdrDetnAzi : 119|11@0+ (0.1,-90.0) [-90.0|90.0] "Deg" ASDM,PAS
 SG_ FrntRdrDetn80RdrDetnChks : 87|8@0+ (1.0,0.0) [0.0|255.0] "Unitless" ASDM,PAS
 SG_ FrntRdrDetn80RdrDetnCntr : 95|4@0+ (1.0,0.0) [0.0|15.0] "Unitless" ASDM,PAS
 SG_ FrntRdrDetn80RdrDetnConf : 111|7@0+ (1.0,0.0) [0.0|100.0] "%" ASDM,PAS
 SG_ FrntRdrDetn80RdrDetnElevn : 159|5@0+ (1.0,-15.0) [-15.0|15.0] "Deg" ASDM,PAS
 SG_ FrntRdrDetn80RdrDetnPwr : 89|9@0+ (0.1,0.0) [0.0|51.1] "dB" ASDM,PAS
 SG_ FrntRdrDetn80RdrDetnRng : 143|14@0+ (0.02,-1.0) [-1.0|200.0] "m" ASDM,PAS
 SG_ FrntRdrDetn80RdrDetnRngV : 124|13@0+ (0.02,-80.0) [-80.0|80.0] "m/s" ASDM,PAS
 SG_ FrntRdrDetn80RdrDetnSts : 91|2@0+ (1,0) [0|3] "" ASDM,PAS
 SG_ FrntRdrDetn81_UB : 234|1@0+ (1,0) [0|1] "" ASDM,PAS
 SG_ FrntRdrDetn81RdrDetnAzi : 199|11@0+ (0.1,-90.0) [-90.0|90.0] "Deg" ASDM,PAS
 SG_ FrntRdrDetn81RdrDetnChks : 167|8@0+ (1.0,0.0) [0.0|255.0] "Unitless" ASDM,PAS
 SG_ FrntRdrDetn81RdrDetnCntr : 175|4@0+ (1.0,0.0) [0.0|15.0] "Unitless" ASDM,PAS
 SG_ FrntRdrDetn81RdrDetnConf : 191|7@0+ (1.0,0.0) [0.0|100.0] "%" ASDM,PAS
 SG_ FrntRdrDetn81RdrDetnElevn : 239|5@0+ (1.0,-15.0) [-15.0|15.0] "Deg" ASDM,PAS
 SG_ FrntRdrDetn81RdrDetnPwr : 169|9@0+ (0.1,0.0) [0.0|51.1] "dB" ASDM,PAS
 SG_ FrntRdrDetn81RdrDetnRng : 223|14@0+ (0.02,-1.0) [-1.0|200.0] "m" ASDM,PAS
 SG_ FrntRdrDetn81RdrDetnRngV : 204|13@0+ (0.02,-80.0) [-80.0|80.0] "m/s" ASDM,PAS
 SG_ FrntRdrDetn81RdrDetnSts : 171|2@0+ (1,0) [0|3] "" ASDM,PAS
 SG_ FrntRdrDetn82_UB : 314|1@0+ (1,0) [0|1] "" ASDM,PAS
 SG_ FrntRdrDetn82RdrDetnAzi : 287|11@0+ (0.1,-90.0) [-90.0|90.0] "Deg" ASDM,PAS
 SG_ FrntRdrDetn82RdrDetnChks : 247|8@0+ (1.0,0.0) [0.0|255.0] "Unitless" ASDM,PAS
 SG_ FrntRdrDetn82RdrDetnCntr : 255|4@0+ (1.0,0.0) [0.0|15.0] "Unitless" ASDM,PAS
 SG_ FrntRdrDetn82RdrDetnConf : 311|7@0+ (1.0,0.0) [0.0|100.0] "%" ASDM,PAS
 SG_ FrntRdrDetn82RdrDetnElevn : 319|5@0+ (1.0,-15.0) [-15.0|15.0] "Deg" ASDM,PAS
 SG_ FrntRdrDetn82RdrDetnPwr : 249|9@0+ (0.1,0.0) [0.0|51.1] "dB" ASDM,PAS
 SG_ FrntRdrDetn82RdrDetnRng : 271|14@0+ (0.02,-1.0) [-1.0|200.0] "m" ASDM,PAS
 SG_ FrntRdrDetn82RdrDetnRngV : 292|13@0+ (0.02,-80.0) [-80.0|80.0] "m/s" ASDM,PAS
 SG_ FrntRdrDetn82RdrDetnSts : 251|2@0+ (1,0) [0|3] "" ASDM,PAS
 SG_ FrntRdrDetn83_UB : 394|1@0+ (1,0) [0|1] "" ASDM,PAS
 SG_ FrntRdrDetn83RdrDetnAzi : 351|11@0+ (0.1,-90.0) [-90.0|90.0] "Deg" ASDM,PAS
 SG_ FrntRdrDetn83RdrDetnChks : 327|8@0+ (1.0,0.0) [0.0|255.0] "Unitless" ASDM,PAS
 SG_ FrntRdrDetn83RdrDetnCntr : 335|4@0+ (1.0,0.0) [0.0|15.0] "Unitless" ASDM,PAS
 SG_ FrntRdrDetn83RdrDetnConf : 391|7@0+ (1.0,0.0) [0.0|100.0] "%" ASDM,PAS
 SG_ FrntRdrDetn83RdrDetnElevn : 399|5@0+ (1.0,-15.0) [-15.0|15.0] "Deg" ASDM,PAS
 SG_ FrntRdrDetn83RdrDetnPwr : 329|9@0+ (0.1,0.0) [0.0|51.1] "dB" ASDM,PAS
 SG_ FrntRdrDetn83RdrDetnRng : 375|14@0+ (0.02,-1.0) [-1.0|200.0] "m" ASDM,PAS
 SG_ FrntRdrDetn83RdrDetnRngV : 356|13@0+ (0.02,-80.0) [-80.0|80.0] "m/s" ASDM,PAS
 SG_ FrntRdrDetn83RdrDetnSts : 331|2@0+ (1,0) [0|3] "" ASDM,PAS
 SG_ FrntRdrDetn84_UB : 474|1@0+ (1,0) [0|1] "" ASDM,PAS
 SG_ FrntRdrDetn84RdrDetnAzi : 447|11@0+ (0.1,-90.0) [-90.0|90.0] "Deg" ASDM,PAS
 SG_ FrntRdrDetn84RdrDetnChks : 407|8@0+ (1.0,0.0) [0.0|255.0] "Unitless" ASDM,PAS
 SG_ FrntRdrDetn84RdrDetnCntr : 415|4@0+ (1.0,0.0) [0.0|15.0] "Unitless" ASDM,PAS
 SG_ FrntRdrDetn84RdrDetnConf : 471|7@0+ (1.0,0.0) [0.0|100.0] "%" ASDM,PAS
 SG_ FrntRdrDetn84RdrDetnElevn : 479|5@0+ (1.0,-15.0) [-15.0|15.0] "Deg" ASDM,PAS
 SG_ FrntRdrDetn84RdrDetnPwr : 409|9@0+ (0.1,0.0) [0.0|51.1] "dB" ASDM,PAS
 SG_ FrntRdrDetn84RdrDetnRng : 431|14@0+ (0.02,-1.0) [-1.0|200.0] "m" ASDM,PAS
 SG_ FrntRdrDetn84RdrDetnRngV : 452|13@0+ (0.02,-80.0) [-80.0|80.0] "m/s" ASDM,PAS
 SG_ FrntRdrDetn84RdrDetnSts : 411|2@0+ (1,0) [0|3] "" ASDM,PAS

BO_ 332 FLRSafetyCANFD2Frame15: 64 FLR
 SG_ FrntRdrDetn85_UB : 74|1@0+ (1,0) [0|1] "" ASDM,PAS
 SG_ FrntRdrDetn85RdrDetnAzi : 31|11@0+ (0.1,-90.0) [-90.0|90.0] "Deg" ASDM,PAS
 SG_ FrntRdrDetn85RdrDetnChks : 7|8@0+ (1.0,0.0) [0.0|255.0] "Unitless" ASDM,PAS
 SG_ FrntRdrDetn85RdrDetnCntr : 15|4@0+ (1.0,0.0) [0.0|15.0] "Unitless" ASDM,PAS
 SG_ FrntRdrDetn85RdrDetnConf : 71|7@0+ (1.0,0.0) [0.0|100.0] "%" ASDM,PAS
 SG_ FrntRdrDetn85RdrDetnElevn : 79|5@0+ (1.0,-15.0) [-15.0|15.0] "Deg" ASDM,PAS
 SG_ FrntRdrDetn85RdrDetnPwr : 8|9@0+ (0.1,0.0) [0.0|51.1] "dB" ASDM,PAS
 SG_ FrntRdrDetn85RdrDetnRng : 55|14@0+ (0.02,-1.0) [-1.0|200.0] "m" ASDM,PAS
 SG_ FrntRdrDetn85RdrDetnRngV : 36|13@0+ (0.02,-80.0) [-80.0|80.0] "m/s" ASDM,PAS
 SG_ FrntRdrDetn85RdrDetnSts : 11|2@0+ (1,0) [0|3] "" ASDM,PAS
 SG_ FrntRdrDetn86_UB : 154|1@0+ (1,0) [0|1] "" ASDM,PAS
 SG_ FrntRdrDetn86RdrDetnAzi : 119|11@0+ (0.1,-90.0) [-90.0|90.0] "Deg" ASDM,PAS
 SG_ FrntRdrDetn86RdrDetnChks : 87|8@0+ (1.0,0.0) [0.0|255.0] "Unitless" ASDM,PAS
 SG_ FrntRdrDetn86RdrDetnCntr : 95|4@0+ (1.0,0.0) [0.0|15.0] "Unitless" ASDM,PAS
 SG_ FrntRdrDetn86RdrDetnConf : 111|7@0+ (1.0,0.0) [0.0|100.0] "%" ASDM,PAS
 SG_ FrntRdrDetn86RdrDetnElevn : 159|5@0+ (1.0,-15.0) [-15.0|15.0] "Deg" ASDM,PAS
 SG_ FrntRdrDetn86RdrDetnPwr : 89|9@0+ (0.1,0.0) [0.0|51.1] "dB" ASDM,PAS
 SG_ FrntRdrDetn86RdrDetnRng : 143|14@0+ (0.02,-1.0) [-1.0|200.0] "m" ASDM,PAS
 SG_ FrntRdrDetn86RdrDetnRngV : 124|13@0+ (0.02,-80.0) [-80.0|80.0] "m/s" ASDM,PAS
 SG_ FrntRdrDetn86RdrDetnSts : 91|2@0+ (1,0) [0|3] "" ASDM,PAS
 SG_ FrntRdrDetn87_UB : 234|1@0+ (1,0) [0|1] "" ASDM,PAS
 SG_ FrntRdrDetn87RdrDetnAzi : 199|11@0+ (0.1,-90.0) [-90.0|90.0] "Deg" ASDM,PAS
 SG_ FrntRdrDetn87RdrDetnChks : 167|8@0+ (1.0,0.0) [0.0|255.0] "Unitless" ASDM,PAS
 SG_ FrntRdrDetn87RdrDetnCntr : 175|4@0+ (1.0,0.0) [0.0|15.0] "Unitless" ASDM,PAS
 SG_ FrntRdrDetn87RdrDetnConf : 191|7@0+ (1.0,0.0) [0.0|100.0] "%" ASDM,PAS
 SG_ FrntRdrDetn87RdrDetnElevn : 239|5@0+ (1.0,-15.0) [-15.0|15.0] "Deg" ASDM,PAS
 SG_ FrntRdrDetn87RdrDetnPwr : 169|9@0+ (0.1,0.0) [0.0|51.1] "dB" ASDM,PAS
 SG_ FrntRdrDetn87RdrDetnRng : 223|14@0+ (0.02,-1.0) [-1.0|200.0] "m" ASDM,PAS
 SG_ FrntRdrDetn87RdrDetnRngV : 204|13@0+ (0.02,-80.0) [-80.0|80.0] "m/s" ASDM,PAS
 SG_ FrntRdrDetn87RdrDetnSts : 171|2@0+ (1,0) [0|3] "" ASDM,PAS
 SG_ FrntRdrDetn88_UB : 314|1@0+ (1,0) [0|1] "" ASDM,PAS
 SG_ FrntRdrDetn88RdrDetnAzi : 287|11@0+ (0.1,-90.0) [-90.0|90.0] "Deg" ASDM,PAS
 SG_ FrntRdrDetn88RdrDetnChks : 247|8@0+ (1.0,0.0) [0.0|255.0] "Unitless" ASDM,PAS
 SG_ FrntRdrDetn88RdrDetnCntr : 255|4@0+ (1.0,0.0) [0.0|15.0] "Unitless" ASDM,PAS
 SG_ FrntRdrDetn88RdrDetnConf : 311|7@0+ (1.0,0.0) [0.0|100.0] "%" ASDM,PAS
 SG_ FrntRdrDetn88RdrDetnElevn : 319|5@0+ (1.0,-15.0) [-15.0|15.0] "Deg" ASDM,PAS
 SG_ FrntRdrDetn88RdrDetnPwr : 249|9@0+ (0.1,0.0) [0.0|51.1] "dB" ASDM,PAS
 SG_ FrntRdrDetn88RdrDetnRng : 271|14@0+ (0.02,-1.0) [-1.0|200.0] "m" ASDM,PAS
 SG_ FrntRdrDetn88RdrDetnRngV : 292|13@0+ (0.02,-80.0) [-80.0|80.0] "m/s" ASDM,PAS
 SG_ FrntRdrDetn88RdrDetnSts : 251|2@0+ (1,0) [0|3] "" ASDM,PAS
 SG_ FrntRdrDetn89_UB : 394|1@0+ (1,0) [0|1] "" ASDM,PAS
 SG_ FrntRdrDetn89RdrDetnAzi : 351|11@0+ (0.1,-90.0) [-90.0|90.0] "Deg" ASDM,PAS
 SG_ FrntRdrDetn89RdrDetnChks : 327|8@0+ (1.0,0.0) [0.0|255.0] "Unitless" ASDM,PAS
 SG_ FrntRdrDetn89RdrDetnCntr : 335|4@0+ (1.0,0.0) [0.0|15.0] "Unitless" ASDM,PAS
 SG_ FrntRdrDetn89RdrDetnConf : 391|7@0+ (1.0,0.0) [0.0|100.0] "%" ASDM,PAS
 SG_ FrntRdrDetn89RdrDetnElevn : 399|5@0+ (1.0,-15.0) [-15.0|15.0] "Deg" ASDM,PAS
 SG_ FrntRdrDetn89RdrDetnPwr : 329|9@0+ (0.1,0.0) [0.0|51.1] "dB" ASDM,PAS
 SG_ FrntRdrDetn89RdrDetnRng : 375|14@0+ (0.02,-1.0) [-1.0|200.0] "m" ASDM,PAS
 SG_ FrntRdrDetn89RdrDetnRngV : 356|13@0+ (0.02,-80.0) [-80.0|80.0] "m/s" ASDM,PAS
 SG_ FrntRdrDetn89RdrDetnSts : 331|2@0+ (1,0) [0|3] "" ASDM,PAS
 SG_ FrntRdrDetn90_UB : 474|1@0+ (1,0) [0|1] "" ASDM,PAS
 SG_ FrntRdrDetn90RdrDetnAzi : 447|11@0+ (0.1,-90.0) [-90.0|90.0] "Deg" ASDM,PAS
 SG_ FrntRdrDetn90RdrDetnChks : 407|8@0+ (1.0,0.0) [0.0|255.0] "Unitless" ASDM,PAS
 SG_ FrntRdrDetn90RdrDetnCntr : 415|4@0+ (1.0,0.0) [0.0|15.0] "Unitless" ASDM,PAS
 SG_ FrntRdrDetn90RdrDetnConf : 471|7@0+ (1.0,0.0) [0.0|100.0] "%" ASDM,PAS
 SG_ FrntRdrDetn90RdrDetnElevn : 479|5@0+ (1.0,-15.0) [-15.0|15.0] "Deg" ASDM,PAS
 SG_ FrntRdrDetn90RdrDetnPwr : 409|9@0+ (0.1,0.0) [0.0|51.1] "dB" ASDM,PAS
 SG_ FrntRdrDetn90RdrDetnRng : 431|14@0+ (0.02,-1.0) [-1.0|200.0] "m" ASDM,PAS
 SG_ FrntRdrDetn90RdrDetnRngV : 452|13@0+ (0.02,-80.0) [-80.0|80.0] "m/s" ASDM,PAS
 SG_ FrntRdrDetn90RdrDetnSts : 411|2@0+ (1,0) [0|3] "" ASDM,PAS

BO_ 334 FLRSafetyCANFD2Frame16: 64 FLR
 SG_ FrntRdrDetn91_UB : 74|1@0+ (1,0) [0|1] "" ASDM,PAS
 SG_ FrntRdrDetn91RdrDetnAzi : 31|11@0+ (0.1,-90.0) [-90.0|90.0] "Deg" ASDM,PAS
 SG_ FrntRdrDetn91RdrDetnChks : 7|8@0+ (1.0,0.0) [0.0|255.0] "Unitless" ASDM,PAS
 SG_ FrntRdrDetn91RdrDetnCntr : 15|4@0+ (1.0,0.0) [0.0|15.0] "Unitless" ASDM,PAS
 SG_ FrntRdrDetn91RdrDetnConf : 71|7@0+ (1.0,0.0) [0.0|100.0] "%" ASDM,PAS
 SG_ FrntRdrDetn91RdrDetnElevn : 79|5@0+ (1.0,-15.0) [-15.0|15.0] "Deg" ASDM,PAS
 SG_ FrntRdrDetn91RdrDetnPwr : 8|9@0+ (0.1,0.0) [0.0|51.1] "dB" ASDM,PAS
 SG_ FrntRdrDetn91RdrDetnRng : 55|14@0+ (0.02,-1.0) [-1.0|200.0] "m" ASDM,PAS
 SG_ FrntRdrDetn91RdrDetnRngV : 36|13@0+ (0.02,-80.0) [-80.0|80.0] "m/s" ASDM,PAS
 SG_ FrntRdrDetn91RdrDetnSts : 11|2@0+ (1,0) [0|3] "" ASDM,PAS
 SG_ FrntRdrDetn92_UB : 154|1@0+ (1,0) [0|1] "" ASDM,PAS
 SG_ FrntRdrDetn92RdrDetnAzi : 119|11@0+ (0.1,-90.0) [-90.0|90.0] "Deg" ASDM,PAS
 SG_ FrntRdrDetn92RdrDetnChks : 87|8@0+ (1.0,0.0) [0.0|255.0] "Unitless" ASDM,PAS
 SG_ FrntRdrDetn92RdrDetnCntr : 95|4@0+ (1.0,0.0) [0.0|15.0] "Unitless" ASDM,PAS
 SG_ FrntRdrDetn92RdrDetnConf : 111|7@0+ (1.0,0.0) [0.0|100.0] "%" ASDM,PAS
 SG_ FrntRdrDetn92RdrDetnElevn : 159|5@0+ (1.0,-15.0) [-15.0|15.0] "Deg" ASDM,PAS
 SG_ FrntRdrDetn92RdrDetnPwr : 89|9@0+ (0.1,0.0) [0.0|51.1] "dB" ASDM,PAS
 SG_ FrntRdrDetn92RdrDetnRng : 143|14@0+ (0.02,-1.0) [-1.0|200.0] "m" ASDM,PAS
 SG_ FrntRdrDetn92RdrDetnRngV : 124|13@0+ (0.02,-80.0) [-80.0|80.0] "m/s" ASDM,PAS
 SG_ FrntRdrDetn92RdrDetnSts : 91|2@0+ (1,0) [0|3] "" ASDM,PAS
 SG_ FrntRdrDetn93_UB : 234|1@0+ (1,0) [0|1] "" ASDM,PAS
 SG_ FrntRdrDetn93RdrDetnAzi : 199|11@0+ (0.1,-90.0) [-90.0|90.0] "Deg" ASDM,PAS
 SG_ FrntRdrDetn93RdrDetnChks : 167|8@0+ (1.0,0.0) [0.0|255.0] "Unitless" ASDM,PAS
 SG_ FrntRdrDetn93RdrDetnCntr : 175|4@0+ (1.0,0.0) [0.0|15.0] "Unitless" ASDM,PAS
 SG_ FrntRdrDetn93RdrDetnConf : 191|7@0+ (1.0,0.0) [0.0|100.0] "%" ASDM,PAS
 SG_ FrntRdrDetn93RdrDetnElevn : 239|5@0+ (1.0,-15.0) [-15.0|15.0] "Deg" ASDM,PAS
 SG_ FrntRdrDetn93RdrDetnPwr : 169|9@0+ (0.1,0.0) [0.0|51.1] "dB" ASDM,PAS
 SG_ FrntRdrDetn93RdrDetnRng : 223|14@0+ (0.02,-1.0) [-1.0|200.0] "m" ASDM,PAS
 SG_ FrntRdrDetn93RdrDetnRngV : 204|13@0+ (0.02,-80.0) [-80.0|80.0] "m/s" ASDM,PAS
 SG_ FrntRdrDetn93RdrDetnSts : 171|2@0+ (1,0) [0|3] "" ASDM,PAS
 SG_ FrntRdrDetn94_UB : 314|1@0+ (1,0) [0|1] "" ASDM,PAS
 SG_ FrntRdrDetn94RdrDetnAzi : 287|11@0+ (0.1,-90.0) [-90.0|90.0] "Deg" ASDM,PAS
 SG_ FrntRdrDetn94RdrDetnChks : 247|8@0+ (1.0,0.0) [0.0|255.0] "Unitless" ASDM,PAS
 SG_ FrntRdrDetn94RdrDetnCntr : 255|4@0+ (1.0,0.0) [0.0|15.0] "Unitless" ASDM,PAS
 SG_ FrntRdrDetn94RdrDetnConf : 311|7@0+ (1.0,0.0) [0.0|100.0] "%" ASDM,PAS
 SG_ FrntRdrDetn94RdrDetnElevn : 319|5@0+ (1.0,-15.0) [-15.0|15.0] "Deg" ASDM,PAS
 SG_ FrntRdrDetn94RdrDetnPwr : 249|9@0+ (0.1,0.0) [0.0|51.1] "dB" ASDM,PAS
 SG_ FrntRdrDetn94RdrDetnRng : 271|14@0+ (0.02,-1.0) [-1.0|200.0] "m" ASDM,PAS
 SG_ FrntRdrDetn94RdrDetnRngV : 292|13@0+ (0.02,-80.0) [-80.0|80.0] "m/s" ASDM,PAS
 SG_ FrntRdrDetn94RdrDetnSts : 251|2@0+ (1,0) [0|3] "" ASDM,PAS
 SG_ FrntRdrDetn95_UB : 394|1@0+ (1,0) [0|1] "" ASDM,PAS
 SG_ FrntRdrDetn95RdrDetnAzi : 351|11@0+ (0.1,-90.0) [-90.0|90.0] "Deg" ASDM,PAS
 SG_ FrntRdrDetn95RdrDetnChks : 327|8@0+ (1.0,0.0) [0.0|255.0] "Unitless" ASDM,PAS
 SG_ FrntRdrDetn95RdrDetnCntr : 335|4@0+ (1.0,0.0) [0.0|15.0] "Unitless" ASDM,PAS
 SG_ FrntRdrDetn95RdrDetnConf : 391|7@0+ (1.0,0.0) [0.0|100.0] "%" ASDM,PAS
 SG_ FrntRdrDetn95RdrDetnElevn : 399|5@0+ (1.0,-15.0) [-15.0|15.0] "Deg" ASDM,PAS
 SG_ FrntRdrDetn95RdrDetnPwr : 329|9@0+ (0.1,0.0) [0.0|51.1] "dB" ASDM,PAS
 SG_ FrntRdrDetn95RdrDetnRng : 375|14@0+ (0.02,-1.0) [-1.0|200.0] "m" ASDM,PAS
 SG_ FrntRdrDetn95RdrDetnRngV : 356|13@0+ (0.02,-80.0) [-80.0|80.0] "m/s" ASDM,PAS
 SG_ FrntRdrDetn95RdrDetnSts : 331|2@0+ (1,0) [0|3] "" ASDM,PAS
 SG_ FrntRdrDetn96_UB : 474|1@0+ (1,0) [0|1] "" ASDM,PAS
 SG_ FrntRdrDetn96RdrDetnAzi : 447|11@0+ (0.1,-90.0) [-90.0|90.0] "Deg" ASDM,PAS
 SG_ FrntRdrDetn96RdrDetnChks : 407|8@0+ (1.0,0.0) [0.0|255.0] "Unitless" ASDM,PAS
 SG_ FrntRdrDetn96RdrDetnCntr : 415|4@0+ (1.0,0.0) [0.0|15.0] "Unitless" ASDM,PAS
 SG_ FrntRdrDetn96RdrDetnConf : 471|7@0+ (1.0,0.0) [0.0|100.0] "%" ASDM,PAS
 SG_ FrntRdrDetn96RdrDetnElevn : 479|5@0+ (1.0,-15.0) [-15.0|15.0] "Deg" ASDM,PAS
 SG_ FrntRdrDetn96RdrDetnPwr : 409|9@0+ (0.1,0.0) [0.0|51.1] "dB" ASDM,PAS
 SG_ FrntRdrDetn96RdrDetnRng : 431|14@0+ (0.02,-1.0) [-1.0|200.0] "m" ASDM,PAS
 SG_ FrntRdrDetn96RdrDetnRngV : 452|13@0+ (0.02,-80.0) [-80.0|80.0] "m/s" ASDM,PAS
 SG_ FrntRdrDetn96RdrDetnSts : 411|2@0+ (1,0) [0|3] "" ASDM,PAS

BO_ 336 FLRSafetyCANFD2Frame17: 64 FLR
 SG_ FrntRdrDetn100_UB : 74|1@0+ (1,0) [0|1] "" ASDM,PAS
 SG_ FrntRdrDetn100RdrDetnAzi : 31|11@0+ (0.1,-90.0) [-90.0|90.0] "Deg" ASDM,PAS
 SG_ FrntRdrDetn100RdrDetnChks : 7|8@0+ (1.0,0.0) [0.0|255.0] "Unitless" ASDM,PAS
 SG_ FrntRdrDetn100RdrDetnCntr : 15|4@0+ (1.0,0.0) [0.0|15.0] "Unitless" ASDM,PAS
 SG_ FrntRdrDetn100RdrDetnConf : 71|7@0+ (1.0,0.0) [0.0|100.0] "%" ASDM,PAS
 SG_ FrntRdrDetn100RdrDetnElevn : 79|5@0+ (1.0,-15.0) [-15.0|15.0] "Deg" ASDM,PAS
 SG_ FrntRdrDetn100RdrDetnPwr : 8|9@0+ (0.1,0.0) [0.0|51.1] "dB" ASDM,PAS
 SG_ FrntRdrDetn100RdrDetnRng : 55|14@0+ (0.02,-1.0) [-1.0|200.0] "m" ASDM,PAS
 SG_ FrntRdrDetn100RdrDetnRngV : 36|13@0+ (0.02,-80.0) [-80.0|80.0] "m/s" ASDM,PAS
 SG_ FrntRdrDetn100RdrDetnSts : 11|2@0+ (1,0) [0|3] "" ASDM,PAS
 SG_ FrntRdrDetn101_UB : 154|1@0+ (1,0) [0|1] "" ASDM,PAS
 SG_ FrntRdrDetn101RdrDetnAzi : 119|11@0+ (0.1,-90.0) [-90.0|90.0] "Deg" ASDM,PAS
 SG_ FrntRdrDetn101RdrDetnChks : 87|8@0+ (1.0,0.0) [0.0|255.0] "Unitless" ASDM,PAS
 SG_ FrntRdrDetn101RdrDetnCntr : 95|4@0+ (1.0,0.0) [0.0|15.0] "Unitless" ASDM,PAS
 SG_ FrntRdrDetn101RdrDetnConf : 111|7@0+ (1.0,0.0) [0.0|100.0] "%" ASDM,PAS
 SG_ FrntRdrDetn101RdrDetnElevn : 159|5@0+ (1.0,-15.0) [-15.0|15.0] "Deg" ASDM,PAS
 SG_ FrntRdrDetn101RdrDetnPwr : 89|9@0+ (0.1,0.0) [0.0|51.1] "dB" ASDM,PAS
 SG_ FrntRdrDetn101RdrDetnRng : 143|14@0+ (0.02,-1.0) [-1.0|200.0] "m" ASDM,PAS
 SG_ FrntRdrDetn101RdrDetnRngV : 124|13@0+ (0.02,-80.0) [-80.0|80.0] "m/s" ASDM,PAS
 SG_ FrntRdrDetn101RdrDetnSts : 91|2@0+ (1,0) [0|3] "" ASDM,PAS
 SG_ FrntRdrDetn102_UB : 234|1@0+ (1,0) [0|1] "" ASDM,PAS
 SG_ FrntRdrDetn102RdrDetnAzi : 199|11@0+ (0.1,-90.0) [-90.0|90.0] "Deg" ASDM,PAS
 SG_ FrntRdrDetn102RdrDetnChks : 167|8@0+ (1.0,0.0) [0.0|255.0] "Unitless" ASDM,PAS
 SG_ FrntRdrDetn102RdrDetnCntr : 175|4@0+ (1.0,0.0) [0.0|15.0] "Unitless" ASDM,PAS
 SG_ FrntRdrDetn102RdrDetnConf : 191|7@0+ (1.0,0.0) [0.0|100.0] "%" ASDM,PAS
 SG_ FrntRdrDetn102RdrDetnElevn : 239|5@0+ (1.0,-15.0) [-15.0|15.0] "Deg" ASDM,PAS
 SG_ FrntRdrDetn102RdrDetnPwr : 169|9@0+ (0.1,0.0) [0.0|51.1] "dB" ASDM,PAS
 SG_ FrntRdrDetn102RdrDetnRng : 223|14@0+ (0.02,-1.0) [-1.0|200.0] "m" ASDM,PAS
 SG_ FrntRdrDetn102RdrDetnRngV : 204|13@0+ (0.02,-80.0) [-80.0|80.0] "m/s" ASDM,PAS
 SG_ FrntRdrDetn102RdrDetnSts : 171|2@0+ (1,0) [0|3] "" ASDM,PAS
 SG_ FrntRdrDetn97_UB : 314|1@0+ (1,0) [0|1] "" ASDM,PAS
 SG_ FrntRdrDetn97RdrDetnAzi : 287|11@0+ (0.1,-90.0) [-90.0|90.0] "Deg" ASDM,PAS
 SG_ FrntRdrDetn97RdrDetnChks : 247|8@0+ (1.0,0.0) [0.0|255.0] "Unitless" ASDM,PAS
 SG_ FrntRdrDetn97RdrDetnCntr : 255|4@0+ (1.0,0.0) [0.0|15.0] "Unitless" ASDM,PAS
 SG_ FrntRdrDetn97RdrDetnConf : 311|7@0+ (1.0,0.0) [0.0|100.0] "%" ASDM,PAS
 SG_ FrntRdrDetn97RdrDetnElevn : 319|5@0+ (1.0,-15.0) [-15.0|15.0] "Deg" ASDM,PAS
 SG_ FrntRdrDetn97RdrDetnPwr : 249|9@0+ (0.1,0.0) [0.0|51.1] "dB" ASDM,PAS
 SG_ FrntRdrDetn97RdrDetnRng : 271|14@0+ (0.02,-1.0) [-1.0|200.0] "m" ASDM,PAS
 SG_ FrntRdrDetn97RdrDetnRngV : 292|13@0+ (0.02,-80.0) [-80.0|80.0] "m/s" ASDM,PAS
 SG_ FrntRdrDetn97RdrDetnSts : 251|2@0+ (1,0) [0|3] "" ASDM,PAS
 SG_ FrntRdrDetn98_UB : 394|1@0+ (1,0) [0|1] "" ASDM,PAS
 SG_ FrntRdrDetn98RdrDetnAzi : 351|11@0+ (0.1,-90.0) [-90.0|90.0] "Deg" ASDM,PAS
 SG_ FrntRdrDetn98RdrDetnChks : 327|8@0+ (1.0,0.0) [0.0|255.0] "Unitless" ASDM,PAS
 SG_ FrntRdrDetn98RdrDetnCntr : 335|4@0+ (1.0,0.0) [0.0|15.0] "Unitless" ASDM,PAS
 SG_ FrntRdrDetn98RdrDetnConf : 391|7@0+ (1.0,0.0) [0.0|100.0] "%" ASDM,PAS
 SG_ FrntRdrDetn98RdrDetnElevn : 399|5@0+ (1.0,-15.0) [-15.0|15.0] "Deg" ASDM,PAS
 SG_ FrntRdrDetn98RdrDetnPwr : 329|9@0+ (0.1,0.0) [0.0|51.1] "dB" ASDM,PAS
 SG_ FrntRdrDetn98RdrDetnRng : 375|14@0+ (0.02,-1.0) [-1.0|200.0] "m" ASDM,PAS
 SG_ FrntRdrDetn98RdrDetnRngV : 356|13@0+ (0.02,-80.0) [-80.0|80.0] "m/s" ASDM,PAS
 SG_ FrntRdrDetn98RdrDetnSts : 331|2@0+ (1,0) [0|3] "" ASDM,PAS
 SG_ FrntRdrDetn99_UB : 474|1@0+ (1,0) [0|1] "" ASDM,PAS
 SG_ FrntRdrDetn99RdrDetnAzi : 447|11@0+ (0.1,-90.0) [-90.0|90.0] "Deg" ASDM,PAS
 SG_ FrntRdrDetn99RdrDetnChks : 407|8@0+ (1.0,0.0) [0.0|255.0] "Unitless" ASDM,PAS
 SG_ FrntRdrDetn99RdrDetnCntr : 415|4@0+ (1.0,0.0) [0.0|15.0] "Unitless" ASDM,PAS
 SG_ FrntRdrDetn99RdrDetnConf : 471|7@0+ (1.0,0.0) [0.0|100.0] "%" ASDM,PAS
 SG_ FrntRdrDetn99RdrDetnElevn : 479|5@0+ (1.0,-15.0) [-15.0|15.0] "Deg" ASDM,PAS
 SG_ FrntRdrDetn99RdrDetnPwr : 409|9@0+ (0.1,0.0) [0.0|51.1] "dB" ASDM,PAS
 SG_ FrntRdrDetn99RdrDetnRng : 431|14@0+ (0.02,-1.0) [-1.0|200.0] "m" ASDM,PAS
 SG_ FrntRdrDetn99RdrDetnRngV : 452|13@0+ (0.02,-80.0) [-80.0|80.0] "m/s" ASDM,PAS
 SG_ FrntRdrDetn99RdrDetnSts : 411|2@0+ (1,0) [0|3] "" ASDM,PAS

BO_ 338 FLRSafetyCANFD2Frame18: 64 FLR
 SG_ FrntRdrDetn103_UB : 74|1@0+ (1,0) [0|1] "" ASDM,PAS
 SG_ FrntRdrDetn103RdrDetnAzi : 31|11@0+ (0.1,-90.0) [-90.0|90.0] "Deg" ASDM,PAS
 SG_ FrntRdrDetn103RdrDetnChks : 7|8@0+ (1.0,0.0) [0.0|255.0] "Unitless" ASDM,PAS
 SG_ FrntRdrDetn103RdrDetnCntr : 15|4@0+ (1.0,0.0) [0.0|15.0] "Unitless" ASDM,PAS
 SG_ FrntRdrDetn103RdrDetnConf : 71|7@0+ (1.0,0.0) [0.0|100.0] "%" ASDM,PAS
 SG_ FrntRdrDetn103RdrDetnElevn : 79|5@0+ (1.0,-15.0) [-15.0|15.0] "Deg" ASDM,PAS
 SG_ FrntRdrDetn103RdrDetnPwr : 8|9@0+ (0.1,0.0) [0.0|51.1] "dB" ASDM,PAS
 SG_ FrntRdrDetn103RdrDetnRng : 55|14@0+ (0.02,-1.0) [-1.0|200.0] "m" ASDM,PAS
 SG_ FrntRdrDetn103RdrDetnRngV : 36|13@0+ (0.02,-80.0) [-80.0|80.0] "m/s" ASDM,PAS
 SG_ FrntRdrDetn103RdrDetnSts : 11|2@0+ (1,0) [0|3] "" ASDM,PAS
 SG_ FrntRdrDetn104_UB : 154|1@0+ (1,0) [0|1] "" ASDM,PAS
 SG_ FrntRdrDetn104RdrDetnAzi : 119|11@0+ (0.1,-90.0) [-90.0|90.0] "Deg" ASDM,PAS
 SG_ FrntRdrDetn104RdrDetnChks : 87|8@0+ (1.0,0.0) [0.0|255.0] "Unitless" ASDM,PAS
 SG_ FrntRdrDetn104RdrDetnCntr : 95|4@0+ (1.0,0.0) [0.0|15.0] "Unitless" ASDM,PAS
 SG_ FrntRdrDetn104RdrDetnConf : 111|7@0+ (1.0,0.0) [0.0|100.0] "%" ASDM,PAS
 SG_ FrntRdrDetn104RdrDetnElevn : 159|5@0+ (1.0,-15.0) [-15.0|15.0] "Deg" ASDM,PAS
 SG_ FrntRdrDetn104RdrDetnPwr : 89|9@0+ (0.1,0.0) [0.0|51.1] "dB" ASDM,PAS
 SG_ FrntRdrDetn104RdrDetnRng : 143|14@0+ (0.02,-1.0) [-1.0|200.0] "m" ASDM,PAS
 SG_ FrntRdrDetn104RdrDetnRngV : 124|13@0+ (0.02,-80.0) [-80.0|80.0] "m/s" ASDM,PAS
 SG_ FrntRdrDetn104RdrDetnSts : 91|2@0+ (1,0) [0|3] "" ASDM,PAS
 SG_ FrntRdrDetn105_UB : 234|1@0+ (1,0) [0|1] "" ASDM,PAS
 SG_ FrntRdrDetn105RdrDetnAzi : 199|11@0+ (0.1,-90.0) [-90.0|90.0] "Deg" ASDM,PAS
 SG_ FrntRdrDetn105RdrDetnChks : 167|8@0+ (1.0,0.0) [0.0|255.0] "Unitless" ASDM,PAS
 SG_ FrntRdrDetn105RdrDetnCntr : 175|4@0+ (1.0,0.0) [0.0|15.0] "Unitless" ASDM,PAS
 SG_ FrntRdrDetn105RdrDetnConf : 191|7@0+ (1.0,0.0) [0.0|100.0] "%" ASDM,PAS
 SG_ FrntRdrDetn105RdrDetnElevn : 239|5@0+ (1.0,-15.0) [-15.0|15.0] "Deg" ASDM,PAS
 SG_ FrntRdrDetn105RdrDetnPwr : 169|9@0+ (0.1,0.0) [0.0|51.1] "dB" ASDM,PAS
 SG_ FrntRdrDetn105RdrDetnRng : 223|14@0+ (0.02,-1.0) [-1.0|200.0] "m" ASDM,PAS
 SG_ FrntRdrDetn105RdrDetnRngV : 204|13@0+ (0.02,-80.0) [-80.0|80.0] "m/s" ASDM,PAS
 SG_ FrntRdrDetn105RdrDetnSts : 171|2@0+ (1,0) [0|3] "" ASDM,PAS
 SG_ FrntRdrDetn106_UB : 314|1@0+ (1,0) [0|1] "" ASDM,PAS
 SG_ FrntRdrDetn106RdrDetnAzi : 287|11@0+ (0.1,-90.0) [-90.0|90.0] "Deg" ASDM,PAS
 SG_ FrntRdrDetn106RdrDetnChks : 247|8@0+ (1.0,0.0) [0.0|255.0] "Unitless" ASDM,PAS
 SG_ FrntRdrDetn106RdrDetnCntr : 255|4@0+ (1.0,0.0) [0.0|15.0] "Unitless" ASDM,PAS
 SG_ FrntRdrDetn106RdrDetnConf : 311|7@0+ (1.0,0.0) [0.0|100.0] "%" ASDM,PAS
 SG_ FrntRdrDetn106RdrDetnElevn : 319|5@0+ (1.0,-15.0) [-15.0|15.0] "Deg" ASDM,PAS
 SG_ FrntRdrDetn106RdrDetnPwr : 249|9@0+ (0.1,0.0) [0.0|51.1] "dB" ASDM,PAS
 SG_ FrntRdrDetn106RdrDetnRng : 271|14@0+ (0.02,-1.0) [-1.0|200.0] "m" ASDM,PAS
 SG_ FrntRdrDetn106RdrDetnRngV : 292|13@0+ (0.02,-80.0) [-80.0|80.0] "m/s" ASDM,PAS
 SG_ FrntRdrDetn106RdrDetnSts : 251|2@0+ (1,0) [0|3] "" ASDM,PAS
 SG_ FrntRdrDetn107_UB : 394|1@0+ (1,0) [0|1] "" ASDM,PAS
 SG_ FrntRdrDetn107RdrDetnAzi : 351|11@0+ (0.1,-90.0) [-90.0|90.0] "Deg" ASDM,PAS
 SG_ FrntRdrDetn107RdrDetnChks : 327|8@0+ (1.0,0.0) [0.0|255.0] "Unitless" ASDM,PAS
 SG_ FrntRdrDetn107RdrDetnCntr : 335|4@0+ (1.0,0.0) [0.0|15.0] "Unitless" ASDM,PAS
 SG_ FrntRdrDetn107RdrDetnConf : 391|7@0+ (1.0,0.0) [0.0|100.0] "%" ASDM,PAS
 SG_ FrntRdrDetn107RdrDetnElevn : 399|5@0+ (1.0,-15.0) [-15.0|15.0] "Deg" ASDM,PAS
 SG_ FrntRdrDetn107RdrDetnPwr : 329|9@0+ (0.1,0.0) [0.0|51.1] "dB" ASDM,PAS
 SG_ FrntRdrDetn107RdrDetnRng : 375|14@0+ (0.02,-1.0) [-1.0|200.0] "m" ASDM,PAS
 SG_ FrntRdrDetn107RdrDetnRngV : 356|13@0+ (0.02,-80.0) [-80.0|80.0] "m/s" ASDM,PAS
 SG_ FrntRdrDetn107RdrDetnSts : 331|2@0+ (1,0) [0|3] "" ASDM,PAS
 SG_ FrntRdrDetn108_UB : 474|1@0+ (1,0) [0|1] "" ASDM,PAS
 SG_ FrntRdrDetn108RdrDetnAzi : 447|11@0+ (0.1,-90.0) [-90.0|90.0] "Deg" ASDM,PAS
 SG_ FrntRdrDetn108RdrDetnChks : 407|8@0+ (1.0,0.0) [0.0|255.0] "Unitless" ASDM,PAS
 SG_ FrntRdrDetn108RdrDetnCntr : 415|4@0+ (1.0,0.0) [0.0|15.0] "Unitless" ASDM,PAS
 SG_ FrntRdrDetn108RdrDetnConf : 471|7@0+ (1.0,0.0) [0.0|100.0] "%" ASDM,PAS
 SG_ FrntRdrDetn108RdrDetnElevn : 479|5@0+ (1.0,-15.0) [-15.0|15.0] "Deg" ASDM,PAS
 SG_ FrntRdrDetn108RdrDetnPwr : 409|9@0+ (0.1,0.0) [0.0|51.1] "dB" ASDM,PAS
 SG_ FrntRdrDetn108RdrDetnRng : 431|14@0+ (0.02,-1.0) [-1.0|200.0] "m" ASDM,PAS
 SG_ FrntRdrDetn108RdrDetnRngV : 452|13@0+ (0.02,-80.0) [-80.0|80.0] "m/s" ASDM,PAS
 SG_ FrntRdrDetn108RdrDetnSts : 411|2@0+ (1,0) [0|3] "" ASDM,PAS

BO_ 340 FLRSafetyCANFD2Frame19: 64 FLR
 SG_ FrntRdrDetn109_UB : 74|1@0+ (1,0) [0|1] "" ASDM,PAS
 SG_ FrntRdrDetn109RdrDetnAzi : 31|11@0+ (0.1,-90.0) [-90.0|90.0] "Deg" ASDM,PAS
 SG_ FrntRdrDetn109RdrDetnChks : 7|8@0+ (1.0,0.0) [0.0|255.0] "Unitless" ASDM,PAS
 SG_ FrntRdrDetn109RdrDetnCntr : 15|4@0+ (1.0,0.0) [0.0|15.0] "Unitless" ASDM,PAS
 SG_ FrntRdrDetn109RdrDetnConf : 71|7@0+ (1.0,0.0) [0.0|100.0] "%" ASDM,PAS
 SG_ FrntRdrDetn109RdrDetnElevn : 79|5@0+ (1.0,-15.0) [-15.0|15.0] "Deg" ASDM,PAS
 SG_ FrntRdrDetn109RdrDetnPwr : 8|9@0+ (0.1,0.0) [0.0|51.1] "dB" ASDM,PAS
 SG_ FrntRdrDetn109RdrDetnRng : 55|14@0+ (0.02,-1.0) [-1.0|200.0] "m" ASDM,PAS
 SG_ FrntRdrDetn109RdrDetnRngV : 36|13@0+ (0.02,-80.0) [-80.0|80.0] "m/s" ASDM,PAS
 SG_ FrntRdrDetn109RdrDetnSts : 11|2@0+ (1,0) [0|3] "" ASDM,PAS
 SG_ FrntRdrDetn110_UB : 154|1@0+ (1,0) [0|1] "" ASDM,PAS
 SG_ FrntRdrDetn110RdrDetnAzi : 119|11@0+ (0.1,-90.0) [-90.0|90.0] "Deg" ASDM,PAS
 SG_ FrntRdrDetn110RdrDetnChks : 87|8@0+ (1.0,0.0) [0.0|255.0] "Unitless" ASDM,PAS
 SG_ FrntRdrDetn110RdrDetnCntr : 95|4@0+ (1.0,0.0) [0.0|15.0] "Unitless" ASDM,PAS
 SG_ FrntRdrDetn110RdrDetnConf : 111|7@0+ (1.0,0.0) [0.0|100.0] "%" ASDM,PAS
 SG_ FrntRdrDetn110RdrDetnElevn : 159|5@0+ (1.0,-15.0) [-15.0|15.0] "Deg" ASDM,PAS
 SG_ FrntRdrDetn110RdrDetnPwr : 89|9@0+ (0.1,0.0) [0.0|51.1] "dB" ASDM,PAS
 SG_ FrntRdrDetn110RdrDetnRng : 143|14@0+ (0.02,-1.0) [-1.0|200.0] "m" ASDM,PAS
 SG_ FrntRdrDetn110RdrDetnRngV : 124|13@0+ (0.02,-80.0) [-80.0|80.0] "m/s" ASDM,PAS
 SG_ FrntRdrDetn110RdrDetnSts : 91|2@0+ (1,0) [0|3] "" ASDM,PAS
 SG_ FrntRdrDetn111_UB : 234|1@0+ (1,0) [0|1] "" ASDM,PAS
 SG_ FrntRdrDetn111RdrDetnAzi : 199|11@0+ (0.1,-90.0) [-90.0|90.0] "Deg" ASDM,PAS
 SG_ FrntRdrDetn111RdrDetnChks : 167|8@0+ (1.0,0.0) [0.0|255.0] "Unitless" ASDM,PAS
 SG_ FrntRdrDetn111RdrDetnCntr : 175|4@0+ (1.0,0.0) [0.0|15.0] "Unitless" ASDM,PAS
 SG_ FrntRdrDetn111RdrDetnConf : 191|7@0+ (1.0,0.0) [0.0|100.0] "%" ASDM,PAS
 SG_ FrntRdrDetn111RdrDetnElevn : 239|5@0+ (1.0,-15.0) [-15.0|15.0] "Deg" ASDM,PAS
 SG_ FrntRdrDetn111RdrDetnPwr : 169|9@0+ (0.1,0.0) [0.0|51.1] "dB" ASDM,PAS
 SG_ FrntRdrDetn111RdrDetnRng : 223|14@0+ (0.02,-1.0) [-1.0|200.0] "m" ASDM,PAS
 SG_ FrntRdrDetn111RdrDetnRngV : 204|13@0+ (0.02,-80.0) [-80.0|80.0] "m/s" ASDM,PAS
 SG_ FrntRdrDetn111RdrDetnSts : 171|2@0+ (1,0) [0|3] "" ASDM,PAS
 SG_ FrntRdrDetn112_UB : 314|1@0+ (1,0) [0|1] "" ASDM,PAS
 SG_ FrntRdrDetn112RdrDetnAzi : 287|11@0+ (0.1,-90.0) [-90.0|90.0] "Deg" ASDM,PAS
 SG_ FrntRdrDetn112RdrDetnChks : 247|8@0+ (1.0,0.0) [0.0|255.0] "Unitless" ASDM,PAS
 SG_ FrntRdrDetn112RdrDetnCntr : 255|4@0+ (1.0,0.0) [0.0|15.0] "Unitless" ASDM,PAS
 SG_ FrntRdrDetn112RdrDetnConf : 311|7@0+ (1.0,0.0) [0.0|100.0] "%" ASDM,PAS
 SG_ FrntRdrDetn112RdrDetnElevn : 319|5@0+ (1.0,-15.0) [-15.0|15.0] "Deg" ASDM,PAS
 SG_ FrntRdrDetn112RdrDetnPwr : 249|9@0+ (0.1,0.0) [0.0|51.1] "dB" ASDM,PAS
 SG_ FrntRdrDetn112RdrDetnRng : 271|14@0+ (0.02,-1.0) [-1.0|200.0] "m" ASDM,PAS
 SG_ FrntRdrDetn112RdrDetnRngV : 292|13@0+ (0.02,-80.0) [-80.0|80.0] "m/s" ASDM,PAS
 SG_ FrntRdrDetn112RdrDetnSts : 251|2@0+ (1,0) [0|3] "" ASDM,PAS
 SG_ FrntRdrDetn113_UB : 394|1@0+ (1,0) [0|1] "" ASDM,PAS
 SG_ FrntRdrDetn113RdrDetnAzi : 351|11@0+ (0.1,-90.0) [-90.0|90.0] "Deg" ASDM,PAS
 SG_ FrntRdrDetn113RdrDetnChks : 327|8@0+ (1.0,0.0) [0.0|255.0] "Unitless" ASDM,PAS
 SG_ FrntRdrDetn113RdrDetnCntr : 335|4@0+ (1.0,0.0) [0.0|15.0] "Unitless" ASDM,PAS
 SG_ FrntRdrDetn113RdrDetnConf : 391|7@0+ (1.0,0.0) [0.0|100.0] "%" ASDM,PAS
 SG_ FrntRdrDetn113RdrDetnElevn : 399|5@0+ (1.0,-15.0) [-15.0|15.0] "Deg" ASDM,PAS
 SG_ FrntRdrDetn113RdrDetnPwr : 329|9@0+ (0.1,0.0) [0.0|51.1] "dB" ASDM,PAS
 SG_ FrntRdrDetn113RdrDetnRng : 375|14@0+ (0.02,-1.0) [-1.0|200.0] "m" ASDM,PAS
 SG_ FrntRdrDetn113RdrDetnRngV : 356|13@0+ (0.02,-80.0) [-80.0|80.0] "m/s" ASDM,PAS
 SG_ FrntRdrDetn113RdrDetnSts : 331|2@0+ (1,0) [0|3] "" ASDM,PAS
 SG_ FrntRdrDetn114_UB : 474|1@0+ (1,0) [0|1] "" ASDM,PAS
 SG_ FrntRdrDetn114RdrDetnAzi : 447|11@0+ (0.1,-90.0) [-90.0|90.0] "Deg" ASDM,PAS
 SG_ FrntRdrDetn114RdrDetnChks : 407|8@0+ (1.0,0.0) [0.0|255.0] "Unitless" ASDM,PAS
 SG_ FrntRdrDetn114RdrDetnCntr : 415|4@0+ (1.0,0.0) [0.0|15.0] "Unitless" ASDM,PAS
 SG_ FrntRdrDetn114RdrDetnConf : 471|7@0+ (1.0,0.0) [0.0|100.0] "%" ASDM,PAS
 SG_ FrntRdrDetn114RdrDetnElevn : 479|5@0+ (1.0,-15.0) [-15.0|15.0] "Deg" ASDM,PAS
 SG_ FrntRdrDetn114RdrDetnPwr : 409|9@0+ (0.1,0.0) [0.0|51.1] "dB" ASDM,PAS
 SG_ FrntRdrDetn114RdrDetnRng : 431|14@0+ (0.02,-1.0) [-1.0|200.0] "m" ASDM,PAS
 SG_ FrntRdrDetn114RdrDetnRngV : 452|13@0+ (0.02,-80.0) [-80.0|80.0] "m/s" ASDM,PAS
 SG_ FrntRdrDetn114RdrDetnSts : 411|2@0+ (1,0) [0|3] "" ASDM,PAS

CM_ SG_ 326 FrntRdrDetn67RdrDetnAzi "Refer to the data element description in FrntRdrDetn1 with the same data element name.";
CM_ SG_ 326 FrntRdrDetn67RdrDetnChks "Refer to the data element description in FrntRdrDetn1 with the same data element name.";
CM_ SG_ 326 FrntRdrDetn67RdrDetnCntr "Refer to the data element description in FrntRdrDetn1 with the same data element name.";
CM_ SG_ 326 FrntRdrDetn67RdrDetnConf "Refer to the data element description in FrntRdrDetn1 with the same data element name.";
CM_ SG_ 326 FrntRdrDetn67RdrDetnElevn "Refer to the data element description in FrntRdrDetn1 with the same data element name.";
CM_ SG_ 326 FrntRdrDetn67RdrDetnPwr "Refer to the data element description in FrntRdrDetn1 with the same data element name.";
CM_ SG_ 326 FrntRdrDetn67RdrDetnRng "Refer to the data element description in FrntRdrDetn1 with the same data element name.";
CM_ SG_ 326 FrntRdrDetn67RdrDetnRngV "Refer to the data element description in FrntRdrDetn1 with the same data element name.";
CM_ SG_ 326 FrntRdrDetn67RdrDetnSts "Refer to the data element description in FrntRdrDetn1 with the same data element name.";
CM_ SG_ 326 FrntRdrDetn68RdrDetnAzi "Refer to the data element description in FrntRdrDetn1 with the same data element name.";
CM_ SG_ 326 FrntRdrDetn68RdrDetnChks "Refer to the data element description in FrntRdrDetn1 with the same data element name.";
CM_ SG_ 326 FrntRdrDetn68RdrDetnCntr "Refer to the data element description in FrntRdrDetn1 with the same data element name.";
CM_ SG_ 326 FrntRdrDetn68RdrDetnConf "Refer to the data element description in FrntRdrDetn1 with the same data element name.";
CM_ SG_ 326 FrntRdrDetn68RdrDetnElevn "Refer to the data element description in FrntRdrDetn1 with the same data element name.";
CM_ SG_ 326 FrntRdrDetn68RdrDetnPwr "Refer to the data element description in FrntRdrDetn1 with the same data element name.";
CM_ SG_ 326 FrntRdrDetn68RdrDetnRng "Refer to the data element description in FrntRdrDetn1 with the same data element name.";
CM_ SG_ 326 FrntRdrDetn68RdrDetnRngV "Refer to the data element description in FrntRdrDetn1 with the same data element name.";
CM_ SG_ 326 FrntRdrDetn68RdrDetnSts "Refer to the data element description in FrntRdrDetn1 with the same data element name.";
CM_ SG_ 326 FrntRdrDetn69RdrDetnAzi "Refer to the data element description in FrntRdrDetn1 with the same data element name.";
CM_ SG_ 326 FrntRdrDetn69RdrDetnChks "Refer to the data element description in FrntRdrDetn1 with the same data element name.";
CM_ SG_ 326 FrntRdrDetn69RdrDetnCntr "Refer to the data element description in FrntRdrDetn1 with the same data element name.";
CM_ SG_ 326 FrntRdrDetn69RdrDetnConf "Refer to the data element description in FrntRdrDetn1 with the same data element name.";
CM_ SG_ 326 FrntRdrDetn69RdrDetnElevn "Refer to the data element description in FrntRdrDetn1 with the same data element name.";
CM_ SG_ 326 FrntRdrDetn69RdrDetnPwr "Refer to the data element description in FrntRdrDetn1 with the same data element name.";
CM_ SG_ 326 FrntRdrDetn69RdrDetnRng "Refer to the data element description in FrntRdrDetn1 with the same data element name.";
CM_ SG_ 326 FrntRdrDetn69RdrDetnRngV "Refer to the data element description in FrntRdrDetn1 with the same data element name.";
CM_ SG_ 326 FrntRdrDetn69RdrDetnSts "Refer to the data element description in FrntRdrDetn1 with the same data element name.";
CM_ SG_ 326 FrntRdrDetn70RdrDetnAzi "Refer to the data element description in FrntRdrDetn1 with the same data element name.";
CM_ SG_ 326 FrntRdrDetn70RdrDetnChks "Refer to the data element description in FrntRdrDetn1 with the same data element name.";
CM_ SG_ 326 FrntRdrDetn70RdrDetnCntr "Refer to the data element description in FrntRdrDetn1 with the same data element name.";
CM_ SG_ 326 FrntRdrDetn70RdrDetnConf "Refer to the data element description in FrntRdrDetn1 with the same data element name.";
CM_ SG_ 326 FrntRdrDetn70RdrDetnElevn "Refer to the data element description in FrntRdrDetn1 with the same data element name.";
CM_ SG_ 326 FrntRdrDetn70RdrDetnPwr "Refer to the data element description in FrntRdrDetn1 with the same data element name.";
CM_ SG_ 326 FrntRdrDetn70RdrDetnRng "Refer to the data element description in FrntRdrDetn1 with the same data element name.";
CM_ SG_ 326 FrntRdrDetn70RdrDetnRngV "Refer to the data element description in FrntRdrDetn1 with the same data element name.";
CM_ SG_ 326 FrntRdrDetn70RdrDetnSts "Refer to the data element description in FrntRdrDetn1 with the same data element name.";
CM_ SG_ 326 FrntRdrDetn71RdrDetnAzi "Refer to the data element description in FrntRdrDetn1 with the same data element name.";
CM_ SG_ 326 FrntRdrDetn71RdrDetnChks "Refer to the data element description in FrntRdrDetn1 with the same data element name.";
CM_ SG_ 326 FrntRdrDetn71RdrDetnCntr "Refer to the data element description in FrntRdrDetn1 with the same data element name.";
CM_ SG_ 326 FrntRdrDetn71RdrDetnConf "Refer to the data element description in FrntRdrDetn1 with the same data element name.";
CM_ SG_ 326 FrntRdrDetn71RdrDetnElevn "Refer to the data element description in FrntRdrDetn1 with the same data element name.";
CM_ SG_ 326 FrntRdrDetn71RdrDetnPwr "Refer to the data element description in FrntRdrDetn1 with the same data element name.";
CM_ SG_ 326 FrntRdrDetn71RdrDetnRng "Refer to the data element description in FrntRdrDetn1 with the same data element name.";
CM_ SG_ 326 FrntRdrDetn71RdrDetnRngV "Refer to the data element description in FrntRdrDetn1 with the same data element name.";
CM_ SG_ 326 FrntRdrDetn71RdrDetnSts "Refer to the data element description in FrntRdrDetn1 with the same data element name.";
CM_ SG_ 326 FrntRdrDetn72RdrDetnAzi "Refer to the data element description in FrntRdrDetn1 with the same data element name.";
CM_ SG_ 326 FrntRdrDetn72RdrDetnChks "Refer to the data element description in FrntRdrDetn1 with the same data element name.";
CM_ SG_ 326 FrntRdrDetn72RdrDetnCntr "Refer to the data element description in FrntRdrDetn1 with the same data element name.";
CM_ SG_ 326 FrntRdrDetn72RdrDetnConf "Refer to the data element description in FrntRdrDetn1 with the same data element name.";
CM_ SG_ 326 FrntRdrDetn72RdrDetnElevn "Refer to the data element description in FrntRdrDetn1 with the same data element name.";
CM_ SG_ 326 FrntRdrDetn72RdrDetnPwr "Refer to the data element description in FrntRdrDetn1 with the same data element name.";
CM_ SG_ 326 FrntRdrDetn72RdrDetnRng "Refer to the data element description in FrntRdrDetn1 with the same data element name.";
CM_ SG_ 326 FrntRdrDetn72RdrDetnRngV "Refer to the data element description in FrntRdrDetn1 with the same data element name.";
CM_ SG_ 326 FrntRdrDetn72RdrDetnSts "Refer to the data element description in FrntRdrDetn1 with the same data element name.";
CM_ SG_ 328 FrntRdrDetn73RdrDetnAzi "Refer to the data element description in FrntRdrDetn1 with the same data element name.";
CM_ SG_ 328 FrntRdrDetn73RdrDetnChks "Refer to the data element description in FrntRdrDetn1 with the same data element name.";
CM_ SG_ 328 FrntRdrDetn73RdrDetnCntr "Refer to the data element description in FrntRdrDetn1 with the same data element name.";
CM_ SG_ 328 FrntRdrDetn73RdrDetnConf "Refer to the data element description in FrntRdrDetn1 with the same data element name.";
CM_ SG_ 328 FrntRdrDetn73RdrDetnElevn "Refer to the data element description in FrntRdrDetn1 with the same data element name.";
CM_ SG_ 328 FrntRdrDetn73RdrDetnPwr "Refer to the data element description in FrntRdrDetn1 with the same data element name.";
CM_ SG_ 328 FrntRdrDetn73RdrDetnRng "Refer to the data element description in FrntRdrDetn1 with the same data element name.";
CM_ SG_ 328 FrntRdrDetn73RdrDetnRngV "Refer to the data element description in FrntRdrDetn1 with the same data element name.";
CM_ SG_ 328 FrntRdrDetn73RdrDetnSts "Refer to the data element description in FrntRdrDetn1 with the same data element name.";
CM_ SG_ 328 FrntRdrDetn74RdrDetnAzi "Refer to the data element description in FrntRdrDetn1 with the same data element name.";
CM_ SG_ 328 FrntRdrDetn74RdrDetnChks "Refer to the data element description in FrntRdrDetn1 with the same data element name.";
CM_ SG_ 328 FrntRdrDetn74RdrDetnCntr "Refer to the data element description in FrntRdrDetn1 with the same data element name.";
CM_ SG_ 328 FrntRdrDetn74RdrDetnConf "Refer to the data element description in FrntRdrDetn1 with the same data element name.";
CM_ SG_ 328 FrntRdrDetn74RdrDetnElevn "Refer to the data element description in FrntRdrDetn1 with the same data element name.";
CM_ SG_ 328 FrntRdrDetn74RdrDetnPwr "Refer to the data element description in FrntRdrDetn1 with the same data element name.";
CM_ SG_ 328 FrntRdrDetn74RdrDetnRng "Refer to the data element description in FrntRdrDetn1 with the same data element name.";
CM_ SG_ 328 FrntRdrDetn74RdrDetnRngV "Refer to the data element description in FrntRdrDetn1 with the same data element name.";
CM_ SG_ 328 FrntRdrDetn74RdrDetnSts "Refer to the data element description in FrntRdrDetn1 with the same data element name.";
CM_ SG_ 328 FrntRdrDetn75RdrDetnAzi "Refer to the data element description in FrntRdrDetn1 with the same data element name.";
CM_ SG_ 328 FrntRdrDetn75RdrDetnChks "Refer to the data element description in FrntRdrDetn1 with the same data element name.";
CM_ SG_ 328 FrntRdrDetn75RdrDetnCntr "Refer to the data element description in FrntRdrDetn1 with the same data element name.";
CM_ SG_ 328 FrntRdrDetn75RdrDetnConf "Refer to the data element description in FrntRdrDetn1 with the same data element name.";
CM_ SG_ 328 FrntRdrDetn75RdrDetnElevn "Refer to the data element description in FrntRdrDetn1 with the same data element name.";
CM_ SG_ 328 FrntRdrDetn75RdrDetnPwr "Refer to the data element description in FrntRdrDetn1 with the same data element name.";
CM_ SG_ 328 FrntRdrDetn75RdrDetnRng "Refer to the data element description in FrntRdrDetn1 with the same data element name.";
CM_ SG_ 328 FrntRdrDetn75RdrDetnRngV "Refer to the data element description in FrntRdrDetn1 with the same data element name.";
CM_ SG_ 328 FrntRdrDetn75RdrDetnSts "Refer to the data element description in FrntRdrDetn1 with the same data element name.";
CM_ SG_ 328 FrntRdrDetn76RdrDetnAzi "Refer to the data element description in FrntRdrDetn1 with the same data element name.";
CM_ SG_ 328 FrntRdrDetn76RdrDetnChks "Refer to the data element description in FrntRdrDetn1 with the same data element name.";
CM_ SG_ 328 FrntRdrDetn76RdrDetnCntr "Refer to the data element description in FrntRdrDetn1 with the same data element name.";
CM_ SG_ 328 FrntRdrDetn76RdrDetnConf "Refer to the data element description in FrntRdrDetn1 with the same data element name.";
CM_ SG_ 328 FrntRdrDetn76RdrDetnElevn "Refer to the data element description in FrntRdrDetn1 with the same data element name.";
CM_ SG_ 328 FrntRdrDetn76RdrDetnPwr "Refer to the data element description in FrntRdrDetn1 with the same data element name.";
CM_ SG_ 328 FrntRdrDetn76RdrDetnRng "Refer to the data element description in FrntRdrDetn1 with the same data element name.";
CM_ SG_ 328 FrntRdrDetn76RdrDetnRngV "Refer to the data element description in FrntRdrDetn1 with the same data element name.";
CM_ SG_ 328 FrntRdrDetn76RdrDetnSts "Refer to the data element description in FrntRdrDetn1 with the same data element name.";
CM_ SG_ 328 FrntRdrDetn77RdrDetnAzi "Refer to the data element description in FrntRdrDetn1 with the same data element name.";
CM_ SG_ 328 FrntRdrDetn77RdrDetnChks "Refer to the data element description in FrntRdrDetn1 with the same data element name.";
CM_ SG_ 328 FrntRdrDetn77RdrDetnCntr "Refer to the data element description in FrntRdrDetn1 with the same data element name.";
CM_ SG_ 328 FrntRdrDetn77RdrDetnConf "Refer to the data element description in FrntRdrDetn1 with the same data element name.";
CM_ SG_ 328 FrntRdrDetn77RdrDetnElevn "Refer to the data element description in FrntRdrDetn1 with the same data element name.";
CM_ SG_ 328 FrntRdrDetn77RdrDetnPwr "Refer to the data element description in FrntRdrDetn1 with the same data element name.";
CM_ SG_ 328 FrntRdrDetn77RdrDetnRng "Refer to the data element description in FrntRdrDetn1 with the same data element name.";
CM_ SG_ 328 FrntRdrDetn77RdrDetnRngV "Refer to the data element description in FrntRdrDetn1 with the same data element name.";
CM_ SG_ 328 FrntRdrDetn77RdrDetnSts "Refer to the data element description in FrntRdrDetn1 with the same data element name.";
CM_ SG_ 328 FrntRdrDetn78RdrDetnAzi "Refer to the data element description in FrntRdrDetn1 with the same data element name.";
CM_ SG_ 328 FrntRdrDetn78RdrDetnChks "Refer to the data element description in FrntRdrDetn1 with the same data element name.";
CM_ SG_ 328 FrntRdrDetn78RdrDetnCntr "Refer to the data element description in FrntRdrDetn1 with the same data element name.";
CM_ SG_ 328 FrntRdrDetn78RdrDetnConf "Refer to the data element description in FrntRdrDetn1 with the same data element name.";
CM_ SG_ 328 FrntRdrDetn78RdrDetnElevn "Refer to the data element description in FrntRdrDetn1 with the same data element name.";
CM_ SG_ 328 FrntRdrDetn78RdrDetnPwr "Refer to the data element description in FrntRdrDetn1 with the same data element name.";
CM_ SG_ 328 FrntRdrDetn78RdrDetnRng "Refer to the data element description in FrntRdrDetn1 with the same data element name.";
CM_ SG_ 328 FrntRdrDetn78RdrDetnRngV "Refer to the data element description in FrntRdrDetn1 with the same data element name.";
CM_ SG_ 328 FrntRdrDetn78RdrDetnSts "Refer to the data element description in FrntRdrDetn1 with the same data element name.";
CM_ SG_ 330 FrntRdrDetn79RdrDetnAzi "Refer to the data element description in FrntRdrDetn1 with the same data element name.";
CM_ SG_ 330 FrntRdrDetn79RdrDetnChks "Refer to the data element description in FrntRdrDetn1 with the same data element name.";
CM_ SG_ 330 FrntRdrDetn79RdrDetnCntr "Refer to the data element description in FrntRdrDetn1 with the same data element name.";
CM_ SG_ 330 FrntRdrDetn79RdrDetnConf "Refer to the data element description in FrntRdrDetn1 with the same data element name.";
CM_ SG_ 330 FrntRdrDetn79RdrDetnElevn "Refer to the data element description in FrntRdrDetn1 with the same data element name.";
CM_ SG_ 330 FrntRdrDetn79RdrDetnPwr "Refer to the data element description in FrntRdrDetn1 with the same data element name.";
CM_ SG_ 330 FrntRdrDetn79RdrDetnRng "Refer to the data element description in FrntRdrDetn1 with the same data element name.";
CM_ SG_ 330 FrntRdrDetn79RdrDetnRngV "Refer to the data element description in FrntRdrDetn1 with the same data element name.";
CM_ SG_ 330 FrntRdrDetn79RdrDetnSts "Refer to the data element description in FrntRdrDetn1 with the same data element name.";
CM_ SG_ 330 FrntRdrDetn80RdrDetnAzi "Refer to the data element description in FrntRdrDetn1 with the same data element name.";
CM_ SG_ 330 FrntRdrDetn80RdrDetnChks "Refer to the data element description in FrntRdrDetn1 with the same data element name.";
CM_ SG_ 330 FrntRdrDetn80RdrDetnCntr "Refer to the data element description in FrntRdrDetn1 with the same data element name.";
CM_ SG_ 330 FrntRdrDetn80RdrDetnConf "Refer to the data element description in FrntRdrDetn1 with the same data element name.";
CM_ SG_ 330 FrntRdrDetn80RdrDetnElevn "Refer to the data element description in FrntRdrDetn1 with the same data element name.";
CM_ SG_ 330 FrntRdrDetn80RdrDetnPwr "Refer to the data element description in FrntRdrDetn1 with the same data element name.";
CM_ SG_ 330 FrntRdrDetn80RdrDetnRng "Refer to the data element description in FrntRdrDetn1 with the same data element name.";
CM_ SG_ 330 FrntRdrDetn80RdrDetnRngV "Refer to the data element description in FrntRdrDetn1 with the same data element name.";
CM_ SG_ 330 FrntRdrDetn80RdrDetnSts "Refer to the data element description in FrntRdrDetn1 with the same data element name.";
CM_ SG_ 330 FrntRdrDetn81RdrDetnAzi "Refer to the data element description in FrntRdrDetn1 with the same data element name.";
CM_ SG_ 330 FrntRdrDetn81RdrDetnChks "Refer to the data element description in FrntRdrDetn1 with the same data element name.";
CM_ SG_ 330 FrntRdrDetn81RdrDetnCntr "Refer to the data element description in FrntRdrDetn1 with the same data element name.";
CM_ SG_ 330 FrntRdrDetn81RdrDetnConf "Refer to the data element description in FrntRdrDetn1 with the same data element name.";
CM_ SG_ 330 FrntRdrDetn81RdrDetnElevn "Refer to the data element description in FrntRdrDetn1 with the same data element name.";
CM_ SG_ 330 FrntRdrDetn81RdrDetnPwr "Refer to the data element description in FrntRdrDetn1 with the same data element name.";
CM_ SG_ 330 FrntRdrDetn81RdrDetnRng "Refer to the data element description in FrntRdrDetn1 with the same data element name.";
CM_ SG_ 330 FrntRdrDetn81RdrDetnRngV "Refer to the data element description in FrntRdrDetn1 with the same data element name.";
CM_ SG_ 330 FrntRdrDetn81RdrDetnSts "Refer to the data element description in FrntRdrDetn1 with the same data element name.";
CM_ SG_ 330 FrntRdrDetn82RdrDetnAzi "Refer to the data element description in FrntRdrDetn1 with the same data element name.";
CM_ SG_ 330 FrntRdrDetn82RdrDetnChks "Refer to the data element description in FrntRdrDetn1 with the same data element name.";
CM_ SG_ 330 FrntRdrDetn82RdrDetnCntr "Refer to the data element description in FrntRdrDetn1 with the same data element name.";
CM_ SG_ 330 FrntRdrDetn82RdrDetnConf "Refer to the data element description in FrntRdrDetn1 with the same data element name.";
CM_ SG_ 330 FrntRdrDetn82RdrDetnElevn "Refer to the data element description in FrntRdrDetn1 with the same data element name.";
CM_ SG_ 330 FrntRdrDetn82RdrDetnPwr "Refer to the data element description in FrntRdrDetn1 with the same data element name.";
CM_ SG_ 330 FrntRdrDetn82RdrDetnRng "Refer to the data element description in FrntRdrDetn1 with the same data element name.";
CM_ SG_ 330 FrntRdrDetn82RdrDetnRngV "Refer to the data element description in FrntRdrDetn1 with the same data element name.";
CM_ SG_ 330 FrntRdrDetn82RdrDetnSts "Refer to the data element description in FrntRdrDetn1 with the same data element name.";
CM_ SG_ 330 FrntRdrDetn83RdrDetnAzi "Refer to the data element description in FrntRdrDetn1 with the same data element name.";
CM_ SG_ 330 FrntRdrDetn83RdrDetnChks "Refer to the data element description in FrntRdrDetn1 with the same data element name.";
CM_ SG_ 330 FrntRdrDetn83RdrDetnCntr "Refer to the data element description in FrntRdrDetn1 with the same data element name.";
CM_ SG_ 330 FrntRdrDetn83RdrDetnConf "Refer to the data element description in FrntRdrDetn1 with the same data element name.";
CM_ SG_ 330 FrntRdrDetn83RdrDetnElevn "Refer to the data element description in FrntRdrDetn1 with the same data element name.";
CM_ SG_ 330 FrntRdrDetn83RdrDetnPwr "Refer to the data element description in FrntRdrDetn1 with the same data element name.";
CM_ SG_ 330 FrntRdrDetn83RdrDetnRng "Refer to the data element description in FrntRdrDetn1 with the same data element name.";
CM_ SG_ 330 FrntRdrDetn83RdrDetnRngV "Refer to the data element description in FrntRdrDetn1 with the same data element name.";
CM_ SG_ 330 FrntRdrDetn83RdrDetnSts "Refer to the data element description in FrntRdrDetn1 with the same data element name.";
CM_ SG_ 330 FrntRdrDetn84RdrDetnAzi "Refer to the data element description in FrntRdrDetn1 with the same data element name.";
CM_ SG_ 330 FrntRdrDetn84RdrDetnChks "Refer to the data element description in FrntRdrDetn1 with the same data element name.";
CM_ SG_ 330 FrntRdrDetn84RdrDetnCntr "Refer to the data element description in FrntRdrDetn1 with the same data element name.";
CM_ SG_ 330 FrntRdrDetn84RdrDetnConf "Refer to the data element description in FrntRdrDetn1 with the same data element name.";
CM_ SG_ 330 FrntRdrDetn84RdrDetnElevn "Refer to the data element description in FrntRdrDetn1 with the same data element name.";
CM_ SG_ 330 FrntRdrDetn84RdrDetnPwr "Refer to the data element description in FrntRdrDetn1 with the same data element name.";
CM_ SG_ 330 FrntRdrDetn84RdrDetnRng "Refer to the data element description in FrntRdrDetn1 with the same data element name.";
CM_ SG_ 330 FrntRdrDetn84RdrDetnRngV "Refer to the data element description in FrntRdrDetn1 with the same data element name.";
CM_ SG_ 330 FrntRdrDetn84RdrDetnSts "Refer to the data element description in FrntRdrDetn1 with the same data element name.";
CM_ SG_ 332 FrntRdrDetn85RdrDetnAzi "Refer to the data element description in FrntRdrDetn1 with the same data element name.";
CM_ SG_ 332 FrntRdrDetn85RdrDetnChks "Refer to the data element description in FrntRdrDetn1 with the same data element name.";
CM_ SG_ 332 FrntRdrDetn85RdrDetnCntr "Refer to the data element description in FrntRdrDetn1 with the same data element name.";
CM_ SG_ 332 FrntRdrDetn85RdrDetnConf "Refer to the data element description in FrntRdrDetn1 with the same data element name.";
CM_ SG_ 332 FrntRdrDetn85RdrDetnElevn "Refer to the data element description in FrntRdrDetn1 with the same data element name.";
CM_ SG_ 332 FrntRdrDetn85RdrDetnPwr "Refer to the data element description in FrntRdrDetn1 with the same data element name.";
CM_ SG_ 332 FrntRdrDetn85RdrDetnRng "Refer to the data element description in FrntRdrDetn1 with the same data element name.";
CM_ SG_ 332 FrntRdrDetn85RdrDetnRngV "Refer to the data element description in FrntRdrDetn1 with the same data element name.";
CM_ SG_ 332 FrntRdrDetn85RdrDetnSts "Refer to the data element description in FrntRdrDetn1 with the same data element name.";
CM_ SG_ 332 FrntRdrDetn86RdrDetnAzi "Refer to the data element description in FrntRdrDetn1 with the same data element name.";
CM_ SG_ 332 FrntRdrDetn86RdrDetnChks "Refer to the data element description in FrntRdrDetn1 with the same data element name.";
CM_ SG_ 332 FrntRdrDetn86RdrDetnCntr "Refer to the data element description in FrntRdrDetn1 with the same data element name.";
CM_ SG_ 332 FrntRdrDetn86RdrDetnConf "Refer to the data element description in FrntRdrDetn1 with the same data element name.";
CM_ SG_ 332 FrntRdrDetn86RdrDetnElevn "Refer to the data element description in FrntRdrDetn1 with the same data element name.";
CM_ SG_ 332 FrntRdrDetn86RdrDetnPwr "Refer to the data element description in FrntRdrDetn1 with the same data element name.";
CM_ SG_ 332 FrntRdrDetn86RdrDetnRng "Refer to the data element description in FrntRdrDetn1 with the same data element name.";
CM_ SG_ 332 FrntRdrDetn86RdrDetnRngV "Refer to the data element description in FrntRdrDetn1 with the same data element name.";
CM_ SG_ 332 FrntRdrDetn86RdrDetnSts "Refer to the data element description in FrntRdrDetn1 with the same data element name.";
CM_ SG_ 332 FrntRdrDetn87RdrDetnAzi "Refer to the data element description in FrntRdrDetn1 with the same data element name.";
CM_ SG_ 332 FrntRdrDetn87RdrDetnChks "Refer to the data element description in FrntRdrDetn1 with the same data element name.";
CM_ SG_ 332 FrntRdrDetn87RdrDetnCntr "Refer to the data element description in FrntRdrDetn1 with the same data element name.";
CM_ SG_ 332 FrntRdrDetn87RdrDetnConf "Refer to the data element description in FrntRdrDetn1 with the same data element name.";
CM_ SG_ 332 FrntRdrDetn87RdrDetnElevn "Refer to the data element description in FrntRdrDetn1 with the same data element name.";
CM_ SG_ 332 FrntRdrDetn87RdrDetnPwr "Refer to the data element description in FrntRdrDetn1 with the same data element name.";
CM_ SG_ 332 FrntRdrDetn87RdrDetnRng "Refer to the data element description in FrntRdrDetn1 with the same data element name.";
CM_ SG_ 332 FrntRdrDetn87RdrDetnRngV "Refer to the data element description in FrntRdrDetn1 with the same data element name.";
CM_ SG_ 332 FrntRdrDetn87RdrDetnSts "Refer to the data element description in FrntRdrDetn1 with the same data element name.";
CM_ SG_ 332 FrntRdrDetn88RdrDetnAzi "Refer to the data element description in FrntRdrDetn1 with the same data element name.";
CM_ SG_ 332 FrntRdrDetn88RdrDetnChks "Refer to the data element description in FrntRdrDetn1 with the same data element name.";
CM_ SG_ 332 FrntRdrDetn88RdrDetnCntr "Refer to the data element description in FrntRdrDetn1 with the same data element name.";
CM_ SG_ 332 FrntRdrDetn88RdrDetnConf "Refer to the data element description in FrntRdrDetn1 with the same data element name.";
CM_ SG_ 332 FrntRdrDetn88RdrDetnElevn "Refer to the data element description in FrntRdrDetn1 with the same data element name.";
CM_ SG_ 332 FrntRdrDetn88RdrDetnPwr "Refer to the data element description in FrntRdrDetn1 with the same data element name.";
CM_ SG_ 332 FrntRdrDetn88RdrDetnRng "Refer to the data element description in FrntRdrDetn1 with the same data element name.";
CM_ SG_ 332 FrntRdrDetn88RdrDetnRngV "Refer to the data element description in FrntRdrDetn1 with the same data element name.";
CM_ SG_ 332 FrntRdrDetn88RdrDetnSts "Refer to the data element description in FrntRdrDetn1 with the same data element name.";
CM_ SG_ 332 FrntRdrDetn89RdrDetnAzi "Refer to the data element description in FrntRdrDetn1 with the same data element name.";
CM_ SG_ 332 FrntRdrDetn89RdrDetnChks "Refer to the data element description in FrntRdrDetn1 with the same data element name.";
CM_ SG_ 332 FrntRdrDetn89RdrDetnCntr "Refer to the data element description in FrntRdrDetn1 with the same data element name.";
CM_ SG_ 332 FrntRdrDetn89RdrDetnConf "Refer to the data element description in FrntRdrDetn1 with the same data element name.";
CM_ SG_ 332 FrntRdrDetn89RdrDetnElevn "Refer to the data element description in FrntRdrDetn1 with the same data element name.";
CM_ SG_ 332 FrntRdrDetn89RdrDetnPwr "Refer to the data element description in FrntRdrDetn1 with the same data element name.";
CM_ SG_ 332 FrntRdrDetn89RdrDetnRng "Refer to the data element description in FrntRdrDetn1 with the same data element name.";
CM_ SG_ 332 FrntRdrDetn89RdrDetnRngV "Refer to the data element description in FrntRdrDetn1 with the same data element name.";
CM_ SG_ 332 FrntRdrDetn89RdrDetnSts "Refer to the data element description in FrntRdrDetn1 with the same data element name.";
CM_ SG_ 332 FrntRdrDetn90RdrDetnAzi "Refer to the data element description in FrntRdrDetn1 with the same data element name.";
CM_ SG_ 332 FrntRdrDetn90RdrDetnChks "Refer to the data element description in FrntRdrDetn1 with the same data element name.";
CM_ SG_ 332 FrntRdrDetn90RdrDetnCntr "Refer to the data element description in FrntRdrDetn1 with the same data element name.";
CM_ SG_ 332 FrntRdrDetn90RdrDetnConf "Refer to the data element description in FrntRdrDetn1 with the same data element name.";
CM_ SG_ 332 FrntRdrDetn90RdrDetnElevn "Refer to the data element description in FrntRdrDetn1 with the same data element name.";
CM_ SG_ 332 FrntRdrDetn90RdrDetnPwr "Refer to the data element description in FrntRdrDetn1 with the same data element name.";
CM_ SG_ 332 FrntRdrDetn90RdrDetnRng "Refer to the data element description in FrntRdrDetn1 with the same data element name.";
CM_ SG_ 332 FrntRdrDetn90RdrDetnRngV "Refer to the data element description in FrntRdrDetn1 with the same data element name.";
CM_ SG_ 332 FrntRdrDetn90RdrDetnSts "Refer to the data element description in FrntRdrDetn1 with the same data element name.";
CM_ SG_ 334 FrntRdrDetn91RdrDetnAzi "Refer to the data element description in FrntRdrDetn1 with the same data element name.";
CM_ SG_ 334 FrntRdrDetn91RdrDetnChks "Refer to the data element description in FrntRdrDetn1 with the same data element name.";
CM_ SG_ 334 FrntRdrDetn91RdrDetnCntr "Refer to the data element description in FrntRdrDetn1 with the same data element name.";
CM_ SG_ 334 FrntRdrDetn91RdrDetnConf "Refer to the data element description in FrntRdrDetn1 with the same data element name.";
CM_ SG_ 334 FrntRdrDetn91RdrDetnElevn "Refer to the data element description in FrntRdrDetn1 with the same data element name.";
CM_ SG_ 334 FrntRdrDetn91RdrDetnPwr "Refer to the data element description in FrntRdrDetn1 with the same data element name.";
CM_ SG_ 334 FrntRdrDetn91RdrDetnRng "Refer to the data element description in FrntRdrDetn1 with the same data element name.";
CM_ SG_ 334 FrntRdrDetn91RdrDetnRngV "Refer to the data element description in FrntRdrDetn1 with the same data element name.";
CM_ SG_ 334 FrntRdrDetn91RdrDetnSts "Refer to the data element description in FrntRdrDetn1 with the same data element name.";
CM_ SG_ 334 FrntRdrDetn92RdrDetnAzi "Refer to the data element description in FrntRdrDetn1 with the same data element name.";
CM_ SG_ 334 FrntRdrDetn92RdrDetnChks "Refer to the data element description in FrntRdrDetn1 with the same data element name.";
CM_ SG_ 334 FrntRdrDetn92RdrDetnCntr "Refer to the data element description in FrntRdrDetn1 with the same data element name.";
CM_ SG_ 334 FrntRdrDetn92RdrDetnConf "Refer to the data element description in FrntRdrDetn1 with the same data element name.";
CM_ SG_ 334 FrntRdrDetn92RdrDetnElevn "Refer to the data element description in FrntRdrDetn1 with the same data element name.";
CM_ SG_ 334 FrntRdrDetn92RdrDetnPwr "Refer to the data element description in FrntRdrDetn1 with the same data element name.";
CM_ SG_ 334 FrntRdrDetn92RdrDetnRng "Refer to the data element description in FrntRdrDetn1 with the same data element name.";
CM_ SG_ 334 FrntRdrDetn92RdrDetnRngV "Refer to the data element description in FrntRdrDetn1 with the same data element name.";
CM_ SG_ 334 FrntRdrDetn92RdrDetnSts "Refer to the data element description in FrntRdrDetn1 with the same data element name.";
CM_ SG_ 334 FrntRdrDetn93RdrDetnAzi "Refer to the data element description in FrntRdrDetn1 with the same data element name.";
CM_ SG_ 334 FrntRdrDetn93RdrDetnChks "Refer to the data element description in FrntRdrDetn1 with the same data element name.";
CM_ SG_ 334 FrntRdrDetn93RdrDetnCntr "Refer to the data element description in FrntRdrDetn1 with the same data element name.";
CM_ SG_ 334 FrntRdrDetn93RdrDetnConf "Refer to the data element description in FrntRdrDetn1 with the same data element name.";
CM_ SG_ 334 FrntRdrDetn93RdrDetnElevn "Refer to the data element description in FrntRdrDetn1 with the same data element name.";
CM_ SG_ 334 FrntRdrDetn93RdrDetnPwr "Refer to the data element description in FrntRdrDetn1 with the same data element name.";
CM_ SG_ 334 FrntRdrDetn93RdrDetnRng "Refer to the data element description in FrntRdrDetn1 with the same data element name.";
CM_ SG_ 334 FrntRdrDetn93RdrDetnRngV "Refer to the data element description in FrntRdrDetn1 with the same data element name.";
CM_ SG_ 334 FrntRdrDetn93RdrDetnSts "Refer to the data element description in FrntRdrDetn1 with the same data element name.";
CM_ SG_ 334 FrntRdrDetn94RdrDetnAzi "Refer to the data element description in FrntRdrDetn1 with the same data element name.";
CM_ SG_ 334 FrntRdrDetn94RdrDetnChks "Refer to the data element description in FrntRdrDetn1 with the same data element name.";
CM_ SG_ 334 FrntRdrDetn94RdrDetnCntr "Refer to the data element description in FrntRdrDetn1 with the same data element name.";
CM_ SG_ 334 FrntRdrDetn94RdrDetnConf "Refer to the data element description in FrntRdrDetn1 with the same data element name.";
CM_ SG_ 334 FrntRdrDetn94RdrDetnElevn "Refer to the data element description in FrntRdrDetn1 with the same data element name.";
CM_ SG_ 334 FrntRdrDetn94RdrDetnPwr "Refer to the data element description in FrntRdrDetn1 with the same data element name.";
CM_ SG_ 334 FrntRdrDetn94RdrDetnRng "Refer to the data element description in FrntRdrDetn1 with the same data element name.";
CM_ SG_ 334 FrntRdrDetn94RdrDetnRngV "Refer to the data element description in FrntRdrDetn1 with the same data element name.";
CM_ SG_ 334 FrntRdrDetn94RdrDetnSts "Refer to the data element description in FrntRdrDetn1 with the same data element name.";
CM_ SG_ 334 FrntRdrDetn95RdrDetnAzi "Refer to the data element description in FrntRdrDetn1 with the same data element name.";
CM_ SG_ 334 FrntRdrDetn95RdrDetnChks "Refer to the data element description in FrntRdrDetn1 with the same data element name.";
CM_ SG_ 334 FrntRdrDetn95RdrDetnCntr "Refer to the data element description in FrntRdrDetn1 with the same data element name.";
CM_ SG_ 334 FrntRdrDetn95RdrDetnConf "Refer to the data element description in FrntRdrDetn1 with the same data element name.";
CM_ SG_ 334 FrntRdrDetn95RdrDetnElevn "Refer to the data element description in FrntRdrDetn1 with the same data element name.";
CM_ SG_ 334 FrntRdrDetn95RdrDetnPwr "Refer to the data element description in FrntRdrDetn1 with the same data element name.";
CM_ SG_ 334 FrntRdrDetn95RdrDetnRng "Refer to the data element description in FrntRdrDetn1 with the same data element name.";
CM_ SG_ 334 FrntRdrDetn95RdrDetnRngV "Refer to the data element description in FrntRdrDetn1 with the same data element name.";
CM_ SG_ 334 FrntRdrDetn95RdrDetnSts "Refer to the data element description in FrntRdrDetn1 with the same data element name.";
CM_ SG_ 334 FrntRdrDetn96RdrDetnAzi "Refer to the data element description in FrntRdrDetn1 with the same data element name.";
CM_ SG_ 334 FrntRdrDetn96RdrDetnChks "Refer to the data element description in FrntRdrDetn1 with the same data element name.";
CM_ SG_ 334 FrntRdrDetn96RdrDetnCntr "Refer to the data element description in FrntRdrDetn1 with the same data element name.";
CM_ SG_ 334 FrntRdrDetn96RdrDetnConf "Refer to the data element description in FrntRdrDetn1 with the same data element name.";
CM_ SG_ 334 FrntRdrDetn96RdrDetnElevn "Refer to the data element description in FrntRdrDetn1 with the same data element name.";
CM_ SG_ 334 FrntRdrDetn96RdrDetnPwr "Refer to the data element description in FrntRdrDetn1 with the same data element name.";
CM_ SG_ 334 FrntRdrDetn96RdrDetnRng "Refer to the data element description in FrntRdrDetn1 with the same data element name.";
CM_ SG_ 334 FrntRdrDetn96RdrDetnRngV "Refer to the data element description in FrntRdrDetn1 with the same data element name.";
CM_ SG_ 334 FrntRdrDetn96RdrDetnSts "Refer to the data element description in FrntRdrDetn1 with the same data element name.";
CM_ SG_ 336 FrntRdrDetn100RdrDetnAzi "Refer to the data element description in FrntRdrDetn1 with the same data element name.";
CM_ SG_ 336 FrntRdrDetn100RdrDetnChks "Refer to the data element description in FrntRdrDetn1 with the same data element name.";
CM_ SG_ 336 FrntRdrDetn100RdrDetnCntr "Refer to the data element description in FrntRdrDetn1 with the same data element name.";
CM_ SG_ 336 FrntRdrDetn100RdrDetnConf "Refer to the data element description in FrntRdrDetn1 with the same data element name.";
CM_ SG_ 336 FrntRdrDetn100RdrDetnElevn "Refer to the data element description in FrntRdrDetn1 with the same data element name.";
CM_ SG_ 336 FrntRdrDetn100RdrDetnPwr "Refer to the data element description in FrntRdrDetn1 with the same data element name.";
CM_ SG_ 336 FrntRdrDetn100RdrDetnRng "Refer to the data element description in FrntRdrDetn1 with the same data element name.";
CM_ SG_ 336 FrntRdrDetn100RdrDetnRngV "Refer to the data element description in FrntRdrDetn1 with the same data element name.";
CM_ SG_ 336 FrntRdrDetn100RdrDetnSts "Refer to the data element description in FrntRdrDetn1 with the same data element name.";
CM_ SG_ 336 FrntRdrDetn101RdrDetnAzi "Refer to the data element description in FrntRdrDetn1 with the same data element name.";
CM_ SG_ 336 FrntRdrDetn101RdrDetnChks "Refer to the data element description in FrntRdrDetn1 with the same data element name.";
CM_ SG_ 336 FrntRdrDetn101RdrDetnCntr "Refer to the data element description in FrntRdrDetn1 with the same data element name.";
CM_ SG_ 336 FrntRdrDetn101RdrDetnConf "Refer to the data element description in FrntRdrDetn1 with the same data element name.";
CM_ SG_ 336 FrntRdrDetn101RdrDetnElevn "Refer to the data element description in FrntRdrDetn1 with the same data element name.";
CM_ SG_ 336 FrntRdrDetn101RdrDetnPwr "Refer to the data element description in FrntRdrDetn1 with the same data element name.";
CM_ SG_ 336 FrntRdrDetn101RdrDetnRng "Refer to the data element description in FrntRdrDetn1 with the same data element name.";
CM_ SG_ 336 FrntRdrDetn101RdrDetnRngV "Refer to the data element description in FrntRdrDetn1 with the same data element name.";
CM_ SG_ 336 FrntRdrDetn101RdrDetnSts "Refer to the data element description in FrntRdrDetn1 with the same data element name.";
CM_ SG_ 336 FrntRdrDetn102RdrDetnAzi "Refer to the data element description in FrntRdrDetn1 with the same data element name.";
CM_ SG_ 336 FrntRdrDetn102RdrDetnChks "Refer to the data element description in FrntRdrDetn1 with the same data element name.";
CM_ SG_ 336 FrntRdrDetn102RdrDetnCntr "Refer to the data element description in FrntRdrDetn1 with the same data element name.";
CM_ SG_ 336 FrntRdrDetn102RdrDetnConf "Refer to the data element description in FrntRdrDetn1 with the same data element name.";
CM_ SG_ 336 FrntRdrDetn102RdrDetnElevn "Refer to the data element description in FrntRdrDetn1 with the same data element name.";
CM_ SG_ 336 FrntRdrDetn102RdrDetnPwr "Refer to the data element description in FrntRdrDetn1 with the same data element name.";
CM_ SG_ 336 FrntRdrDetn102RdrDetnRng "Refer to the data element description in FrntRdrDetn1 with the same data element name.";
CM_ SG_ 336 FrntRdrDetn102RdrDetnRngV "Refer to the data element description in FrntRdrDetn1 with the same data element name.";
CM_ SG_ 336 FrntRdrDetn102RdrDetnSts "Refer to the data element description in FrntRdrDetn1 with the same data element name.";
CM_ SG_ 336 FrntRdrDetn97RdrDetnAzi "Refer to the data element description in FrntRdrDetn1 with the same data element name.";
CM_ SG_ 336 FrntRdrDetn97RdrDetnChks "Refer to the data element description in FrntRdrDetn1 with the same data element name.";
CM_ SG_ 336 FrntRdrDetn97RdrDetnCntr "Refer to the data element description in FrntRdrDetn1 with the same data element name.";
CM_ SG_ 336 FrntRdrDetn97RdrDetnConf "Refer to the data element description in FrntRdrDetn1 with the same data element name.";
CM_ SG_ 336 FrntRdrDetn97RdrDetnElevn "Refer to the data element description in FrntRdrDetn1 with the same data element name.";
CM_ SG_ 336 FrntRdrDetn97RdrDetnPwr "Refer to the data element description in FrntRdrDetn1 with the same data element name.";
CM_ SG_ 336 FrntRdrDetn97RdrDetnRng "Refer to the data element description in FrntRdrDetn1 with the same data element name.";
CM_ SG_ 336 FrntRdrDetn97RdrDetnRngV "Refer to the data element description in FrntRdrDetn1 with the same data element name.";
CM_ SG_ 336 FrntRdrDetn97RdrDetnSts "Refer to the data element description in FrntRdrDetn1 with the same data element name.";
CM_ SG_ 336 FrntRdrDetn98RdrDetnAzi "Refer to the data element description in FrntRdrDetn1 with the same data element name.";
CM_ SG_ 336 FrntRdrDetn98RdrDetnChks "Refer to the data element description in FrntRdrDetn1 with the same data element name.";
CM_ SG_ 336 FrntRdrDetn98RdrDetnCntr "Refer to the data element description in FrntRdrDetn1 with the same data element name.";
CM_ SG_ 336 FrntRdrDetn98RdrDetnConf "Refer to the data element description in FrntRdrDetn1 with the same data element name.";
CM_ SG_ 336 FrntRdrDetn98RdrDetnElevn "Refer to the data element description in FrntRdrDetn1 with the same data element name.";
CM_ SG_ 336 FrntRdrDetn98RdrDetnPwr "Refer to the data element description in FrntRdrDetn1 with the same data element name.";
CM_ SG_ 336 FrntRdrDetn98RdrDetnRng "Refer to the data element description in FrntRdrDetn1 with the same data element name.";
CM_ SG_ 336 FrntRdrDetn98RdrDetnRngV "Refer to the data element description in FrntRdrDetn1 with the same data element name.";
CM_ SG_ 336 FrntRdrDetn98RdrDetnSts "Refer to the data element description in FrntRdrDetn1 with the same data element name.";
CM_ SG_ 336 FrntRdrDetn99RdrDetnAzi "Refer to the data element description in FrntRdrDetn1 with the same data element name.";
CM_ SG_ 336 FrntRdrDetn99RdrDetnChks "Refer to the data element description in FrntRdrDetn1 with the same data element name.";
CM_ SG_ 336 FrntRdrDetn99RdrDetnCntr "Refer to the data element description in FrntRdrDetn1 with the same data element name.";
CM_ SG_ 336 FrntRdrDetn99RdrDetnConf "Refer to the data element description in FrntRdrDetn1 with the same data element name.";
CM_ SG_ 336 FrntRdrDetn99RdrDetnElevn "Refer to the data element description in FrntRdrDetn1 with the same data element name.";
CM_ SG_ 336 FrntRdrDetn99RdrDetnPwr "Refer to the data element description in FrntRdrDetn1 with the same data element name.";
CM_ SG_ 336 FrntRdrDetn99RdrDetnRng "Refer to the data element description in FrntRdrDetn1 with the same data element name.";
CM_ SG_ 336 FrntRdrDetn99RdrDetnRngV "Refer to the data element description in FrntRdrDetn1 with the same data element name.";
CM_ SG_ 336 FrntRdrDetn99RdrDetnSts "Refer to the data element description in FrntRdrDetn1 with the same data element name.";
CM_ SG_ 338 FrntRdrDetn103RdrDetnAzi "Refer to the data element description in FrntRdrDetn1 with the same data element name.";
CM_ SG_ 338 FrntRdrDetn103RdrDetnChks "Refer to the data element description in FrntRdrDetn1 with the same data element name.";
CM_ SG_ 338 FrntRdrDetn103RdrDetnCntr "Refer to the data element description in FrntRdrDetn1 with the same data element name.";
CM_ SG_ 338 FrntRdrDetn103RdrDetnConf "Refer to the data element description in FrntRdrDetn1 with the same data element name.";
CM_ SG_ 338 FrntRdrDetn103RdrDetnElevn "Refer to the data element description in FrntRdrDetn1 with the same data element name.";
CM_ SG_ 338 FrntRdrDetn103RdrDetnPwr "Refer to the data element description in FrntRdrDetn1 with the same data element name.";
CM_ SG_ 338 FrntRdrDetn103RdrDetnRng "Refer to the data element description in FrntRdrDetn1 with the same data element name.";
CM_ SG_ 338 FrntRdrDetn103RdrDetnRngV "Refer to the data element description in FrntRdrDetn1 with the same data element name.";
CM_ SG_ 338 FrntRdrDetn103RdrDetnSts "Refer to the data element description in FrntRdrDetn1 with the same data element name.";
CM_ SG_ 338 FrntRdrDetn104RdrDetnAzi "Refer to the data element description in FrntRdrDetn1 with the same data element name.";
CM_ SG_ 338 FrntRdrDetn104RdrDetnChks "Refer to the data element description in FrntRdrDetn1 with the same data element name.";
CM_ SG_ 338 FrntRdrDetn104RdrDetnCntr "Refer to the data element description in FrntRdrDetn1 with the same data element name.";
CM_ SG_ 338 FrntRdrDetn104RdrDetnConf "Refer to the data element description in FrntRdrDetn1 with the same data element name.";
CM_ SG_ 338 FrntRdrDetn104RdrDetnElevn "Refer to the data element description in FrntRdrDetn1 with the same data element name.";
CM_ SG_ 338 FrntRdrDetn104RdrDetnPwr "Refer to the data element description in FrntRdrDetn1 with the same data element name.";
CM_ SG_ 338 FrntRdrDetn104RdrDetnRng "Refer to the data element description in FrntRdrDetn1 with the same data element name.";
CM_ SG_ 338 FrntRdrDetn104RdrDetnRngV "Refer to the data element description in FrntRdrDetn1 with the same data element name.";
CM_ SG_ 338 FrntRdrDetn104RdrDetnSts "Refer to the data element description in FrntRdrDetn1 with the same data element name.";
CM_ SG_ 338 FrntRdrDetn105RdrDetnAzi "Refer to the data element description in FrntRdrDetn1 with the same data element name.";
CM_ SG_ 338 FrntRdrDetn105RdrDetnChks "Refer to the data element description in FrntRdrDetn1 with the same data element name.";
CM_ SG_ 338 FrntRdrDetn105RdrDetnCntr "Refer to the data element description in FrntRdrDetn1 with the same data element name.";
CM_ SG_ 338 FrntRdrDetn105RdrDetnConf "Refer to the data element description in FrntRdrDetn1 with the same data element name.";
CM_ SG_ 338 FrntRdrDetn105RdrDetnElevn "Refer to the data element description in FrntRdrDetn1 with the same data element name.";
CM_ SG_ 338 FrntRdrDetn105RdrDetnPwr "Refer to the data element description in FrntRdrDetn1 with the same data element name.";
CM_ SG_ 338 FrntRdrDetn105RdrDetnRng "Refer to the data element description in FrntRdrDetn1 with the same data element name.";
CM_ SG_ 338 FrntRdrDetn105RdrDetnRngV "Refer to the data element description in FrntRdrDetn1 with the same data element name.";
CM_ SG_ 338 FrntRdrDetn105RdrDetnSts "Refer to the data element description in FrntRdrDetn1 with the same data element name.";
CM_ SG_ 338 FrntRdrDetn106RdrDetnAzi "Refer to the data element description in FrntRdrDetn1 with the same data element name.";
CM_ SG_ 338 FrntRdrDetn106RdrDetnChks "Refer to the data element description in FrntRdrDetn1 with the same data element name.";
CM_ SG_ 338 FrntRdrDetn106RdrDetnCntr "Refer to the data element description in FrntRdrDetn1 with the same data element name.";
CM_ SG_ 338 FrntRdrDetn106RdrDetnConf "Refer to the data element description in FrntRdrDetn1 with the same data element name.";
CM_ SG_ 338 FrntRdrDetn106RdrDetnElevn "Refer to the data element description in FrntRdrDetn1 with the same data element name.";
CM_ SG_ 338 FrntRdrDetn106RdrDetnPwr "Refer to the data element description in FrntRdrDetn1 with the same data element name.";
CM_ SG_ 338 FrntRdrDetn106RdrDetnRng "Refer to the data element description in FrntRdrDetn1 with the same data element name.";
CM_ SG_ 338 FrntRdrDetn106RdrDetnRngV "Refer to the data element description in FrntRdrDetn1 with the same data element name.";
CM_ SG_ 338 FrntRdrDetn106RdrDetnSts "Refer to the data element description in FrntRdrDetn1 with the same data element name.";
CM_ SG_ 338 FrntRdrDetn107RdrDetnAzi "Refer to the data element description in FrntRdrDetn1 with the same data element name.";
CM_ SG_ 338 FrntRdrDetn107RdrDetnChks "Refer to the data element description in FrntRdrDetn1 with the same data element name.";
CM_ SG_ 338 FrntRdrDetn107RdrDetnCntr "Refer to the data element description in FrntRdrDetn1 with the same data element name.";
CM_ SG_ 338 FrntRdrDetn107RdrDetnConf "Refer to the data element description in FrntRdrDetn1 with the same data element name.";
CM_ SG_ 338 FrntRdrDetn107RdrDetnElevn "Refer to the data element description in FrntRdrDetn1 with the same data element name.";
CM_ SG_ 338 FrntRdrDetn107RdrDetnPwr "Refer to the data element description in FrntRdrDetn1 with the same data element name.";
CM_ SG_ 338 FrntRdrDetn107RdrDetnRng "Refer to the data element description in FrntRdrDetn1 with the same data element name.";
CM_ SG_ 338 FrntRdrDetn107RdrDetnRngV "Refer to the data element description in FrntRdrDetn1 with the same data element name.";
CM_ SG_ 338 FrntRdrDetn107RdrDetnSts "Refer to the data element description in FrntRdrDetn1 with the same data element name.";
CM_ SG_ 338 FrntRdrDetn108RdrDetnAzi "Refer to the data element description in FrntRdrDetn1 with the same data element name.";
CM_ SG_ 338 FrntRdrDetn108RdrDetnChks "Refer to the data element description in FrntRdrDetn1 with the same data element name.";
CM_ SG_ 338 FrntRdrDetn108RdrDetnCntr "Refer to the data element description in FrntRdrDetn1 with the same data element name.";
CM_ SG_ 338 FrntRdrDetn108RdrDetnConf "Refer to the data element description in FrntRdrDetn1 with the same data element name.";
CM_ SG_ 338 FrntRdrDetn108RdrDetnElevn "Refer to the data element description in FrntRdrDetn1 with the same data element name.";
CM_ SG_ 338 FrntRdrDetn108RdrDetnPwr "Refer to the data element description in FrntRdrDetn1 with the same data element name.";
CM_ SG_ 338 FrntRdrDetn108RdrDetnRng "Refer to the data element description in FrntRdrDetn1 with the same data element name.";
CM_ SG_ 338 FrntRdrDetn108RdrDetnRngV "Refer to the data element description in FrntRdrDetn1 with the same data element name.";
CM_ SG_ 338 FrntRdrDetn108RdrDetnSts "Refer to the data element description in FrntRdrDetn1 with the same data element name.";
CM_ SG_ 340 FrntRdrDetn109RdrDetnAzi "Refer to the data element description in FrntRdrDetn1 with the same data element name.";
CM_ SG_ 340 FrntRdrDetn109RdrDetnChks "Refer to the data element description in FrntRdrDetn1 with the same data element name.";
CM_ SG_ 340 FrntRdrDetn109RdrDetnCntr "Refer to the data element description in FrntRdrDetn1 with the same data element name.";
CM_ SG_ 340 FrntRdrDetn109RdrDetnConf "Refer to the data element description in FrntRdrDetn1 with the same data element name.";
CM_ SG_ 340 FrntRdrDetn109RdrDetnElevn "Refer to the data element description in FrntRdrDetn1 with the same data element name.";
CM_ SG_ 340 FrntRdrDetn109RdrDetnPwr "Refer to the data element description in FrntRdrDetn1 with the same data element name.";
CM_ SG_ 340 FrntRdrDetn109RdrDetnRng "Refer to the data element description in FrntRdrDetn1 with the same data element name.";
CM_ SG_ 340 FrntRdrDetn109RdrDetnRngV "Refer to the data element description in FrntRdrDetn1 with the same data element name.";
CM_ SG_ 340 FrntRdrDetn109RdrDetnSts "Refer to the data element description in FrntRdrDetn1 with the same data element name.";
CM_ SG_ 340 FrntRdrDetn110RdrDetnAzi "Refer to the data element description in FrntRdrDetn1 with the same data element name.";
CM_ SG_ 340 FrntRdrDetn110RdrDetnChks "Refer to the data element description in FrntRdrDetn1 with the same data element name.";
CM_ SG_ 340 FrntRdrDetn110RdrDetnCntr "Refer to the data element description in FrntRdrDetn1 with the same data element name.";
CM_ SG_ 340 FrntRdrDetn110RdrDetnConf "Refer to the data element description in FrntRdrDetn1 with the same data element name.";
CM_ SG_ 340 FrntRdrDetn110RdrDetnElevn "Refer to the data element description in FrntRdrDetn1 with the same data element name.";
CM_ SG_ 340 FrntRdrDetn110RdrDetnPwr "Refer to the data element description in FrntRdrDetn1 with the same data element name.";
CM_ SG_ 340 FrntRdrDetn110RdrDetnRng "Refer to the data element description in FrntRdrDetn1 with the same data element name.";
CM_ SG_ 340 FrntRdrDetn110RdrDetnRngV "Refer to the data element description in FrntRdrDetn1 with the same data element name.";
CM_ SG_ 340 FrntRdrDetn110RdrDetnSts "Refer to the data element description in FrntRdrDetn1 with the same data element name.";
CM_ SG_ 340 FrntRdrDetn111RdrDetnAzi "Refer to the data element description in FrntRdrDetn1 with the same data element name.";
CM_ SG_ 340 FrntRdrDetn111RdrDetnChks "Refer to the data element description in FrntRdrDetn1 with the same data element name.";
CM_ SG_ 340 FrntRdrDetn111RdrDetnCntr "Refer to the data element description in FrntRdrDetn1 with the same data element name.";
CM_ SG_ 340 FrntRdrDetn111RdrDetnConf "Refer to the data element description in FrntRdrDetn1 with the same data element name.";
CM_ SG_ 340 FrntRdrDetn111RdrDetnElevn "Refer to the data element description in FrntRdrDetn1 with the same data element name.";
CM_ SG_ 340 FrntRdrDetn111RdrDetnPwr "Refer to the data element description in FrntRdrDetn1 with the same data element name.";
CM_ SG_ 340 FrntRdrDetn111RdrDetnRng "Refer to the data element description in FrntRdrDetn1 with the same data element name.";
CM_ SG_ 340 FrntRdrDetn111RdrDetnRngV "Refer to the data element description in FrntRdrDetn1 with the same data element name.";
CM_ SG_ 340 FrntRdrDetn111RdrDetnSts "Refer to the data element description in FrntRdrDetn1 with the same data element name.";
CM_ SG_ 340 FrntRdrDetn112RdrDetnAzi "Refer to the data element description in FrntRdrDetn1 with the same data element name.";
CM_ SG_ 340 FrntRdrDetn112RdrDetnChks "Refer to the data element description in FrntRdrDetn1 with the same data element name.";
CM_ SG_ 340 FrntRdrDetn112RdrDetnCntr "Refer to the data element description in FrntRdrDetn1 with the same data element name.";
CM_ SG_ 340 FrntRdrDetn112RdrDetnConf "Refer to the data element description in FrntRdrDetn1 with the same data element name.";
CM_ SG_ 340 FrntRdrDetn112RdrDetnElevn "Refer to the data element description in FrntRdrDetn1 with the same data element name.";
CM_ SG_ 340 FrntRdrDetn112RdrDetnPwr "Refer to the data element description in FrntRdrDetn1 with the same data element name.";
CM_ SG_ 340 FrntRdrDetn112RdrDetnRng "Refer to the data element description in FrntRdrDetn1 with the same data element name.";
CM_ SG_ 340 FrntRdrDetn112RdrDetnRngV "Refer to the data element description in FrntRdrDetn1 with the same data element name.";
CM_ SG_ 340 FrntRdrDetn112RdrDetnSts "Refer to the data element description in FrntRdrDetn1 with the same data element name.";
CM_ SG_ 340 FrntRdrDetn113RdrDetnAzi "Refer to the data element description in FrntRdrDetn1 with the same data element name.";
CM_ SG_ 340 FrntRdrDetn113RdrDetnChks "Refer to the data element description in FrntRdrDetn1 with the same data element name.";
CM_ SG_ 340 FrntRdrDetn113RdrDetnCntr "Refer to the data element description in FrntRdrDetn1 with the same data element name.";
CM_ SG_ 340 FrntRdrDetn113RdrDetnConf "Refer to the data element description in FrntRdrDetn1 with the same data element name.";
CM_ SG_ 340 FrntRdrDetn113RdrDetnElevn "Refer to the data element description in FrntRdrDetn1 with the same data element name.";
CM_ SG_ 340 FrntRdrDetn113RdrDetnPwr "Refer to the data element description in FrntRdrDetn1 with the same data element name.";
CM_ SG_ 340 FrntRdrDetn113RdrDetnRng "Refer to the data element description in FrntRdrDetn1 with the same data element name.";
CM_ SG_ 340 FrntRdrDetn113RdrDetnRngV "Refer to the data element description in FrntRdrDetn1 with the same data element name.";
CM_ SG_ 340 FrntRdrDetn113RdrDetnSts "Refer to the data element description in FrntRdrDetn1 with the same data element name.";
CM_ SG_ 340 FrntRdrDetn114RdrDetnAzi "Refer to the data element description in FrntRdrDetn1 with the same data element name.";
CM_ SG_ 340 FrntRdrDetn114RdrDetnChks "Refer to the data element description in FrntRdrDetn1 with the same data element name.";
CM_ SG_ 340 FrntRdrDetn114RdrDetnCntr "Refer to the data element description in FrntRdrDetn1 with the same data element name.";
CM_ SG_ 340 FrntRdrDetn114RdrDetnConf "Refer to the data element description in FrntRdrDetn1 with the same data element name.";
CM_ SG_ 340 FrntRdrDetn114RdrDetnElevn "Refer to the data element description in FrntRdrDetn1 with the same data element name.";
CM_ SG_ 340 FrntRdrDetn114RdrDetnPwr "Refer to the data element description in FrntRdrDetn1 with the same data element name.";
CM_ SG_ 340 FrntRdrDetn114RdrDetnRng "Refer to the data element description in FrntRdrDetn1 with the same data element name.";
CM_ SG_ 340 FrntRdrDetn114RdrDetnRngV "Refer to the data element description in FrntRdrDetn1 with the same data element name.";
CM_ SG_ 340 FrntRdrDetn114RdrDetnSts "Refer to the data element description in FrntRdrDetn1 with the same data element name.";
BA_DEF_ BO_ "VFrameFormat" ENUM "StandardCAN","ExtendedCAN","reserved","J1939PG","reserved","reserved","reserved","reserved","reserved","reserved","reserved","reserved","reserved","reserved","StandardCAN_FD","ExtendedCAN_FD";
BA_DEF_ BO_ "CANFD_BRS" ENUM "0","1";
BA_DEF_ BO_ "GenMsgSendType" ENUM "cyclic", "spontaneous", "not-used", "not-used", "not-used", "cyclicAndSpontaneous", "not-used", "cyclicIfActive", "NoMsgSendType"; // [us]
BA_DEF_ BO_ "GenMsgCycleTime" INT 0 65536; // [ms]
BA_DEF_ BO_ "GenMsgStartDelayTime" INT 0 65536; // [ms]
BA_DEF_ BO_ "GenMsgDelayTime" INT 0 65536; // [ms]
BA_DEF_ SG_ "GenSigSendType" ENUM "Cyclic","OnWrite","OnWriteWithRepetition","OnChange","OnChangeWithRepetition","IfActive","IfActiveWithRepetition","NoSigSendType";
BA_DEF_ SG_ "GenSigStartValue" HEX 0 80000000;
BA_DEF_ BO_ "GenMsgILSupport" ENUM "No","Yes";
BA_DEF_ BO_ "NmAsrMessage" ENUM "No","Yes";
BA_DEF_ SG_ "GenSigFuncType" ENUM "NoFunction","n/a","n/a","n/a","n/a","n/a","n/a","n/a","n/a","n/a","n/a","n/a","n/a","n/a","n/a","CHK","CNTR","n/a","n/a","n/a","CNTR_AR_01","CRC_AR_01_BOTH","CRC_AR_01_ALT","CRC_AR_01_LOW","CRC_AR_01_NIBBLE","CNTR_AR_04","CRC_AR_04A","CNTR_AR_05","CRC_AR_05";
BA_DEF_ SG_ "GenSigDataID" STRING;

BA_DEF_DEF_ "VFrameFormat" "J1939PG";
BA_DEF_DEF_ "CANFD_BRS" "1";
BA_DEF_DEF_ "GenSigStartValue" 0;
BA_DEF_DEF_ "GenSigSendType" "NoSigSendType";
BA_DEF_DEF_ "GenMsgCycleTime" 0;
BA_DEF_DEF_ "GenMsgDelayTime" 0;
BA_DEF_DEF_ "GenMsgStartDelayTime" 0;
BA_DEF_DEF_ "GenMsgSendType" "NoMsgSendType";
BA_DEF_DEF_ "GenMsgILSupport" "Yes";
BA_DEF_DEF_ "NmAsrMessage" "No";
BA_DEF_DEF_ "GenSigFuncType" "NoFunction";
BA_DEF_DEF_ "GenSigDataID" "";
// Frame: FLRSafetyCANFD2Frame12
BA_ "VFrameFormat" BO_ 326 14;
BA_ "GenMsgSendType" BO_ 326 0;
BA_ "GenMsgCycleTime" BO_ 326 50.000;
BA_ "GenSigStartValue" SG_ 326 FrntRdrDetn67RdrDetnAzi 900;
BA_ "GenSigSendType" SG_ 326 FrntRdrDetn67RdrDetnAzi 0;
BA_ "GenSigSendType" SG_ 326 FrntRdrDetn67RdrDetnChks 0;
BA_ "GenSigFuncType" SG_ 326 FrntRdrDetn67RdrDetnChks 15;
BA_ "GenSigDataID" SG_ 326 FrntRdrDetn67RdrDetnChks "0x74A";
BA_ "GenSigSendType" SG_ 326 FrntRdrDetn67RdrDetnCntr 0;
BA_ "GenSigFuncType" SG_ 326 FrntRdrDetn67RdrDetnCntr 16;
BA_ "GenSigSendType" SG_ 326 FrntRdrDetn67RdrDetnConf 0;
BA_ "GenSigStartValue" SG_ 326 FrntRdrDetn67RdrDetnElevn 15;
BA_ "GenSigSendType" SG_ 326 FrntRdrDetn67RdrDetnElevn 0;
BA_ "GenSigSendType" SG_ 326 FrntRdrDetn67RdrDetnPwr 0;
BA_ "GenSigStartValue" SG_ 326 FrntRdrDetn67RdrDetnRng 10050;
BA_ "GenSigSendType" SG_ 326 FrntRdrDetn67RdrDetnRng 0;
BA_ "GenSigStartValue" SG_ 326 FrntRdrDetn67RdrDetnRngV 4000;
BA_ "GenSigSendType" SG_ 326 FrntRdrDetn67RdrDetnRngV 0;
BA_ "GenSigStartValue" SG_ 326 FrntRdrDetn67RdrDetnSts 3;
BA_ "GenSigSendType" SG_ 326 FrntRdrDetn67RdrDetnSts 0;
BA_ "GenSigStartValue" SG_ 326 FrntRdrDetn68RdrDetnAzi 900;
BA_ "GenSigSendType" SG_ 326 FrntRdrDetn68RdrDetnAzi 0;
BA_ "GenSigSendType" SG_ 326 FrntRdrDetn68RdrDetnChks 0;
BA_ "GenSigFuncType" SG_ 326 FrntRdrDetn68RdrDetnChks 15;
BA_ "GenSigDataID" SG_ 326 FrntRdrDetn68RdrDetnChks "0x74B";
BA_ "GenSigSendType" SG_ 326 FrntRdrDetn68RdrDetnCntr 0;
BA_ "GenSigFuncType" SG_ 326 FrntRdrDetn68RdrDetnCntr 16;
BA_ "GenSigSendType" SG_ 326 FrntRdrDetn68RdrDetnConf 0;
BA_ "GenSigStartValue" SG_ 326 FrntRdrDetn68RdrDetnElevn 15;
BA_ "GenSigSendType" SG_ 326 FrntRdrDetn68RdrDetnElevn 0;
BA_ "GenSigSendType" SG_ 326 FrntRdrDetn68RdrDetnPwr 0;
BA_ "GenSigStartValue" SG_ 326 FrntRdrDetn68RdrDetnRng 10050;
BA_ "GenSigSendType" SG_ 326 FrntRdrDetn68RdrDetnRng 0;
BA_ "GenSigStartValue" SG_ 326 FrntRdrDetn68RdrDetnRngV 4000;
BA_ "GenSigSendType" SG_ 326 FrntRdrDetn68RdrDetnRngV 0;
BA_ "GenSigStartValue" SG_ 326 FrntRdrDetn68RdrDetnSts 3;
BA_ "GenSigSendType" SG_ 326 FrntRdrDetn68RdrDetnSts 0;
BA_ "GenSigStartValue" SG_ 326 FrntRdrDetn69RdrDetnAzi 900;
BA_ "GenSigSendType" SG_ 326 FrntRdrDetn69RdrDetnAzi 0;
BA_ "GenSigSendType" SG_ 326 FrntRdrDetn69RdrDetnChks 0;
BA_ "GenSigFuncType" SG_ 326 FrntRdrDetn69RdrDetnChks 15;
BA_ "GenSigDataID" SG_ 326 FrntRdrDetn69RdrDetnChks "0x74C";
BA_ "GenSigSendType" SG_ 326 FrntRdrDetn69RdrDetnCntr 0;
BA_ "GenSigFuncType" SG_ 326 FrntRdrDetn69RdrDetnCntr 16;
BA_ "GenSigSendType" SG_ 326 FrntRdrDetn69RdrDetnConf 0;
BA_ "GenSigStartValue" SG_ 326 FrntRdrDetn69RdrDetnElevn 15;
BA_ "GenSigSendType" SG_ 326 FrntRdrDetn69RdrDetnElevn 0;
BA_ "GenSigSendType" SG_ 326 FrntRdrDetn69RdrDetnPwr 0;
BA_ "GenSigStartValue" SG_ 326 FrntRdrDetn69RdrDetnRng 10050;
BA_ "GenSigSendType" SG_ 326 FrntRdrDetn69RdrDetnRng 0;
BA_ "GenSigStartValue" SG_ 326 FrntRdrDetn69RdrDetnRngV 4000;
BA_ "GenSigSendType" SG_ 326 FrntRdrDetn69RdrDetnRngV 0;
BA_ "GenSigStartValue" SG_ 326 FrntRdrDetn69RdrDetnSts 3;
BA_ "GenSigSendType" SG_ 326 FrntRdrDetn69RdrDetnSts 0;
BA_ "GenSigStartValue" SG_ 326 FrntRdrDetn70RdrDetnAzi 900;
BA_ "GenSigSendType" SG_ 326 FrntRdrDetn70RdrDetnAzi 0;
BA_ "GenSigSendType" SG_ 326 FrntRdrDetn70RdrDetnChks 0;
BA_ "GenSigFuncType" SG_ 326 FrntRdrDetn70RdrDetnChks 15;
BA_ "GenSigDataID" SG_ 326 FrntRdrDetn70RdrDetnChks "0x74D";
BA_ "GenSigSendType" SG_ 326 FrntRdrDetn70RdrDetnCntr 0;
BA_ "GenSigFuncType" SG_ 326 FrntRdrDetn70RdrDetnCntr 16;
BA_ "GenSigSendType" SG_ 326 FrntRdrDetn70RdrDetnConf 0;
BA_ "GenSigStartValue" SG_ 326 FrntRdrDetn70RdrDetnElevn 15;
BA_ "GenSigSendType" SG_ 326 FrntRdrDetn70RdrDetnElevn 0;
BA_ "GenSigSendType" SG_ 326 FrntRdrDetn70RdrDetnPwr 0;
BA_ "GenSigStartValue" SG_ 326 FrntRdrDetn70RdrDetnRng 10050;
BA_ "GenSigSendType" SG_ 326 FrntRdrDetn70RdrDetnRng 0;
BA_ "GenSigStartValue" SG_ 326 FrntRdrDetn70RdrDetnRngV 4000;
BA_ "GenSigSendType" SG_ 326 FrntRdrDetn70RdrDetnRngV 0;
BA_ "GenSigStartValue" SG_ 326 FrntRdrDetn70RdrDetnSts 3;
BA_ "GenSigSendType" SG_ 326 FrntRdrDetn70RdrDetnSts 0;
BA_ "GenSigStartValue" SG_ 326 FrntRdrDetn71RdrDetnAzi 900;
BA_ "GenSigSendType" SG_ 326 FrntRdrDetn71RdrDetnAzi 0;
BA_ "GenSigSendType" SG_ 326 FrntRdrDetn71RdrDetnChks 0;
BA_ "GenSigFuncType" SG_ 326 FrntRdrDetn71RdrDetnChks 15;
BA_ "GenSigDataID" SG_ 326 FrntRdrDetn71RdrDetnChks "0x74E";
BA_ "GenSigSendType" SG_ 326 FrntRdrDetn71RdrDetnCntr 0;
BA_ "GenSigFuncType" SG_ 326 FrntRdrDetn71RdrDetnCntr 16;
BA_ "GenSigSendType" SG_ 326 FrntRdrDetn71RdrDetnConf 0;
BA_ "GenSigStartValue" SG_ 326 FrntRdrDetn71RdrDetnElevn 15;
BA_ "GenSigSendType" SG_ 326 FrntRdrDetn71RdrDetnElevn 0;
BA_ "GenSigSendType" SG_ 326 FrntRdrDetn71RdrDetnPwr 0;
BA_ "GenSigStartValue" SG_ 326 FrntRdrDetn71RdrDetnRng 10050;
BA_ "GenSigSendType" SG_ 326 FrntRdrDetn71RdrDetnRng 0;
BA_ "GenSigStartValue" SG_ 326 FrntRdrDetn71RdrDetnRngV 4000;
BA_ "GenSigSendType" SG_ 326 FrntRdrDetn71RdrDetnRngV 0;
BA_ "GenSigStartValue" SG_ 326 FrntRdrDetn71RdrDetnSts 3;
BA_ "GenSigSendType" SG_ 326 FrntRdrDetn71RdrDetnSts 0;
BA_ "GenSigStartValue" SG_ 326 FrntRdrDetn72RdrDetnAzi 900;
BA_ "GenSigSendType" SG_ 326 FrntRdrDetn72RdrDetnAzi 0;
BA_ "GenSigSendType" SG_ 326 FrntRdrDetn72RdrDetnChks 0;
BA_ "GenSigFuncType" SG_ 326 FrntRdrDetn72RdrDetnChks 15;
BA_ "GenSigDataID" SG_ 326 FrntRdrDetn72RdrDetnChks "0x74F";
BA_ "GenSigSendType" SG_ 326 FrntRdrDetn72RdrDetnCntr 0;
BA_ "GenSigFuncType" SG_ 326 FrntRdrDetn72RdrDetnCntr 16;
BA_ "GenSigSendType" SG_ 326 FrntRdrDetn72RdrDetnConf 0;
BA_ "GenSigStartValue" SG_ 326 FrntRdrDetn72RdrDetnElevn 15;
BA_ "GenSigSendType" SG_ 326 FrntRdrDetn72RdrDetnElevn 0;
BA_ "GenSigSendType" SG_ 326 FrntRdrDetn72RdrDetnPwr 0;
BA_ "GenSigStartValue" SG_ 326 FrntRdrDetn72RdrDetnRng 10050;
BA_ "GenSigSendType" SG_ 326 FrntRdrDetn72RdrDetnRng 0;
BA_ "GenSigStartValue" SG_ 326 FrntRdrDetn72RdrDetnRngV 4000;
BA_ "GenSigSendType" SG_ 326 FrntRdrDetn72RdrDetnRngV 0;
BA_ "GenSigStartValue" SG_ 326 FrntRdrDetn72RdrDetnSts 3;
BA_ "GenSigSendType" SG_ 326 FrntRdrDetn72RdrDetnSts 0;
// Frame: FLRSafetyCANFD2Frame13
BA_ "VFrameFormat" BO_ 328 14;
BA_ "GenMsgSendType" BO_ 328 0;
BA_ "GenMsgCycleTime" BO_ 328 50.000;
BA_ "GenSigStartValue" SG_ 328 FrntRdrDetn73RdrDetnAzi 900;
BA_ "GenSigSendType" SG_ 328 FrntRdrDetn73RdrDetnAzi 0;
BA_ "GenSigSendType" SG_ 328 FrntRdrDetn73RdrDetnChks 0;
BA_ "GenSigFuncType" SG_ 328 FrntRdrDetn73RdrDetnChks 15;
BA_ "GenSigDataID" SG_ 328 FrntRdrDetn73RdrDetnChks "0x750";
BA_ "GenSigSendType" SG_ 328 FrntRdrDetn73RdrDetnCntr 0;
BA_ "GenSigFuncType" SG_ 328 FrntRdrDetn73RdrDetnCntr 16;
BA_ "GenSigSendType" SG_ 328 FrntRdrDetn73RdrDetnConf 0;
BA_ "GenSigStartValue" SG_ 328 FrntRdrDetn73RdrDetnElevn 15;
BA_ "GenSigSendType" SG_ 328 FrntRdrDetn73RdrDetnElevn 0;
BA_ "GenSigSendType" SG_ 328 FrntRdrDetn73RdrDetnPwr 0;
BA_ "GenSigStartValue" SG_ 328 FrntRdrDetn73RdrDetnRng 10050;
BA_ "GenSigSendType" SG_ 328 FrntRdrDetn73RdrDetnRng 0;
BA_ "GenSigStartValue" SG_ 328 FrntRdrDetn73RdrDetnRngV 4000;
BA_ "GenSigSendType" SG_ 328 FrntRdrDetn73RdrDetnRngV 0;
BA_ "GenSigStartValue" SG_ 328 FrntRdrDetn73RdrDetnSts 3;
BA_ "GenSigSendType" SG_ 328 FrntRdrDetn73RdrDetnSts 0;
BA_ "GenSigStartValue" SG_ 328 FrntRdrDetn74RdrDetnAzi 900;
BA_ "GenSigSendType" SG_ 328 FrntRdrDetn74RdrDetnAzi 0;
BA_ "GenSigSendType" SG_ 328 FrntRdrDetn74RdrDetnChks 0;
BA_ "GenSigFuncType" SG_ 328 FrntRdrDetn74RdrDetnChks 15;
BA_ "GenSigDataID" SG_ 328 FrntRdrDetn74RdrDetnChks "0x751";
BA_ "GenSigSendType" SG_ 328 FrntRdrDetn74RdrDetnCntr 0;
BA_ "GenSigFuncType" SG_ 328 FrntRdrDetn74RdrDetnCntr 16;
BA_ "GenSigSendType" SG_ 328 FrntRdrDetn74RdrDetnConf 0;
BA_ "GenSigStartValue" SG_ 328 FrntRdrDetn74RdrDetnElevn 15;
BA_ "GenSigSendType" SG_ 328 FrntRdrDetn74RdrDetnElevn 0;
BA_ "GenSigSendType" SG_ 328 FrntRdrDetn74RdrDetnPwr 0;
BA_ "GenSigStartValue" SG_ 328 FrntRdrDetn74RdrDetnRng 10050;
BA_ "GenSigSendType" SG_ 328 FrntRdrDetn74RdrDetnRng 0;
BA_ "GenSigStartValue" SG_ 328 FrntRdrDetn74RdrDetnRngV 4000;
BA_ "GenSigSendType" SG_ 328 FrntRdrDetn74RdrDetnRngV 0;
BA_ "GenSigStartValue" SG_ 328 FrntRdrDetn74RdrDetnSts 3;
BA_ "GenSigSendType" SG_ 328 FrntRdrDetn74RdrDetnSts 0;
BA_ "GenSigStartValue" SG_ 328 FrntRdrDetn75RdrDetnAzi 900;
BA_ "GenSigSendType" SG_ 328 FrntRdrDetn75RdrDetnAzi 0;
BA_ "GenSigSendType" SG_ 328 FrntRdrDetn75RdrDetnChks 0;
BA_ "GenSigFuncType" SG_ 328 FrntRdrDetn75RdrDetnChks 15;
BA_ "GenSigDataID" SG_ 328 FrntRdrDetn75RdrDetnChks "0x752";
BA_ "GenSigSendType" SG_ 328 FrntRdrDetn75RdrDetnCntr 0;
BA_ "GenSigFuncType" SG_ 328 FrntRdrDetn75RdrDetnCntr 16;
BA_ "GenSigSendType" SG_ 328 FrntRdrDetn75RdrDetnConf 0;
BA_ "GenSigStartValue" SG_ 328 FrntRdrDetn75RdrDetnElevn 15;
BA_ "GenSigSendType" SG_ 328 FrntRdrDetn75RdrDetnElevn 0;
BA_ "GenSigSendType" SG_ 328 FrntRdrDetn75RdrDetnPwr 0;
BA_ "GenSigStartValue" SG_ 328 FrntRdrDetn75RdrDetnRng 10050;
BA_ "GenSigSendType" SG_ 328 FrntRdrDetn75RdrDetnRng 0;
BA_ "GenSigStartValue" SG_ 328 FrntRdrDetn75RdrDetnRngV 4000;
BA_ "GenSigSendType" SG_ 328 FrntRdrDetn75RdrDetnRngV 0;
BA_ "GenSigStartValue" SG_ 328 FrntRdrDetn75RdrDetnSts 3;
BA_ "GenSigSendType" SG_ 328 FrntRdrDetn75RdrDetnSts 0;
BA_ "GenSigStartValue" SG_ 328 FrntRdrDetn76RdrDetnAzi 900;
BA_ "GenSigSendType" SG_ 328 FrntRdrDetn76RdrDetnAzi 0;
BA_ "GenSigSendType" SG_ 328 FrntRdrDetn76RdrDetnChks 0;
BA_ "GenSigFuncType" SG_ 328 FrntRdrDetn76RdrDetnChks 15;
BA_ "GenSigDataID" SG_ 328 FrntRdrDetn76RdrDetnChks "0x753";
BA_ "GenSigSendType" SG_ 328 FrntRdrDetn76RdrDetnCntr 0;
BA_ "GenSigFuncType" SG_ 328 FrntRdrDetn76RdrDetnCntr 16;
BA_ "GenSigSendType" SG_ 328 FrntRdrDetn76RdrDetnConf 0;
BA_ "GenSigStartValue" SG_ 328 FrntRdrDetn76RdrDetnElevn 15;
BA_ "GenSigSendType" SG_ 328 FrntRdrDetn76RdrDetnElevn 0;
BA_ "GenSigSendType" SG_ 328 FrntRdrDetn76RdrDetnPwr 0;
BA_ "GenSigStartValue" SG_ 328 FrntRdrDetn76RdrDetnRng 10050;
BA_ "GenSigSendType" SG_ 328 FrntRdrDetn76RdrDetnRng 0;
BA_ "GenSigStartValue" SG_ 328 FrntRdrDetn76RdrDetnRngV 4000;
BA_ "GenSigSendType" SG_ 328 FrntRdrDetn76RdrDetnRngV 0;
BA_ "GenSigStartValue" SG_ 328 FrntRdrDetn76RdrDetnSts 3;
BA_ "GenSigSendType" SG_ 328 FrntRdrDetn76RdrDetnSts 0;
BA_ "GenSigStartValue" SG_ 328 FrntRdrDetn77RdrDetnAzi 900;
BA_ "GenSigSendType" SG_ 328 FrntRdrDetn77RdrDetnAzi 0;
BA_ "GenSigSendType" SG_ 328 FrntRdrDetn77RdrDetnChks 0;
BA_ "GenSigFuncType" SG_ 328 FrntRdrDetn77RdrDetnChks 15;
BA_ "GenSigDataID" SG_ 328 FrntRdrDetn77RdrDetnChks "0x754";
BA_ "GenSigSendType" SG_ 328 FrntRdrDetn77RdrDetnCntr 0;
BA_ "GenSigFuncType" SG_ 328 FrntRdrDetn77RdrDetnCntr 16;
BA_ "GenSigSendType" SG_ 328 FrntRdrDetn77RdrDetnConf 0;
BA_ "GenSigStartValue" SG_ 328 FrntRdrDetn77RdrDetnElevn 15;
BA_ "GenSigSendType" SG_ 328 FrntRdrDetn77RdrDetnElevn 0;
BA_ "GenSigSendType" SG_ 328 FrntRdrDetn77RdrDetnPwr 0;
BA_ "GenSigStartValue" SG_ 328 FrntRdrDetn77RdrDetnRng 10050;
BA_ "GenSigSendType" SG_ 328 FrntRdrDetn77RdrDetnRng 0;
BA_ "GenSigStartValue" SG_ 328 FrntRdrDetn77RdrDetnRngV 4000;
BA_ "GenSigSendType" SG_ 328 FrntRdrDetn77RdrDetnRngV 0;
BA_ "GenSigStartValue" SG_ 328 FrntRdrDetn77RdrDetnSts 3;
BA_ "GenSigSendType" SG_ 328 FrntRdrDetn77RdrDetnSts 0;
BA_ "GenSigStartValue" SG_ 328 FrntRdrDetn78RdrDetnAzi 900;
BA_ "GenSigSendType" SG_ 328 FrntRdrDetn78RdrDetnAzi 0;
BA_ "GenSigSendType" SG_ 328 FrntRdrDetn78RdrDetnChks 0;
BA_ "GenSigFuncType" SG_ 328 FrntRdrDetn78RdrDetnChks 15;
BA_ "GenSigDataID" SG_ 328 FrntRdrDetn78RdrDetnChks "0x755";
BA_ "GenSigSendType" SG_ 328 FrntRdrDetn78RdrDetnCntr 0;
BA_ "GenSigFuncType" SG_ 328 FrntRdrDetn78RdrDetnCntr 16;
BA_ "GenSigSendType" SG_ 328 FrntRdrDetn78RdrDetnConf 0;
BA_ "GenSigStartValue" SG_ 328 FrntRdrDetn78RdrDetnElevn 15;
BA_ "GenSigSendType" SG_ 328 FrntRdrDetn78RdrDetnElevn 0;
BA_ "GenSigSendType" SG_ 328 FrntRdrDetn78RdrDetnPwr 0;
BA_ "GenSigStartValue" SG_ 328 FrntRdrDetn78RdrDetnRng 10050;
BA_ "GenSigSendType" SG_ 328 FrntRdrDetn78RdrDetnRng 0;
BA_ "GenSigStartValue" SG_ 328 FrntRdrDetn78RdrDetnRngV 4000;
BA_ "GenSigSendType" SG_ 328 FrntRdrDetn78RdrDetnRngV 0;
BA_ "GenSigStartValue" SG_ 328 FrntRdrDetn78RdrDetnSts 3;
BA_ "GenSigSendType" SG_ 328 FrntRdrDetn78RdrDetnSts 0;
// Frame: FLRSafetyCANFD2Frame14
BA_ "VFrameFormat" BO_ 330 14;
BA_ "GenMsgSendType" BO_ 330 0;
BA_ "GenMsgCycleTime" BO_ 330 50.000;
BA_ "GenSigStartValue" SG_ 330 FrntRdrDetn79RdrDetnAzi 900;
BA_ "GenSigSendType" SG_ 330 FrntRdrDetn79RdrDetnAzi 0;
BA_ "GenSigSendType" SG_ 330 FrntRdrDetn79RdrDetnChks 0;
BA_ "GenSigFuncType" SG_ 330 FrntRdrDetn79RdrDetnChks 15;
BA_ "GenSigDataID" SG_ 330 FrntRdrDetn79RdrDetnChks "0x756";
BA_ "GenSigSendType" SG_ 330 FrntRdrDetn79RdrDetnCntr 0;
BA_ "GenSigFuncType" SG_ 330 FrntRdrDetn79RdrDetnCntr 16;
BA_ "GenSigSendType" SG_ 330 FrntRdrDetn79RdrDetnConf 0;
BA_ "GenSigStartValue" SG_ 330 FrntRdrDetn79RdrDetnElevn 15;
BA_ "GenSigSendType" SG_ 330 FrntRdrDetn79RdrDetnElevn 0;
BA_ "GenSigSendType" SG_ 330 FrntRdrDetn79RdrDetnPwr 0;
BA_ "GenSigStartValue" SG_ 330 FrntRdrDetn79RdrDetnRng 10050;
BA_ "GenSigSendType" SG_ 330 FrntRdrDetn79RdrDetnRng 0;
BA_ "GenSigStartValue" SG_ 330 FrntRdrDetn79RdrDetnRngV 4000;
BA_ "GenSigSendType" SG_ 330 FrntRdrDetn79RdrDetnRngV 0;
BA_ "GenSigStartValue" SG_ 330 FrntRdrDetn79RdrDetnSts 3;
BA_ "GenSigSendType" SG_ 330 FrntRdrDetn79RdrDetnSts 0;
BA_ "GenSigStartValue" SG_ 330 FrntRdrDetn80RdrDetnAzi 900;
BA_ "GenSigSendType" SG_ 330 FrntRdrDetn80RdrDetnAzi 0;
BA_ "GenSigSendType" SG_ 330 FrntRdrDetn80RdrDetnChks 0;
BA_ "GenSigFuncType" SG_ 330 FrntRdrDetn80RdrDetnChks 15;
BA_ "GenSigDataID" SG_ 330 FrntRdrDetn80RdrDetnChks "0x757";
BA_ "GenSigSendType" SG_ 330 FrntRdrDetn80RdrDetnCntr 0;
BA_ "GenSigFuncType" SG_ 330 FrntRdrDetn80RdrDetnCntr 16;
BA_ "GenSigSendType" SG_ 330 FrntRdrDetn80RdrDetnConf 0;
BA_ "GenSigStartValue" SG_ 330 FrntRdrDetn80RdrDetnElevn 15;
BA_ "GenSigSendType" SG_ 330 FrntRdrDetn80RdrDetnElevn 0;
BA_ "GenSigSendType" SG_ 330 FrntRdrDetn80RdrDetnPwr 0;
BA_ "GenSigStartValue" SG_ 330 FrntRdrDetn80RdrDetnRng 10050;
BA_ "GenSigSendType" SG_ 330 FrntRdrDetn80RdrDetnRng 0;
BA_ "GenSigStartValue" SG_ 330 FrntRdrDetn80RdrDetnRngV 4000;
BA_ "GenSigSendType" SG_ 330 FrntRdrDetn80RdrDetnRngV 0;
BA_ "GenSigStartValue" SG_ 330 FrntRdrDetn80RdrDetnSts 3;
BA_ "GenSigSendType" SG_ 330 FrntRdrDetn80RdrDetnSts 0;
BA_ "GenSigStartValue" SG_ 330 FrntRdrDetn81RdrDetnAzi 900;
BA_ "GenSigSendType" SG_ 330 FrntRdrDetn81RdrDetnAzi 0;
BA_ "GenSigSendType" SG_ 330 FrntRdrDetn81RdrDetnChks 0;
BA_ "GenSigFuncType" SG_ 330 FrntRdrDetn81RdrDetnChks 15;
BA_ "GenSigDataID" SG_ 330 FrntRdrDetn81RdrDetnChks "0x758";
BA_ "GenSigSendType" SG_ 330 FrntRdrDetn81RdrDetnCntr 0;
BA_ "GenSigFuncType" SG_ 330 FrntRdrDetn81RdrDetnCntr 16;
BA_ "GenSigSendType" SG_ 330 FrntRdrDetn81RdrDetnConf 0;
BA_ "GenSigStartValue" SG_ 330 FrntRdrDetn81RdrDetnElevn 15;
BA_ "GenSigSendType" SG_ 330 FrntRdrDetn81RdrDetnElevn 0;
BA_ "GenSigSendType" SG_ 330 FrntRdrDetn81RdrDetnPwr 0;
BA_ "GenSigStartValue" SG_ 330 FrntRdrDetn81RdrDetnRng 10050;
BA_ "GenSigSendType" SG_ 330 FrntRdrDetn81RdrDetnRng 0;
BA_ "GenSigStartValue" SG_ 330 FrntRdrDetn81RdrDetnRngV 4000;
BA_ "GenSigSendType" SG_ 330 FrntRdrDetn81RdrDetnRngV 0;
BA_ "GenSigStartValue" SG_ 330 FrntRdrDetn81RdrDetnSts 3;
BA_ "GenSigSendType" SG_ 330 FrntRdrDetn81RdrDetnSts 0;
BA_ "GenSigStartValue" SG_ 330 FrntRdrDetn82RdrDetnAzi 900;
BA_ "GenSigSendType" SG_ 330 FrntRdrDetn82RdrDetnAzi 0;
BA_ "GenSigSendType" SG_ 330 FrntRdrDetn82RdrDetnChks 0;
BA_ "GenSigFuncType" SG_ 330 FrntRdrDetn82RdrDetnChks 15;
BA_ "GenSigDataID" SG_ 330 FrntRdrDetn82RdrDetnChks "0x759";
BA_ "GenSigSendType" SG_ 330 FrntRdrDetn82RdrDetnCntr 0;
BA_ "GenSigFuncType" SG_ 330 FrntRdrDetn82RdrDetnCntr 16;
BA_ "GenSigSendType" SG_ 330 FrntRdrDetn82RdrDetnConf 0;
BA_ "GenSigStartValue" SG_ 330 FrntRdrDetn82RdrDetnElevn 15;
BA_ "GenSigSendType" SG_ 330 FrntRdrDetn82RdrDetnElevn 0;
BA_ "GenSigSendType" SG_ 330 FrntRdrDetn82RdrDetnPwr 0;
BA_ "GenSigStartValue" SG_ 330 FrntRdrDetn82RdrDetnRng 10050;
BA_ "GenSigSendType" SG_ 330 FrntRdrDetn82RdrDetnRng 0;
BA_ "GenSigStartValue" SG_ 330 FrntRdrDetn82RdrDetnRngV 4000;
BA_ "GenSigSendType" SG_ 330 FrntRdrDetn82RdrDetnRngV 0;
BA_ "GenSigStartValue" SG_ 330 FrntRdrDetn82RdrDetnSts 3;
BA_ "GenSigSendType" SG_ 330 FrntRdrDetn82RdrDetnSts 0;
BA_ "GenSigStartValue" SG_ 330 FrntRdrDetn83RdrDetnAzi 900;
BA_ "GenSigSendType" SG_ 330 FrntRdrDetn83RdrDetnAzi 0;
BA_ "GenSigSendType" SG_ 330 FrntRdrDetn83RdrDetnChks 0;
BA_ "GenSigFuncType" SG_ 330 FrntRdrDetn83RdrDetnChks 15;
BA_ "GenSigDataID" SG_ 330 FrntRdrDetn83RdrDetnChks "0x75A";
BA_ "GenSigSendType" SG_ 330 FrntRdrDetn83RdrDetnCntr 0;
BA_ "GenSigFuncType" SG_ 330 FrntRdrDetn83RdrDetnCntr 16;
BA_ "GenSigSendType" SG_ 330 FrntRdrDetn83RdrDetnConf 0;
BA_ "GenSigStartValue" SG_ 330 FrntRdrDetn83RdrDetnElevn 15;
BA_ "GenSigSendType" SG_ 330 FrntRdrDetn83RdrDetnElevn 0;
BA_ "GenSigSendType" SG_ 330 FrntRdrDetn83RdrDetnPwr 0;
BA_ "GenSigStartValue" SG_ 330 FrntRdrDetn83RdrDetnRng 10050;
BA_ "GenSigSendType" SG_ 330 FrntRdrDetn83RdrDetnRng 0;
BA_ "GenSigStartValue" SG_ 330 FrntRdrDetn83RdrDetnRngV 4000;
BA_ "GenSigSendType" SG_ 330 FrntRdrDetn83RdrDetnRngV 0;
BA_ "GenSigStartValue" SG_ 330 FrntRdrDetn83RdrDetnSts 3;
BA_ "GenSigSendType" SG_ 330 FrntRdrDetn83RdrDetnSts 0;
BA_ "GenSigStartValue" SG_ 330 FrntRdrDetn84RdrDetnAzi 900;
BA_ "GenSigSendType" SG_ 330 FrntRdrDetn84RdrDetnAzi 0;
BA_ "GenSigSendType" SG_ 330 FrntRdrDetn84RdrDetnChks 0;
BA_ "GenSigFuncType" SG_ 330 FrntRdrDetn84RdrDetnChks 15;
BA_ "GenSigDataID" SG_ 330 FrntRdrDetn84RdrDetnChks "0x75B";
BA_ "GenSigSendType" SG_ 330 FrntRdrDetn84RdrDetnCntr 0;
BA_ "GenSigFuncType" SG_ 330 FrntRdrDetn84RdrDetnCntr 16;
BA_ "GenSigSendType" SG_ 330 FrntRdrDetn84RdrDetnConf 0;
BA_ "GenSigStartValue" SG_ 330 FrntRdrDetn84RdrDetnElevn 15;
BA_ "GenSigSendType" SG_ 330 FrntRdrDetn84RdrDetnElevn 0;
BA_ "GenSigSendType" SG_ 330 FrntRdrDetn84RdrDetnPwr 0;
BA_ "GenSigStartValue" SG_ 330 FrntRdrDetn84RdrDetnRng 10050;
BA_ "GenSigSendType" SG_ 330 FrntRdrDetn84RdrDetnRng 0;
BA_ "GenSigStartValue" SG_ 330 FrntRdrDetn84RdrDetnRngV 4000;
BA_ "GenSigSendType" SG_ 330 FrntRdrDetn84RdrDetnRngV 0;
BA_ "GenSigStartValue" SG_ 330 FrntRdrDetn84RdrDetnSts 3;
BA_ "GenSigSendType" SG_ 330 FrntRdrDetn84RdrDetnSts 0;
// Frame: FLRSafetyCANFD2Frame15
BA_ "VFrameFormat" BO_ 332 14;
BA_ "GenMsgSendType" BO_ 332 0;
BA_ "GenMsgCycleTime" BO_ 332 50.000;
BA_ "GenSigStartValue" SG_ 332 FrntRdrDetn85RdrDetnAzi 900;
BA_ "GenSigSendType" SG_ 332 FrntRdrDetn85RdrDetnAzi 0;
BA_ "GenSigSendType" SG_ 332 FrntRdrDetn85RdrDetnChks 0;
BA_ "GenSigFuncType" SG_ 332 FrntRdrDetn85RdrDetnChks 15;
BA_ "GenSigDataID" SG_ 332 FrntRdrDetn85RdrDetnChks "0x75C";
BA_ "GenSigSendType" SG_ 332 FrntRdrDetn85RdrDetnCntr 0;
BA_ "GenSigFuncType" SG_ 332 FrntRdrDetn85RdrDetnCntr 16;
BA_ "GenSigSendType" SG_ 332 FrntRdrDetn85RdrDetnConf 0;
BA_ "GenSigStartValue" SG_ 332 FrntRdrDetn85RdrDetnElevn 15;
BA_ "GenSigSendType" SG_ 332 FrntRdrDetn85RdrDetnElevn 0;
BA_ "GenSigSendType" SG_ 332 FrntRdrDetn85RdrDetnPwr 0;
BA_ "GenSigStartValue" SG_ 332 FrntRdrDetn85RdrDetnRng 10050;
BA_ "GenSigSendType" SG_ 332 FrntRdrDetn85RdrDetnRng 0;
BA_ "GenSigStartValue" SG_ 332 FrntRdrDetn85RdrDetnRngV 4000;
BA_ "GenSigSendType" SG_ 332 FrntRdrDetn85RdrDetnRngV 0;
BA_ "GenSigStartValue" SG_ 332 FrntRdrDetn85RdrDetnSts 3;
BA_ "GenSigSendType" SG_ 332 FrntRdrDetn85RdrDetnSts 0;
BA_ "GenSigStartValue" SG_ 332 FrntRdrDetn86RdrDetnAzi 900;
BA_ "GenSigSendType" SG_ 332 FrntRdrDetn86RdrDetnAzi 0;
BA_ "GenSigSendType" SG_ 332 FrntRdrDetn86RdrDetnChks 0;
BA_ "GenSigFuncType" SG_ 332 FrntRdrDetn86RdrDetnChks 15;
BA_ "GenSigDataID" SG_ 332 FrntRdrDetn86RdrDetnChks "0x75D";
BA_ "GenSigSendType" SG_ 332 FrntRdrDetn86RdrDetnCntr 0;
BA_ "GenSigFuncType" SG_ 332 FrntRdrDetn86RdrDetnCntr 16;
BA_ "GenSigSendType" SG_ 332 FrntRdrDetn86RdrDetnConf 0;
BA_ "GenSigStartValue" SG_ 332 FrntRdrDetn86RdrDetnElevn 15;
BA_ "GenSigSendType" SG_ 332 FrntRdrDetn86RdrDetnElevn 0;
BA_ "GenSigSendType" SG_ 332 FrntRdrDetn86RdrDetnPwr 0;
BA_ "GenSigStartValue" SG_ 332 FrntRdrDetn86RdrDetnRng 10050;
BA_ "GenSigSendType" SG_ 332 FrntRdrDetn86RdrDetnRng 0;
BA_ "GenSigStartValue" SG_ 332 FrntRdrDetn86RdrDetnRngV 4000;
BA_ "GenSigSendType" SG_ 332 FrntRdrDetn86RdrDetnRngV 0;
BA_ "GenSigStartValue" SG_ 332 FrntRdrDetn86RdrDetnSts 3;
BA_ "GenSigSendType" SG_ 332 FrntRdrDetn86RdrDetnSts 0;
BA_ "GenSigStartValue" SG_ 332 FrntRdrDetn87RdrDetnAzi 900;
BA_ "GenSigSendType" SG_ 332 FrntRdrDetn87RdrDetnAzi 0;
BA_ "GenSigSendType" SG_ 332 FrntRdrDetn87RdrDetnChks 0;
BA_ "GenSigFuncType" SG_ 332 FrntRdrDetn87RdrDetnChks 15;
BA_ "GenSigDataID" SG_ 332 FrntRdrDetn87RdrDetnChks "0x75E";
BA_ "GenSigSendType" SG_ 332 FrntRdrDetn87RdrDetnCntr 0;
BA_ "GenSigFuncType" SG_ 332 FrntRdrDetn87RdrDetnCntr 16;
BA_ "GenSigSendType" SG_ 332 FrntRdrDetn87RdrDetnConf 0;
BA_ "GenSigStartValue" SG_ 332 FrntRdrDetn87RdrDetnElevn 15;
BA_ "GenSigSendType" SG_ 332 FrntRdrDetn87RdrDetnElevn 0;
BA_ "GenSigSendType" SG_ 332 FrntRdrDetn87RdrDetnPwr 0;
BA_ "GenSigStartValue" SG_ 332 FrntRdrDetn87RdrDetnRng 10050;
BA_ "GenSigSendType" SG_ 332 FrntRdrDetn87RdrDetnRng 0;
BA_ "GenSigStartValue" SG_ 332 FrntRdrDetn87RdrDetnRngV 4000;
BA_ "GenSigSendType" SG_ 332 FrntRdrDetn87RdrDetnRngV 0;
BA_ "GenSigStartValue" SG_ 332 FrntRdrDetn87RdrDetnSts 3;
BA_ "GenSigSendType" SG_ 332 FrntRdrDetn87RdrDetnSts 0;
BA_ "GenSigStartValue" SG_ 332 FrntRdrDetn88RdrDetnAzi 900;
BA_ "GenSigSendType" SG_ 332 FrntRdrDetn88RdrDetnAzi 0;
BA_ "GenSigSendType" SG_ 332 FrntRdrDetn88RdrDetnChks 0;
BA_ "GenSigFuncType" SG_ 332 FrntRdrDetn88RdrDetnChks 15;
BA_ "GenSigDataID" SG_ 332 FrntRdrDetn88RdrDetnChks "0x75F";
BA_ "GenSigSendType" SG_ 332 FrntRdrDetn88RdrDetnCntr 0;
BA_ "GenSigFuncType" SG_ 332 FrntRdrDetn88RdrDetnCntr 16;
BA_ "GenSigSendType" SG_ 332 FrntRdrDetn88RdrDetnConf 0;
BA_ "GenSigStartValue" SG_ 332 FrntRdrDetn88RdrDetnElevn 15;
BA_ "GenSigSendType" SG_ 332 FrntRdrDetn88RdrDetnElevn 0;
BA_ "GenSigSendType" SG_ 332 FrntRdrDetn88RdrDetnPwr 0;
BA_ "GenSigStartValue" SG_ 332 FrntRdrDetn88RdrDetnRng 10050;
BA_ "GenSigSendType" SG_ 332 FrntRdrDetn88RdrDetnRng 0;
BA_ "GenSigStartValue" SG_ 332 FrntRdrDetn88RdrDetnRngV 4000;
BA_ "GenSigSendType" SG_ 332 FrntRdrDetn88RdrDetnRngV 0;
BA_ "GenSigStartValue" SG_ 332 FrntRdrDetn88RdrDetnSts 3;
BA_ "GenSigSendType" SG_ 332 FrntRdrDetn88RdrDetnSts 0;
BA_ "GenSigStartValue" SG_ 332 FrntRdrDetn89RdrDetnAzi 900;
BA_ "GenSigSendType" SG_ 332 FrntRdrDetn89RdrDetnAzi 0;
BA_ "GenSigSendType" SG_ 332 FrntRdrDetn89RdrDetnChks 0;
BA_ "GenSigFuncType" SG_ 332 FrntRdrDetn89RdrDetnChks 15;
BA_ "GenSigDataID" SG_ 332 FrntRdrDetn89RdrDetnChks "0x760";
BA_ "GenSigSendType" SG_ 332 FrntRdrDetn89RdrDetnCntr 0;
BA_ "GenSigFuncType" SG_ 332 FrntRdrDetn89RdrDetnCntr 16;
BA_ "GenSigSendType" SG_ 332 FrntRdrDetn89RdrDetnConf 0;
BA_ "GenSigStartValue" SG_ 332 FrntRdrDetn89RdrDetnElevn 15;
BA_ "GenSigSendType" SG_ 332 FrntRdrDetn89RdrDetnElevn 0;
BA_ "GenSigSendType" SG_ 332 FrntRdrDetn89RdrDetnPwr 0;
BA_ "GenSigStartValue" SG_ 332 FrntRdrDetn89RdrDetnRng 10050;
BA_ "GenSigSendType" SG_ 332 FrntRdrDetn89RdrDetnRng 0;
BA_ "GenSigStartValue" SG_ 332 FrntRdrDetn89RdrDetnRngV 4000;
BA_ "GenSigSendType" SG_ 332 FrntRdrDetn89RdrDetnRngV 0;
BA_ "GenSigStartValue" SG_ 332 FrntRdrDetn89RdrDetnSts 3;
BA_ "GenSigSendType" SG_ 332 FrntRdrDetn89RdrDetnSts 0;
BA_ "GenSigStartValue" SG_ 332 FrntRdrDetn90RdrDetnAzi 900;
BA_ "GenSigSendType" SG_ 332 FrntRdrDetn90RdrDetnAzi 0;
BA_ "GenSigSendType" SG_ 332 FrntRdrDetn90RdrDetnChks 0;
BA_ "GenSigFuncType" SG_ 332 FrntRdrDetn90RdrDetnChks 15;
BA_ "GenSigDataID" SG_ 332 FrntRdrDetn90RdrDetnChks "0x761";
BA_ "GenSigSendType" SG_ 332 FrntRdrDetn90RdrDetnCntr 0;
BA_ "GenSigFuncType" SG_ 332 FrntRdrDetn90RdrDetnCntr 16;
BA_ "GenSigSendType" SG_ 332 FrntRdrDetn90RdrDetnConf 0;
BA_ "GenSigStartValue" SG_ 332 FrntRdrDetn90RdrDetnElevn 15;
BA_ "GenSigSendType" SG_ 332 FrntRdrDetn90RdrDetnElevn 0;
BA_ "GenSigSendType" SG_ 332 FrntRdrDetn90RdrDetnPwr 0;
BA_ "GenSigStartValue" SG_ 332 FrntRdrDetn90RdrDetnRng 10050;
BA_ "GenSigSendType" SG_ 332 FrntRdrDetn90RdrDetnRng 0;
BA_ "GenSigStartValue" SG_ 332 FrntRdrDetn90RdrDetnRngV 4000;
BA_ "GenSigSendType" SG_ 332 FrntRdrDetn90RdrDetnRngV 0;
BA_ "GenSigStartValue" SG_ 332 FrntRdrDetn90RdrDetnSts 3;
BA_ "GenSigSendType" SG_ 332 FrntRdrDetn90RdrDetnSts 0;
// Frame: FLRSafetyCANFD2Frame16
BA_ "VFrameFormat" BO_ 334 14;
BA_ "GenMsgSendType" BO_ 334 0;
BA_ "GenMsgCycleTime" BO_ 334 50.000;
BA_ "GenSigStartValue" SG_ 334 FrntRdrDetn91RdrDetnAzi 900;
BA_ "GenSigSendType" SG_ 334 FrntRdrDetn91RdrDetnAzi 0;
BA_ "GenSigSendType" SG_ 334 FrntRdrDetn91RdrDetnChks 0;
BA_ "GenSigFuncType" SG_ 334 FrntRdrDetn91RdrDetnChks 15;
BA_ "GenSigDataID" SG_ 334 FrntRdrDetn91RdrDetnChks "0x762";
BA_ "GenSigSendType" SG_ 334 FrntRdrDetn91RdrDetnCntr 0;
BA_ "GenSigFuncType" SG_ 334 FrntRdrDetn91RdrDetnCntr 16;
BA_ "GenSigSendType" SG_ 334 FrntRdrDetn91RdrDetnConf 0;
BA_ "GenSigStartValue" SG_ 334 FrntRdrDetn91RdrDetnElevn 15;
BA_ "GenSigSendType" SG_ 334 FrntRdrDetn91RdrDetnElevn 0;
BA_ "GenSigSendType" SG_ 334 FrntRdrDetn91RdrDetnPwr 0;
BA_ "GenSigStartValue" SG_ 334 FrntRdrDetn91RdrDetnRng 10050;
BA_ "GenSigSendType" SG_ 334 FrntRdrDetn91RdrDetnRng 0;
BA_ "GenSigStartValue" SG_ 334 FrntRdrDetn91RdrDetnRngV 4000;
BA_ "GenSigSendType" SG_ 334 FrntRdrDetn91RdrDetnRngV 0;
BA_ "GenSigStartValue" SG_ 334 FrntRdrDetn91RdrDetnSts 3;
BA_ "GenSigSendType" SG_ 334 FrntRdrDetn91RdrDetnSts 0;
BA_ "GenSigStartValue" SG_ 334 FrntRdrDetn92RdrDetnAzi 900;
BA_ "GenSigSendType" SG_ 334 FrntRdrDetn92RdrDetnAzi 0;
BA_ "GenSigSendType" SG_ 334 FrntRdrDetn92RdrDetnChks 0;
BA_ "GenSigFuncType" SG_ 334 FrntRdrDetn92RdrDetnChks 15;
BA_ "GenSigDataID" SG_ 334 FrntRdrDetn92RdrDetnChks "0x763";
BA_ "GenSigSendType" SG_ 334 FrntRdrDetn92RdrDetnCntr 0;
BA_ "GenSigFuncType" SG_ 334 FrntRdrDetn92RdrDetnCntr 16;
BA_ "GenSigSendType" SG_ 334 FrntRdrDetn92RdrDetnConf 0;
BA_ "GenSigStartValue" SG_ 334 FrntRdrDetn92RdrDetnElevn 15;
BA_ "GenSigSendType" SG_ 334 FrntRdrDetn92RdrDetnElevn 0;
BA_ "GenSigSendType" SG_ 334 FrntRdrDetn92RdrDetnPwr 0;
BA_ "GenSigStartValue" SG_ 334 FrntRdrDetn92RdrDetnRng 10050;
BA_ "GenSigSendType" SG_ 334 FrntRdrDetn92RdrDetnRng 0;
BA_ "GenSigStartValue" SG_ 334 FrntRdrDetn92RdrDetnRngV 4000;
BA_ "GenSigSendType" SG_ 334 FrntRdrDetn92RdrDetnRngV 0;
BA_ "GenSigStartValue" SG_ 334 FrntRdrDetn92RdrDetnSts 3;
BA_ "GenSigSendType" SG_ 334 FrntRdrDetn92RdrDetnSts 0;
BA_ "GenSigStartValue" SG_ 334 FrntRdrDetn93RdrDetnAzi 900;
BA_ "GenSigSendType" SG_ 334 FrntRdrDetn93RdrDetnAzi 0;
BA_ "GenSigSendType" SG_ 334 FrntRdrDetn93RdrDetnChks 0;
BA_ "GenSigFuncType" SG_ 334 FrntRdrDetn93RdrDetnChks 15;
BA_ "GenSigDataID" SG_ 334 FrntRdrDetn93RdrDetnChks "0x764";
BA_ "GenSigSendType" SG_ 334 FrntRdrDetn93RdrDetnCntr 0;
BA_ "GenSigFuncType" SG_ 334 FrntRdrDetn93RdrDetnCntr 16;
BA_ "GenSigSendType" SG_ 334 FrntRdrDetn93RdrDetnConf 0;
BA_ "GenSigStartValue" SG_ 334 FrntRdrDetn93RdrDetnElevn 15;
BA_ "GenSigSendType" SG_ 334 FrntRdrDetn93RdrDetnElevn 0;
BA_ "GenSigSendType" SG_ 334 FrntRdrDetn93RdrDetnPwr 0;
BA_ "GenSigStartValue" SG_ 334 FrntRdrDetn93RdrDetnRng 10050;
BA_ "GenSigSendType" SG_ 334 FrntRdrDetn93RdrDetnRng 0;
BA_ "GenSigStartValue" SG_ 334 FrntRdrDetn93RdrDetnRngV 4000;
BA_ "GenSigSendType" SG_ 334 FrntRdrDetn93RdrDetnRngV 0;
BA_ "GenSigStartValue" SG_ 334 FrntRdrDetn93RdrDetnSts 3;
BA_ "GenSigSendType" SG_ 334 FrntRdrDetn93RdrDetnSts 0;
BA_ "GenSigStartValue" SG_ 334 FrntRdrDetn94RdrDetnAzi 900;
BA_ "GenSigSendType" SG_ 334 FrntRdrDetn94RdrDetnAzi 0;
BA_ "GenSigSendType" SG_ 334 FrntRdrDetn94RdrDetnChks 0;
BA_ "GenSigFuncType" SG_ 334 FrntRdrDetn94RdrDetnChks 15;
BA_ "GenSigDataID" SG_ 334 FrntRdrDetn94RdrDetnChks "0x765";
BA_ "GenSigSendType" SG_ 334 FrntRdrDetn94RdrDetnCntr 0;
BA_ "GenSigFuncType" SG_ 334 FrntRdrDetn94RdrDetnCntr 16;
BA_ "GenSigSendType" SG_ 334 FrntRdrDetn94RdrDetnConf 0;
BA_ "GenSigStartValue" SG_ 334 FrntRdrDetn94RdrDetnElevn 15;
BA_ "GenSigSendType" SG_ 334 FrntRdrDetn94RdrDetnElevn 0;
BA_ "GenSigSendType" SG_ 334 FrntRdrDetn94RdrDetnPwr 0;
BA_ "GenSigStartValue" SG_ 334 FrntRdrDetn94RdrDetnRng 10050;
BA_ "GenSigSendType" SG_ 334 FrntRdrDetn94RdrDetnRng 0;
BA_ "GenSigStartValue" SG_ 334 FrntRdrDetn94RdrDetnRngV 4000;
BA_ "GenSigSendType" SG_ 334 FrntRdrDetn94RdrDetnRngV 0;
BA_ "GenSigStartValue" SG_ 334 FrntRdrDetn94RdrDetnSts 3;
BA_ "GenSigSendType" SG_ 334 FrntRdrDetn94RdrDetnSts 0;
BA_ "GenSigStartValue" SG_ 334 FrntRdrDetn95RdrDetnAzi 900;
BA_ "GenSigSendType" SG_ 334 FrntRdrDetn95RdrDetnAzi 0;
BA_ "GenSigSendType" SG_ 334 FrntRdrDetn95RdrDetnChks 0;
BA_ "GenSigFuncType" SG_ 334 FrntRdrDetn95RdrDetnChks 15;
BA_ "GenSigDataID" SG_ 334 FrntRdrDetn95RdrDetnChks "0x766";
BA_ "GenSigSendType" SG_ 334 FrntRdrDetn95RdrDetnCntr 0;
BA_ "GenSigFuncType" SG_ 334 FrntRdrDetn95RdrDetnCntr 16;
BA_ "GenSigSendType" SG_ 334 FrntRdrDetn95RdrDetnConf 0;
BA_ "GenSigStartValue" SG_ 334 FrntRdrDetn95RdrDetnElevn 15;
BA_ "GenSigSendType" SG_ 334 FrntRdrDetn95RdrDetnElevn 0;
BA_ "GenSigSendType" SG_ 334 FrntRdrDetn95RdrDetnPwr 0;
BA_ "GenSigStartValue" SG_ 334 FrntRdrDetn95RdrDetnRng 10050;
BA_ "GenSigSendType" SG_ 334 FrntRdrDetn95RdrDetnRng 0;
BA_ "GenSigStartValue" SG_ 334 FrntRdrDetn95RdrDetnRngV 4000;
BA_ "GenSigSendType" SG_ 334 FrntRdrDetn95RdrDetnRngV 0;
BA_ "GenSigStartValue" SG_ 334 FrntRdrDetn95RdrDetnSts 3;
BA_ "GenSigSendType" SG_ 334 FrntRdrDetn95RdrDetnSts 0;
BA_ "GenSigStartValue" SG_ 334 FrntRdrDetn96RdrDetnAzi 900;
BA_ "GenSigSendType" SG_ 334 FrntRdrDetn96RdrDetnAzi 0;
BA_ "GenSigSendType" SG_ 334 FrntRdrDetn96RdrDetnChks 0;
BA_ "GenSigFuncType" SG_ 334 FrntRdrDetn96RdrDetnChks 15;
BA_ "GenSigDataID" SG_ 334 FrntRdrDetn96RdrDetnChks "0x767";
BA_ "GenSigSendType" SG_ 334 FrntRdrDetn96RdrDetnCntr 0;
BA_ "GenSigFuncType" SG_ 334 FrntRdrDetn96RdrDetnCntr 16;
BA_ "GenSigSendType" SG_ 334 FrntRdrDetn96RdrDetnConf 0;
BA_ "GenSigStartValue" SG_ 334 FrntRdrDetn96RdrDetnElevn 15;
BA_ "GenSigSendType" SG_ 334 FrntRdrDetn96RdrDetnElevn 0;
BA_ "GenSigSendType" SG_ 334 FrntRdrDetn96RdrDetnPwr 0;
BA_ "GenSigStartValue" SG_ 334 FrntRdrDetn96RdrDetnRng 10050;
BA_ "GenSigSendType" SG_ 334 FrntRdrDetn96RdrDetnRng 0;
BA_ "GenSigStartValue" SG_ 334 FrntRdrDetn96RdrDetnRngV 4000;
BA_ "GenSigSendType" SG_ 334 FrntRdrDetn96RdrDetnRngV 0;
BA_ "GenSigStartValue" SG_ 334 FrntRdrDetn96RdrDetnSts 3;
BA_ "GenSigSendType" SG_ 334 FrntRdrDetn96RdrDetnSts 0;
// Frame: FLRSafetyCANFD2Frame17
BA_ "VFrameFormat" BO_ 336 14;
BA_ "GenMsgSendType" BO_ 336 0;
BA_ "GenMsgCycleTime" BO_ 336 50.000;
BA_ "GenSigStartValue" SG_ 336 FrntRdrDetn100RdrDetnAzi 900;
BA_ "GenSigSendType" SG_ 336 FrntRdrDetn100RdrDetnAzi 0;
BA_ "GenSigSendType" SG_ 336 FrntRdrDetn100RdrDetnChks 0;
BA_ "GenSigFuncType" SG_ 336 FrntRdrDetn100RdrDetnChks 15;
BA_ "GenSigDataID" SG_ 336 FrntRdrDetn100RdrDetnChks "0x76B";
BA_ "GenSigSendType" SG_ 336 FrntRdrDetn100RdrDetnCntr 0;
BA_ "GenSigFuncType" SG_ 336 FrntRdrDetn100RdrDetnCntr 16;
BA_ "GenSigSendType" SG_ 336 FrntRdrDetn100RdrDetnConf 0;
BA_ "GenSigStartValue" SG_ 336 FrntRdrDetn100RdrDetnElevn 15;
BA_ "GenSigSendType" SG_ 336 FrntRdrDetn100RdrDetnElevn 0;
BA_ "GenSigSendType" SG_ 336 FrntRdrDetn100RdrDetnPwr 0;
BA_ "GenSigStartValue" SG_ 336 FrntRdrDetn100RdrDetnRng 10050;
BA_ "GenSigSendType" SG_ 336 FrntRdrDetn100RdrDetnRng 0;
BA_ "GenSigStartValue" SG_ 336 FrntRdrDetn100RdrDetnRngV 4000;
BA_ "GenSigSendType" SG_ 336 FrntRdrDetn100RdrDetnRngV 0;
BA_ "GenSigStartValue" SG_ 336 FrntRdrDetn100RdrDetnSts 3;
BA_ "GenSigSendType" SG_ 336 FrntRdrDetn100RdrDetnSts 0;
BA_ "GenSigStartValue" SG_ 336 FrntRdrDetn101RdrDetnAzi 900;
BA_ "GenSigSendType" SG_ 336 FrntRdrDetn101RdrDetnAzi 0;
BA_ "GenSigSendType" SG_ 336 FrntRdrDetn101RdrDetnChks 0;
BA_ "GenSigFuncType" SG_ 336 FrntRdrDetn101RdrDetnChks 15;
BA_ "GenSigDataID" SG_ 336 FrntRdrDetn101RdrDetnChks "0x76C";
BA_ "GenSigSendType" SG_ 336 FrntRdrDetn101RdrDetnCntr 0;
BA_ "GenSigFuncType" SG_ 336 FrntRdrDetn101RdrDetnCntr 16;
BA_ "GenSigSendType" SG_ 336 FrntRdrDetn101RdrDetnConf 0;
BA_ "GenSigStartValue" SG_ 336 FrntRdrDetn101RdrDetnElevn 15;
BA_ "GenSigSendType" SG_ 336 FrntRdrDetn101RdrDetnElevn 0;
BA_ "GenSigSendType" SG_ 336 FrntRdrDetn101RdrDetnPwr 0;
BA_ "GenSigStartValue" SG_ 336 FrntRdrDetn101RdrDetnRng 10050;
BA_ "GenSigSendType" SG_ 336 FrntRdrDetn101RdrDetnRng 0;
BA_ "GenSigStartValue" SG_ 336 FrntRdrDetn101RdrDetnRngV 4000;
BA_ "GenSigSendType" SG_ 336 FrntRdrDetn101RdrDetnRngV 0;
BA_ "GenSigStartValue" SG_ 336 FrntRdrDetn101RdrDetnSts 3;
BA_ "GenSigSendType" SG_ 336 FrntRdrDetn101RdrDetnSts 0;
BA_ "GenSigStartValue" SG_ 336 FrntRdrDetn102RdrDetnAzi 900;
BA_ "GenSigSendType" SG_ 336 FrntRdrDetn102RdrDetnAzi 0;
BA_ "GenSigSendType" SG_ 336 FrntRdrDetn102RdrDetnChks 0;
BA_ "GenSigFuncType" SG_ 336 FrntRdrDetn102RdrDetnChks 15;
BA_ "GenSigDataID" SG_ 336 FrntRdrDetn102RdrDetnChks "0x76D";
BA_ "GenSigSendType" SG_ 336 FrntRdrDetn102RdrDetnCntr 0;
BA_ "GenSigFuncType" SG_ 336 FrntRdrDetn102RdrDetnCntr 16;
BA_ "GenSigSendType" SG_ 336 FrntRdrDetn102RdrDetnConf 0;
BA_ "GenSigStartValue" SG_ 336 FrntRdrDetn102RdrDetnElevn 15;
BA_ "GenSigSendType" SG_ 336 FrntRdrDetn102RdrDetnElevn 0;
BA_ "GenSigSendType" SG_ 336 FrntRdrDetn102RdrDetnPwr 0;
BA_ "GenSigStartValue" SG_ 336 FrntRdrDetn102RdrDetnRng 10050;
BA_ "GenSigSendType" SG_ 336 FrntRdrDetn102RdrDetnRng 0;
BA_ "GenSigStartValue" SG_ 336 FrntRdrDetn102RdrDetnRngV 4000;
BA_ "GenSigSendType" SG_ 336 FrntRdrDetn102RdrDetnRngV 0;
BA_ "GenSigStartValue" SG_ 336 FrntRdrDetn102RdrDetnSts 3;
BA_ "GenSigSendType" SG_ 336 FrntRdrDetn102RdrDetnSts 0;
BA_ "GenSigStartValue" SG_ 336 FrntRdrDetn97RdrDetnAzi 900;
BA_ "GenSigSendType" SG_ 336 FrntRdrDetn97RdrDetnAzi 0;
BA_ "GenSigSendType" SG_ 336 FrntRdrDetn97RdrDetnChks 0;
BA_ "GenSigFuncType" SG_ 336 FrntRdrDetn97RdrDetnChks 15;
BA_ "GenSigDataID" SG_ 336 FrntRdrDetn97RdrDetnChks "0x768";
BA_ "GenSigSendType" SG_ 336 FrntRdrDetn97RdrDetnCntr 0;
BA_ "GenSigFuncType" SG_ 336 FrntRdrDetn97RdrDetnCntr 16;
BA_ "GenSigSendType" SG_ 336 FrntRdrDetn97RdrDetnConf 0;
BA_ "GenSigStartValue" SG_ 336 FrntRdrDetn97RdrDetnElevn 15;
BA_ "GenSigSendType" SG_ 336 FrntRdrDetn97RdrDetnElevn 0;
BA_ "GenSigSendType" SG_ 336 FrntRdrDetn97RdrDetnPwr 0;
BA_ "GenSigStartValue" SG_ 336 FrntRdrDetn97RdrDetnRng 10050;
BA_ "GenSigSendType" SG_ 336 FrntRdrDetn97RdrDetnRng 0;
BA_ "GenSigStartValue" SG_ 336 FrntRdrDetn97RdrDetnRngV 4000;
BA_ "GenSigSendType" SG_ 336 FrntRdrDetn97RdrDetnRngV 0;
BA_ "GenSigStartValue" SG_ 336 FrntRdrDetn97RdrDetnSts 3;
BA_ "GenSigSendType" SG_ 336 FrntRdrDetn97RdrDetnSts 0;
BA_ "GenSigStartValue" SG_ 336 FrntRdrDetn98RdrDetnAzi 900;
BA_ "GenSigSendType" SG_ 336 FrntRdrDetn98RdrDetnAzi 0;
BA_ "GenSigSendType" SG_ 336 FrntRdrDetn98RdrDetnChks 0;
BA_ "GenSigFuncType" SG_ 336 FrntRdrDetn98RdrDetnChks 15;
BA_ "GenSigDataID" SG_ 336 FrntRdrDetn98RdrDetnChks "0x769";
BA_ "GenSigSendType" SG_ 336 FrntRdrDetn98RdrDetnCntr 0;
BA_ "GenSigFuncType" SG_ 336 FrntRdrDetn98RdrDetnCntr 16;
BA_ "GenSigSendType" SG_ 336 FrntRdrDetn98RdrDetnConf 0;
BA_ "GenSigStartValue" SG_ 336 FrntRdrDetn98RdrDetnElevn 15;
BA_ "GenSigSendType" SG_ 336 FrntRdrDetn98RdrDetnElevn 0;
BA_ "GenSigSendType" SG_ 336 FrntRdrDetn98RdrDetnPwr 0;
BA_ "GenSigStartValue" SG_ 336 FrntRdrDetn98RdrDetnRng 10050;
BA_ "GenSigSendType" SG_ 336 FrntRdrDetn98RdrDetnRng 0;
BA_ "GenSigStartValue" SG_ 336 FrntRdrDetn98RdrDetnRngV 4000;
BA_ "GenSigSendType" SG_ 336 FrntRdrDetn98RdrDetnRngV 0;
BA_ "GenSigStartValue" SG_ 336 FrntRdrDetn98RdrDetnSts 3;
BA_ "GenSigSendType" SG_ 336 FrntRdrDetn98RdrDetnSts 0;
BA_ "GenSigStartValue" SG_ 336 FrntRdrDetn99RdrDetnAzi 900;
BA_ "GenSigSendType" SG_ 336 FrntRdrDetn99RdrDetnAzi 0;
BA_ "GenSigSendType" SG_ 336 FrntRdrDetn99RdrDetnChks 0;
BA_ "GenSigFuncType" SG_ 336 FrntRdrDetn99RdrDetnChks 15;
BA_ "GenSigDataID" SG_ 336 FrntRdrDetn99RdrDetnChks "0x76A";
BA_ "GenSigSendType" SG_ 336 FrntRdrDetn99RdrDetnCntr 0;
BA_ "GenSigFuncType" SG_ 336 FrntRdrDetn99RdrDetnCntr 16;
BA_ "GenSigSendType" SG_ 336 FrntRdrDetn99RdrDetnConf 0;
BA_ "GenSigStartValue" SG_ 336 FrntRdrDetn99RdrDetnElevn 15;
BA_ "GenSigSendType" SG_ 336 FrntRdrDetn99RdrDetnElevn 0;
BA_ "GenSigSendType" SG_ 336 FrntRdrDetn99RdrDetnPwr 0;
BA_ "GenSigStartValue" SG_ 336 FrntRdrDetn99RdrDetnRng 10050;
BA_ "GenSigSendType" SG_ 336 FrntRdrDetn99RdrDetnRng 0;
BA_ "GenSigStartValue" SG_ 336 FrntRdrDetn99RdrDetnRngV 4000;
BA_ "GenSigSendType" SG_ 336 FrntRdrDetn99RdrDetnRngV 0;
BA_ "GenSigStartValue" SG_ 336 FrntRdrDetn99RdrDetnSts 3;
BA_ "GenSigSendType" SG_ 336 FrntRdrDetn99RdrDetnSts 0;
// Frame: FLRSafetyCANFD2Frame18
BA_ "VFrameFormat" BO_ 338 14;
BA_ "GenMsgSendType" BO_ 338 0;
BA_ "GenMsgCycleTime" BO_ 338 50.000;
BA_ "GenSigStartValue" SG_ 338 FrntRdrDetn103RdrDetnAzi 900;
BA_ "GenSigSendType" SG_ 338 FrntRdrDetn103RdrDetnAzi 0;
BA_ "GenSigSendType" SG_ 338 FrntRdrDetn103RdrDetnChks 0;
BA_ "GenSigFuncType" SG_ 338 FrntRdrDetn103RdrDetnChks 15;
BA_ "GenSigDataID" SG_ 338 FrntRdrDetn103RdrDetnChks "0x76E";
BA_ "GenSigSendType" SG_ 338 FrntRdrDetn103RdrDetnCntr 0;
BA_ "GenSigFuncType" SG_ 338 FrntRdrDetn103RdrDetnCntr 16;
BA_ "GenSigSendType" SG_ 338 FrntRdrDetn103RdrDetnConf 0;
BA_ "GenSigStartValue" SG_ 338 FrntRdrDetn103RdrDetnElevn 15;
BA_ "GenSigSendType" SG_ 338 FrntRdrDetn103RdrDetnElevn 0;
BA_ "GenSigSendType" SG_ 338 FrntRdrDetn103RdrDetnPwr 0;
BA_ "GenSigStartValue" SG_ 338 FrntRdrDetn103RdrDetnRng 10050;
BA_ "GenSigSendType" SG_ 338 FrntRdrDetn103RdrDetnRng 0;
BA_ "GenSigStartValue" SG_ 338 FrntRdrDetn103RdrDetnRngV 4000;
BA_ "GenSigSendType" SG_ 338 FrntRdrDetn103RdrDetnRngV 0;
BA_ "GenSigStartValue" SG_ 338 FrntRdrDetn103RdrDetnSts 3;
BA_ "GenSigSendType" SG_ 338 FrntRdrDetn103RdrDetnSts 0;
BA_ "GenSigStartValue" SG_ 338 FrntRdrDetn104RdrDetnAzi 900;
BA_ "GenSigSendType" SG_ 338 FrntRdrDetn104RdrDetnAzi 0;
BA_ "GenSigSendType" SG_ 338 FrntRdrDetn104RdrDetnChks 0;
BA_ "GenSigFuncType" SG_ 338 FrntRdrDetn104RdrDetnChks 15;
BA_ "GenSigDataID" SG_ 338 FrntRdrDetn104RdrDetnChks "0x76F";
BA_ "GenSigSendType" SG_ 338 FrntRdrDetn104RdrDetnCntr 0;
BA_ "GenSigFuncType" SG_ 338 FrntRdrDetn104RdrDetnCntr 16;
BA_ "GenSigSendType" SG_ 338 FrntRdrDetn104RdrDetnConf 0;
BA_ "GenSigStartValue" SG_ 338 FrntRdrDetn104RdrDetnElevn 15;
BA_ "GenSigSendType" SG_ 338 FrntRdrDetn104RdrDetnElevn 0;
BA_ "GenSigSendType" SG_ 338 FrntRdrDetn104RdrDetnPwr 0;
BA_ "GenSigStartValue" SG_ 338 FrntRdrDetn104RdrDetnRng 10050;
BA_ "GenSigSendType" SG_ 338 FrntRdrDetn104RdrDetnRng 0;
BA_ "GenSigStartValue" SG_ 338 FrntRdrDetn104RdrDetnRngV 4000;
BA_ "GenSigSendType" SG_ 338 FrntRdrDetn104RdrDetnRngV 0;
BA_ "GenSigStartValue" SG_ 338 FrntRdrDetn104RdrDetnSts 3;
BA_ "GenSigSendType" SG_ 338 FrntRdrDetn104RdrDetnSts 0;
BA_ "GenSigStartValue" SG_ 338 FrntRdrDetn105RdrDetnAzi 900;
BA_ "GenSigSendType" SG_ 338 FrntRdrDetn105RdrDetnAzi 0;
BA_ "GenSigSendType" SG_ 338 FrntRdrDetn105RdrDetnChks 0;
BA_ "GenSigFuncType" SG_ 338 FrntRdrDetn105RdrDetnChks 15;
BA_ "GenSigDataID" SG_ 338 FrntRdrDetn105RdrDetnChks "0x770";
BA_ "GenSigSendType" SG_ 338 FrntRdrDetn105RdrDetnCntr 0;
BA_ "GenSigFuncType" SG_ 338 FrntRdrDetn105RdrDetnCntr 16;
BA_ "GenSigSendType" SG_ 338 FrntRdrDetn105RdrDetnConf 0;
BA_ "GenSigStartValue" SG_ 338 FrntRdrDetn105RdrDetnElevn 15;
BA_ "GenSigSendType" SG_ 338 FrntRdrDetn105RdrDetnElevn 0;
BA_ "GenSigSendType" SG_ 338 FrntRdrDetn105RdrDetnPwr 0;
BA_ "GenSigStartValue" SG_ 338 FrntRdrDetn105RdrDetnRng 10050;
BA_ "GenSigSendType" SG_ 338 FrntRdrDetn105RdrDetnRng 0;
BA_ "GenSigStartValue" SG_ 338 FrntRdrDetn105RdrDetnRngV 4000;
BA_ "GenSigSendType" SG_ 338 FrntRdrDetn105RdrDetnRngV 0;
BA_ "GenSigStartValue" SG_ 338 FrntRdrDetn105RdrDetnSts 3;
BA_ "GenSigSendType" SG_ 338 FrntRdrDetn105RdrDetnSts 0;
BA_ "GenSigStartValue" SG_ 338 FrntRdrDetn106RdrDetnAzi 900;
BA_ "GenSigSendType" SG_ 338 FrntRdrDetn106RdrDetnAzi 0;
BA_ "GenSigSendType" SG_ 338 FrntRdrDetn106RdrDetnChks 0;
BA_ "GenSigFuncType" SG_ 338 FrntRdrDetn106RdrDetnChks 15;
BA_ "GenSigDataID" SG_ 338 FrntRdrDetn106RdrDetnChks "0x771";
BA_ "GenSigSendType" SG_ 338 FrntRdrDetn106RdrDetnCntr 0;
BA_ "GenSigFuncType" SG_ 338 FrntRdrDetn106RdrDetnCntr 16;
BA_ "GenSigSendType" SG_ 338 FrntRdrDetn106RdrDetnConf 0;
BA_ "GenSigStartValue" SG_ 338 FrntRdrDetn106RdrDetnElevn 15;
BA_ "GenSigSendType" SG_ 338 FrntRdrDetn106RdrDetnElevn 0;
BA_ "GenSigSendType" SG_ 338 FrntRdrDetn106RdrDetnPwr 0;
BA_ "GenSigStartValue" SG_ 338 FrntRdrDetn106RdrDetnRng 10050;
BA_ "GenSigSendType" SG_ 338 FrntRdrDetn106RdrDetnRng 0;
BA_ "GenSigStartValue" SG_ 338 FrntRdrDetn106RdrDetnRngV 4000;
BA_ "GenSigSendType" SG_ 338 FrntRdrDetn106RdrDetnRngV 0;
BA_ "GenSigStartValue" SG_ 338 FrntRdrDetn106RdrDetnSts 3;
BA_ "GenSigSendType" SG_ 338 FrntRdrDetn106RdrDetnSts 0;
BA_ "GenSigStartValue" SG_ 338 FrntRdrDetn107RdrDetnAzi 900;
BA_ "GenSigSendType" SG_ 338 FrntRdrDetn107RdrDetnAzi 0;
BA_ "GenSigSendType" SG_ 338 FrntRdrDetn107RdrDetnChks 0;
BA_ "GenSigFuncType" SG_ 338 FrntRdrDetn107RdrDetnChks 15;
BA_ "GenSigDataID" SG_ 338 FrntRdrDetn107RdrDetnChks "0x772";
BA_ "GenSigSendType" SG_ 338 FrntRdrDetn107RdrDetnCntr 0;
BA_ "GenSigFuncType" SG_ 338 FrntRdrDetn107RdrDetnCntr 16;
BA_ "GenSigSendType" SG_ 338 FrntRdrDetn107RdrDetnConf 0;
BA_ "GenSigStartValue" SG_ 338 FrntRdrDetn107RdrDetnElevn 15;
BA_ "GenSigSendType" SG_ 338 FrntRdrDetn107RdrDetnElevn 0;
BA_ "GenSigSendType" SG_ 338 FrntRdrDetn107RdrDetnPwr 0;
BA_ "GenSigStartValue" SG_ 338 FrntRdrDetn107RdrDetnRng 10050;
BA_ "GenSigSendType" SG_ 338 FrntRdrDetn107RdrDetnRng 0;
BA_ "GenSigStartValue" SG_ 338 FrntRdrDetn107RdrDetnRngV 4000;
BA_ "GenSigSendType" SG_ 338 FrntRdrDetn107RdrDetnRngV 0;
BA_ "GenSigStartValue" SG_ 338 FrntRdrDetn107RdrDetnSts 3;
BA_ "GenSigSendType" SG_ 338 FrntRdrDetn107RdrDetnSts 0;
BA_ "GenSigStartValue" SG_ 338 FrntRdrDetn108RdrDetnAzi 900;
BA_ "GenSigSendType" SG_ 338 FrntRdrDetn108RdrDetnAzi 0;
BA_ "GenSigSendType" SG_ 338 FrntRdrDetn108RdrDetnChks 0;
BA_ "GenSigFuncType" SG_ 338 FrntRdrDetn108RdrDetnChks 15;
BA_ "GenSigDataID" SG_ 338 FrntRdrDetn108RdrDetnChks "0x773";
BA_ "GenSigSendType" SG_ 338 FrntRdrDetn108RdrDetnCntr 0;
BA_ "GenSigFuncType" SG_ 338 FrntRdrDetn108RdrDetnCntr 16;
BA_ "GenSigSendType" SG_ 338 FrntRdrDetn108RdrDetnConf 0;
BA_ "GenSigStartValue" SG_ 338 FrntRdrDetn108RdrDetnElevn 15;
BA_ "GenSigSendType" SG_ 338 FrntRdrDetn108RdrDetnElevn 0;
BA_ "GenSigSendType" SG_ 338 FrntRdrDetn108RdrDetnPwr 0;
BA_ "GenSigStartValue" SG_ 338 FrntRdrDetn108RdrDetnRng 10050;
BA_ "GenSigSendType" SG_ 338 FrntRdrDetn108RdrDetnRng 0;
BA_ "GenSigStartValue" SG_ 338 FrntRdrDetn108RdrDetnRngV 4000;
BA_ "GenSigSendType" SG_ 338 FrntRdrDetn108RdrDetnRngV 0;
BA_ "GenSigStartValue" SG_ 338 FrntRdrDetn108RdrDetnSts 3;
BA_ "GenSigSendType" SG_ 338 FrntRdrDetn108RdrDetnSts 0;
// Frame: FLRSafetyCANFD2Frame19
BA_ "VFrameFormat" BO_ 340 14;
BA_ "GenMsgSendType" BO_ 340 0;
BA_ "GenMsgCycleTime" BO_ 340 50.000;
BA_ "GenSigStartValue" SG_ 340 FrntRdrDetn109RdrDetnAzi 900;
BA_ "GenSigSendType" SG_ 340 FrntRdrDetn109RdrDetnAzi 0;
BA_ "GenSigSendType" SG_ 340 FrntRdrDetn109RdrDetnChks 0;
BA_ "GenSigFuncType" SG_ 340 FrntRdrDetn109RdrDetnChks 15;
BA_ "GenSigDataID" SG_ 340 FrntRdrDetn109RdrDetnChks "0x774";
BA_ "GenSigSendType" SG_ 340 FrntRdrDetn109RdrDetnCntr 0;
BA_ "GenSigFuncType" SG_ 340 FrntRdrDetn109RdrDetnCntr 16;
BA_ "GenSigSendType" SG_ 340 FrntRdrDetn109RdrDetnConf 0;
BA_ "GenSigStartValue" SG_ 340 FrntRdrDetn109RdrDetnElevn 15;
BA_ "GenSigSendType" SG_ 340 FrntRdrDetn109RdrDetnElevn 0;
BA_ "GenSigSendType" SG_ 340 FrntRdrDetn109RdrDetnPwr 0;
BA_ "GenSigStartValue" SG_ 340 FrntRdrDetn109RdrDetnRng 10050;
BA_ "GenSigSendType" SG_ 340 FrntRdrDetn109RdrDetnRng 0;
BA_ "GenSigStartValue" SG_ 340 FrntRdrDetn109RdrDetnRngV 4000;
BA_ "GenSigSendType" SG_ 340 FrntRdrDetn109RdrDetnRngV 0;
BA_ "GenSigStartValue" SG_ 340 FrntRdrDetn109RdrDetnSts 3;
BA_ "GenSigSendType" SG_ 340 FrntRdrDetn109RdrDetnSts 0;
BA_ "GenSigStartValue" SG_ 340 FrntRdrDetn110RdrDetnAzi 900;
BA_ "GenSigSendType" SG_ 340 FrntRdrDetn110RdrDetnAzi 0;
BA_ "GenSigSendType" SG_ 340 FrntRdrDetn110RdrDetnChks 0;
BA_ "GenSigFuncType" SG_ 340 FrntRdrDetn110RdrDetnChks 15;
BA_ "GenSigDataID" SG_ 340 FrntRdrDetn110RdrDetnChks "0x775";
BA_ "GenSigSendType" SG_ 340 FrntRdrDetn110RdrDetnCntr 0;
BA_ "GenSigFuncType" SG_ 340 FrntRdrDetn110RdrDetnCntr 16;
BA_ "GenSigSendType" SG_ 340 FrntRdrDetn110RdrDetnConf 0;
BA_ "GenSigStartValue" SG_ 340 FrntRdrDetn110RdrDetnElevn 15;
BA_ "GenSigSendType" SG_ 340 FrntRdrDetn110RdrDetnElevn 0;
BA_ "GenSigSendType" SG_ 340 FrntRdrDetn110RdrDetnPwr 0;
BA_ "GenSigStartValue" SG_ 340 FrntRdrDetn110RdrDetnRng 10050;
BA_ "GenSigSendType" SG_ 340 FrntRdrDetn110RdrDetnRng 0;
BA_ "GenSigStartValue" SG_ 340 FrntRdrDetn110RdrDetnRngV 4000;
BA_ "GenSigSendType" SG_ 340 FrntRdrDetn110RdrDetnRngV 0;
BA_ "GenSigStartValue" SG_ 340 FrntRdrDetn110RdrDetnSts 3;
BA_ "GenSigSendType" SG_ 340 FrntRdrDetn110RdrDetnSts 0;
BA_ "GenSigStartValue" SG_ 340 FrntRdrDetn111RdrDetnAzi 900;
BA_ "GenSigSendType" SG_ 340 FrntRdrDetn111RdrDetnAzi 0;
BA_ "GenSigSendType" SG_ 340 FrntRdrDetn111RdrDetnChks 0;
BA_ "GenSigFuncType" SG_ 340 FrntRdrDetn111RdrDetnChks 15;
BA_ "GenSigDataID" SG_ 340 FrntRdrDetn111RdrDetnChks "0x776";
BA_ "GenSigSendType" SG_ 340 FrntRdrDetn111RdrDetnCntr 0;
BA_ "GenSigFuncType" SG_ 340 FrntRdrDetn111RdrDetnCntr 16;
BA_ "GenSigSendType" SG_ 340 FrntRdrDetn111RdrDetnConf 0;
BA_ "GenSigStartValue" SG_ 340 FrntRdrDetn111RdrDetnElevn 15;
BA_ "GenSigSendType" SG_ 340 FrntRdrDetn111RdrDetnElevn 0;
BA_ "GenSigSendType" SG_ 340 FrntRdrDetn111RdrDetnPwr 0;
BA_ "GenSigStartValue" SG_ 340 FrntRdrDetn111RdrDetnRng 10050;
BA_ "GenSigSendType" SG_ 340 FrntRdrDetn111RdrDetnRng 0;
BA_ "GenSigStartValue" SG_ 340 FrntRdrDetn111RdrDetnRngV 4000;
BA_ "GenSigSendType" SG_ 340 FrntRdrDetn111RdrDetnRngV 0;
BA_ "GenSigStartValue" SG_ 340 FrntRdrDetn111RdrDetnSts 3;
BA_ "GenSigSendType" SG_ 340 FrntRdrDetn111RdrDetnSts 0;
BA_ "GenSigStartValue" SG_ 340 FrntRdrDetn112RdrDetnAzi 900;
BA_ "GenSigSendType" SG_ 340 FrntRdrDetn112RdrDetnAzi 0;
BA_ "GenSigSendType" SG_ 340 FrntRdrDetn112RdrDetnChks 0;
BA_ "GenSigFuncType" SG_ 340 FrntRdrDetn112RdrDetnChks 15;
BA_ "GenSigDataID" SG_ 340 FrntRdrDetn112RdrDetnChks "0x777";
BA_ "GenSigSendType" SG_ 340 FrntRdrDetn112RdrDetnCntr 0;
BA_ "GenSigFuncType" SG_ 340 FrntRdrDetn112RdrDetnCntr 16;
BA_ "GenSigSendType" SG_ 340 FrntRdrDetn112RdrDetnConf 0;
BA_ "GenSigStartValue" SG_ 340 FrntRdrDetn112RdrDetnElevn 15;
BA_ "GenSigSendType" SG_ 340 FrntRdrDetn112RdrDetnElevn 0;
BA_ "GenSigSendType" SG_ 340 FrntRdrDetn112RdrDetnPwr 0;
BA_ "GenSigStartValue" SG_ 340 FrntRdrDetn112RdrDetnRng 10050;
BA_ "GenSigSendType" SG_ 340 FrntRdrDetn112RdrDetnRng 0;
BA_ "GenSigStartValue" SG_ 340 FrntRdrDetn112RdrDetnRngV 4000;
BA_ "GenSigSendType" SG_ 340 FrntRdrDetn112RdrDetnRngV 0;
BA_ "GenSigStartValue" SG_ 340 FrntRdrDetn112RdrDetnSts 3;
BA_ "GenSigSendType" SG_ 340 FrntRdrDetn112RdrDetnSts 0;
BA_ "GenSigStartValue" SG_ 340 FrntRdrDetn113RdrDetnAzi 900;
BA_ "GenSigSendType" SG_ 340 FrntRdrDetn113RdrDetnAzi 0;
BA_ "GenSigSendType" SG_ 340 FrntRdrDetn113RdrDetnChks 0;
BA_ "GenSigFuncType" SG_ 340 FrntRdrDetn113RdrDetnChks 15;
BA_ "GenSigDataID" SG_ 340 FrntRdrDetn113RdrDetnChks "0x778";
BA_ "GenSigSendType" SG_ 340 FrntRdrDetn113RdrDetnCntr 0;
BA_ "GenSigFuncType" SG_ 340 FrntRdrDetn113RdrDetnCntr 16;
BA_ "GenSigSendType" SG_ 340 FrntRdrDetn113RdrDetnConf 0;
BA_ "GenSigStartValue" SG_ 340 FrntRdrDetn113RdrDetnElevn 15;
BA_ "GenSigSendType" SG_ 340 FrntRdrDetn113RdrDetnElevn 0;
BA_ "GenSigSendType" SG_ 340 FrntRdrDetn113RdrDetnPwr 0;
BA_ "GenSigStartValue" SG_ 340 FrntRdrDetn113RdrDetnRng 10050;
BA_ "GenSigSendType" SG_ 340 FrntRdrDetn113RdrDetnRng 0;
BA_ "GenSigStartValue" SG_ 340 FrntRdrDetn113RdrDetnRngV 4000;
BA_ "GenSigSendType" SG_ 340 FrntRdrDetn113RdrDetnRngV 0;
BA_ "GenSigStartValue" SG_ 340 FrntRdrDetn113RdrDetnSts 3;
BA_ "GenSigSendType" SG_ 340 FrntRdrDetn113RdrDetnSts 0;
BA_ "GenSigStartValue" SG_ 340 FrntRdrDetn114RdrDetnAzi 900;
BA_ "GenSigSendType" SG_ 340 FrntRdrDetn114RdrDetnAzi 0;
BA_ "GenSigSendType" SG_ 340 FrntRdrDetn114RdrDetnChks 0;
BA_ "GenSigFuncType" SG_ 340 FrntRdrDetn114RdrDetnChks 15;
BA_ "GenSigDataID" SG_ 340 FrntRdrDetn114RdrDetnChks "0x779";
BA_ "GenSigSendType" SG_ 340 FrntRdrDetn114RdrDetnCntr 0;
BA_ "GenSigFuncType" SG_ 340 FrntRdrDetn114RdrDetnCntr 16;
BA_ "GenSigSendType" SG_ 340 FrntRdrDetn114RdrDetnConf 0;
BA_ "GenSigStartValue" SG_ 340 FrntRdrDetn114RdrDetnElevn 15;
BA_ "GenSigSendType" SG_ 340 FrntRdrDetn114RdrDetnElevn 0;
BA_ "GenSigSendType" SG_ 340 FrntRdrDetn114RdrDetnPwr 0;
BA_ "GenSigStartValue" SG_ 340 FrntRdrDetn114RdrDetnRng 10050;
BA_ "GenSigSendType" SG_ 340 FrntRdrDetn114RdrDetnRng 0;
BA_ "GenSigStartValue" SG_ 340 FrntRdrDetn114RdrDetnRngV 4000;
BA_ "GenSigSendType" SG_ 340 FrntRdrDetn114RdrDetnRngV 0;
BA_ "GenSigStartValue" SG_ 340 FrntRdrDetn114RdrDetnSts 3;
BA_ "GenSigSendType" SG_ 340 FrntRdrDetn114RdrDetnSts 0;
VAL_ 326 FrntRdrDetn67RdrDetnSts 0 "RdrDetnSts_Ukwn" 1 "RdrDetnSts_Movg" 2 "RdrDetnSts_Staty" 3 "RdrDetnSts_Invalid";
VAL_ 326 FrntRdrDetn68RdrDetnSts 0 "RdrDetnSts_Ukwn" 1 "RdrDetnSts_Movg" 2 "RdrDetnSts_Staty" 3 "RdrDetnSts_Invalid";
VAL_ 326 FrntRdrDetn69RdrDetnSts 0 "RdrDetnSts_Ukwn" 1 "RdrDetnSts_Movg" 2 "RdrDetnSts_Staty" 3 "RdrDetnSts_Invalid";
VAL_ 326 FrntRdrDetn70RdrDetnSts 0 "RdrDetnSts_Ukwn" 1 "RdrDetnSts_Movg" 2 "RdrDetnSts_Staty" 3 "RdrDetnSts_Invalid";
VAL_ 326 FrntRdrDetn71RdrDetnSts 0 "RdrDetnSts_Ukwn" 1 "RdrDetnSts_Movg" 2 "RdrDetnSts_Staty" 3 "RdrDetnSts_Invalid";
VAL_ 326 FrntRdrDetn72RdrDetnSts 0 "RdrDetnSts_Ukwn" 1 "RdrDetnSts_Movg" 2 "RdrDetnSts_Staty" 3 "RdrDetnSts_Invalid";
VAL_ 328 FrntRdrDetn73RdrDetnSts 0 "RdrDetnSts_Ukwn" 1 "RdrDetnSts_Movg" 2 "RdrDetnSts_Staty" 3 "RdrDetnSts_Invalid";
VAL_ 328 FrntRdrDetn74RdrDetnSts 0 "RdrDetnSts_Ukwn" 1 "RdrDetnSts_Movg" 2 "RdrDetnSts_Staty" 3 "RdrDetnSts_Invalid";
VAL_ 328 FrntRdrDetn75RdrDetnSts 0 "RdrDetnSts_Ukwn" 1 "RdrDetnSts_Movg" 2 "RdrDetnSts_Staty" 3 "RdrDetnSts_Invalid";
VAL_ 328 FrntRdrDetn76RdrDetnSts 0 "RdrDetnSts_Ukwn" 1 "RdrDetnSts_Movg" 2 "RdrDetnSts_Staty" 3 "RdrDetnSts_Invalid";
VAL_ 328 FrntRdrDetn77RdrDetnSts 0 "RdrDetnSts_Ukwn" 1 "RdrDetnSts_Movg" 2 "RdrDetnSts_Staty" 3 "RdrDetnSts_Invalid";
VAL_ 328 FrntRdrDetn78RdrDetnSts 0 "RdrDetnSts_Ukwn" 1 "RdrDetnSts_Movg" 2 "RdrDetnSts_Staty" 3 "RdrDetnSts_Invalid";
VAL_ 330 FrntRdrDetn79RdrDetnSts 0 "RdrDetnSts_Ukwn" 1 "RdrDetnSts_Movg" 2 "RdrDetnSts_Staty" 3 "RdrDetnSts_Invalid";
VAL_ 330 FrntRdrDetn80RdrDetnSts 0 "RdrDetnSts_Ukwn" 1 "RdrDetnSts_Movg" 2 "RdrDetnSts_Staty" 3 "RdrDetnSts_Invalid";
VAL_ 330 FrntRdrDetn81RdrDetnSts 0 "RdrDetnSts_Ukwn" 1 "RdrDetnSts_Movg" 2 "RdrDetnSts_Staty" 3 "RdrDetnSts_Invalid";
VAL_ 330 FrntRdrDetn82RdrDetnSts 0 "RdrDetnSts_Ukwn" 1 "RdrDetnSts_Movg" 2 "RdrDetnSts_Staty" 3 "RdrDetnSts_Invalid";
VAL_ 330 FrntRdrDetn83RdrDetnSts 0 "RdrDetnSts_Ukwn" 1 "RdrDetnSts_Movg" 2 "RdrDetnSts_Staty" 3 "RdrDetnSts_Invalid";
VAL_ 330 FrntRdrDetn84RdrDetnSts 0 "RdrDetnSts_Ukwn" 1 "RdrDetnSts_Movg" 2 "RdrDetnSts_Staty" 3 "RdrDetnSts_Invalid";
VAL_ 332 FrntRdrDetn85RdrDetnSts 0 "RdrDetnSts_Ukwn" 1 "RdrDetnSts_Movg" 2 "RdrDetnSts_Staty" 3 "RdrDetnSts_Invalid";
VAL_ 332 FrntRdrDetn86RdrDetnSts 0 "RdrDetnSts_Ukwn" 1 "RdrDetnSts_Movg" 2 "RdrDetnSts_Staty" 3 "RdrDetnSts_Invalid";
VAL_ 332 FrntRdrDetn87RdrDetnSts 0 "RdrDetnSts_Ukwn" 1 "RdrDetnSts_Movg" 2 "RdrDetnSts_Staty" 3 "RdrDetnSts_Invalid";
VAL_ 332 FrntRdrDetn88RdrDetnSts 0 "RdrDetnSts_Ukwn" 1 "RdrDetnSts_Movg" 2 "RdrDetnSts_Staty" 3 "RdrDetnSts_Invalid";
VAL_ 332 FrntRdrDetn89RdrDetnSts 0 "RdrDetnSts_Ukwn" 1 "RdrDetnSts_Movg" 2 "RdrDetnSts_Staty" 3 "RdrDetnSts_Invalid";
VAL_ 332 FrntRdrDetn90RdrDetnSts 0 "RdrDetnSts_Ukwn" 1 "RdrDetnSts_Movg" 2 "RdrDetnSts_Staty" 3 "RdrDetnSts_Invalid";
VAL_ 334 FrntRdrDetn91RdrDetnSts 0 "RdrDetnSts_Ukwn" 1 "RdrDetnSts_Movg" 2 "RdrDetnSts_Staty" 3 "RdrDetnSts_Invalid";
VAL_ 334 FrntRdrDetn92RdrDetnSts 0 "RdrDetnSts_Ukwn" 1 "RdrDetnSts_Movg" 2 "RdrDetnSts_Staty" 3 "RdrDetnSts_Invalid";
VAL_ 334 FrntRdrDetn93RdrDetnSts 0 "RdrDetnSts_Ukwn" 1 "RdrDetnSts_Movg" 2 "RdrDetnSts_Staty" 3 "RdrDetnSts_Invalid";
VAL_ 334 FrntRdrDetn94RdrDetnSts 0 "RdrDetnSts_Ukwn" 1 "RdrDetnSts_Movg" 2 "RdrDetnSts_Staty" 3 "RdrDetnSts_Invalid";
VAL_ 334 FrntRdrDetn95RdrDetnSts 0 "RdrDetnSts_Ukwn" 1 "RdrDetnSts_Movg" 2 "RdrDetnSts_Staty" 3 "RdrDetnSts_Invalid";
VAL_ 334 FrntRdrDetn96RdrDetnSts 0 "RdrDetnSts_Ukwn" 1 "RdrDetnSts_Movg" 2 "RdrDetnSts_Staty" 3 "RdrDetnSts_Invalid";
VAL_ 336 FrntRdrDetn100RdrDetnSts 0 "RdrDetnSts_Ukwn" 1 "RdrDetnSts_Movg" 2 "RdrDetnSts_Staty" 3 "RdrDetnSts_Invalid";
VAL_ 336 FrntRdrDetn101RdrDetnSts 0 "RdrDetnSts_Ukwn" 1 "RdrDetnSts_Movg" 2 "RdrDetnSts_Staty" 3 "RdrDetnSts_Invalid";
VAL_ 336 FrntRdrDetn102RdrDetnSts 0 "RdrDetnSts_Ukwn" 1 "RdrDetnSts_Movg" 2 "RdrDetnSts_Staty" 3 "RdrDetnSts_Invalid";
VAL_ 336 FrntRdrDetn97RdrDetnSts 0 "RdrDetnSts_Ukwn" 1 "RdrDetnSts_Movg" 2 "RdrDetnSts_Staty" 3 "RdrDetnSts_Invalid";
VAL_ 336 FrntRdrDetn98RdrDetnSts 0 "RdrDetnSts_Ukwn" 1 "RdrDetnSts_Movg" 2 "RdrDetnSts_Staty" 3 "RdrDetnSts_Invalid";
VAL_ 336 FrntRdrDetn99RdrDetnSts 0 "RdrDetnSts_Ukwn" 1 "RdrDetnSts_Movg" 2 "RdrDetnSts_Staty" 3 "RdrDetnSts_Invalid";
VAL_ 338 FrntRdrDetn103RdrDetnSts 0 "RdrDetnSts_Ukwn" 1 "RdrDetnSts_Movg" 2 "RdrDetnSts_Staty" 3 "RdrDetnSts_Invalid";
VAL_ 338 FrntRdrDetn104RdrDetnSts 0 "RdrDetnSts_Ukwn" 1 "RdrDetnSts_Movg" 2 "RdrDetnSts_Staty" 3 "RdrDetnSts_Invalid";
VAL_ 338 FrntRdrDetn105RdrDetnSts 0 "RdrDetnSts_Ukwn" 1 "RdrDetnSts_Movg" 2 "RdrDetnSts_Staty" 3 "RdrDetnSts_Invalid";
VAL_ 338 FrntRdrDetn106RdrDetnSts 0 "RdrDetnSts_Ukwn" 1 "RdrDetnSts_Movg" 2 "RdrDetnSts_Staty" 3 "RdrDetnSts_Invalid";
VAL_ 338 FrntRdrDetn107RdrDetnSts 0 "RdrDetnSts_Ukwn" 1 "RdrDetnSts_Movg" 2 "RdrDetnSts_Staty" 3 "RdrDetnSts_Invalid";
VAL_ 338 FrntRdrDetn108RdrDetnSts 0 "RdrDetnSts_Ukwn" 1 "RdrDetnSts_Movg" 2 "RdrDetnSts_Staty" 3 "RdrDetnSts_Invalid";
VAL_ 340 FrntRdrDetn109RdrDetnSts 0 "RdrDetnSts_Ukwn" 1 "RdrDetnSts_Movg" 2 "RdrDetnSts_Staty" 3 "RdrDetnSts_Invalid";
VAL_ 340 FrntRdrDetn110RdrDetnSts 0 "RdrDetnSts_Ukwn" 1 "RdrDetnSts_Movg" 2 "RdrDetnSts_Staty" 3 "RdrDetnSts_Invalid";
VAL_ 340 FrntRdrDetn111RdrDetnSts 0 "RdrDetnSts_Ukwn" 1 "RdrDetnSts_Movg" 2 "RdrDetnSts_Staty" 3 "RdrDetnSts_Invalid";
VAL_ 340 FrntRdrDetn112RdrDetnSts 0 "RdrDetnSts_Ukwn" 1 "RdrDetnSts_Movg" 2 "RdrDetnSts_Staty" 3 "RdrDetnSts_Invalid";
VAL_ 340 FrntRdrDetn113RdrDetnSts 0 "RdrDetnSts_Ukwn" 1 "RdrDetnSts_Movg" 2 "RdrDetnSts_Staty" 3 "RdrDetnSts_Invalid";
VAL_ 340 FrntRdrDetn114RdrDetnSts 0 "RdrDetnSts_Ukwn" 1 "RdrDetnSts_Movg" 2 "RdrDetnSts_Staty" 3 "RdrDetnSts_Invalid";
SIG_GROUP_ 336 FrntRdrDetn100 1 : FrntRdrDetn100RdrDetnAzi FrntRdrDetn100RdrDetnChks FrntRdrDetn100RdrDetnCntr FrntRdrDetn100RdrDetnConf FrntRdrDetn100RdrDetnElevn FrntRdrDetn100RdrDetnPwr FrntRdrDetn100RdrDetnRng FrntRdrDetn100RdrDetnRngV FrntRdrDetn100RdrDetnSts;
SIG_GROUP_ 336 FrntRdrDetn101 1 : FrntRdrDetn101RdrDetnAzi FrntRdrDetn101RdrDetnChks FrntRdrDetn101RdrDetnCntr FrntRdrDetn101RdrDetnConf FrntRdrDetn101RdrDetnElevn FrntRdrDetn101RdrDetnPwr FrntRdrDetn101RdrDetnRng FrntRdrDetn101RdrDetnRngV FrntRdrDetn101RdrDetnSts;
SIG_GROUP_ 336 FrntRdrDetn102 1 : FrntRdrDetn102RdrDetnAzi FrntRdrDetn102RdrDetnChks FrntRdrDetn102RdrDetnCntr FrntRdrDetn102RdrDetnConf FrntRdrDetn102RdrDetnElevn FrntRdrDetn102RdrDetnPwr FrntRdrDetn102RdrDetnRng FrntRdrDetn102RdrDetnRngV FrntRdrDetn102RdrDetnSts;
SIG_GROUP_ 338 FrntRdrDetn103 1 : FrntRdrDetn103RdrDetnAzi FrntRdrDetn103RdrDetnChks FrntRdrDetn103RdrDetnCntr FrntRdrDetn103RdrDetnConf FrntRdrDetn103RdrDetnElevn FrntRdrDetn103RdrDetnPwr FrntRdrDetn103RdrDetnRng FrntRdrDetn103RdrDetnRngV FrntRdrDetn103RdrDetnSts;
SIG_GROUP_ 338 FrntRdrDetn104 1 : FrntRdrDetn104RdrDetnAzi FrntRdrDetn104RdrDetnChks FrntRdrDetn104RdrDetnCntr FrntRdrDetn104RdrDetnConf FrntRdrDetn104RdrDetnElevn FrntRdrDetn104RdrDetnPwr FrntRdrDetn104RdrDetnRng FrntRdrDetn104RdrDetnRngV FrntRdrDetn104RdrDetnSts;
SIG_GROUP_ 338 FrntRdrDetn105 1 : FrntRdrDetn105RdrDetnAzi FrntRdrDetn105RdrDetnChks FrntRdrDetn105RdrDetnCntr FrntRdrDetn105RdrDetnConf FrntRdrDetn105RdrDetnElevn FrntRdrDetn105RdrDetnPwr FrntRdrDetn105RdrDetnRng FrntRdrDetn105RdrDetnRngV FrntRdrDetn105RdrDetnSts;
SIG_GROUP_ 338 FrntRdrDetn106 1 : FrntRdrDetn106RdrDetnAzi FrntRdrDetn106RdrDetnChks FrntRdrDetn106RdrDetnCntr FrntRdrDetn106RdrDetnConf FrntRdrDetn106RdrDetnElevn FrntRdrDetn106RdrDetnPwr FrntRdrDetn106RdrDetnRng FrntRdrDetn106RdrDetnRngV FrntRdrDetn106RdrDetnSts;
SIG_GROUP_ 338 FrntRdrDetn107 1 : FrntRdrDetn107RdrDetnAzi FrntRdrDetn107RdrDetnChks FrntRdrDetn107RdrDetnCntr FrntRdrDetn107RdrDetnConf FrntRdrDetn107RdrDetnElevn FrntRdrDetn107RdrDetnPwr FrntRdrDetn107RdrDetnRng FrntRdrDetn107RdrDetnRngV FrntRdrDetn107RdrDetnSts;
SIG_GROUP_ 338 FrntRdrDetn108 1 : FrntRdrDetn108RdrDetnAzi FrntRdrDetn108RdrDetnChks FrntRdrDetn108RdrDetnCntr FrntRdrDetn108RdrDetnConf FrntRdrDetn108RdrDetnElevn FrntRdrDetn108RdrDetnPwr FrntRdrDetn108RdrDetnRng FrntRdrDetn108RdrDetnRngV FrntRdrDetn108RdrDetnSts;
SIG_GROUP_ 340 FrntRdrDetn109 1 : FrntRdrDetn109RdrDetnAzi FrntRdrDetn109RdrDetnChks FrntRdrDetn109RdrDetnCntr FrntRdrDetn109RdrDetnConf FrntRdrDetn109RdrDetnElevn FrntRdrDetn109RdrDetnPwr FrntRdrDetn109RdrDetnRng FrntRdrDetn109RdrDetnRngV FrntRdrDetn109RdrDetnSts;
SIG_GROUP_ 340 FrntRdrDetn110 1 : FrntRdrDetn110RdrDetnAzi FrntRdrDetn110RdrDetnChks FrntRdrDetn110RdrDetnCntr FrntRdrDetn110RdrDetnConf FrntRdrDetn110RdrDetnElevn FrntRdrDetn110RdrDetnPwr FrntRdrDetn110RdrDetnRng FrntRdrDetn110RdrDetnRngV FrntRdrDetn110RdrDetnSts;
SIG_GROUP_ 340 FrntRdrDetn111 1 : FrntRdrDetn111RdrDetnAzi FrntRdrDetn111RdrDetnChks FrntRdrDetn111RdrDetnCntr FrntRdrDetn111RdrDetnConf FrntRdrDetn111RdrDetnElevn FrntRdrDetn111RdrDetnPwr FrntRdrDetn111RdrDetnRng FrntRdrDetn111RdrDetnRngV FrntRdrDetn111RdrDetnSts;
SIG_GROUP_ 340 FrntRdrDetn112 1 : FrntRdrDetn112RdrDetnAzi FrntRdrDetn112RdrDetnChks FrntRdrDetn112RdrDetnCntr FrntRdrDetn112RdrDetnConf FrntRdrDetn112RdrDetnElevn FrntRdrDetn112RdrDetnPwr FrntRdrDetn112RdrDetnRng FrntRdrDetn112RdrDetnRngV FrntRdrDetn112RdrDetnSts;
SIG_GROUP_ 340 FrntRdrDetn113 1 : FrntRdrDetn113RdrDetnAzi FrntRdrDetn113RdrDetnChks FrntRdrDetn113RdrDetnCntr FrntRdrDetn113RdrDetnConf FrntRdrDetn113RdrDetnElevn FrntRdrDetn113RdrDetnPwr FrntRdrDetn113RdrDetnRng FrntRdrDetn113RdrDetnRngV FrntRdrDetn113RdrDetnSts;
SIG_GROUP_ 340 FrntRdrDetn114 1 : FrntRdrDetn114RdrDetnAzi FrntRdrDetn114RdrDetnChks FrntRdrDetn114RdrDetnCntr FrntRdrDetn114RdrDetnConf FrntRdrDetn114RdrDetnElevn FrntRdrDetn114RdrDetnPwr FrntRdrDetn114RdrDetnRng FrntRdrDetn114RdrDetnRngV FrntRdrDetn114RdrDetnSts;
SIG_GROUP_ 326 FrntRdrDetn67 1 : FrntRdrDetn67RdrDetnAzi FrntRdrDetn67RdrDetnChks FrntRdrDetn67RdrDetnCntr FrntRdrDetn67RdrDetnConf FrntRdrDetn67RdrDetnElevn FrntRdrDetn67RdrDetnPwr FrntRdrDetn67RdrDetnRng FrntRdrDetn67RdrDetnRngV FrntRdrDetn67RdrDetnSts;
SIG_GROUP_ 326 FrntRdrDetn68 1 : FrntRdrDetn68RdrDetnAzi FrntRdrDetn68RdrDetnChks FrntRdrDetn68RdrDetnCntr FrntRdrDetn68RdrDetnConf FrntRdrDetn68RdrDetnElevn FrntRdrDetn68RdrDetnPwr FrntRdrDetn68RdrDetnRng FrntRdrDetn68RdrDetnRngV FrntRdrDetn68RdrDetnSts;
SIG_GROUP_ 326 FrntRdrDetn69 1 : FrntRdrDetn69RdrDetnAzi FrntRdrDetn69RdrDetnChks FrntRdrDetn69RdrDetnCntr FrntRdrDetn69RdrDetnConf FrntRdrDetn69RdrDetnElevn FrntRdrDetn69RdrDetnPwr FrntRdrDetn69RdrDetnRng FrntRdrDetn69RdrDetnRngV FrntRdrDetn69RdrDetnSts;
SIG_GROUP_ 326 FrntRdrDetn70 1 : FrntRdrDetn70RdrDetnAzi FrntRdrDetn70RdrDetnChks FrntRdrDetn70RdrDetnCntr FrntRdrDetn70RdrDetnConf FrntRdrDetn70RdrDetnElevn FrntRdrDetn70RdrDetnPwr FrntRdrDetn70RdrDetnRng FrntRdrDetn70RdrDetnRngV FrntRdrDetn70RdrDetnSts;
SIG_GROUP_ 326 FrntRdrDetn71 1 : FrntRdrDetn71RdrDetnAzi FrntRdrDetn71RdrDetnChks FrntRdrDetn71RdrDetnCntr FrntRdrDetn71RdrDetnConf FrntRdrDetn71RdrDetnElevn FrntRdrDetn71RdrDetnPwr FrntRdrDetn71RdrDetnRng FrntRdrDetn71RdrDetnRngV FrntRdrDetn71RdrDetnSts;
SIG_GROUP_ 326 FrntRdrDetn72 1 : FrntRdrDetn72RdrDetnAzi FrntRdrDetn72RdrDetnChks FrntRdrDetn72RdrDetnCntr FrntRdrDetn72RdrDetnConf FrntRdrDetn72RdrDetnElevn FrntRdrDetn72RdrDetnPwr FrntRdrDetn72RdrDetnRng FrntRdrDetn72RdrDetnRngV FrntRdrDetn72RdrDetnSts;
SIG_GROUP_ 328 FrntRdrDetn73 1 : FrntRdrDetn73RdrDetnAzi FrntRdrDetn73RdrDetnChks FrntRdrDetn73RdrDetnCntr FrntRdrDetn73RdrDetnConf FrntRdrDetn73RdrDetnElevn FrntRdrDetn73RdrDetnPwr FrntRdrDetn73RdrDetnRng FrntRdrDetn73RdrDetnRngV FrntRdrDetn73RdrDetnSts;
SIG_GROUP_ 328 FrntRdrDetn74 1 : FrntRdrDetn74RdrDetnAzi FrntRdrDetn74RdrDetnChks FrntRdrDetn74RdrDetnCntr FrntRdrDetn74RdrDetnConf FrntRdrDetn74RdrDetnElevn FrntRdrDetn74RdrDetnPwr FrntRdrDetn74RdrDetnRng FrntRdrDetn74RdrDetnRngV FrntRdrDetn74RdrDetnSts;
SIG_GROUP_ 328 FrntRdrDetn75 1 : FrntRdrDetn75RdrDetnAzi FrntRdrDetn75RdrDetnChks FrntRdrDetn75RdrDetnCntr FrntRdrDetn75RdrDetnConf FrntRdrDetn75RdrDetnElevn FrntRdrDetn75RdrDetnPwr FrntRdrDetn75RdrDetnRng FrntRdrDetn75RdrDetnRngV FrntRdrDetn75RdrDetnSts;
SIG_GROUP_ 328 FrntRdrDetn76 1 : FrntRdrDetn76RdrDetnAzi FrntRdrDetn76RdrDetnChks FrntRdrDetn76RdrDetnCntr FrntRdrDetn76RdrDetnConf FrntRdrDetn76RdrDetnElevn FrntRdrDetn76RdrDetnPwr FrntRdrDetn76RdrDetnRng FrntRdrDetn76RdrDetnRngV FrntRdrDetn76RdrDetnSts;
SIG_GROUP_ 328 FrntRdrDetn77 1 : FrntRdrDetn77RdrDetnAzi FrntRdrDetn77RdrDetnChks FrntRdrDetn77RdrDetnCntr FrntRdrDetn77RdrDetnConf FrntRdrDetn77RdrDetnElevn FrntRdrDetn77RdrDetnPwr FrntRdrDetn77RdrDetnRng FrntRdrDetn77RdrDetnRngV FrntRdrDetn77RdrDetnSts;
SIG_GROUP_ 328 FrntRdrDetn78 1 : FrntRdrDetn78RdrDetnAzi FrntRdrDetn78RdrDetnChks FrntRdrDetn78RdrDetnCntr FrntRdrDetn78RdrDetnConf FrntRdrDetn78RdrDetnElevn FrntRdrDetn78RdrDetnPwr FrntRdrDetn78RdrDetnRng FrntRdrDetn78RdrDetnRngV FrntRdrDetn78RdrDetnSts;
SIG_GROUP_ 330 FrntRdrDetn79 1 : FrntRdrDetn79RdrDetnAzi FrntRdrDetn79RdrDetnChks FrntRdrDetn79RdrDetnCntr FrntRdrDetn79RdrDetnConf FrntRdrDetn79RdrDetnElevn FrntRdrDetn79RdrDetnPwr FrntRdrDetn79RdrDetnRng FrntRdrDetn79RdrDetnRngV FrntRdrDetn79RdrDetnSts;
SIG_GROUP_ 330 FrntRdrDetn80 1 : FrntRdrDetn80RdrDetnAzi FrntRdrDetn80RdrDetnChks FrntRdrDetn80RdrDetnCntr FrntRdrDetn80RdrDetnConf FrntRdrDetn80RdrDetnElevn FrntRdrDetn80RdrDetnPwr FrntRdrDetn80RdrDetnRng FrntRdrDetn80RdrDetnRngV FrntRdrDetn80RdrDetnSts;
SIG_GROUP_ 330 FrntRdrDetn81 1 : FrntRdrDetn81RdrDetnAzi FrntRdrDetn81RdrDetnChks FrntRdrDetn81RdrDetnCntr FrntRdrDetn81RdrDetnConf FrntRdrDetn81RdrDetnElevn FrntRdrDetn81RdrDetnPwr FrntRdrDetn81RdrDetnRng FrntRdrDetn81RdrDetnRngV FrntRdrDetn81RdrDetnSts;
SIG_GROUP_ 330 FrntRdrDetn82 1 : FrntRdrDetn82RdrDetnAzi FrntRdrDetn82RdrDetnChks FrntRdrDetn82RdrDetnCntr FrntRdrDetn82RdrDetnConf FrntRdrDetn82RdrDetnElevn FrntRdrDetn82RdrDetnPwr FrntRdrDetn82RdrDetnRng FrntRdrDetn82RdrDetnRngV FrntRdrDetn82RdrDetnSts;
SIG_GROUP_ 330 FrntRdrDetn83 1 : FrntRdrDetn83RdrDetnAzi FrntRdrDetn83RdrDetnChks FrntRdrDetn83RdrDetnCntr FrntRdrDetn83RdrDetnConf FrntRdrDetn83RdrDetnElevn FrntRdrDetn83RdrDetnPwr FrntRdrDetn83RdrDetnRng FrntRdrDetn83RdrDetnRngV FrntRdrDetn83RdrDetnSts;
SIG_GROUP_ 330 FrntRdrDetn84 1 : FrntRdrDetn84RdrDetnAzi FrntRdrDetn84RdrDetnChks FrntRdrDetn84RdrDetnCntr FrntRdrDetn84RdrDetnConf FrntRdrDetn84RdrDetnElevn FrntRdrDetn84RdrDetnPwr FrntRdrDetn84RdrDetnRng FrntRdrDetn84RdrDetnRngV FrntRdrDetn84RdrDetnSts;
SIG_GROUP_ 332 FrntRdrDetn85 1 : FrntRdrDetn85RdrDetnAzi FrntRdrDetn85RdrDetnChks FrntRdrDetn85RdrDetnCntr FrntRdrDetn85RdrDetnConf FrntRdrDetn85RdrDetnElevn FrntRdrDetn85RdrDetnPwr FrntRdrDetn85RdrDetnRng FrntRdrDetn85RdrDetnRngV FrntRdrDetn85RdrDetnSts;
SIG_GROUP_ 332 FrntRdrDetn86 1 : FrntRdrDetn86RdrDetnAzi FrntRdrDetn86RdrDetnChks FrntRdrDetn86RdrDetnCntr FrntRdrDetn86RdrDetnConf FrntRdrDetn86RdrDetnElevn FrntRdrDetn86RdrDetnPwr FrntRdrDetn86RdrDetnRng FrntRdrDetn86RdrDetnRngV FrntRdrDetn86RdrDetnSts;
SIG_GROUP_ 332 FrntRdrDetn87 1 : FrntRdrDetn87RdrDetnAzi FrntRdrDetn87RdrDetnChks FrntRdrDetn87RdrDetnCntr FrntRdrDetn87RdrDetnConf FrntRdrDetn87RdrDetnElevn FrntRdrDetn87RdrDetnPwr FrntRdrDetn87RdrDetnRng FrntRdrDetn87RdrDetnRngV FrntRdrDetn87RdrDetnSts;
SIG_GROUP_ 332 FrntRdrDetn88 1 : FrntRdrDetn88RdrDetnAzi FrntRdrDetn88RdrDetnChks FrntRdrDetn88RdrDetnCntr FrntRdrDetn88RdrDetnConf FrntRdrDetn88RdrDetnElevn FrntRdrDetn88RdrDetnPwr FrntRdrDetn88RdrDetnRng FrntRdrDetn88RdrDetnRngV FrntRdrDetn88RdrDetnSts;
SIG_GROUP_ 332 FrntRdrDetn89 1 : FrntRdrDetn89RdrDetnAzi FrntRdrDetn89RdrDetnChks FrntRdrDetn89RdrDetnCntr FrntRdrDetn89RdrDetnConf FrntRdrDetn89RdrDetnElevn FrntRdrDetn89RdrDetnPwr FrntRdrDetn89RdrDetnRng FrntRdrDetn89RdrDetnRngV FrntRdrDetn89RdrDetnSts;
SIG_GROUP_ 332 FrntRdrDetn90 1 : FrntRdrDetn90RdrDetnAzi FrntRdrDetn90RdrDetnChks FrntRdrDetn90RdrDetnCntr FrntRdrDetn90RdrDetnConf FrntRdrDetn90RdrDetnElevn FrntRdrDetn90RdrDetnPwr FrntRdrDetn90RdrDetnRng FrntRdrDetn90RdrDetnRngV FrntRdrDetn90RdrDetnSts;
SIG_GROUP_ 334 FrntRdrDetn91 1 : FrntRdrDetn91RdrDetnAzi FrntRdrDetn91RdrDetnChks FrntRdrDetn91RdrDetnCntr FrntRdrDetn91RdrDetnConf FrntRdrDetn91RdrDetnElevn FrntRdrDetn91RdrDetnPwr FrntRdrDetn91RdrDetnRng FrntRdrDetn91RdrDetnRngV FrntRdrDetn91RdrDetnSts;
SIG_GROUP_ 334 FrntRdrDetn92 1 : FrntRdrDetn92RdrDetnAzi FrntRdrDetn92RdrDetnChks FrntRdrDetn92RdrDetnCntr FrntRdrDetn92RdrDetnConf FrntRdrDetn92RdrDetnElevn FrntRdrDetn92RdrDetnPwr FrntRdrDetn92RdrDetnRng FrntRdrDetn92RdrDetnRngV FrntRdrDetn92RdrDetnSts;
SIG_GROUP_ 334 FrntRdrDetn93 1 : FrntRdrDetn93RdrDetnAzi FrntRdrDetn93RdrDetnChks FrntRdrDetn93RdrDetnCntr FrntRdrDetn93RdrDetnConf FrntRdrDetn93RdrDetnElevn FrntRdrDetn93RdrDetnPwr FrntRdrDetn93RdrDetnRng FrntRdrDetn93RdrDetnRngV FrntRdrDetn93RdrDetnSts;
SIG_GROUP_ 334 FrntRdrDetn94 1 : FrntRdrDetn94RdrDetnAzi FrntRdrDetn94RdrDetnChks FrntRdrDetn94RdrDetnCntr FrntRdrDetn94RdrDetnConf FrntRdrDetn94RdrDetnElevn FrntRdrDetn94RdrDetnPwr FrntRdrDetn94RdrDetnRng FrntRdrDetn94RdrDetnRngV FrntRdrDetn94RdrDetnSts;
SIG_GROUP_ 334 FrntRdrDetn95 1 : FrntRdrDetn95RdrDetnAzi FrntRdrDetn95RdrDetnChks FrntRdrDetn95RdrDetnCntr FrntRdrDetn95RdrDetnConf FrntRdrDetn95RdrDetnElevn FrntRdrDetn95RdrDetnPwr FrntRdrDetn95RdrDetnRng FrntRdrDetn95RdrDetnRngV FrntRdrDetn95RdrDetnSts;
SIG_GROUP_ 334 FrntRdrDetn96 1 : FrntRdrDetn96RdrDetnAzi FrntRdrDetn96RdrDetnChks FrntRdrDetn96RdrDetnCntr FrntRdrDetn96RdrDetnConf FrntRdrDetn96RdrDetnElevn FrntRdrDetn96RdrDetnPwr FrntRdrDetn96RdrDetnRng FrntRdrDetn96RdrDetnRngV FrntRdrDetn96RdrDetnSts;
SIG_GROUP_ 336 FrntRdrDetn97 1 : FrntRdrDetn97RdrDetnAzi FrntRdrDetn97RdrDetnChks FrntRdrDetn97RdrDetnCntr FrntRdrDetn97RdrDetnConf FrntRdrDetn97RdrDetnElevn FrntRdrDetn97RdrDetnPwr FrntRdrDetn97RdrDetnRng FrntRdrDetn97RdrDetnRngV FrntRdrDetn97RdrDetnSts;
SIG_GROUP_ 336 FrntRdrDetn98 1 : FrntRdrDetn98RdrDetnAzi FrntRdrDetn98RdrDetnChks FrntRdrDetn98RdrDetnCntr FrntRdrDetn98RdrDetnConf FrntRdrDetn98RdrDetnElevn FrntRdrDetn98RdrDetnPwr FrntRdrDetn98RdrDetnRng FrntRdrDetn98RdrDetnRngV FrntRdrDetn98RdrDetnSts;
SIG_GROUP_ 336 FrntRdrDetn99 1 : FrntRdrDetn99RdrDetnAzi FrntRdrDetn99RdrDetnChks FrntRdrDetn99RdrDetnCntr FrntRdrDetn99RdrDetnConf FrntRdrDetn99RdrDetnElevn FrntRdrDetn99RdrDetnPwr FrntRdrDetn99RdrDetnRng FrntRdrDetn99RdrDetnRngV FrntRdrDetn99RdrDetnSts;
