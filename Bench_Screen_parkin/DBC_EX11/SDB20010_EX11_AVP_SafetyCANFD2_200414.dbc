// *************************************************************************** *
// *                                                                           *
// *                      Mentor Graphics Corporation                          *
// *                          All rights reserved                              *
// *                                                                           *
// *************************************************************************** *
// *                                                                           *
// * Description:         CANDB File                                           *
// * Generated at:        2020-04-14 13:13:01                                  *
// * System:              SDB20010                                             *
// * Variant:             EX11_AVP                                             *
// * Network:             SafetyCANFD2                                         *
// *                                                                           *
// *************************************************************************** *
// *                                                                           *
// *             THIS CONFIGURATION MIGHT CONTAIN SOME ERRORS                  *
// *              IF THE INPUT MODEL WAS NOT PROPERLY FORMED!                  *
// *                    Do Not Use this File directly!                         *
// *                                                                           *
// *************************************************************************** *
VERSION "SafetyCANFD2"

NS_ :

BS_:

BU_:  ASDM ETC FLC FLR PAS

BO_ 342 FLRSafetyCANFD2Frame20: 64 FLR
 SG_ FrntRdrDetn115_UB : 74|1@0+ (1,0) [0|1] "" ASDM,PAS
 SG_ FrntRdrDetn115RdrDetnAzi : 31|11@0+ (0.1,-90.0) [-90.0|90.0] "Deg" ASDM,PAS
 SG_ FrntRdrDetn115RdrDetnChks : 7|8@0+ (1.0,0.0) [0.0|255.0] "Unitless" ASDM,PAS
 SG_ FrntRdrDetn115RdrDetnCntr : 15|4@0+ (1.0,0.0) [0.0|15.0] "Unitless" ASDM,PAS
 SG_ FrntRdrDetn115RdrDetnConf : 71|7@0+ (1.0,0.0) [0.0|100.0] "%" ASDM,PAS
 SG_ FrntRdrDetn115RdrDetnElevn : 79|5@0+ (1.0,-15.0) [-15.0|15.0] "Deg" ASDM,PAS
 SG_ FrntRdrDetn115RdrDetnPwr : 8|9@0+ (0.1,0.0) [0.0|51.1] "dB" ASDM,PAS
 SG_ FrntRdrDetn115RdrDetnRng : 55|14@0+ (0.02,-1.0) [-1.0|200.0] "m" ASDM,PAS
 SG_ FrntRdrDetn115RdrDetnRngV : 36|13@0+ (0.02,-80.0) [-80.0|80.0] "m/s" ASDM,PAS
 SG_ FrntRdrDetn115RdrDetnSts : 11|2@0+ (1,0) [0|3] "" ASDM,PAS
 SG_ FrntRdrDetn116_UB : 154|1@0+ (1,0) [0|1] "" ASDM,PAS
 SG_ FrntRdrDetn116RdrDetnAzi : 119|11@0+ (0.1,-90.0) [-90.0|90.0] "Deg" ASDM,PAS
 SG_ FrntRdrDetn116RdrDetnChks : 87|8@0+ (1.0,0.0) [0.0|255.0] "Unitless" ASDM,PAS
 SG_ FrntRdrDetn116RdrDetnCntr : 95|4@0+ (1.0,0.0) [0.0|15.0] "Unitless" ASDM,PAS
 SG_ FrntRdrDetn116RdrDetnConf : 111|7@0+ (1.0,0.0) [0.0|100.0] "%" ASDM,PAS
 SG_ FrntRdrDetn116RdrDetnElevn : 159|5@0+ (1.0,-15.0) [-15.0|15.0] "Deg" ASDM,PAS
 SG_ FrntRdrDetn116RdrDetnPwr : 89|9@0+ (0.1,0.0) [0.0|51.1] "dB" ASDM,PAS
 SG_ FrntRdrDetn116RdrDetnRng : 143|14@0+ (0.02,-1.0) [-1.0|200.0] "m" ASDM,PAS
 SG_ FrntRdrDetn116RdrDetnRngV : 124|13@0+ (0.02,-80.0) [-80.0|80.0] "m/s" ASDM,PAS
 SG_ FrntRdrDetn116RdrDetnSts : 91|2@0+ (1,0) [0|3] "" ASDM,PAS
 SG_ FrntRdrDetn117_UB : 234|1@0+ (1,0) [0|1] "" ASDM,PAS
 SG_ FrntRdrDetn117RdrDetnAzi : 199|11@0+ (0.1,-90.0) [-90.0|90.0] "Deg" ASDM,PAS
 SG_ FrntRdrDetn117RdrDetnChks : 167|8@0+ (1.0,0.0) [0.0|255.0] "Unitless" ASDM,PAS
 SG_ FrntRdrDetn117RdrDetnCntr : 175|4@0+ (1.0,0.0) [0.0|15.0] "Unitless" ASDM,PAS
 SG_ FrntRdrDetn117RdrDetnConf : 191|7@0+ (1.0,0.0) [0.0|100.0] "%" ASDM,PAS
 SG_ FrntRdrDetn117RdrDetnElevn : 239|5@0+ (1.0,-15.0) [-15.0|15.0] "Deg" ASDM,PAS
 SG_ FrntRdrDetn117RdrDetnPwr : 169|9@0+ (0.1,0.0) [0.0|51.1] "dB" ASDM,PAS
 SG_ FrntRdrDetn117RdrDetnRng : 223|14@0+ (0.02,-1.0) [-1.0|200.0] "m" ASDM,PAS
 SG_ FrntRdrDetn117RdrDetnRngV : 204|13@0+ (0.02,-80.0) [-80.0|80.0] "m/s" ASDM,PAS
 SG_ FrntRdrDetn117RdrDetnSts : 171|2@0+ (1,0) [0|3] "" ASDM,PAS
 SG_ FrntRdrDetn118_UB : 314|1@0+ (1,0) [0|1] "" ASDM,PAS
 SG_ FrntRdrDetn118RdrDetnAzi : 287|11@0+ (0.1,-90.0) [-90.0|90.0] "Deg" ASDM,PAS
 SG_ FrntRdrDetn118RdrDetnChks : 247|8@0+ (1.0,0.0) [0.0|255.0] "Unitless" ASDM,PAS
 SG_ FrntRdrDetn118RdrDetnCntr : 255|4@0+ (1.0,0.0) [0.0|15.0] "Unitless" ASDM,PAS
 SG_ FrntRdrDetn118RdrDetnConf : 311|7@0+ (1.0,0.0) [0.0|100.0] "%" ASDM,PAS
 SG_ FrntRdrDetn118RdrDetnElevn : 319|5@0+ (1.0,-15.0) [-15.0|15.0] "Deg" ASDM,PAS
 SG_ FrntRdrDetn118RdrDetnPwr : 249|9@0+ (0.1,0.0) [0.0|51.1] "dB" ASDM,PAS
 SG_ FrntRdrDetn118RdrDetnRng : 271|14@0+ (0.02,-1.0) [-1.0|200.0] "m" ASDM,PAS
 SG_ FrntRdrDetn118RdrDetnRngV : 292|13@0+ (0.02,-80.0) [-80.0|80.0] "m/s" ASDM,PAS
 SG_ FrntRdrDetn118RdrDetnSts : 251|2@0+ (1,0) [0|3] "" ASDM,PAS
 SG_ FrntRdrDetn119_UB : 394|1@0+ (1,0) [0|1] "" ASDM,PAS
 SG_ FrntRdrDetn119RdrDetnAzi : 351|11@0+ (0.1,-90.0) [-90.0|90.0] "Deg" ASDM,PAS
 SG_ FrntRdrDetn119RdrDetnChks : 327|8@0+ (1.0,0.0) [0.0|255.0] "Unitless" ASDM,PAS
 SG_ FrntRdrDetn119RdrDetnCntr : 335|4@0+ (1.0,0.0) [0.0|15.0] "Unitless" ASDM,PAS
 SG_ FrntRdrDetn119RdrDetnConf : 391|7@0+ (1.0,0.0) [0.0|100.0] "%" ASDM,PAS
 SG_ FrntRdrDetn119RdrDetnElevn : 399|5@0+ (1.0,-15.0) [-15.0|15.0] "Deg" ASDM,PAS
 SG_ FrntRdrDetn119RdrDetnPwr : 329|9@0+ (0.1,0.0) [0.0|51.1] "dB" ASDM,PAS
 SG_ FrntRdrDetn119RdrDetnRng : 375|14@0+ (0.02,-1.0) [-1.0|200.0] "m" ASDM,PAS
 SG_ FrntRdrDetn119RdrDetnRngV : 356|13@0+ (0.02,-80.0) [-80.0|80.0] "m/s" ASDM,PAS
 SG_ FrntRdrDetn119RdrDetnSts : 331|2@0+ (1,0) [0|3] "" ASDM,PAS
 SG_ FrntRdrDetn120_UB : 474|1@0+ (1,0) [0|1] "" ASDM,PAS
 SG_ FrntRdrDetn120RdrDetnAzi : 447|11@0+ (0.1,-90.0) [-90.0|90.0] "Deg" ASDM,PAS
 SG_ FrntRdrDetn120RdrDetnChks : 407|8@0+ (1.0,0.0) [0.0|255.0] "Unitless" ASDM,PAS
 SG_ FrntRdrDetn120RdrDetnCntr : 415|4@0+ (1.0,0.0) [0.0|15.0] "Unitless" ASDM,PAS
 SG_ FrntRdrDetn120RdrDetnConf : 471|7@0+ (1.0,0.0) [0.0|100.0] "%" ASDM,PAS
 SG_ FrntRdrDetn120RdrDetnElevn : 479|5@0+ (1.0,-15.0) [-15.0|15.0] "Deg" ASDM,PAS
 SG_ FrntRdrDetn120RdrDetnPwr : 409|9@0+ (0.1,0.0) [0.0|51.1] "dB" ASDM,PAS
 SG_ FrntRdrDetn120RdrDetnRng : 431|14@0+ (0.02,-1.0) [-1.0|200.0] "m" ASDM,PAS
 SG_ FrntRdrDetn120RdrDetnRngV : 452|13@0+ (0.02,-80.0) [-80.0|80.0] "m/s" ASDM,PAS
 SG_ FrntRdrDetn120RdrDetnSts : 411|2@0+ (1,0) [0|3] "" ASDM,PAS

BO_ 344 FLRSafetyCANFD2Frame21: 64 FLR
 SG_ FrntRdrDetn121_UB : 74|1@0+ (1,0) [0|1] "" ASDM,PAS
 SG_ FrntRdrDetn121RdrDetnAzi : 31|11@0+ (0.1,-90.0) [-90.0|90.0] "Deg" ASDM,PAS
 SG_ FrntRdrDetn121RdrDetnChks : 7|8@0+ (1.0,0.0) [0.0|255.0] "Unitless" ASDM,PAS
 SG_ FrntRdrDetn121RdrDetnCntr : 15|4@0+ (1.0,0.0) [0.0|15.0] "Unitless" ASDM,PAS
 SG_ FrntRdrDetn121RdrDetnConf : 71|7@0+ (1.0,0.0) [0.0|100.0] "%" ASDM,PAS
 SG_ FrntRdrDetn121RdrDetnElevn : 79|5@0+ (1.0,-15.0) [-15.0|15.0] "Deg" ASDM,PAS
 SG_ FrntRdrDetn121RdrDetnPwr : 8|9@0+ (0.1,0.0) [0.0|51.1] "dB" ASDM,PAS
 SG_ FrntRdrDetn121RdrDetnRng : 55|14@0+ (0.02,-1.0) [-1.0|200.0] "m" ASDM,PAS
 SG_ FrntRdrDetn121RdrDetnRngV : 36|13@0+ (0.02,-80.0) [-80.0|80.0] "m/s" ASDM,PAS
 SG_ FrntRdrDetn121RdrDetnSts : 11|2@0+ (1,0) [0|3] "" ASDM,PAS
 SG_ FrntRdrDetn122_UB : 154|1@0+ (1,0) [0|1] "" ASDM,PAS
 SG_ FrntRdrDetn122RdrDetnAzi : 119|11@0+ (0.1,-90.0) [-90.0|90.0] "Deg" ASDM,PAS
 SG_ FrntRdrDetn122RdrDetnChks : 87|8@0+ (1.0,0.0) [0.0|255.0] "Unitless" ASDM,PAS
 SG_ FrntRdrDetn122RdrDetnCntr : 95|4@0+ (1.0,0.0) [0.0|15.0] "Unitless" ASDM,PAS
 SG_ FrntRdrDetn122RdrDetnConf : 111|7@0+ (1.0,0.0) [0.0|100.0] "%" ASDM,PAS
 SG_ FrntRdrDetn122RdrDetnElevn : 159|5@0+ (1.0,-15.0) [-15.0|15.0] "Deg" ASDM,PAS
 SG_ FrntRdrDetn122RdrDetnPwr : 89|9@0+ (0.1,0.0) [0.0|51.1] "dB" ASDM,PAS
 SG_ FrntRdrDetn122RdrDetnRng : 143|14@0+ (0.02,-1.0) [-1.0|200.0] "m" ASDM,PAS
 SG_ FrntRdrDetn122RdrDetnRngV : 124|13@0+ (0.02,-80.0) [-80.0|80.0] "m/s" ASDM,PAS
 SG_ FrntRdrDetn122RdrDetnSts : 91|2@0+ (1,0) [0|3] "" ASDM,PAS
 SG_ FrntRdrDetn123_UB : 234|1@0+ (1,0) [0|1] "" ASDM,PAS
 SG_ FrntRdrDetn123RdrDetnAzi : 199|11@0+ (0.1,-90.0) [-90.0|90.0] "Deg" ASDM,PAS
 SG_ FrntRdrDetn123RdrDetnChks : 167|8@0+ (1.0,0.0) [0.0|255.0] "Unitless" ASDM,PAS
 SG_ FrntRdrDetn123RdrDetnCntr : 175|4@0+ (1.0,0.0) [0.0|15.0] "Unitless" ASDM,PAS
 SG_ FrntRdrDetn123RdrDetnConf : 191|7@0+ (1.0,0.0) [0.0|100.0] "%" ASDM,PAS
 SG_ FrntRdrDetn123RdrDetnElevn : 239|5@0+ (1.0,-15.0) [-15.0|15.0] "Deg" ASDM,PAS
 SG_ FrntRdrDetn123RdrDetnPwr : 169|9@0+ (0.1,0.0) [0.0|51.1] "dB" ASDM,PAS
 SG_ FrntRdrDetn123RdrDetnRng : 223|14@0+ (0.02,-1.0) [-1.0|200.0] "m" ASDM,PAS
 SG_ FrntRdrDetn123RdrDetnRngV : 204|13@0+ (0.02,-80.0) [-80.0|80.0] "m/s" ASDM,PAS
 SG_ FrntRdrDetn123RdrDetnSts : 171|2@0+ (1,0) [0|3] "" ASDM,PAS
 SG_ FrntRdrDetn124_UB : 314|1@0+ (1,0) [0|1] "" ASDM,PAS
 SG_ FrntRdrDetn124RdrDetnAzi : 287|11@0+ (0.1,-90.0) [-90.0|90.0] "Deg" ASDM,PAS
 SG_ FrntRdrDetn124RdrDetnChks : 247|8@0+ (1.0,0.0) [0.0|255.0] "Unitless" ASDM,PAS
 SG_ FrntRdrDetn124RdrDetnCntr : 255|4@0+ (1.0,0.0) [0.0|15.0] "Unitless" ASDM,PAS
 SG_ FrntRdrDetn124RdrDetnConf : 311|7@0+ (1.0,0.0) [0.0|100.0] "%" ASDM,PAS
 SG_ FrntRdrDetn124RdrDetnElevn : 319|5@0+ (1.0,-15.0) [-15.0|15.0] "Deg" ASDM,PAS
 SG_ FrntRdrDetn124RdrDetnPwr : 249|9@0+ (0.1,0.0) [0.0|51.1] "dB" ASDM,PAS
 SG_ FrntRdrDetn124RdrDetnRng : 271|14@0+ (0.02,-1.0) [-1.0|200.0] "m" ASDM,PAS
 SG_ FrntRdrDetn124RdrDetnRngV : 292|13@0+ (0.02,-80.0) [-80.0|80.0] "m/s" ASDM,PAS
 SG_ FrntRdrDetn124RdrDetnSts : 251|2@0+ (1,0) [0|3] "" ASDM,PAS
 SG_ FrntRdrDetn125_UB : 394|1@0+ (1,0) [0|1] "" ASDM,PAS
 SG_ FrntRdrDetn125RdrDetnAzi : 351|11@0+ (0.1,-90.0) [-90.0|90.0] "Deg" ASDM,PAS
 SG_ FrntRdrDetn125RdrDetnChks : 327|8@0+ (1.0,0.0) [0.0|255.0] "Unitless" ASDM,PAS
 SG_ FrntRdrDetn125RdrDetnCntr : 335|4@0+ (1.0,0.0) [0.0|15.0] "Unitless" ASDM,PAS
 SG_ FrntRdrDetn125RdrDetnConf : 391|7@0+ (1.0,0.0) [0.0|100.0] "%" ASDM,PAS
 SG_ FrntRdrDetn125RdrDetnElevn : 399|5@0+ (1.0,-15.0) [-15.0|15.0] "Deg" ASDM,PAS
 SG_ FrntRdrDetn125RdrDetnPwr : 329|9@0+ (0.1,0.0) [0.0|51.1] "dB" ASDM,PAS
 SG_ FrntRdrDetn125RdrDetnRng : 375|14@0+ (0.02,-1.0) [-1.0|200.0] "m" ASDM,PAS
 SG_ FrntRdrDetn125RdrDetnRngV : 356|13@0+ (0.02,-80.0) [-80.0|80.0] "m/s" ASDM,PAS
 SG_ FrntRdrDetn125RdrDetnSts : 331|2@0+ (1,0) [0|3] "" ASDM,PAS
 SG_ FrntRdrDetn126_UB : 474|1@0+ (1,0) [0|1] "" ASDM,PAS
 SG_ FrntRdrDetn126RdrDetnAzi : 447|11@0+ (0.1,-90.0) [-90.0|90.0] "Deg" ASDM,PAS
 SG_ FrntRdrDetn126RdrDetnChks : 407|8@0+ (1.0,0.0) [0.0|255.0] "Unitless" ASDM,PAS
 SG_ FrntRdrDetn126RdrDetnCntr : 415|4@0+ (1.0,0.0) [0.0|15.0] "Unitless" ASDM,PAS
 SG_ FrntRdrDetn126RdrDetnConf : 471|7@0+ (1.0,0.0) [0.0|100.0] "%" ASDM,PAS
 SG_ FrntRdrDetn126RdrDetnElevn : 479|5@0+ (1.0,-15.0) [-15.0|15.0] "Deg" ASDM,PAS
 SG_ FrntRdrDetn126RdrDetnPwr : 409|9@0+ (0.1,0.0) [0.0|51.1] "dB" ASDM,PAS
 SG_ FrntRdrDetn126RdrDetnRng : 431|14@0+ (0.02,-1.0) [-1.0|200.0] "m" ASDM,PAS
 SG_ FrntRdrDetn126RdrDetnRngV : 452|13@0+ (0.02,-80.0) [-80.0|80.0] "m/s" ASDM,PAS
 SG_ FrntRdrDetn126RdrDetnSts : 411|2@0+ (1,0) [0|3] "" ASDM,PAS

BO_ 346 FLRSafetyCANFD2Frame22: 64 FLR
 SG_ FrntRdrDetn127_UB : 74|1@0+ (1,0) [0|1] "" ASDM,PAS
 SG_ FrntRdrDetn127RdrDetnAzi : 31|11@0+ (0.1,-90.0) [-90.0|90.0] "Deg" ASDM,PAS
 SG_ FrntRdrDetn127RdrDetnChks : 7|8@0+ (1.0,0.0) [0.0|255.0] "Unitless" ASDM,PAS
 SG_ FrntRdrDetn127RdrDetnCntr : 15|4@0+ (1.0,0.0) [0.0|15.0] "Unitless" ASDM,PAS
 SG_ FrntRdrDetn127RdrDetnConf : 71|7@0+ (1.0,0.0) [0.0|100.0] "%" ASDM,PAS
 SG_ FrntRdrDetn127RdrDetnElevn : 79|5@0+ (1.0,-15.0) [-15.0|15.0] "Deg" ASDM,PAS
 SG_ FrntRdrDetn127RdrDetnPwr : 8|9@0+ (0.1,0.0) [0.0|51.1] "dB" ASDM,PAS
 SG_ FrntRdrDetn127RdrDetnRng : 55|14@0+ (0.02,-1.0) [-1.0|200.0] "m" ASDM,PAS
 SG_ FrntRdrDetn127RdrDetnRngV : 36|13@0+ (0.02,-80.0) [-80.0|80.0] "m/s" ASDM,PAS
 SG_ FrntRdrDetn127RdrDetnSts : 11|2@0+ (1,0) [0|3] "" ASDM,PAS
 SG_ FrntRdrDetn128_UB : 154|1@0+ (1,0) [0|1] "" ASDM,PAS
 SG_ FrntRdrDetn128RdrDetnAzi : 119|11@0+ (0.1,-90.0) [-90.0|90.0] "Deg" ASDM,PAS
 SG_ FrntRdrDetn128RdrDetnChks : 87|8@0+ (1.0,0.0) [0.0|255.0] "Unitless" ASDM,PAS
 SG_ FrntRdrDetn128RdrDetnCntr : 95|4@0+ (1.0,0.0) [0.0|15.0] "Unitless" ASDM,PAS
 SG_ FrntRdrDetn128RdrDetnConf : 111|7@0+ (1.0,0.0) [0.0|100.0] "%" ASDM,PAS
 SG_ FrntRdrDetn128RdrDetnElevn : 159|5@0+ (1.0,-15.0) [-15.0|15.0] "Deg" ASDM,PAS
 SG_ FrntRdrDetn128RdrDetnPwr : 89|9@0+ (0.1,0.0) [0.0|51.1] "dB" ASDM,PAS
 SG_ FrntRdrDetn128RdrDetnRng : 143|14@0+ (0.02,-1.0) [-1.0|200.0] "m" ASDM,PAS
 SG_ FrntRdrDetn128RdrDetnRngV : 124|13@0+ (0.02,-80.0) [-80.0|80.0] "m/s" ASDM,PAS
 SG_ FrntRdrDetn128RdrDetnSts : 91|2@0+ (1,0) [0|3] "" ASDM,PAS
 SG_ FrntRdrDetn129_UB : 234|1@0+ (1,0) [0|1] "" ASDM,PAS
 SG_ FrntRdrDetn129RdrDetnAzi : 199|11@0+ (0.1,-90.0) [-90.0|90.0] "Deg" ASDM,PAS
 SG_ FrntRdrDetn129RdrDetnChks : 167|8@0+ (1.0,0.0) [0.0|255.0] "Unitless" ASDM,PAS
 SG_ FrntRdrDetn129RdrDetnCntr : 175|4@0+ (1.0,0.0) [0.0|15.0] "Unitless" ASDM,PAS
 SG_ FrntRdrDetn129RdrDetnConf : 191|7@0+ (1.0,0.0) [0.0|100.0] "%" ASDM,PAS
 SG_ FrntRdrDetn129RdrDetnElevn : 239|5@0+ (1.0,-15.0) [-15.0|15.0] "Deg" ASDM,PAS
 SG_ FrntRdrDetn129RdrDetnPwr : 169|9@0+ (0.1,0.0) [0.0|51.1] "dB" ASDM,PAS
 SG_ FrntRdrDetn129RdrDetnRng : 223|14@0+ (0.02,-1.0) [-1.0|200.0] "m" ASDM,PAS
 SG_ FrntRdrDetn129RdrDetnRngV : 204|13@0+ (0.02,-80.0) [-80.0|80.0] "m/s" ASDM,PAS
 SG_ FrntRdrDetn129RdrDetnSts : 171|2@0+ (1,0) [0|3] "" ASDM,PAS
 SG_ FrntRdrDetn130_UB : 314|1@0+ (1,0) [0|1] "" ASDM,PAS
 SG_ FrntRdrDetn130RdrDetnAzi : 287|11@0+ (0.1,-90.0) [-90.0|90.0] "Deg" ASDM,PAS
 SG_ FrntRdrDetn130RdrDetnChks : 247|8@0+ (1.0,0.0) [0.0|255.0] "Unitless" ASDM,PAS
 SG_ FrntRdrDetn130RdrDetnCntr : 255|4@0+ (1.0,0.0) [0.0|15.0] "Unitless" ASDM,PAS
 SG_ FrntRdrDetn130RdrDetnConf : 311|7@0+ (1.0,0.0) [0.0|100.0] "%" ASDM,PAS
 SG_ FrntRdrDetn130RdrDetnElevn : 319|5@0+ (1.0,-15.0) [-15.0|15.0] "Deg" ASDM,PAS
 SG_ FrntRdrDetn130RdrDetnPwr : 249|9@0+ (0.1,0.0) [0.0|51.1] "dB" ASDM,PAS
 SG_ FrntRdrDetn130RdrDetnRng : 271|14@0+ (0.02,-1.0) [-1.0|200.0] "m" ASDM,PAS
 SG_ FrntRdrDetn130RdrDetnRngV : 292|13@0+ (0.02,-80.0) [-80.0|80.0] "m/s" ASDM,PAS
 SG_ FrntRdrDetn130RdrDetnSts : 251|2@0+ (1,0) [0|3] "" ASDM,PAS
 SG_ FrntRdrDetn131_UB : 394|1@0+ (1,0) [0|1] "" ASDM,PAS
 SG_ FrntRdrDetn131RdrDetnAzi : 351|11@0+ (0.1,-90.0) [-90.0|90.0] "Deg" ASDM,PAS
 SG_ FrntRdrDetn131RdrDetnChks : 327|8@0+ (1.0,0.0) [0.0|255.0] "Unitless" ASDM,PAS
 SG_ FrntRdrDetn131RdrDetnCntr : 335|4@0+ (1.0,0.0) [0.0|15.0] "Unitless" ASDM,PAS
 SG_ FrntRdrDetn131RdrDetnConf : 391|7@0+ (1.0,0.0) [0.0|100.0] "%" ASDM,PAS
 SG_ FrntRdrDetn131RdrDetnElevn : 399|5@0+ (1.0,-15.0) [-15.0|15.0] "Deg" ASDM,PAS
 SG_ FrntRdrDetn131RdrDetnPwr : 329|9@0+ (0.1,0.0) [0.0|51.1] "dB" ASDM,PAS
 SG_ FrntRdrDetn131RdrDetnRng : 375|14@0+ (0.02,-1.0) [-1.0|200.0] "m" ASDM,PAS
 SG_ FrntRdrDetn131RdrDetnRngV : 356|13@0+ (0.02,-80.0) [-80.0|80.0] "m/s" ASDM,PAS
 SG_ FrntRdrDetn131RdrDetnSts : 331|2@0+ (1,0) [0|3] "" ASDM,PAS
 SG_ FrntRdrDetn132_UB : 474|1@0+ (1,0) [0|1] "" ASDM,PAS
 SG_ FrntRdrDetn132RdrDetnAzi : 447|11@0+ (0.1,-90.0) [-90.0|90.0] "Deg" ASDM,PAS
 SG_ FrntRdrDetn132RdrDetnChks : 407|8@0+ (1.0,0.0) [0.0|255.0] "Unitless" ASDM,PAS
 SG_ FrntRdrDetn132RdrDetnCntr : 415|4@0+ (1.0,0.0) [0.0|15.0] "Unitless" ASDM,PAS
 SG_ FrntRdrDetn132RdrDetnConf : 471|7@0+ (1.0,0.0) [0.0|100.0] "%" ASDM,PAS
 SG_ FrntRdrDetn132RdrDetnElevn : 479|5@0+ (1.0,-15.0) [-15.0|15.0] "Deg" ASDM,PAS
 SG_ FrntRdrDetn132RdrDetnPwr : 409|9@0+ (0.1,0.0) [0.0|51.1] "dB" ASDM,PAS
 SG_ FrntRdrDetn132RdrDetnRng : 431|14@0+ (0.02,-1.0) [-1.0|200.0] "m" ASDM,PAS
 SG_ FrntRdrDetn132RdrDetnRngV : 452|13@0+ (0.02,-80.0) [-80.0|80.0] "m/s" ASDM,PAS
 SG_ FrntRdrDetn132RdrDetnSts : 411|2@0+ (1,0) [0|3] "" ASDM,PAS

BO_ 348 FLRSafetyCANFD2Frame23: 64 FLR
 SG_ FrntRdrDetn133_UB : 74|1@0+ (1,0) [0|1] "" ASDM,PAS
 SG_ FrntRdrDetn133RdrDetnAzi : 31|11@0+ (0.1,-90.0) [-90.0|90.0] "Deg" ASDM,PAS
 SG_ FrntRdrDetn133RdrDetnChks : 7|8@0+ (1.0,0.0) [0.0|255.0] "Unitless" ASDM,PAS
 SG_ FrntRdrDetn133RdrDetnCntr : 15|4@0+ (1.0,0.0) [0.0|15.0] "Unitless" ASDM,PAS
 SG_ FrntRdrDetn133RdrDetnConf : 71|7@0+ (1.0,0.0) [0.0|100.0] "%" ASDM,PAS
 SG_ FrntRdrDetn133RdrDetnElevn : 79|5@0+ (1.0,-15.0) [-15.0|15.0] "Deg" ASDM,PAS
 SG_ FrntRdrDetn133RdrDetnPwr : 8|9@0+ (0.1,0.0) [0.0|51.1] "dB" ASDM,PAS
 SG_ FrntRdrDetn133RdrDetnRng : 55|14@0+ (0.02,-1.0) [-1.0|200.0] "m" ASDM,PAS
 SG_ FrntRdrDetn133RdrDetnRngV : 36|13@0+ (0.02,-80.0) [-80.0|80.0] "m/s" ASDM,PAS
 SG_ FrntRdrDetn133RdrDetnSts : 11|2@0+ (1,0) [0|3] "" ASDM,PAS
 SG_ FrntRdrDetn134_UB : 154|1@0+ (1,0) [0|1] "" ASDM,PAS
 SG_ FrntRdrDetn134RdrDetnAzi : 119|11@0+ (0.1,-90.0) [-90.0|90.0] "Deg" ASDM,PAS
 SG_ FrntRdrDetn134RdrDetnChks : 87|8@0+ (1.0,0.0) [0.0|255.0] "Unitless" ASDM,PAS
 SG_ FrntRdrDetn134RdrDetnCntr : 95|4@0+ (1.0,0.0) [0.0|15.0] "Unitless" ASDM,PAS
 SG_ FrntRdrDetn134RdrDetnConf : 111|7@0+ (1.0,0.0) [0.0|100.0] "%" ASDM,PAS
 SG_ FrntRdrDetn134RdrDetnElevn : 159|5@0+ (1.0,-15.0) [-15.0|15.0] "Deg" ASDM,PAS
 SG_ FrntRdrDetn134RdrDetnPwr : 89|9@0+ (0.1,0.0) [0.0|51.1] "dB" ASDM,PAS
 SG_ FrntRdrDetn134RdrDetnRng : 143|14@0+ (0.02,-1.0) [-1.0|200.0] "m" ASDM,PAS
 SG_ FrntRdrDetn134RdrDetnRngV : 124|13@0+ (0.02,-80.0) [-80.0|80.0] "m/s" ASDM,PAS
 SG_ FrntRdrDetn134RdrDetnSts : 91|2@0+ (1,0) [0|3] "" ASDM,PAS
 SG_ FrntRdrDetn135_UB : 234|1@0+ (1,0) [0|1] "" ASDM,PAS
 SG_ FrntRdrDetn135RdrDetnAzi : 199|11@0+ (0.1,-90.0) [-90.0|90.0] "Deg" ASDM,PAS
 SG_ FrntRdrDetn135RdrDetnChks : 167|8@0+ (1.0,0.0) [0.0|255.0] "Unitless" ASDM,PAS
 SG_ FrntRdrDetn135RdrDetnCntr : 175|4@0+ (1.0,0.0) [0.0|15.0] "Unitless" ASDM,PAS
 SG_ FrntRdrDetn135RdrDetnConf : 191|7@0+ (1.0,0.0) [0.0|100.0] "%" ASDM,PAS
 SG_ FrntRdrDetn135RdrDetnElevn : 239|5@0+ (1.0,-15.0) [-15.0|15.0] "Deg" ASDM,PAS
 SG_ FrntRdrDetn135RdrDetnPwr : 169|9@0+ (0.1,0.0) [0.0|51.1] "dB" ASDM,PAS
 SG_ FrntRdrDetn135RdrDetnRng : 223|14@0+ (0.02,-1.0) [-1.0|200.0] "m" ASDM,PAS
 SG_ FrntRdrDetn135RdrDetnRngV : 204|13@0+ (0.02,-80.0) [-80.0|80.0] "m/s" ASDM,PAS
 SG_ FrntRdrDetn135RdrDetnSts : 171|2@0+ (1,0) [0|3] "" ASDM,PAS
 SG_ FrntRdrDetn136_UB : 314|1@0+ (1,0) [0|1] "" ASDM,PAS
 SG_ FrntRdrDetn136RdrDetnAzi : 287|11@0+ (0.1,-90.0) [-90.0|90.0] "Deg" ASDM,PAS
 SG_ FrntRdrDetn136RdrDetnChks : 247|8@0+ (1.0,0.0) [0.0|255.0] "Unitless" ASDM,PAS
 SG_ FrntRdrDetn136RdrDetnCntr : 255|4@0+ (1.0,0.0) [0.0|15.0] "Unitless" ASDM,PAS
 SG_ FrntRdrDetn136RdrDetnConf : 311|7@0+ (1.0,0.0) [0.0|100.0] "%" ASDM,PAS
 SG_ FrntRdrDetn136RdrDetnElevn : 319|5@0+ (1.0,-15.0) [-15.0|15.0] "Deg" ASDM,PAS
 SG_ FrntRdrDetn136RdrDetnPwr : 249|9@0+ (0.1,0.0) [0.0|51.1] "dB" ASDM,PAS
 SG_ FrntRdrDetn136RdrDetnRng : 271|14@0+ (0.02,-1.0) [-1.0|200.0] "m" ASDM,PAS
 SG_ FrntRdrDetn136RdrDetnRngV : 292|13@0+ (0.02,-80.0) [-80.0|80.0] "m/s" ASDM,PAS
 SG_ FrntRdrDetn136RdrDetnSts : 251|2@0+ (1,0) [0|3] "" ASDM,PAS
 SG_ FrntRdrDetn137_UB : 394|1@0+ (1,0) [0|1] "" ASDM,PAS
 SG_ FrntRdrDetn137RdrDetnAzi : 351|11@0+ (0.1,-90.0) [-90.0|90.0] "Deg" ASDM,PAS
 SG_ FrntRdrDetn137RdrDetnChks : 327|8@0+ (1.0,0.0) [0.0|255.0] "Unitless" ASDM,PAS
 SG_ FrntRdrDetn137RdrDetnCntr : 335|4@0+ (1.0,0.0) [0.0|15.0] "Unitless" ASDM,PAS
 SG_ FrntRdrDetn137RdrDetnConf : 391|7@0+ (1.0,0.0) [0.0|100.0] "%" ASDM,PAS
 SG_ FrntRdrDetn137RdrDetnElevn : 399|5@0+ (1.0,-15.0) [-15.0|15.0] "Deg" ASDM,PAS
 SG_ FrntRdrDetn137RdrDetnPwr : 329|9@0+ (0.1,0.0) [0.0|51.1] "dB" ASDM,PAS
 SG_ FrntRdrDetn137RdrDetnRng : 375|14@0+ (0.02,-1.0) [-1.0|200.0] "m" ASDM,PAS
 SG_ FrntRdrDetn137RdrDetnRngV : 356|13@0+ (0.02,-80.0) [-80.0|80.0] "m/s" ASDM,PAS
 SG_ FrntRdrDetn137RdrDetnSts : 331|2@0+ (1,0) [0|3] "" ASDM,PAS
 SG_ FrntRdrDetn138_UB : 474|1@0+ (1,0) [0|1] "" ASDM,PAS
 SG_ FrntRdrDetn138RdrDetnAzi : 447|11@0+ (0.1,-90.0) [-90.0|90.0] "Deg" ASDM,PAS
 SG_ FrntRdrDetn138RdrDetnChks : 407|8@0+ (1.0,0.0) [0.0|255.0] "Unitless" ASDM,PAS
 SG_ FrntRdrDetn138RdrDetnCntr : 415|4@0+ (1.0,0.0) [0.0|15.0] "Unitless" ASDM,PAS
 SG_ FrntRdrDetn138RdrDetnConf : 471|7@0+ (1.0,0.0) [0.0|100.0] "%" ASDM,PAS
 SG_ FrntRdrDetn138RdrDetnElevn : 479|5@0+ (1.0,-15.0) [-15.0|15.0] "Deg" ASDM,PAS
 SG_ FrntRdrDetn138RdrDetnPwr : 409|9@0+ (0.1,0.0) [0.0|51.1] "dB" ASDM,PAS
 SG_ FrntRdrDetn138RdrDetnRng : 431|14@0+ (0.02,-1.0) [-1.0|200.0] "m" ASDM,PAS
 SG_ FrntRdrDetn138RdrDetnRngV : 452|13@0+ (0.02,-80.0) [-80.0|80.0] "m/s" ASDM,PAS
 SG_ FrntRdrDetn138RdrDetnSts : 411|2@0+ (1,0) [0|3] "" ASDM,PAS

BO_ 350 FLRSafetyCANFD2Frame24: 64 FLR
 SG_ FrntRdrDetn139_UB : 74|1@0+ (1,0) [0|1] "" ASDM,PAS
 SG_ FrntRdrDetn139RdrDetnAzi : 31|11@0+ (0.1,-90.0) [-90.0|90.0] "Deg" ASDM,PAS
 SG_ FrntRdrDetn139RdrDetnChks : 7|8@0+ (1.0,0.0) [0.0|255.0] "Unitless" ASDM,PAS
 SG_ FrntRdrDetn139RdrDetnCntr : 15|4@0+ (1.0,0.0) [0.0|15.0] "Unitless" ASDM,PAS
 SG_ FrntRdrDetn139RdrDetnConf : 71|7@0+ (1.0,0.0) [0.0|100.0] "%" ASDM,PAS
 SG_ FrntRdrDetn139RdrDetnElevn : 79|5@0+ (1.0,-15.0) [-15.0|15.0] "Deg" ASDM,PAS
 SG_ FrntRdrDetn139RdrDetnPwr : 8|9@0+ (0.1,0.0) [0.0|51.1] "dB" ASDM,PAS
 SG_ FrntRdrDetn139RdrDetnRng : 55|14@0+ (0.02,-1.0) [-1.0|200.0] "m" ASDM,PAS
 SG_ FrntRdrDetn139RdrDetnRngV : 36|13@0+ (0.02,-80.0) [-80.0|80.0] "m/s" ASDM,PAS
 SG_ FrntRdrDetn139RdrDetnSts : 11|2@0+ (1,0) [0|3] "" ASDM,PAS
 SG_ FrntRdrDetn140_UB : 154|1@0+ (1,0) [0|1] "" ASDM,PAS
 SG_ FrntRdrDetn140RdrDetnAzi : 119|11@0+ (0.1,-90.0) [-90.0|90.0] "Deg" ASDM,PAS
 SG_ FrntRdrDetn140RdrDetnChks : 87|8@0+ (1.0,0.0) [0.0|255.0] "Unitless" ASDM,PAS
 SG_ FrntRdrDetn140RdrDetnCntr : 95|4@0+ (1.0,0.0) [0.0|15.0] "Unitless" ASDM,PAS
 SG_ FrntRdrDetn140RdrDetnConf : 111|7@0+ (1.0,0.0) [0.0|100.0] "%" ASDM,PAS
 SG_ FrntRdrDetn140RdrDetnElevn : 159|5@0+ (1.0,-15.0) [-15.0|15.0] "Deg" ASDM,PAS
 SG_ FrntRdrDetn140RdrDetnPwr : 89|9@0+ (0.1,0.0) [0.0|51.1] "dB" ASDM,PAS
 SG_ FrntRdrDetn140RdrDetnRng : 143|14@0+ (0.02,-1.0) [-1.0|200.0] "m" ASDM,PAS
 SG_ FrntRdrDetn140RdrDetnRngV : 124|13@0+ (0.02,-80.0) [-80.0|80.0] "m/s" ASDM,PAS
 SG_ FrntRdrDetn140RdrDetnSts : 91|2@0+ (1,0) [0|3] "" ASDM,PAS
 SG_ FrntRdrDetn141_UB : 234|1@0+ (1,0) [0|1] "" ASDM,PAS
 SG_ FrntRdrDetn141RdrDetnAzi : 199|11@0+ (0.1,-90.0) [-90.0|90.0] "Deg" ASDM,PAS
 SG_ FrntRdrDetn141RdrDetnChks : 167|8@0+ (1.0,0.0) [0.0|255.0] "Unitless" ASDM,PAS
 SG_ FrntRdrDetn141RdrDetnCntr : 175|4@0+ (1.0,0.0) [0.0|15.0] "Unitless" ASDM,PAS
 SG_ FrntRdrDetn141RdrDetnConf : 191|7@0+ (1.0,0.0) [0.0|100.0] "%" ASDM,PAS
 SG_ FrntRdrDetn141RdrDetnElevn : 239|5@0+ (1.0,-15.0) [-15.0|15.0] "Deg" ASDM,PAS
 SG_ FrntRdrDetn141RdrDetnPwr : 169|9@0+ (0.1,0.0) [0.0|51.1] "dB" ASDM,PAS
 SG_ FrntRdrDetn141RdrDetnRng : 223|14@0+ (0.02,-1.0) [-1.0|200.0] "m" ASDM,PAS
 SG_ FrntRdrDetn141RdrDetnRngV : 204|13@0+ (0.02,-80.0) [-80.0|80.0] "m/s" ASDM,PAS
 SG_ FrntRdrDetn141RdrDetnSts : 171|2@0+ (1,0) [0|3] "" ASDM,PAS
 SG_ FrntRdrDetn142_UB : 314|1@0+ (1,0) [0|1] "" ASDM,PAS
 SG_ FrntRdrDetn142RdrDetnAzi : 287|11@0+ (0.1,-90.0) [-90.0|90.0] "Deg" ASDM,PAS
 SG_ FrntRdrDetn142RdrDetnChks : 247|8@0+ (1.0,0.0) [0.0|255.0] "Unitless" ASDM,PAS
 SG_ FrntRdrDetn142RdrDetnCntr : 255|4@0+ (1.0,0.0) [0.0|15.0] "Unitless" ASDM,PAS
 SG_ FrntRdrDetn142RdrDetnConf : 311|7@0+ (1.0,0.0) [0.0|100.0] "%" ASDM,PAS
 SG_ FrntRdrDetn142RdrDetnElevn : 319|5@0+ (1.0,-15.0) [-15.0|15.0] "Deg" ASDM,PAS
 SG_ FrntRdrDetn142RdrDetnPwr : 249|9@0+ (0.1,0.0) [0.0|51.1] "dB" ASDM,PAS
 SG_ FrntRdrDetn142RdrDetnRng : 271|14@0+ (0.02,-1.0) [-1.0|200.0] "m" ASDM,PAS
 SG_ FrntRdrDetn142RdrDetnRngV : 292|13@0+ (0.02,-80.0) [-80.0|80.0] "m/s" ASDM,PAS
 SG_ FrntRdrDetn142RdrDetnSts : 251|2@0+ (1,0) [0|3] "" ASDM,PAS
 SG_ FrntRdrDetn143_UB : 394|1@0+ (1,0) [0|1] "" ASDM,PAS
 SG_ FrntRdrDetn143RdrDetnAzi : 351|11@0+ (0.1,-90.0) [-90.0|90.0] "Deg" ASDM,PAS
 SG_ FrntRdrDetn143RdrDetnChks : 327|8@0+ (1.0,0.0) [0.0|255.0] "Unitless" ASDM,PAS
 SG_ FrntRdrDetn143RdrDetnCntr : 335|4@0+ (1.0,0.0) [0.0|15.0] "Unitless" ASDM,PAS
 SG_ FrntRdrDetn143RdrDetnConf : 391|7@0+ (1.0,0.0) [0.0|100.0] "%" ASDM,PAS
 SG_ FrntRdrDetn143RdrDetnElevn : 399|5@0+ (1.0,-15.0) [-15.0|15.0] "Deg" ASDM,PAS
 SG_ FrntRdrDetn143RdrDetnPwr : 329|9@0+ (0.1,0.0) [0.0|51.1] "dB" ASDM,PAS
 SG_ FrntRdrDetn143RdrDetnRng : 375|14@0+ (0.02,-1.0) [-1.0|200.0] "m" ASDM,PAS
 SG_ FrntRdrDetn143RdrDetnRngV : 356|13@0+ (0.02,-80.0) [-80.0|80.0] "m/s" ASDM,PAS
 SG_ FrntRdrDetn143RdrDetnSts : 331|2@0+ (1,0) [0|3] "" ASDM,PAS
 SG_ FrntRdrDetn144_UB : 474|1@0+ (1,0) [0|1] "" ASDM,PAS
 SG_ FrntRdrDetn144RdrDetnAzi : 447|11@0+ (0.1,-90.0) [-90.0|90.0] "Deg" ASDM,PAS
 SG_ FrntRdrDetn144RdrDetnChks : 407|8@0+ (1.0,0.0) [0.0|255.0] "Unitless" ASDM,PAS
 SG_ FrntRdrDetn144RdrDetnCntr : 415|4@0+ (1.0,0.0) [0.0|15.0] "Unitless" ASDM,PAS
 SG_ FrntRdrDetn144RdrDetnConf : 471|7@0+ (1.0,0.0) [0.0|100.0] "%" ASDM,PAS
 SG_ FrntRdrDetn144RdrDetnElevn : 479|5@0+ (1.0,-15.0) [-15.0|15.0] "Deg" ASDM,PAS
 SG_ FrntRdrDetn144RdrDetnPwr : 409|9@0+ (0.1,0.0) [0.0|51.1] "dB" ASDM,PAS
 SG_ FrntRdrDetn144RdrDetnRng : 431|14@0+ (0.02,-1.0) [-1.0|200.0] "m" ASDM,PAS
 SG_ FrntRdrDetn144RdrDetnRngV : 452|13@0+ (0.02,-80.0) [-80.0|80.0] "m/s" ASDM,PAS
 SG_ FrntRdrDetn144RdrDetnSts : 411|2@0+ (1,0) [0|3] "" ASDM,PAS

BO_ 352 FLRSafetyCANFD2Frame25: 64 FLR
 SG_ FrntRdrDetn145_UB : 74|1@0+ (1,0) [0|1] "" ASDM,PAS
 SG_ FrntRdrDetn145RdrDetnAzi : 31|11@0+ (0.1,-90.0) [-90.0|90.0] "Deg" ASDM,PAS
 SG_ FrntRdrDetn145RdrDetnChks : 7|8@0+ (1.0,0.0) [0.0|255.0] "Unitless" ASDM,PAS
 SG_ FrntRdrDetn145RdrDetnCntr : 15|4@0+ (1.0,0.0) [0.0|15.0] "Unitless" ASDM,PAS
 SG_ FrntRdrDetn145RdrDetnConf : 71|7@0+ (1.0,0.0) [0.0|100.0] "%" ASDM,PAS
 SG_ FrntRdrDetn145RdrDetnElevn : 79|5@0+ (1.0,-15.0) [-15.0|15.0] "Deg" ASDM,PAS
 SG_ FrntRdrDetn145RdrDetnPwr : 8|9@0+ (0.1,0.0) [0.0|51.1] "dB" ASDM,PAS
 SG_ FrntRdrDetn145RdrDetnRng : 55|14@0+ (0.02,-1.0) [-1.0|200.0] "m" ASDM,PAS
 SG_ FrntRdrDetn145RdrDetnRngV : 36|13@0+ (0.02,-80.0) [-80.0|80.0] "m/s" ASDM,PAS
 SG_ FrntRdrDetn145RdrDetnSts : 11|2@0+ (1,0) [0|3] "" ASDM,PAS
 SG_ FrntRdrDetn146_UB : 154|1@0+ (1,0) [0|1] "" ASDM,PAS
 SG_ FrntRdrDetn146RdrDetnAzi : 119|11@0+ (0.1,-90.0) [-90.0|90.0] "Deg" ASDM,PAS
 SG_ FrntRdrDetn146RdrDetnChks : 87|8@0+ (1.0,0.0) [0.0|255.0] "Unitless" ASDM,PAS
 SG_ FrntRdrDetn146RdrDetnCntr : 95|4@0+ (1.0,0.0) [0.0|15.0] "Unitless" ASDM,PAS
 SG_ FrntRdrDetn146RdrDetnConf : 111|7@0+ (1.0,0.0) [0.0|100.0] "%" ASDM,PAS
 SG_ FrntRdrDetn146RdrDetnElevn : 159|5@0+ (1.0,-15.0) [-15.0|15.0] "Deg" ASDM,PAS
 SG_ FrntRdrDetn146RdrDetnPwr : 89|9@0+ (0.1,0.0) [0.0|51.1] "dB" ASDM,PAS
 SG_ FrntRdrDetn146RdrDetnRng : 143|14@0+ (0.02,-1.0) [-1.0|200.0] "m" ASDM,PAS
 SG_ FrntRdrDetn146RdrDetnRngV : 124|13@0+ (0.02,-80.0) [-80.0|80.0] "m/s" ASDM,PAS
 SG_ FrntRdrDetn146RdrDetnSts : 91|2@0+ (1,0) [0|3] "" ASDM,PAS
 SG_ FrntRdrDetn147_UB : 234|1@0+ (1,0) [0|1] "" ASDM,PAS
 SG_ FrntRdrDetn147RdrDetnAzi : 199|11@0+ (0.1,-90.0) [-90.0|90.0] "Deg" ASDM,PAS
 SG_ FrntRdrDetn147RdrDetnChks : 167|8@0+ (1.0,0.0) [0.0|255.0] "Unitless" ASDM,PAS
 SG_ FrntRdrDetn147RdrDetnCntr : 175|4@0+ (1.0,0.0) [0.0|15.0] "Unitless" ASDM,PAS
 SG_ FrntRdrDetn147RdrDetnConf : 191|7@0+ (1.0,0.0) [0.0|100.0] "%" ASDM,PAS
 SG_ FrntRdrDetn147RdrDetnElevn : 239|5@0+ (1.0,-15.0) [-15.0|15.0] "Deg" ASDM,PAS
 SG_ FrntRdrDetn147RdrDetnPwr : 169|9@0+ (0.1,0.0) [0.0|51.1] "dB" ASDM,PAS
 SG_ FrntRdrDetn147RdrDetnRng : 223|14@0+ (0.02,-1.0) [-1.0|200.0] "m" ASDM,PAS
 SG_ FrntRdrDetn147RdrDetnRngV : 204|13@0+ (0.02,-80.0) [-80.0|80.0] "m/s" ASDM,PAS
 SG_ FrntRdrDetn147RdrDetnSts : 171|2@0+ (1,0) [0|3] "" ASDM,PAS
 SG_ FrntRdrDetn148_UB : 314|1@0+ (1,0) [0|1] "" ASDM,PAS
 SG_ FrntRdrDetn148RdrDetnAzi : 287|11@0+ (0.1,-90.0) [-90.0|90.0] "Deg" ASDM,PAS
 SG_ FrntRdrDetn148RdrDetnChks : 247|8@0+ (1.0,0.0) [0.0|255.0] "Unitless" ASDM,PAS
 SG_ FrntRdrDetn148RdrDetnCntr : 255|4@0+ (1.0,0.0) [0.0|15.0] "Unitless" ASDM,PAS
 SG_ FrntRdrDetn148RdrDetnConf : 311|7@0+ (1.0,0.0) [0.0|100.0] "%" ASDM,PAS
 SG_ FrntRdrDetn148RdrDetnElevn : 319|5@0+ (1.0,-15.0) [-15.0|15.0] "Deg" ASDM,PAS
 SG_ FrntRdrDetn148RdrDetnPwr : 249|9@0+ (0.1,0.0) [0.0|51.1] "dB" ASDM,PAS
 SG_ FrntRdrDetn148RdrDetnRng : 271|14@0+ (0.02,-1.0) [-1.0|200.0] "m" ASDM,PAS
 SG_ FrntRdrDetn148RdrDetnRngV : 292|13@0+ (0.02,-80.0) [-80.0|80.0] "m/s" ASDM,PAS
 SG_ FrntRdrDetn148RdrDetnSts : 251|2@0+ (1,0) [0|3] "" ASDM,PAS
 SG_ FrntRdrDetn149_UB : 394|1@0+ (1,0) [0|1] "" ASDM,PAS
 SG_ FrntRdrDetn149RdrDetnAzi : 351|11@0+ (0.1,-90.0) [-90.0|90.0] "Deg" ASDM,PAS
 SG_ FrntRdrDetn149RdrDetnChks : 327|8@0+ (1.0,0.0) [0.0|255.0] "Unitless" ASDM,PAS
 SG_ FrntRdrDetn149RdrDetnCntr : 335|4@0+ (1.0,0.0) [0.0|15.0] "Unitless" ASDM,PAS
 SG_ FrntRdrDetn149RdrDetnConf : 391|7@0+ (1.0,0.0) [0.0|100.0] "%" ASDM,PAS
 SG_ FrntRdrDetn149RdrDetnElevn : 399|5@0+ (1.0,-15.0) [-15.0|15.0] "Deg" ASDM,PAS
 SG_ FrntRdrDetn149RdrDetnPwr : 329|9@0+ (0.1,0.0) [0.0|51.1] "dB" ASDM,PAS
 SG_ FrntRdrDetn149RdrDetnRng : 375|14@0+ (0.02,-1.0) [-1.0|200.0] "m" ASDM,PAS
 SG_ FrntRdrDetn149RdrDetnRngV : 356|13@0+ (0.02,-80.0) [-80.0|80.0] "m/s" ASDM,PAS
 SG_ FrntRdrDetn149RdrDetnSts : 331|2@0+ (1,0) [0|3] "" ASDM,PAS
 SG_ FrntRdrDetn150_UB : 474|1@0+ (1,0) [0|1] "" ASDM,PAS
 SG_ FrntRdrDetn150RdrDetnAzi : 447|11@0+ (0.1,-90.0) [-90.0|90.0] "Deg" ASDM,PAS
 SG_ FrntRdrDetn150RdrDetnChks : 407|8@0+ (1.0,0.0) [0.0|255.0] "Unitless" ASDM,PAS
 SG_ FrntRdrDetn150RdrDetnCntr : 415|4@0+ (1.0,0.0) [0.0|15.0] "Unitless" ASDM,PAS
 SG_ FrntRdrDetn150RdrDetnConf : 471|7@0+ (1.0,0.0) [0.0|100.0] "%" ASDM,PAS
 SG_ FrntRdrDetn150RdrDetnElevn : 479|5@0+ (1.0,-15.0) [-15.0|15.0] "Deg" ASDM,PAS
 SG_ FrntRdrDetn150RdrDetnPwr : 409|9@0+ (0.1,0.0) [0.0|51.1] "dB" ASDM,PAS
 SG_ FrntRdrDetn150RdrDetnRng : 431|14@0+ (0.02,-1.0) [-1.0|200.0] "m" ASDM,PAS
 SG_ FrntRdrDetn150RdrDetnRngV : 452|13@0+ (0.02,-80.0) [-80.0|80.0] "m/s" ASDM,PAS
 SG_ FrntRdrDetn150RdrDetnSts : 411|2@0+ (1,0) [0|3] "" ASDM,PAS

BO_ 354 FLRSafetyCANFD2Frame26: 64 FLR
 SG_ FrntRdrDetn151_UB : 74|1@0+ (1,0) [0|1] "" ASDM,PAS
 SG_ FrntRdrDetn151RdrDetnAzi : 31|11@0+ (0.1,-90.0) [-90.0|90.0] "Deg" ASDM,PAS
 SG_ FrntRdrDetn151RdrDetnChks : 7|8@0+ (1.0,0.0) [0.0|255.0] "Unitless" ASDM,PAS
 SG_ FrntRdrDetn151RdrDetnCntr : 15|4@0+ (1.0,0.0) [0.0|15.0] "Unitless" ASDM,PAS
 SG_ FrntRdrDetn151RdrDetnConf : 71|7@0+ (1.0,0.0) [0.0|100.0] "%" ASDM,PAS
 SG_ FrntRdrDetn151RdrDetnElevn : 79|5@0+ (1.0,-15.0) [-15.0|15.0] "Deg" ASDM,PAS
 SG_ FrntRdrDetn151RdrDetnPwr : 8|9@0+ (0.1,0.0) [0.0|51.1] "dB" ASDM,PAS
 SG_ FrntRdrDetn151RdrDetnRng : 55|14@0+ (0.02,-1.0) [-1.0|200.0] "m" ASDM,PAS
 SG_ FrntRdrDetn151RdrDetnRngV : 36|13@0+ (0.02,-80.0) [-80.0|80.0] "m/s" ASDM,PAS
 SG_ FrntRdrDetn151RdrDetnSts : 11|2@0+ (1,0) [0|3] "" ASDM,PAS
 SG_ FrntRdrDetn152_UB : 154|1@0+ (1,0) [0|1] "" ASDM,PAS
 SG_ FrntRdrDetn152RdrDetnAzi : 119|11@0+ (0.1,-90.0) [-90.0|90.0] "Deg" ASDM,PAS
 SG_ FrntRdrDetn152RdrDetnChks : 87|8@0+ (1.0,0.0) [0.0|255.0] "Unitless" ASDM,PAS
 SG_ FrntRdrDetn152RdrDetnCntr : 95|4@0+ (1.0,0.0) [0.0|15.0] "Unitless" ASDM,PAS
 SG_ FrntRdrDetn152RdrDetnConf : 111|7@0+ (1.0,0.0) [0.0|100.0] "%" ASDM,PAS
 SG_ FrntRdrDetn152RdrDetnElevn : 159|5@0+ (1.0,-15.0) [-15.0|15.0] "Deg" ASDM,PAS
 SG_ FrntRdrDetn152RdrDetnPwr : 89|9@0+ (0.1,0.0) [0.0|51.1] "dB" ASDM,PAS
 SG_ FrntRdrDetn152RdrDetnRng : 143|14@0+ (0.02,-1.0) [-1.0|200.0] "m" ASDM,PAS
 SG_ FrntRdrDetn152RdrDetnRngV : 124|13@0+ (0.02,-80.0) [-80.0|80.0] "m/s" ASDM,PAS
 SG_ FrntRdrDetn152RdrDetnSts : 91|2@0+ (1,0) [0|3] "" ASDM,PAS
 SG_ FrntRdrDetn153_UB : 234|1@0+ (1,0) [0|1] "" ASDM,PAS
 SG_ FrntRdrDetn153RdrDetnAzi : 199|11@0+ (0.1,-90.0) [-90.0|90.0] "Deg" ASDM,PAS
 SG_ FrntRdrDetn153RdrDetnChks : 167|8@0+ (1.0,0.0) [0.0|255.0] "Unitless" ASDM,PAS
 SG_ FrntRdrDetn153RdrDetnCntr : 175|4@0+ (1.0,0.0) [0.0|15.0] "Unitless" ASDM,PAS
 SG_ FrntRdrDetn153RdrDetnConf : 191|7@0+ (1.0,0.0) [0.0|100.0] "%" ASDM,PAS
 SG_ FrntRdrDetn153RdrDetnElevn : 239|5@0+ (1.0,-15.0) [-15.0|15.0] "Deg" ASDM,PAS
 SG_ FrntRdrDetn153RdrDetnPwr : 169|9@0+ (0.1,0.0) [0.0|51.1] "dB" ASDM,PAS
 SG_ FrntRdrDetn153RdrDetnRng : 223|14@0+ (0.02,-1.0) [-1.0|200.0] "m" ASDM,PAS
 SG_ FrntRdrDetn153RdrDetnRngV : 204|13@0+ (0.02,-80.0) [-80.0|80.0] "m/s" ASDM,PAS
 SG_ FrntRdrDetn153RdrDetnSts : 171|2@0+ (1,0) [0|3] "" ASDM,PAS
 SG_ FrntRdrDetn154_UB : 314|1@0+ (1,0) [0|1] "" ASDM,PAS
 SG_ FrntRdrDetn154RdrDetnAzi : 287|11@0+ (0.1,-90.0) [-90.0|90.0] "Deg" ASDM,PAS
 SG_ FrntRdrDetn154RdrDetnChks : 247|8@0+ (1.0,0.0) [0.0|255.0] "Unitless" ASDM,PAS
 SG_ FrntRdrDetn154RdrDetnCntr : 255|4@0+ (1.0,0.0) [0.0|15.0] "Unitless" ASDM,PAS
 SG_ FrntRdrDetn154RdrDetnConf : 311|7@0+ (1.0,0.0) [0.0|100.0] "%" ASDM,PAS
 SG_ FrntRdrDetn154RdrDetnElevn : 319|5@0+ (1.0,-15.0) [-15.0|15.0] "Deg" ASDM,PAS
 SG_ FrntRdrDetn154RdrDetnPwr : 249|9@0+ (0.1,0.0) [0.0|51.1] "dB" ASDM,PAS
 SG_ FrntRdrDetn154RdrDetnRng : 271|14@0+ (0.02,-1.0) [-1.0|200.0] "m" ASDM,PAS
 SG_ FrntRdrDetn154RdrDetnRngV : 292|13@0+ (0.02,-80.0) [-80.0|80.0] "m/s" ASDM,PAS
 SG_ FrntRdrDetn154RdrDetnSts : 251|2@0+ (1,0) [0|3] "" ASDM,PAS
 SG_ FrntRdrDetn155_UB : 394|1@0+ (1,0) [0|1] "" ASDM,PAS
 SG_ FrntRdrDetn155RdrDetnAzi : 351|11@0+ (0.1,-90.0) [-90.0|90.0] "Deg" ASDM,PAS
 SG_ FrntRdrDetn155RdrDetnChks : 327|8@0+ (1.0,0.0) [0.0|255.0] "Unitless" ASDM,PAS
 SG_ FrntRdrDetn155RdrDetnCntr : 335|4@0+ (1.0,0.0) [0.0|15.0] "Unitless" ASDM,PAS
 SG_ FrntRdrDetn155RdrDetnConf : 391|7@0+ (1.0,0.0) [0.0|100.0] "%" ASDM,PAS
 SG_ FrntRdrDetn155RdrDetnElevn : 399|5@0+ (1.0,-15.0) [-15.0|15.0] "Deg" ASDM,PAS
 SG_ FrntRdrDetn155RdrDetnPwr : 329|9@0+ (0.1,0.0) [0.0|51.1] "dB" ASDM,PAS
 SG_ FrntRdrDetn155RdrDetnRng : 375|14@0+ (0.02,-1.0) [-1.0|200.0] "m" ASDM,PAS
 SG_ FrntRdrDetn155RdrDetnRngV : 356|13@0+ (0.02,-80.0) [-80.0|80.0] "m/s" ASDM,PAS
 SG_ FrntRdrDetn155RdrDetnSts : 331|2@0+ (1,0) [0|3] "" ASDM,PAS
 SG_ FrntRdrDetn156_UB : 474|1@0+ (1,0) [0|1] "" ASDM,PAS
 SG_ FrntRdrDetn156RdrDetnAzi : 447|11@0+ (0.1,-90.0) [-90.0|90.0] "Deg" ASDM,PAS
 SG_ FrntRdrDetn156RdrDetnChks : 407|8@0+ (1.0,0.0) [0.0|255.0] "Unitless" ASDM,PAS
 SG_ FrntRdrDetn156RdrDetnCntr : 415|4@0+ (1.0,0.0) [0.0|15.0] "Unitless" ASDM,PAS
 SG_ FrntRdrDetn156RdrDetnConf : 471|7@0+ (1.0,0.0) [0.0|100.0] "%" ASDM,PAS
 SG_ FrntRdrDetn156RdrDetnElevn : 479|5@0+ (1.0,-15.0) [-15.0|15.0] "Deg" ASDM,PAS
 SG_ FrntRdrDetn156RdrDetnPwr : 409|9@0+ (0.1,0.0) [0.0|51.1] "dB" ASDM,PAS
 SG_ FrntRdrDetn156RdrDetnRng : 431|14@0+ (0.02,-1.0) [-1.0|200.0] "m" ASDM,PAS
 SG_ FrntRdrDetn156RdrDetnRngV : 452|13@0+ (0.02,-80.0) [-80.0|80.0] "m/s" ASDM,PAS
 SG_ FrntRdrDetn156RdrDetnSts : 411|2@0+ (1,0) [0|3] "" ASDM,PAS

BO_ 356 FLRSafetyCANFD2Frame27: 64 FLR
 SG_ FrntRdrDetn157_UB : 74|1@0+ (1,0) [0|1] "" ASDM,PAS
 SG_ FrntRdrDetn157RdrDetnAzi : 31|11@0+ (0.1,-90.0) [-90.0|90.0] "Deg" ASDM,PAS
 SG_ FrntRdrDetn157RdrDetnChks : 7|8@0+ (1.0,0.0) [0.0|255.0] "Unitless" ASDM,PAS
 SG_ FrntRdrDetn157RdrDetnCntr : 15|4@0+ (1.0,0.0) [0.0|15.0] "Unitless" ASDM,PAS
 SG_ FrntRdrDetn157RdrDetnConf : 71|7@0+ (1.0,0.0) [0.0|100.0] "%" ASDM,PAS
 SG_ FrntRdrDetn157RdrDetnElevn : 79|5@0+ (1.0,-15.0) [-15.0|15.0] "Deg" ASDM,PAS
 SG_ FrntRdrDetn157RdrDetnPwr : 8|9@0+ (0.1,0.0) [0.0|51.1] "dB" ASDM,PAS
 SG_ FrntRdrDetn157RdrDetnRng : 55|14@0+ (0.02,-1.0) [-1.0|200.0] "m" ASDM,PAS
 SG_ FrntRdrDetn157RdrDetnRngV : 36|13@0+ (0.02,-80.0) [-80.0|80.0] "m/s" ASDM,PAS
 SG_ FrntRdrDetn157RdrDetnSts : 11|2@0+ (1,0) [0|3] "" ASDM,PAS
 SG_ FrntRdrDetn158_UB : 154|1@0+ (1,0) [0|1] "" ASDM,PAS
 SG_ FrntRdrDetn158RdrDetnAzi : 119|11@0+ (0.1,-90.0) [-90.0|90.0] "Deg" ASDM,PAS
 SG_ FrntRdrDetn158RdrDetnChks : 87|8@0+ (1.0,0.0) [0.0|255.0] "Unitless" ASDM,PAS
 SG_ FrntRdrDetn158RdrDetnCntr : 95|4@0+ (1.0,0.0) [0.0|15.0] "Unitless" ASDM,PAS
 SG_ FrntRdrDetn158RdrDetnConf : 111|7@0+ (1.0,0.0) [0.0|100.0] "%" ASDM,PAS
 SG_ FrntRdrDetn158RdrDetnElevn : 159|5@0+ (1.0,-15.0) [-15.0|15.0] "Deg" ASDM,PAS
 SG_ FrntRdrDetn158RdrDetnPwr : 89|9@0+ (0.1,0.0) [0.0|51.1] "dB" ASDM,PAS
 SG_ FrntRdrDetn158RdrDetnRng : 143|14@0+ (0.02,-1.0) [-1.0|200.0] "m" ASDM,PAS
 SG_ FrntRdrDetn158RdrDetnRngV : 124|13@0+ (0.02,-80.0) [-80.0|80.0] "m/s" ASDM,PAS
 SG_ FrntRdrDetn158RdrDetnSts : 91|2@0+ (1,0) [0|3] "" ASDM,PAS
 SG_ FrntRdrDetn159_UB : 234|1@0+ (1,0) [0|1] "" ASDM,PAS
 SG_ FrntRdrDetn159RdrDetnAzi : 199|11@0+ (0.1,-90.0) [-90.0|90.0] "Deg" ASDM,PAS
 SG_ FrntRdrDetn159RdrDetnChks : 167|8@0+ (1.0,0.0) [0.0|255.0] "Unitless" ASDM,PAS
 SG_ FrntRdrDetn159RdrDetnCntr : 175|4@0+ (1.0,0.0) [0.0|15.0] "Unitless" ASDM,PAS
 SG_ FrntRdrDetn159RdrDetnConf : 191|7@0+ (1.0,0.0) [0.0|100.0] "%" ASDM,PAS
 SG_ FrntRdrDetn159RdrDetnElevn : 239|5@0+ (1.0,-15.0) [-15.0|15.0] "Deg" ASDM,PAS
 SG_ FrntRdrDetn159RdrDetnPwr : 169|9@0+ (0.1,0.0) [0.0|51.1] "dB" ASDM,PAS
 SG_ FrntRdrDetn159RdrDetnRng : 223|14@0+ (0.02,-1.0) [-1.0|200.0] "m" ASDM,PAS
 SG_ FrntRdrDetn159RdrDetnRngV : 204|13@0+ (0.02,-80.0) [-80.0|80.0] "m/s" ASDM,PAS
 SG_ FrntRdrDetn159RdrDetnSts : 171|2@0+ (1,0) [0|3] "" ASDM,PAS
 SG_ FrntRdrDetn160_UB : 314|1@0+ (1,0) [0|1] "" ASDM,PAS
 SG_ FrntRdrDetn160RdrDetnAzi : 287|11@0+ (0.1,-90.0) [-90.0|90.0] "Deg" ASDM,PAS
 SG_ FrntRdrDetn160RdrDetnChks : 247|8@0+ (1.0,0.0) [0.0|255.0] "Unitless" ASDM,PAS
 SG_ FrntRdrDetn160RdrDetnCntr : 255|4@0+ (1.0,0.0) [0.0|15.0] "Unitless" ASDM,PAS
 SG_ FrntRdrDetn160RdrDetnConf : 311|7@0+ (1.0,0.0) [0.0|100.0] "%" ASDM,PAS
 SG_ FrntRdrDetn160RdrDetnElevn : 319|5@0+ (1.0,-15.0) [-15.0|15.0] "Deg" ASDM,PAS
 SG_ FrntRdrDetn160RdrDetnPwr : 249|9@0+ (0.1,0.0) [0.0|51.1] "dB" ASDM,PAS
 SG_ FrntRdrDetn160RdrDetnRng : 271|14@0+ (0.02,-1.0) [-1.0|200.0] "m" ASDM,PAS
 SG_ FrntRdrDetn160RdrDetnRngV : 292|13@0+ (0.02,-80.0) [-80.0|80.0] "m/s" ASDM,PAS
 SG_ FrntRdrDetn160RdrDetnSts : 251|2@0+ (1,0) [0|3] "" ASDM,PAS
 SG_ FrntRdrDetn161_UB : 394|1@0+ (1,0) [0|1] "" ASDM,PAS
 SG_ FrntRdrDetn161RdrDetnAzi : 351|11@0+ (0.1,-90.0) [-90.0|90.0] "Deg" ASDM,PAS
 SG_ FrntRdrDetn161RdrDetnChks : 327|8@0+ (1.0,0.0) [0.0|255.0] "Unitless" ASDM,PAS
 SG_ FrntRdrDetn161RdrDetnCntr : 335|4@0+ (1.0,0.0) [0.0|15.0] "Unitless" ASDM,PAS
 SG_ FrntRdrDetn161RdrDetnConf : 391|7@0+ (1.0,0.0) [0.0|100.0] "%" ASDM,PAS
 SG_ FrntRdrDetn161RdrDetnElevn : 399|5@0+ (1.0,-15.0) [-15.0|15.0] "Deg" ASDM,PAS
 SG_ FrntRdrDetn161RdrDetnPwr : 329|9@0+ (0.1,0.0) [0.0|51.1] "dB" ASDM,PAS
 SG_ FrntRdrDetn161RdrDetnRng : 375|14@0+ (0.02,-1.0) [-1.0|200.0] "m" ASDM,PAS
 SG_ FrntRdrDetn161RdrDetnRngV : 356|13@0+ (0.02,-80.0) [-80.0|80.0] "m/s" ASDM,PAS
 SG_ FrntRdrDetn161RdrDetnSts : 331|2@0+ (1,0) [0|3] "" ASDM,PAS
 SG_ FrntRdrDetn162_UB : 474|1@0+ (1,0) [0|1] "" ASDM,PAS
 SG_ FrntRdrDetn162RdrDetnAzi : 447|11@0+ (0.1,-90.0) [-90.0|90.0] "Deg" ASDM,PAS
 SG_ FrntRdrDetn162RdrDetnChks : 407|8@0+ (1.0,0.0) [0.0|255.0] "Unitless" ASDM,PAS
 SG_ FrntRdrDetn162RdrDetnCntr : 415|4@0+ (1.0,0.0) [0.0|15.0] "Unitless" ASDM,PAS
 SG_ FrntRdrDetn162RdrDetnConf : 471|7@0+ (1.0,0.0) [0.0|100.0] "%" ASDM,PAS
 SG_ FrntRdrDetn162RdrDetnElevn : 479|5@0+ (1.0,-15.0) [-15.0|15.0] "Deg" ASDM,PAS
 SG_ FrntRdrDetn162RdrDetnPwr : 409|9@0+ (0.1,0.0) [0.0|51.1] "dB" ASDM,PAS
 SG_ FrntRdrDetn162RdrDetnRng : 431|14@0+ (0.02,-1.0) [-1.0|200.0] "m" ASDM,PAS
 SG_ FrntRdrDetn162RdrDetnRngV : 452|13@0+ (0.02,-80.0) [-80.0|80.0] "m/s" ASDM,PAS
 SG_ FrntRdrDetn162RdrDetnSts : 411|2@0+ (1,0) [0|3] "" ASDM,PAS

CM_ SG_ 342 FrntRdrDetn115RdrDetnAzi "Refer to the data element description in FrntRdrDetn1 with the same data element name.";
CM_ SG_ 342 FrntRdrDetn115RdrDetnChks "Refer to the data element description in FrntRdrDetn1 with the same data element name.";
CM_ SG_ 342 FrntRdrDetn115RdrDetnCntr "Refer to the data element description in FrntRdrDetn1 with the same data element name.";
CM_ SG_ 342 FrntRdrDetn115RdrDetnConf "Refer to the data element description in FrntRdrDetn1 with the same data element name.";
CM_ SG_ 342 FrntRdrDetn115RdrDetnElevn "Refer to the data element description in FrntRdrDetn1 with the same data element name.";
CM_ SG_ 342 FrntRdrDetn115RdrDetnPwr "Refer to the data element description in FrntRdrDetn1 with the same data element name.";
CM_ SG_ 342 FrntRdrDetn115RdrDetnRng "Refer to the data element description in FrntRdrDetn1 with the same data element name.";
CM_ SG_ 342 FrntRdrDetn115RdrDetnRngV "Refer to the data element description in FrntRdrDetn1 with the same data element name.";
CM_ SG_ 342 FrntRdrDetn115RdrDetnSts "Refer to the data element description in FrntRdrDetn1 with the same data element name.";
CM_ SG_ 342 FrntRdrDetn116RdrDetnAzi "Refer to the data element description in FrntRdrDetn1 with the same data element name.";
CM_ SG_ 342 FrntRdrDetn116RdrDetnChks "Refer to the data element description in FrntRdrDetn1 with the same data element name.";
CM_ SG_ 342 FrntRdrDetn116RdrDetnCntr "Refer to the data element description in FrntRdrDetn1 with the same data element name.";
CM_ SG_ 342 FrntRdrDetn116RdrDetnConf "Refer to the data element description in FrntRdrDetn1 with the same data element name.";
CM_ SG_ 342 FrntRdrDetn116RdrDetnElevn "Refer to the data element description in FrntRdrDetn1 with the same data element name.";
CM_ SG_ 342 FrntRdrDetn116RdrDetnPwr "Refer to the data element description in FrntRdrDetn1 with the same data element name.";
CM_ SG_ 342 FrntRdrDetn116RdrDetnRng "Refer to the data element description in FrntRdrDetn1 with the same data element name.";
CM_ SG_ 342 FrntRdrDetn116RdrDetnRngV "Refer to the data element description in FrntRdrDetn1 with the same data element name.";
CM_ SG_ 342 FrntRdrDetn116RdrDetnSts "Refer to the data element description in FrntRdrDetn1 with the same data element name.";
CM_ SG_ 342 FrntRdrDetn117RdrDetnAzi "Refer to the data element description in FrntRdrDetn1 with the same data element name.";
CM_ SG_ 342 FrntRdrDetn117RdrDetnChks "Refer to the data element description in FrntRdrDetn1 with the same data element name.";
CM_ SG_ 342 FrntRdrDetn117RdrDetnCntr "Refer to the data element description in FrntRdrDetn1 with the same data element name.";
CM_ SG_ 342 FrntRdrDetn117RdrDetnConf "Refer to the data element description in FrntRdrDetn1 with the same data element name.";
CM_ SG_ 342 FrntRdrDetn117RdrDetnElevn "Refer to the data element description in FrntRdrDetn1 with the same data element name.";
CM_ SG_ 342 FrntRdrDetn117RdrDetnPwr "Refer to the data element description in FrntRdrDetn1 with the same data element name.";
CM_ SG_ 342 FrntRdrDetn117RdrDetnRng "Refer to the data element description in FrntRdrDetn1 with the same data element name.";
CM_ SG_ 342 FrntRdrDetn117RdrDetnRngV "Refer to the data element description in FrntRdrDetn1 with the same data element name.";
CM_ SG_ 342 FrntRdrDetn117RdrDetnSts "Refer to the data element description in FrntRdrDetn1 with the same data element name.";
CM_ SG_ 342 FrntRdrDetn118RdrDetnAzi "Refer to the data element description in FrntRdrDetn1 with the same data element name.";
CM_ SG_ 342 FrntRdrDetn118RdrDetnChks "Refer to the data element description in FrntRdrDetn1 with the same data element name.";
CM_ SG_ 342 FrntRdrDetn118RdrDetnCntr "Refer to the data element description in FrntRdrDetn1 with the same data element name.";
CM_ SG_ 342 FrntRdrDetn118RdrDetnConf "Refer to the data element description in FrntRdrDetn1 with the same data element name.";
CM_ SG_ 342 FrntRdrDetn118RdrDetnElevn "Refer to the data element description in FrntRdrDetn1 with the same data element name.";
CM_ SG_ 342 FrntRdrDetn118RdrDetnPwr "Refer to the data element description in FrntRdrDetn1 with the same data element name.";
CM_ SG_ 342 FrntRdrDetn118RdrDetnRng "Refer to the data element description in FrntRdrDetn1 with the same data element name.";
CM_ SG_ 342 FrntRdrDetn118RdrDetnRngV "Refer to the data element description in FrntRdrDetn1 with the same data element name.";
CM_ SG_ 342 FrntRdrDetn118RdrDetnSts "Refer to the data element description in FrntRdrDetn1 with the same data element name.";
CM_ SG_ 342 FrntRdrDetn119RdrDetnAzi "Refer to the data element description in FrntRdrDetn1 with the same data element name.";
CM_ SG_ 342 FrntRdrDetn119RdrDetnChks "Refer to the data element description in FrntRdrDetn1 with the same data element name.";
CM_ SG_ 342 FrntRdrDetn119RdrDetnCntr "Refer to the data element description in FrntRdrDetn1 with the same data element name.";
CM_ SG_ 342 FrntRdrDetn119RdrDetnConf "Refer to the data element description in FrntRdrDetn1 with the same data element name.";
CM_ SG_ 342 FrntRdrDetn119RdrDetnElevn "Refer to the data element description in FrntRdrDetn1 with the same data element name.";
CM_ SG_ 342 FrntRdrDetn119RdrDetnPwr "Refer to the data element description in FrntRdrDetn1 with the same data element name.";
CM_ SG_ 342 FrntRdrDetn119RdrDetnRng "Refer to the data element description in FrntRdrDetn1 with the same data element name.";
CM_ SG_ 342 FrntRdrDetn119RdrDetnRngV "Refer to the data element description in FrntRdrDetn1 with the same data element name.";
CM_ SG_ 342 FrntRdrDetn119RdrDetnSts "Refer to the data element description in FrntRdrDetn1 with the same data element name.";
CM_ SG_ 342 FrntRdrDetn120RdrDetnAzi "Refer to the data element description in FrntRdrDetn1 with the same data element name.";
CM_ SG_ 342 FrntRdrDetn120RdrDetnChks "Refer to the data element description in FrntRdrDetn1 with the same data element name.";
CM_ SG_ 342 FrntRdrDetn120RdrDetnCntr "Refer to the data element description in FrntRdrDetn1 with the same data element name.";
CM_ SG_ 342 FrntRdrDetn120RdrDetnConf "Refer to the data element description in FrntRdrDetn1 with the same data element name.";
CM_ SG_ 342 FrntRdrDetn120RdrDetnElevn "Refer to the data element description in FrntRdrDetn1 with the same data element name.";
CM_ SG_ 342 FrntRdrDetn120RdrDetnPwr "Refer to the data element description in FrntRdrDetn1 with the same data element name.";
CM_ SG_ 342 FrntRdrDetn120RdrDetnRng "Refer to the data element description in FrntRdrDetn1 with the same data element name.";
CM_ SG_ 342 FrntRdrDetn120RdrDetnRngV "Refer to the data element description in FrntRdrDetn1 with the same data element name.";
CM_ SG_ 342 FrntRdrDetn120RdrDetnSts "Refer to the data element description in FrntRdrDetn1 with the same data element name.";
CM_ SG_ 344 FrntRdrDetn121RdrDetnAzi "Refer to the data element description in FrntRdrDetn1 with the same data element name.";
CM_ SG_ 344 FrntRdrDetn121RdrDetnChks "Refer to the data element description in FrntRdrDetn1 with the same data element name.";
CM_ SG_ 344 FrntRdrDetn121RdrDetnCntr "Refer to the data element description in FrntRdrDetn1 with the same data element name.";
CM_ SG_ 344 FrntRdrDetn121RdrDetnConf "Refer to the data element description in FrntRdrDetn1 with the same data element name.";
CM_ SG_ 344 FrntRdrDetn121RdrDetnElevn "Refer to the data element description in FrntRdrDetn1 with the same data element name.";
CM_ SG_ 344 FrntRdrDetn121RdrDetnPwr "Refer to the data element description in FrntRdrDetn1 with the same data element name.";
CM_ SG_ 344 FrntRdrDetn121RdrDetnRng "Refer to the data element description in FrntRdrDetn1 with the same data element name.";
CM_ SG_ 344 FrntRdrDetn121RdrDetnRngV "Refer to the data element description in FrntRdrDetn1 with the same data element name.";
CM_ SG_ 344 FrntRdrDetn121RdrDetnSts "Refer to the data element description in FrntRdrDetn1 with the same data element name.";
CM_ SG_ 344 FrntRdrDetn122RdrDetnAzi "Refer to the data element description in FrntRdrDetn1 with the same data element name.";
CM_ SG_ 344 FrntRdrDetn122RdrDetnChks "Refer to the data element description in FrntRdrDetn1 with the same data element name.";
CM_ SG_ 344 FrntRdrDetn122RdrDetnCntr "Refer to the data element description in FrntRdrDetn1 with the same data element name.";
CM_ SG_ 344 FrntRdrDetn122RdrDetnConf "Refer to the data element description in FrntRdrDetn1 with the same data element name.";
CM_ SG_ 344 FrntRdrDetn122RdrDetnElevn "Refer to the data element description in FrntRdrDetn1 with the same data element name.";
CM_ SG_ 344 FrntRdrDetn122RdrDetnPwr "Refer to the data element description in FrntRdrDetn1 with the same data element name.";
CM_ SG_ 344 FrntRdrDetn122RdrDetnRng "Refer to the data element description in FrntRdrDetn1 with the same data element name.";
CM_ SG_ 344 FrntRdrDetn122RdrDetnRngV "Refer to the data element description in FrntRdrDetn1 with the same data element name.";
CM_ SG_ 344 FrntRdrDetn122RdrDetnSts "Refer to the data element description in FrntRdrDetn1 with the same data element name.";
CM_ SG_ 344 FrntRdrDetn123RdrDetnAzi "Refer to the data element description in FrntRdrDetn1 with the same data element name.";
CM_ SG_ 344 FrntRdrDetn123RdrDetnChks "Refer to the data element description in FrntRdrDetn1 with the same data element name.";
CM_ SG_ 344 FrntRdrDetn123RdrDetnCntr "Refer to the data element description in FrntRdrDetn1 with the same data element name.";
CM_ SG_ 344 FrntRdrDetn123RdrDetnConf "Refer to the data element description in FrntRdrDetn1 with the same data element name.";
CM_ SG_ 344 FrntRdrDetn123RdrDetnElevn "Refer to the data element description in FrntRdrDetn1 with the same data element name.";
CM_ SG_ 344 FrntRdrDetn123RdrDetnPwr "Refer to the data element description in FrntRdrDetn1 with the same data element name.";
CM_ SG_ 344 FrntRdrDetn123RdrDetnRng "Refer to the data element description in FrntRdrDetn1 with the same data element name.";
CM_ SG_ 344 FrntRdrDetn123RdrDetnRngV "Refer to the data element description in FrntRdrDetn1 with the same data element name.";
CM_ SG_ 344 FrntRdrDetn123RdrDetnSts "Refer to the data element description in FrntRdrDetn1 with the same data element name.";
CM_ SG_ 344 FrntRdrDetn124RdrDetnAzi "Refer to the data element description in FrntRdrDetn1 with the same data element name.";
CM_ SG_ 344 FrntRdrDetn124RdrDetnChks "Refer to the data element description in FrntRdrDetn1 with the same data element name.";
CM_ SG_ 344 FrntRdrDetn124RdrDetnCntr "Refer to the data element description in FrntRdrDetn1 with the same data element name.";
CM_ SG_ 344 FrntRdrDetn124RdrDetnConf "Refer to the data element description in FrntRdrDetn1 with the same data element name.";
CM_ SG_ 344 FrntRdrDetn124RdrDetnElevn "Refer to the data element description in FrntRdrDetn1 with the same data element name.";
CM_ SG_ 344 FrntRdrDetn124RdrDetnPwr "Refer to the data element description in FrntRdrDetn1 with the same data element name.";
CM_ SG_ 344 FrntRdrDetn124RdrDetnRng "Refer to the data element description in FrntRdrDetn1 with the same data element name.";
CM_ SG_ 344 FrntRdrDetn124RdrDetnRngV "Refer to the data element description in FrntRdrDetn1 with the same data element name.";
CM_ SG_ 344 FrntRdrDetn124RdrDetnSts "Refer to the data element description in FrntRdrDetn1 with the same data element name.";
CM_ SG_ 344 FrntRdrDetn125RdrDetnAzi "Refer to the data element description in FrntRdrDetn1 with the same data element name.";
CM_ SG_ 344 FrntRdrDetn125RdrDetnChks "Refer to the data element description in FrntRdrDetn1 with the same data element name.";
CM_ SG_ 344 FrntRdrDetn125RdrDetnCntr "Refer to the data element description in FrntRdrDetn1 with the same data element name.";
CM_ SG_ 344 FrntRdrDetn125RdrDetnConf "Refer to the data element description in FrntRdrDetn1 with the same data element name.";
CM_ SG_ 344 FrntRdrDetn125RdrDetnElevn "Refer to the data element description in FrntRdrDetn1 with the same data element name.";
CM_ SG_ 344 FrntRdrDetn125RdrDetnPwr "Refer to the data element description in FrntRdrDetn1 with the same data element name.";
CM_ SG_ 344 FrntRdrDetn125RdrDetnRng "Refer to the data element description in FrntRdrDetn1 with the same data element name.";
CM_ SG_ 344 FrntRdrDetn125RdrDetnRngV "Refer to the data element description in FrntRdrDetn1 with the same data element name.";
CM_ SG_ 344 FrntRdrDetn125RdrDetnSts "Refer to the data element description in FrntRdrDetn1 with the same data element name.";
CM_ SG_ 344 FrntRdrDetn126RdrDetnAzi "Refer to the data element description in FrntRdrDetn1 with the same data element name.";
CM_ SG_ 344 FrntRdrDetn126RdrDetnChks "Refer to the data element description in FrntRdrDetn1 with the same data element name.";
CM_ SG_ 344 FrntRdrDetn126RdrDetnCntr "Refer to the data element description in FrntRdrDetn1 with the same data element name.";
CM_ SG_ 344 FrntRdrDetn126RdrDetnConf "Refer to the data element description in FrntRdrDetn1 with the same data element name.";
CM_ SG_ 344 FrntRdrDetn126RdrDetnElevn "Refer to the data element description in FrntRdrDetn1 with the same data element name.";
CM_ SG_ 344 FrntRdrDetn126RdrDetnPwr "Refer to the data element description in FrntRdrDetn1 with the same data element name.";
CM_ SG_ 344 FrntRdrDetn126RdrDetnRng "Refer to the data element description in FrntRdrDetn1 with the same data element name.";
CM_ SG_ 344 FrntRdrDetn126RdrDetnRngV "Refer to the data element description in FrntRdrDetn1 with the same data element name.";
CM_ SG_ 344 FrntRdrDetn126RdrDetnSts "Refer to the data element description in FrntRdrDetn1 with the same data element name.";
CM_ SG_ 346 FrntRdrDetn127RdrDetnAzi "Refer to the data element description in FrntRdrDetn1 with the same data element name.";
CM_ SG_ 346 FrntRdrDetn127RdrDetnChks "Refer to the data element description in FrntRdrDetn1 with the same data element name.";
CM_ SG_ 346 FrntRdrDetn127RdrDetnCntr "Refer to the data element description in FrntRdrDetn1 with the same data element name.";
CM_ SG_ 346 FrntRdrDetn127RdrDetnConf "Refer to the data element description in FrntRdrDetn1 with the same data element name.";
CM_ SG_ 346 FrntRdrDetn127RdrDetnElevn "Refer to the data element description in FrntRdrDetn1 with the same data element name.";
CM_ SG_ 346 FrntRdrDetn127RdrDetnPwr "Refer to the data element description in FrntRdrDetn1 with the same data element name.";
CM_ SG_ 346 FrntRdrDetn127RdrDetnRng "Refer to the data element description in FrntRdrDetn1 with the same data element name.";
CM_ SG_ 346 FrntRdrDetn127RdrDetnRngV "Refer to the data element description in FrntRdrDetn1 with the same data element name.";
CM_ SG_ 346 FrntRdrDetn127RdrDetnSts "Refer to the data element description in FrntRdrDetn1 with the same data element name.";
CM_ SG_ 346 FrntRdrDetn128RdrDetnAzi "Refer to the data element description in FrntRdrDetn1 with the same data element name.";
CM_ SG_ 346 FrntRdrDetn128RdrDetnChks "Refer to the data element description in FrntRdrDetn1 with the same data element name.";
CM_ SG_ 346 FrntRdrDetn128RdrDetnCntr "Refer to the data element description in FrntRdrDetn1 with the same data element name.";
CM_ SG_ 346 FrntRdrDetn128RdrDetnConf "Refer to the data element description in FrntRdrDetn1 with the same data element name.";
CM_ SG_ 346 FrntRdrDetn128RdrDetnElevn "Refer to the data element description in FrntRdrDetn1 with the same data element name.";
CM_ SG_ 346 FrntRdrDetn128RdrDetnPwr "Refer to the data element description in FrntRdrDetn1 with the same data element name.";
CM_ SG_ 346 FrntRdrDetn128RdrDetnRng "Refer to the data element description in FrntRdrDetn1 with the same data element name.";
CM_ SG_ 346 FrntRdrDetn128RdrDetnRngV "Refer to the data element description in FrntRdrDetn1 with the same data element name.";
CM_ SG_ 346 FrntRdrDetn128RdrDetnSts "Refer to the data element description in FrntRdrDetn1 with the same data element name.";
CM_ SG_ 346 FrntRdrDetn129RdrDetnAzi "Refer to the data element description in FrntRdrDetn1 with the same data element name.";
CM_ SG_ 346 FrntRdrDetn129RdrDetnChks "Refer to the data element description in FrntRdrDetn1 with the same data element name.";
CM_ SG_ 346 FrntRdrDetn129RdrDetnCntr "Refer to the data element description in FrntRdrDetn1 with the same data element name.";
CM_ SG_ 346 FrntRdrDetn129RdrDetnConf "Refer to the data element description in FrntRdrDetn1 with the same data element name.";
CM_ SG_ 346 FrntRdrDetn129RdrDetnElevn "Refer to the data element description in FrntRdrDetn1 with the same data element name.";
CM_ SG_ 346 FrntRdrDetn129RdrDetnPwr "Refer to the data element description in FrntRdrDetn1 with the same data element name.";
CM_ SG_ 346 FrntRdrDetn129RdrDetnRng "Refer to the data element description in FrntRdrDetn1 with the same data element name.";
CM_ SG_ 346 FrntRdrDetn129RdrDetnRngV "Refer to the data element description in FrntRdrDetn1 with the same data element name.";
CM_ SG_ 346 FrntRdrDetn129RdrDetnSts "Refer to the data element description in FrntRdrDetn1 with the same data element name.";
CM_ SG_ 346 FrntRdrDetn130RdrDetnAzi "Refer to the data element description in FrntRdrDetn1 with the same data element name.";
CM_ SG_ 346 FrntRdrDetn130RdrDetnChks "Refer to the data element description in FrntRdrDetn1 with the same data element name.";
CM_ SG_ 346 FrntRdrDetn130RdrDetnCntr "Refer to the data element description in FrntRdrDetn1 with the same data element name.";
CM_ SG_ 346 FrntRdrDetn130RdrDetnConf "Refer to the data element description in FrntRdrDetn1 with the same data element name.";
CM_ SG_ 346 FrntRdrDetn130RdrDetnElevn "Refer to the data element description in FrntRdrDetn1 with the same data element name.";
CM_ SG_ 346 FrntRdrDetn130RdrDetnPwr "Refer to the data element description in FrntRdrDetn1 with the same data element name.";
CM_ SG_ 346 FrntRdrDetn130RdrDetnRng "Refer to the data element description in FrntRdrDetn1 with the same data element name.";
CM_ SG_ 346 FrntRdrDetn130RdrDetnRngV "Refer to the data element description in FrntRdrDetn1 with the same data element name.";
CM_ SG_ 346 FrntRdrDetn130RdrDetnSts "Refer to the data element description in FrntRdrDetn1 with the same data element name.";
CM_ SG_ 346 FrntRdrDetn131RdrDetnAzi "Refer to the data element description in FrntRdrDetn1 with the same data element name.";
CM_ SG_ 346 FrntRdrDetn131RdrDetnChks "Refer to the data element description in FrntRdrDetn1 with the same data element name.";
CM_ SG_ 346 FrntRdrDetn131RdrDetnCntr "Refer to the data element description in FrntRdrDetn1 with the same data element name.";
CM_ SG_ 346 FrntRdrDetn131RdrDetnConf "Refer to the data element description in FrntRdrDetn1 with the same data element name.";
CM_ SG_ 346 FrntRdrDetn131RdrDetnElevn "Refer to the data element description in FrntRdrDetn1 with the same data element name.";
CM_ SG_ 346 FrntRdrDetn131RdrDetnPwr "Refer to the data element description in FrntRdrDetn1 with the same data element name.";
CM_ SG_ 346 FrntRdrDetn131RdrDetnRng "Refer to the data element description in FrntRdrDetn1 with the same data element name.";
CM_ SG_ 346 FrntRdrDetn131RdrDetnRngV "Refer to the data element description in FrntRdrDetn1 with the same data element name.";
CM_ SG_ 346 FrntRdrDetn131RdrDetnSts "Refer to the data element description in FrntRdrDetn1 with the same data element name.";
CM_ SG_ 346 FrntRdrDetn132RdrDetnAzi "Refer to the data element description in FrntRdrDetn1 with the same data element name.";
CM_ SG_ 346 FrntRdrDetn132RdrDetnChks "Refer to the data element description in FrntRdrDetn1 with the same data element name.";
CM_ SG_ 346 FrntRdrDetn132RdrDetnCntr "Refer to the data element description in FrntRdrDetn1 with the same data element name.";
CM_ SG_ 346 FrntRdrDetn132RdrDetnConf "Refer to the data element description in FrntRdrDetn1 with the same data element name.";
CM_ SG_ 346 FrntRdrDetn132RdrDetnElevn "Refer to the data element description in FrntRdrDetn1 with the same data element name.";
CM_ SG_ 346 FrntRdrDetn132RdrDetnPwr "Refer to the data element description in FrntRdrDetn1 with the same data element name.";
CM_ SG_ 346 FrntRdrDetn132RdrDetnRng "Refer to the data element description in FrntRdrDetn1 with the same data element name.";
CM_ SG_ 346 FrntRdrDetn132RdrDetnRngV "Refer to the data element description in FrntRdrDetn1 with the same data element name.";
CM_ SG_ 346 FrntRdrDetn132RdrDetnSts "Refer to the data element description in FrntRdrDetn1 with the same data element name.";
CM_ SG_ 348 FrntRdrDetn133RdrDetnAzi "Refer to the data element description in FrntRdrDetn1 with the same data element name.";
CM_ SG_ 348 FrntRdrDetn133RdrDetnChks "Refer to the data element description in FrntRdrDetn1 with the same data element name.";
CM_ SG_ 348 FrntRdrDetn133RdrDetnCntr "Refer to the data element description in FrntRdrDetn1 with the same data element name.";
CM_ SG_ 348 FrntRdrDetn133RdrDetnConf "Refer to the data element description in FrntRdrDetn1 with the same data element name.";
CM_ SG_ 348 FrntRdrDetn133RdrDetnElevn "Refer to the data element description in FrntRdrDetn1 with the same data element name.";
CM_ SG_ 348 FrntRdrDetn133RdrDetnPwr "Refer to the data element description in FrntRdrDetn1 with the same data element name.";
CM_ SG_ 348 FrntRdrDetn133RdrDetnRng "Refer to the data element description in FrntRdrDetn1 with the same data element name.";
CM_ SG_ 348 FrntRdrDetn133RdrDetnRngV "Refer to the data element description in FrntRdrDetn1 with the same data element name.";
CM_ SG_ 348 FrntRdrDetn133RdrDetnSts "Refer to the data element description in FrntRdrDetn1 with the same data element name.";
CM_ SG_ 348 FrntRdrDetn134RdrDetnAzi "Refer to the data element description in FrntRdrDetn1 with the same data element name.";
CM_ SG_ 348 FrntRdrDetn134RdrDetnChks "Refer to the data element description in FrntRdrDetn1 with the same data element name.";
CM_ SG_ 348 FrntRdrDetn134RdrDetnCntr "Refer to the data element description in FrntRdrDetn1 with the same data element name.";
CM_ SG_ 348 FrntRdrDetn134RdrDetnConf "Refer to the data element description in FrntRdrDetn1 with the same data element name.";
CM_ SG_ 348 FrntRdrDetn134RdrDetnElevn "Refer to the data element description in FrntRdrDetn1 with the same data element name.";
CM_ SG_ 348 FrntRdrDetn134RdrDetnPwr "Refer to the data element description in FrntRdrDetn1 with the same data element name.";
CM_ SG_ 348 FrntRdrDetn134RdrDetnRng "Refer to the data element description in FrntRdrDetn1 with the same data element name.";
CM_ SG_ 348 FrntRdrDetn134RdrDetnRngV "Refer to the data element description in FrntRdrDetn1 with the same data element name.";
CM_ SG_ 348 FrntRdrDetn134RdrDetnSts "Refer to the data element description in FrntRdrDetn1 with the same data element name.";
CM_ SG_ 348 FrntRdrDetn135RdrDetnAzi "Refer to the data element description in FrntRdrDetn1 with the same data element name.";
CM_ SG_ 348 FrntRdrDetn135RdrDetnChks "Refer to the data element description in FrntRdrDetn1 with the same data element name.";
CM_ SG_ 348 FrntRdrDetn135RdrDetnCntr "Refer to the data element description in FrntRdrDetn1 with the same data element name.";
CM_ SG_ 348 FrntRdrDetn135RdrDetnConf "Refer to the data element description in FrntRdrDetn1 with the same data element name.";
CM_ SG_ 348 FrntRdrDetn135RdrDetnElevn "Refer to the data element description in FrntRdrDetn1 with the same data element name.";
CM_ SG_ 348 FrntRdrDetn135RdrDetnPwr "Refer to the data element description in FrntRdrDetn1 with the same data element name.";
CM_ SG_ 348 FrntRdrDetn135RdrDetnRng "Refer to the data element description in FrntRdrDetn1 with the same data element name.";
CM_ SG_ 348 FrntRdrDetn135RdrDetnRngV "Refer to the data element description in FrntRdrDetn1 with the same data element name.";
CM_ SG_ 348 FrntRdrDetn135RdrDetnSts "Refer to the data element description in FrntRdrDetn1 with the same data element name.";
CM_ SG_ 348 FrntRdrDetn136RdrDetnAzi "Refer to the data element description in FrntRdrDetn1 with the same data element name.";
CM_ SG_ 348 FrntRdrDetn136RdrDetnChks "Refer to the data element description in FrntRdrDetn1 with the same data element name.";
CM_ SG_ 348 FrntRdrDetn136RdrDetnCntr "Refer to the data element description in FrntRdrDetn1 with the same data element name.";
CM_ SG_ 348 FrntRdrDetn136RdrDetnConf "Refer to the data element description in FrntRdrDetn1 with the same data element name.";
CM_ SG_ 348 FrntRdrDetn136RdrDetnElevn "Refer to the data element description in FrntRdrDetn1 with the same data element name.";
CM_ SG_ 348 FrntRdrDetn136RdrDetnPwr "Refer to the data element description in FrntRdrDetn1 with the same data element name.";
CM_ SG_ 348 FrntRdrDetn136RdrDetnRng "Refer to the data element description in FrntRdrDetn1 with the same data element name.";
CM_ SG_ 348 FrntRdrDetn136RdrDetnRngV "Refer to the data element description in FrntRdrDetn1 with the same data element name.";
CM_ SG_ 348 FrntRdrDetn136RdrDetnSts "Refer to the data element description in FrntRdrDetn1 with the same data element name.";
CM_ SG_ 348 FrntRdrDetn137RdrDetnAzi "Refer to the data element description in FrntRdrDetn1 with the same data element name.";
CM_ SG_ 348 FrntRdrDetn137RdrDetnChks "Refer to the data element description in FrntRdrDetn1 with the same data element name.";
CM_ SG_ 348 FrntRdrDetn137RdrDetnCntr "Refer to the data element description in FrntRdrDetn1 with the same data element name.";
CM_ SG_ 348 FrntRdrDetn137RdrDetnConf "Refer to the data element description in FrntRdrDetn1 with the same data element name.";
CM_ SG_ 348 FrntRdrDetn137RdrDetnElevn "Refer to the data element description in FrntRdrDetn1 with the same data element name.";
CM_ SG_ 348 FrntRdrDetn137RdrDetnPwr "Refer to the data element description in FrntRdrDetn1 with the same data element name.";
CM_ SG_ 348 FrntRdrDetn137RdrDetnRng "Refer to the data element description in FrntRdrDetn1 with the same data element name.";
CM_ SG_ 348 FrntRdrDetn137RdrDetnRngV "Refer to the data element description in FrntRdrDetn1 with the same data element name.";
CM_ SG_ 348 FrntRdrDetn137RdrDetnSts "Refer to the data element description in FrntRdrDetn1 with the same data element name.";
CM_ SG_ 348 FrntRdrDetn138RdrDetnAzi "Refer to the data element description in FrntRdrDetn1 with the same data element name.";
CM_ SG_ 348 FrntRdrDetn138RdrDetnChks "Refer to the data element description in FrntRdrDetn1 with the same data element name.";
CM_ SG_ 348 FrntRdrDetn138RdrDetnCntr "Refer to the data element description in FrntRdrDetn1 with the same data element name.";
CM_ SG_ 348 FrntRdrDetn138RdrDetnConf "Refer to the data element description in FrntRdrDetn1 with the same data element name.";
CM_ SG_ 348 FrntRdrDetn138RdrDetnElevn "Refer to the data element description in FrntRdrDetn1 with the same data element name.";
CM_ SG_ 348 FrntRdrDetn138RdrDetnPwr "Refer to the data element description in FrntRdrDetn1 with the same data element name.";
CM_ SG_ 348 FrntRdrDetn138RdrDetnRng "Refer to the data element description in FrntRdrDetn1 with the same data element name.";
CM_ SG_ 348 FrntRdrDetn138RdrDetnRngV "Refer to the data element description in FrntRdrDetn1 with the same data element name.";
CM_ SG_ 348 FrntRdrDetn138RdrDetnSts "Refer to the data element description in FrntRdrDetn1 with the same data element name.";
CM_ SG_ 350 FrntRdrDetn139RdrDetnAzi "Refer to the data element description in FrntRdrDetn1 with the same data element name.";
CM_ SG_ 350 FrntRdrDetn139RdrDetnChks "Refer to the data element description in FrntRdrDetn1 with the same data element name.";
CM_ SG_ 350 FrntRdrDetn139RdrDetnCntr "Refer to the data element description in FrntRdrDetn1 with the same data element name.";
CM_ SG_ 350 FrntRdrDetn139RdrDetnConf "Refer to the data element description in FrntRdrDetn1 with the same data element name.";
CM_ SG_ 350 FrntRdrDetn139RdrDetnElevn "Refer to the data element description in FrntRdrDetn1 with the same data element name.";
CM_ SG_ 350 FrntRdrDetn139RdrDetnPwr "Refer to the data element description in FrntRdrDetn1 with the same data element name.";
CM_ SG_ 350 FrntRdrDetn139RdrDetnRng "Refer to the data element description in FrntRdrDetn1 with the same data element name.";
CM_ SG_ 350 FrntRdrDetn139RdrDetnRngV "Refer to the data element description in FrntRdrDetn1 with the same data element name.";
CM_ SG_ 350 FrntRdrDetn139RdrDetnSts "Refer to the data element description in FrntRdrDetn1 with the same data element name.";
CM_ SG_ 350 FrntRdrDetn140RdrDetnAzi "Refer to the data element description in FrntRdrDetn1 with the same data element name.";
CM_ SG_ 350 FrntRdrDetn140RdrDetnChks "Refer to the data element description in FrntRdrDetn1 with the same data element name.";
CM_ SG_ 350 FrntRdrDetn140RdrDetnCntr "Refer to the data element description in FrntRdrDetn1 with the same data element name.";
CM_ SG_ 350 FrntRdrDetn140RdrDetnConf "Refer to the data element description in FrntRdrDetn1 with the same data element name.";
CM_ SG_ 350 FrntRdrDetn140RdrDetnElevn "Refer to the data element description in FrntRdrDetn1 with the same data element name.";
CM_ SG_ 350 FrntRdrDetn140RdrDetnPwr "Refer to the data element description in FrntRdrDetn1 with the same data element name.";
CM_ SG_ 350 FrntRdrDetn140RdrDetnRng "Refer to the data element description in FrntRdrDetn1 with the same data element name.";
CM_ SG_ 350 FrntRdrDetn140RdrDetnRngV "Refer to the data element description in FrntRdrDetn1 with the same data element name.";
CM_ SG_ 350 FrntRdrDetn140RdrDetnSts "Refer to the data element description in FrntRdrDetn1 with the same data element name.";
CM_ SG_ 350 FrntRdrDetn141RdrDetnAzi "Refer to the data element description in FrntRdrDetn1 with the same data element name.";
CM_ SG_ 350 FrntRdrDetn141RdrDetnChks "Refer to the data element description in FrntRdrDetn1 with the same data element name.";
CM_ SG_ 350 FrntRdrDetn141RdrDetnCntr "Refer to the data element description in FrntRdrDetn1 with the same data element name.";
CM_ SG_ 350 FrntRdrDetn141RdrDetnConf "Refer to the data element description in FrntRdrDetn1 with the same data element name.";
CM_ SG_ 350 FrntRdrDetn141RdrDetnElevn "Refer to the data element description in FrntRdrDetn1 with the same data element name.";
CM_ SG_ 350 FrntRdrDetn141RdrDetnPwr "Refer to the data element description in FrntRdrDetn1 with the same data element name.";
CM_ SG_ 350 FrntRdrDetn141RdrDetnRng "Refer to the data element description in FrntRdrDetn1 with the same data element name.";
CM_ SG_ 350 FrntRdrDetn141RdrDetnRngV "Refer to the data element description in FrntRdrDetn1 with the same data element name.";
CM_ SG_ 350 FrntRdrDetn141RdrDetnSts "Refer to the data element description in FrntRdrDetn1 with the same data element name.";
CM_ SG_ 350 FrntRdrDetn142RdrDetnAzi "Refer to the data element description in FrntRdrDetn1 with the same data element name.";
CM_ SG_ 350 FrntRdrDetn142RdrDetnChks "Refer to the data element description in FrntRdrDetn1 with the same data element name.";
CM_ SG_ 350 FrntRdrDetn142RdrDetnCntr "Refer to the data element description in FrntRdrDetn1 with the same data element name.";
CM_ SG_ 350 FrntRdrDetn142RdrDetnConf "Refer to the data element description in FrntRdrDetn1 with the same data element name.";
CM_ SG_ 350 FrntRdrDetn142RdrDetnElevn "Refer to the data element description in FrntRdrDetn1 with the same data element name.";
CM_ SG_ 350 FrntRdrDetn142RdrDetnPwr "Refer to the data element description in FrntRdrDetn1 with the same data element name.";
CM_ SG_ 350 FrntRdrDetn142RdrDetnRng "Refer to the data element description in FrntRdrDetn1 with the same data element name.";
CM_ SG_ 350 FrntRdrDetn142RdrDetnRngV "Refer to the data element description in FrntRdrDetn1 with the same data element name.";
CM_ SG_ 350 FrntRdrDetn142RdrDetnSts "Refer to the data element description in FrntRdrDetn1 with the same data element name.";
CM_ SG_ 350 FrntRdrDetn143RdrDetnAzi "Refer to the data element description in FrntRdrDetn1 with the same data element name.";
CM_ SG_ 350 FrntRdrDetn143RdrDetnChks "Refer to the data element description in FrntRdrDetn1 with the same data element name.";
CM_ SG_ 350 FrntRdrDetn143RdrDetnCntr "Refer to the data element description in FrntRdrDetn1 with the same data element name.";
CM_ SG_ 350 FrntRdrDetn143RdrDetnConf "Refer to the data element description in FrntRdrDetn1 with the same data element name.";
CM_ SG_ 350 FrntRdrDetn143RdrDetnElevn "Refer to the data element description in FrntRdrDetn1 with the same data element name.";
CM_ SG_ 350 FrntRdrDetn143RdrDetnPwr "Refer to the data element description in FrntRdrDetn1 with the same data element name.";
CM_ SG_ 350 FrntRdrDetn143RdrDetnRng "Refer to the data element description in FrntRdrDetn1 with the same data element name.";
CM_ SG_ 350 FrntRdrDetn143RdrDetnRngV "Refer to the data element description in FrntRdrDetn1 with the same data element name.";
CM_ SG_ 350 FrntRdrDetn143RdrDetnSts "Refer to the data element description in FrntRdrDetn1 with the same data element name.";
CM_ SG_ 350 FrntRdrDetn144RdrDetnAzi "Refer to the data element description in FrntRdrDetn1 with the same data element name.";
CM_ SG_ 350 FrntRdrDetn144RdrDetnChks "Refer to the data element description in FrntRdrDetn1 with the same data element name.";
CM_ SG_ 350 FrntRdrDetn144RdrDetnCntr "Refer to the data element description in FrntRdrDetn1 with the same data element name.";
CM_ SG_ 350 FrntRdrDetn144RdrDetnConf "Refer to the data element description in FrntRdrDetn1 with the same data element name.";
CM_ SG_ 350 FrntRdrDetn144RdrDetnElevn "Refer to the data element description in FrntRdrDetn1 with the same data element name.";
CM_ SG_ 350 FrntRdrDetn144RdrDetnPwr "Refer to the data element description in FrntRdrDetn1 with the same data element name.";
CM_ SG_ 350 FrntRdrDetn144RdrDetnRng "Refer to the data element description in FrntRdrDetn1 with the same data element name.";
CM_ SG_ 350 FrntRdrDetn144RdrDetnRngV "Refer to the data element description in FrntRdrDetn1 with the same data element name.";
CM_ SG_ 350 FrntRdrDetn144RdrDetnSts "Refer to the data element description in FrntRdrDetn1 with the same data element name.";
CM_ SG_ 352 FrntRdrDetn145RdrDetnAzi "Refer to the data element description in FrntRdrDetn1 with the same data element name.";
CM_ SG_ 352 FrntRdrDetn145RdrDetnChks "Refer to the data element description in FrntRdrDetn1 with the same data element name.";
CM_ SG_ 352 FrntRdrDetn145RdrDetnCntr "Refer to the data element description in FrntRdrDetn1 with the same data element name.";
CM_ SG_ 352 FrntRdrDetn145RdrDetnConf "Refer to the data element description in FrntRdrDetn1 with the same data element name.";
CM_ SG_ 352 FrntRdrDetn145RdrDetnElevn "Refer to the data element description in FrntRdrDetn1 with the same data element name.";
CM_ SG_ 352 FrntRdrDetn145RdrDetnPwr "Refer to the data element description in FrntRdrDetn1 with the same data element name.";
CM_ SG_ 352 FrntRdrDetn145RdrDetnRng "Refer to the data element description in FrntRdrDetn1 with the same data element name.";
CM_ SG_ 352 FrntRdrDetn145RdrDetnRngV "Refer to the data element description in FrntRdrDetn1 with the same data element name.";
CM_ SG_ 352 FrntRdrDetn145RdrDetnSts "Refer to the data element description in FrntRdrDetn1 with the same data element name.";
CM_ SG_ 352 FrntRdrDetn146RdrDetnAzi "Refer to the data element description in FrntRdrDetn1 with the same data element name.";
CM_ SG_ 352 FrntRdrDetn146RdrDetnChks "Refer to the data element description in FrntRdrDetn1 with the same data element name.";
CM_ SG_ 352 FrntRdrDetn146RdrDetnCntr "Refer to the data element description in FrntRdrDetn1 with the same data element name.";
CM_ SG_ 352 FrntRdrDetn146RdrDetnConf "Refer to the data element description in FrntRdrDetn1 with the same data element name.";
CM_ SG_ 352 FrntRdrDetn146RdrDetnElevn "Refer to the data element description in FrntRdrDetn1 with the same data element name.";
CM_ SG_ 352 FrntRdrDetn146RdrDetnPwr "Refer to the data element description in FrntRdrDetn1 with the same data element name.";
CM_ SG_ 352 FrntRdrDetn146RdrDetnRng "Refer to the data element description in FrntRdrDetn1 with the same data element name.";
CM_ SG_ 352 FrntRdrDetn146RdrDetnRngV "Refer to the data element description in FrntRdrDetn1 with the same data element name.";
CM_ SG_ 352 FrntRdrDetn146RdrDetnSts "Refer to the data element description in FrntRdrDetn1 with the same data element name.";
CM_ SG_ 352 FrntRdrDetn147RdrDetnAzi "Refer to the data element description in FrntRdrDetn1 with the same data element name.";
CM_ SG_ 352 FrntRdrDetn147RdrDetnChks "Refer to the data element description in FrntRdrDetn1 with the same data element name.";
CM_ SG_ 352 FrntRdrDetn147RdrDetnCntr "Refer to the data element description in FrntRdrDetn1 with the same data element name.";
CM_ SG_ 352 FrntRdrDetn147RdrDetnConf "Refer to the data element description in FrntRdrDetn1 with the same data element name.";
CM_ SG_ 352 FrntRdrDetn147RdrDetnElevn "Refer to the data element description in FrntRdrDetn1 with the same data element name.";
CM_ SG_ 352 FrntRdrDetn147RdrDetnPwr "Refer to the data element description in FrntRdrDetn1 with the same data element name.";
CM_ SG_ 352 FrntRdrDetn147RdrDetnRng "Refer to the data element description in FrntRdrDetn1 with the same data element name.";
CM_ SG_ 352 FrntRdrDetn147RdrDetnRngV "Refer to the data element description in FrntRdrDetn1 with the same data element name.";
CM_ SG_ 352 FrntRdrDetn147RdrDetnSts "Refer to the data element description in FrntRdrDetn1 with the same data element name.";
CM_ SG_ 352 FrntRdrDetn148RdrDetnAzi "Refer to the data element description in FrntRdrDetn1 with the same data element name.";
CM_ SG_ 352 FrntRdrDetn148RdrDetnChks "Refer to the data element description in FrntRdrDetn1 with the same data element name.";
CM_ SG_ 352 FrntRdrDetn148RdrDetnCntr "Refer to the data element description in FrntRdrDetn1 with the same data element name.";
CM_ SG_ 352 FrntRdrDetn148RdrDetnConf "Refer to the data element description in FrntRdrDetn1 with the same data element name.";
CM_ SG_ 352 FrntRdrDetn148RdrDetnElevn "Refer to the data element description in FrntRdrDetn1 with the same data element name.";
CM_ SG_ 352 FrntRdrDetn148RdrDetnPwr "Refer to the data element description in FrntRdrDetn1 with the same data element name.";
CM_ SG_ 352 FrntRdrDetn148RdrDetnRng "Refer to the data element description in FrntRdrDetn1 with the same data element name.";
CM_ SG_ 352 FrntRdrDetn148RdrDetnRngV "Refer to the data element description in FrntRdrDetn1 with the same data element name.";
CM_ SG_ 352 FrntRdrDetn148RdrDetnSts "Refer to the data element description in FrntRdrDetn1 with the same data element name.";
CM_ SG_ 352 FrntRdrDetn149RdrDetnAzi "Refer to the data element description in FrntRdrDetn1 with the same data element name.";
CM_ SG_ 352 FrntRdrDetn149RdrDetnChks "Refer to the data element description in FrntRdrDetn1 with the same data element name.";
CM_ SG_ 352 FrntRdrDetn149RdrDetnCntr "Refer to the data element description in FrntRdrDetn1 with the same data element name.";
CM_ SG_ 352 FrntRdrDetn149RdrDetnConf "Refer to the data element description in FrntRdrDetn1 with the same data element name.";
CM_ SG_ 352 FrntRdrDetn149RdrDetnElevn "Refer to the data element description in FrntRdrDetn1 with the same data element name.";
CM_ SG_ 352 FrntRdrDetn149RdrDetnPwr "Refer to the data element description in FrntRdrDetn1 with the same data element name.";
CM_ SG_ 352 FrntRdrDetn149RdrDetnRng "Refer to the data element description in FrntRdrDetn1 with the same data element name.";
CM_ SG_ 352 FrntRdrDetn149RdrDetnRngV "Refer to the data element description in FrntRdrDetn1 with the same data element name.";
CM_ SG_ 352 FrntRdrDetn149RdrDetnSts "Refer to the data element description in FrntRdrDetn1 with the same data element name.";
CM_ SG_ 352 FrntRdrDetn150RdrDetnAzi "Refer to the data element description in FrntRdrDetn1 with the same data element name.";
CM_ SG_ 352 FrntRdrDetn150RdrDetnChks "Refer to the data element description in FrntRdrDetn1 with the same data element name.";
CM_ SG_ 352 FrntRdrDetn150RdrDetnCntr "Refer to the data element description in FrntRdrDetn1 with the same data element name.";
CM_ SG_ 352 FrntRdrDetn150RdrDetnConf "Refer to the data element description in FrntRdrDetn1 with the same data element name.";
CM_ SG_ 352 FrntRdrDetn150RdrDetnElevn "Refer to the data element description in FrntRdrDetn1 with the same data element name.";
CM_ SG_ 352 FrntRdrDetn150RdrDetnPwr "Refer to the data element description in FrntRdrDetn1 with the same data element name.";
CM_ SG_ 352 FrntRdrDetn150RdrDetnRng "Refer to the data element description in FrntRdrDetn1 with the same data element name.";
CM_ SG_ 352 FrntRdrDetn150RdrDetnRngV "Refer to the data element description in FrntRdrDetn1 with the same data element name.";
CM_ SG_ 352 FrntRdrDetn150RdrDetnSts "Refer to the data element description in FrntRdrDetn1 with the same data element name.";
CM_ SG_ 354 FrntRdrDetn151RdrDetnAzi "Refer to the data element description in FrntRdrDetn1 with the same data element name.";
CM_ SG_ 354 FrntRdrDetn151RdrDetnChks "Refer to the data element description in FrntRdrDetn1 with the same data element name.";
CM_ SG_ 354 FrntRdrDetn151RdrDetnCntr "Refer to the data element description in FrntRdrDetn1 with the same data element name.";
CM_ SG_ 354 FrntRdrDetn151RdrDetnConf "Refer to the data element description in FrntRdrDetn1 with the same data element name.";
CM_ SG_ 354 FrntRdrDetn151RdrDetnElevn "Refer to the data element description in FrntRdrDetn1 with the same data element name.";
CM_ SG_ 354 FrntRdrDetn151RdrDetnPwr "Refer to the data element description in FrntRdrDetn1 with the same data element name.";
CM_ SG_ 354 FrntRdrDetn151RdrDetnRng "Refer to the data element description in FrntRdrDetn1 with the same data element name.";
CM_ SG_ 354 FrntRdrDetn151RdrDetnRngV "Refer to the data element description in FrntRdrDetn1 with the same data element name.";
CM_ SG_ 354 FrntRdrDetn151RdrDetnSts "Refer to the data element description in FrntRdrDetn1 with the same data element name.";
CM_ SG_ 354 FrntRdrDetn152RdrDetnAzi "Refer to the data element description in FrntRdrDetn1 with the same data element name.";
CM_ SG_ 354 FrntRdrDetn152RdrDetnChks "Refer to the data element description in FrntRdrDetn1 with the same data element name.";
CM_ SG_ 354 FrntRdrDetn152RdrDetnCntr "Refer to the data element description in FrntRdrDetn1 with the same data element name.";
CM_ SG_ 354 FrntRdrDetn152RdrDetnConf "Refer to the data element description in FrntRdrDetn1 with the same data element name.";
CM_ SG_ 354 FrntRdrDetn152RdrDetnElevn "Refer to the data element description in FrntRdrDetn1 with the same data element name.";
CM_ SG_ 354 FrntRdrDetn152RdrDetnPwr "Refer to the data element description in FrntRdrDetn1 with the same data element name.";
CM_ SG_ 354 FrntRdrDetn152RdrDetnRng "Refer to the data element description in FrntRdrDetn1 with the same data element name.";
CM_ SG_ 354 FrntRdrDetn152RdrDetnRngV "Refer to the data element description in FrntRdrDetn1 with the same data element name.";
CM_ SG_ 354 FrntRdrDetn152RdrDetnSts "Refer to the data element description in FrntRdrDetn1 with the same data element name.";
CM_ SG_ 354 FrntRdrDetn153RdrDetnAzi "Refer to the data element description in FrntRdrDetn1 with the same data element name.";
CM_ SG_ 354 FrntRdrDetn153RdrDetnChks "Refer to the data element description in FrntRdrDetn1 with the same data element name.";
CM_ SG_ 354 FrntRdrDetn153RdrDetnCntr "Refer to the data element description in FrntRdrDetn1 with the same data element name.";
CM_ SG_ 354 FrntRdrDetn153RdrDetnConf "Refer to the data element description in FrntRdrDetn1 with the same data element name.";
CM_ SG_ 354 FrntRdrDetn153RdrDetnElevn "Refer to the data element description in FrntRdrDetn1 with the same data element name.";
CM_ SG_ 354 FrntRdrDetn153RdrDetnPwr "Refer to the data element description in FrntRdrDetn1 with the same data element name.";
CM_ SG_ 354 FrntRdrDetn153RdrDetnRng "Refer to the data element description in FrntRdrDetn1 with the same data element name.";
CM_ SG_ 354 FrntRdrDetn153RdrDetnRngV "Refer to the data element description in FrntRdrDetn1 with the same data element name.";
CM_ SG_ 354 FrntRdrDetn153RdrDetnSts "Refer to the data element description in FrntRdrDetn1 with the same data element name.";
CM_ SG_ 354 FrntRdrDetn154RdrDetnAzi "Refer to the data element description in FrntRdrDetn1 with the same data element name.";
CM_ SG_ 354 FrntRdrDetn154RdrDetnChks "Refer to the data element description in FrntRdrDetn1 with the same data element name.";
CM_ SG_ 354 FrntRdrDetn154RdrDetnCntr "Refer to the data element description in FrntRdrDetn1 with the same data element name.";
CM_ SG_ 354 FrntRdrDetn154RdrDetnConf "Refer to the data element description in FrntRdrDetn1 with the same data element name.";
CM_ SG_ 354 FrntRdrDetn154RdrDetnElevn "Refer to the data element description in FrntRdrDetn1 with the same data element name.";
CM_ SG_ 354 FrntRdrDetn154RdrDetnPwr "Refer to the data element description in FrntRdrDetn1 with the same data element name.";
CM_ SG_ 354 FrntRdrDetn154RdrDetnRng "Refer to the data element description in FrntRdrDetn1 with the same data element name.";
CM_ SG_ 354 FrntRdrDetn154RdrDetnRngV "Refer to the data element description in FrntRdrDetn1 with the same data element name.";
CM_ SG_ 354 FrntRdrDetn154RdrDetnSts "Refer to the data element description in FrntRdrDetn1 with the same data element name.";
CM_ SG_ 354 FrntRdrDetn155RdrDetnAzi "Refer to the data element description in FrntRdrDetn1 with the same data element name.";
CM_ SG_ 354 FrntRdrDetn155RdrDetnChks "Refer to the data element description in FrntRdrDetn1 with the same data element name.";
CM_ SG_ 354 FrntRdrDetn155RdrDetnCntr "Refer to the data element description in FrntRdrDetn1 with the same data element name.";
CM_ SG_ 354 FrntRdrDetn155RdrDetnConf "Refer to the data element description in FrntRdrDetn1 with the same data element name.";
CM_ SG_ 354 FrntRdrDetn155RdrDetnElevn "Refer to the data element description in FrntRdrDetn1 with the same data element name.";
CM_ SG_ 354 FrntRdrDetn155RdrDetnPwr "Refer to the data element description in FrntRdrDetn1 with the same data element name.";
CM_ SG_ 354 FrntRdrDetn155RdrDetnRng "Refer to the data element description in FrntRdrDetn1 with the same data element name.";
CM_ SG_ 354 FrntRdrDetn155RdrDetnRngV "Refer to the data element description in FrntRdrDetn1 with the same data element name.";
CM_ SG_ 354 FrntRdrDetn155RdrDetnSts "Refer to the data element description in FrntRdrDetn1 with the same data element name.";
CM_ SG_ 354 FrntRdrDetn156RdrDetnAzi "Refer to the data element description in FrntRdrDetn1 with the same data element name.";
CM_ SG_ 354 FrntRdrDetn156RdrDetnChks "Refer to the data element description in FrntRdrDetn1 with the same data element name.";
CM_ SG_ 354 FrntRdrDetn156RdrDetnCntr "Refer to the data element description in FrntRdrDetn1 with the same data element name.";
CM_ SG_ 354 FrntRdrDetn156RdrDetnConf "Refer to the data element description in FrntRdrDetn1 with the same data element name.";
CM_ SG_ 354 FrntRdrDetn156RdrDetnElevn "Refer to the data element description in FrntRdrDetn1 with the same data element name.";
CM_ SG_ 354 FrntRdrDetn156RdrDetnPwr "Refer to the data element description in FrntRdrDetn1 with the same data element name.";
CM_ SG_ 354 FrntRdrDetn156RdrDetnRng "Refer to the data element description in FrntRdrDetn1 with the same data element name.";
CM_ SG_ 354 FrntRdrDetn156RdrDetnRngV "Refer to the data element description in FrntRdrDetn1 with the same data element name.";
CM_ SG_ 354 FrntRdrDetn156RdrDetnSts "Refer to the data element description in FrntRdrDetn1 with the same data element name.";
CM_ SG_ 356 FrntRdrDetn157RdrDetnAzi "Refer to the data element description in FrntRdrDetn1 with the same data element name.";
CM_ SG_ 356 FrntRdrDetn157RdrDetnChks "Refer to the data element description in FrntRdrDetn1 with the same data element name.";
CM_ SG_ 356 FrntRdrDetn157RdrDetnCntr "Refer to the data element description in FrntRdrDetn1 with the same data element name.";
CM_ SG_ 356 FrntRdrDetn157RdrDetnConf "Refer to the data element description in FrntRdrDetn1 with the same data element name.";
CM_ SG_ 356 FrntRdrDetn157RdrDetnElevn "Refer to the data element description in FrntRdrDetn1 with the same data element name.";
CM_ SG_ 356 FrntRdrDetn157RdrDetnPwr "Refer to the data element description in FrntRdrDetn1 with the same data element name.";
CM_ SG_ 356 FrntRdrDetn157RdrDetnRng "Refer to the data element description in FrntRdrDetn1 with the same data element name.";
CM_ SG_ 356 FrntRdrDetn157RdrDetnRngV "Refer to the data element description in FrntRdrDetn1 with the same data element name.";
CM_ SG_ 356 FrntRdrDetn157RdrDetnSts "Refer to the data element description in FrntRdrDetn1 with the same data element name.";
CM_ SG_ 356 FrntRdrDetn158RdrDetnAzi "Refer to the data element description in FrntRdrDetn1 with the same data element name.";
CM_ SG_ 356 FrntRdrDetn158RdrDetnChks "Refer to the data element description in FrntRdrDetn1 with the same data element name.";
CM_ SG_ 356 FrntRdrDetn158RdrDetnCntr "Refer to the data element description in FrntRdrDetn1 with the same data element name.";
CM_ SG_ 356 FrntRdrDetn158RdrDetnConf "Refer to the data element description in FrntRdrDetn1 with the same data element name.";
CM_ SG_ 356 FrntRdrDetn158RdrDetnElevn "Refer to the data element description in FrntRdrDetn1 with the same data element name.";
CM_ SG_ 356 FrntRdrDetn158RdrDetnPwr "Refer to the data element description in FrntRdrDetn1 with the same data element name.";
CM_ SG_ 356 FrntRdrDetn158RdrDetnRng "Refer to the data element description in FrntRdrDetn1 with the same data element name.";
CM_ SG_ 356 FrntRdrDetn158RdrDetnRngV "Refer to the data element description in FrntRdrDetn1 with the same data element name.";
CM_ SG_ 356 FrntRdrDetn158RdrDetnSts "Refer to the data element description in FrntRdrDetn1 with the same data element name.";
CM_ SG_ 356 FrntRdrDetn159RdrDetnAzi "Refer to the data element description in FrntRdrDetn1 with the same data element name.";
CM_ SG_ 356 FrntRdrDetn159RdrDetnChks "Refer to the data element description in FrntRdrDetn1 with the same data element name.";
CM_ SG_ 356 FrntRdrDetn159RdrDetnCntr "Refer to the data element description in FrntRdrDetn1 with the same data element name.";
CM_ SG_ 356 FrntRdrDetn159RdrDetnConf "Refer to the data element description in FrntRdrDetn1 with the same data element name.";
CM_ SG_ 356 FrntRdrDetn159RdrDetnElevn "Refer to the data element description in FrntRdrDetn1 with the same data element name.";
CM_ SG_ 356 FrntRdrDetn159RdrDetnPwr "Refer to the data element description in FrntRdrDetn1 with the same data element name.";
CM_ SG_ 356 FrntRdrDetn159RdrDetnRng "Refer to the data element description in FrntRdrDetn1 with the same data element name.";
CM_ SG_ 356 FrntRdrDetn159RdrDetnRngV "Refer to the data element description in FrntRdrDetn1 with the same data element name.";
CM_ SG_ 356 FrntRdrDetn159RdrDetnSts "Refer to the data element description in FrntRdrDetn1 with the same data element name.";
CM_ SG_ 356 FrntRdrDetn160RdrDetnAzi "Refer to the data element description in FrntRdrDetn1 with the same data element name.";
CM_ SG_ 356 FrntRdrDetn160RdrDetnChks "Refer to the data element description in FrntRdrDetn1 with the same data element name.";
CM_ SG_ 356 FrntRdrDetn160RdrDetnCntr "Refer to the data element description in FrntRdrDetn1 with the same data element name.";
CM_ SG_ 356 FrntRdrDetn160RdrDetnConf "Refer to the data element description in FrntRdrDetn1 with the same data element name.";
CM_ SG_ 356 FrntRdrDetn160RdrDetnElevn "Refer to the data element description in FrntRdrDetn1 with the same data element name.";
CM_ SG_ 356 FrntRdrDetn160RdrDetnPwr "Refer to the data element description in FrntRdrDetn1 with the same data element name.";
CM_ SG_ 356 FrntRdrDetn160RdrDetnRng "Refer to the data element description in FrntRdrDetn1 with the same data element name.";
CM_ SG_ 356 FrntRdrDetn160RdrDetnRngV "Refer to the data element description in FrntRdrDetn1 with the same data element name.";
CM_ SG_ 356 FrntRdrDetn160RdrDetnSts "Refer to the data element description in FrntRdrDetn1 with the same data element name.";
CM_ SG_ 356 FrntRdrDetn161RdrDetnAzi "Refer to the data element description in FrntRdrDetn1 with the same data element name.";
CM_ SG_ 356 FrntRdrDetn161RdrDetnChks "Refer to the data element description in FrntRdrDetn1 with the same data element name.";
CM_ SG_ 356 FrntRdrDetn161RdrDetnCntr "Refer to the data element description in FrntRdrDetn1 with the same data element name.";
CM_ SG_ 356 FrntRdrDetn161RdrDetnConf "Refer to the data element description in FrntRdrDetn1 with the same data element name.";
CM_ SG_ 356 FrntRdrDetn161RdrDetnElevn "Refer to the data element description in FrntRdrDetn1 with the same data element name.";
CM_ SG_ 356 FrntRdrDetn161RdrDetnPwr "Refer to the data element description in FrntRdrDetn1 with the same data element name.";
CM_ SG_ 356 FrntRdrDetn161RdrDetnRng "Refer to the data element description in FrntRdrDetn1 with the same data element name.";
CM_ SG_ 356 FrntRdrDetn161RdrDetnRngV "Refer to the data element description in FrntRdrDetn1 with the same data element name.";
CM_ SG_ 356 FrntRdrDetn161RdrDetnSts "Refer to the data element description in FrntRdrDetn1 with the same data element name.";
CM_ SG_ 356 FrntRdrDetn162RdrDetnAzi "Refer to the data element description in FrntRdrDetn1 with the same data element name.";
CM_ SG_ 356 FrntRdrDetn162RdrDetnChks "Refer to the data element description in FrntRdrDetn1 with the same data element name.";
CM_ SG_ 356 FrntRdrDetn162RdrDetnCntr "Refer to the data element description in FrntRdrDetn1 with the same data element name.";
CM_ SG_ 356 FrntRdrDetn162RdrDetnConf "Refer to the data element description in FrntRdrDetn1 with the same data element name.";
CM_ SG_ 356 FrntRdrDetn162RdrDetnElevn "Refer to the data element description in FrntRdrDetn1 with the same data element name.";
CM_ SG_ 356 FrntRdrDetn162RdrDetnPwr "Refer to the data element description in FrntRdrDetn1 with the same data element name.";
CM_ SG_ 356 FrntRdrDetn162RdrDetnRng "Refer to the data element description in FrntRdrDetn1 with the same data element name.";
CM_ SG_ 356 FrntRdrDetn162RdrDetnRngV "Refer to the data element description in FrntRdrDetn1 with the same data element name.";
CM_ SG_ 356 FrntRdrDetn162RdrDetnSts "Refer to the data element description in FrntRdrDetn1 with the same data element name.";
BA_DEF_ BO_ "VFrameFormat" ENUM "StandardCAN","ExtendedCAN","reserved","J1939PG","reserved","reserved","reserved","reserved","reserved","reserved","reserved","reserved","reserved","reserved","StandardCAN_FD","ExtendedCAN_FD";
BA_DEF_ BO_ "CANFD_BRS" ENUM "0","1";
BA_DEF_ BO_ "GenMsgSendType" ENUM "cyclic", "spontaneous", "not-used", "not-used", "not-used", "cyclicAndSpontaneous", "not-used", "cyclicIfActive", "NoMsgSendType"; // [us]
BA_DEF_ BO_ "GenMsgCycleTime" INT 0 65536; // [ms]
BA_DEF_ BO_ "GenMsgStartDelayTime" INT 0 65536; // [ms]
BA_DEF_ BO_ "GenMsgDelayTime" INT 0 65536; // [ms]
BA_DEF_ SG_ "GenSigSendType" ENUM "Cyclic","OnWrite","OnWriteWithRepetition","OnChange","OnChangeWithRepetition","IfActive","IfActiveWithRepetition","NoSigSendType";
BA_DEF_ SG_ "GenSigStartValue" HEX 0 80000000;
BA_DEF_ BO_ "GenMsgILSupport" ENUM "No","Yes";
BA_DEF_ BO_ "NmAsrMessage" ENUM "No","Yes";
BA_DEF_ SG_ "GenSigFuncType" ENUM "NoFunction","n/a","n/a","n/a","n/a","n/a","n/a","n/a","n/a","n/a","n/a","n/a","n/a","n/a","n/a","CHK","CNTR","n/a","n/a","n/a","CNTR_AR_01","CRC_AR_01_BOTH","CRC_AR_01_ALT","CRC_AR_01_LOW","CRC_AR_01_NIBBLE","CNTR_AR_04","CRC_AR_04A","CNTR_AR_05","CRC_AR_05";
BA_DEF_ SG_ "GenSigDataID" STRING;

BA_DEF_DEF_ "VFrameFormat" "J1939PG";
BA_DEF_DEF_ "CANFD_BRS" "1";
BA_DEF_DEF_ "GenSigStartValue" 0;
BA_DEF_DEF_ "GenSigSendType" "NoSigSendType";
BA_DEF_DEF_ "GenMsgCycleTime" 0;
BA_DEF_DEF_ "GenMsgDelayTime" 0;
BA_DEF_DEF_ "GenMsgStartDelayTime" 0;
BA_DEF_DEF_ "GenMsgSendType" "NoMsgSendType";
BA_DEF_DEF_ "GenMsgILSupport" "Yes";
BA_DEF_DEF_ "NmAsrMessage" "No";
BA_DEF_DEF_ "GenSigFuncType" "NoFunction";
BA_DEF_DEF_ "GenSigDataID" "";
// Frame: FLRSafetyCANFD2Frame20
BA_ "VFrameFormat" BO_ 342 14;
BA_ "GenMsgSendType" BO_ 342 0;
BA_ "GenMsgCycleTime" BO_ 342 50.000;
BA_ "GenSigStartValue" SG_ 342 FrntRdrDetn115RdrDetnAzi 900;
BA_ "GenSigSendType" SG_ 342 FrntRdrDetn115RdrDetnAzi 0;
BA_ "GenSigSendType" SG_ 342 FrntRdrDetn115RdrDetnChks 0;
BA_ "GenSigFuncType" SG_ 342 FrntRdrDetn115RdrDetnChks 15;
BA_ "GenSigDataID" SG_ 342 FrntRdrDetn115RdrDetnChks "0x77A";
BA_ "GenSigSendType" SG_ 342 FrntRdrDetn115RdrDetnCntr 0;
BA_ "GenSigFuncType" SG_ 342 FrntRdrDetn115RdrDetnCntr 16;
BA_ "GenSigSendType" SG_ 342 FrntRdrDetn115RdrDetnConf 0;
BA_ "GenSigStartValue" SG_ 342 FrntRdrDetn115RdrDetnElevn 15;
BA_ "GenSigSendType" SG_ 342 FrntRdrDetn115RdrDetnElevn 0;
BA_ "GenSigSendType" SG_ 342 FrntRdrDetn115RdrDetnPwr 0;
BA_ "GenSigStartValue" SG_ 342 FrntRdrDetn115RdrDetnRng 10050;
BA_ "GenSigSendType" SG_ 342 FrntRdrDetn115RdrDetnRng 0;
BA_ "GenSigStartValue" SG_ 342 FrntRdrDetn115RdrDetnRngV 4000;
BA_ "GenSigSendType" SG_ 342 FrntRdrDetn115RdrDetnRngV 0;
BA_ "GenSigStartValue" SG_ 342 FrntRdrDetn115RdrDetnSts 3;
BA_ "GenSigSendType" SG_ 342 FrntRdrDetn115RdrDetnSts 0;
BA_ "GenSigStartValue" SG_ 342 FrntRdrDetn116RdrDetnAzi 900;
BA_ "GenSigSendType" SG_ 342 FrntRdrDetn116RdrDetnAzi 0;
BA_ "GenSigSendType" SG_ 342 FrntRdrDetn116RdrDetnChks 0;
BA_ "GenSigFuncType" SG_ 342 FrntRdrDetn116RdrDetnChks 15;
BA_ "GenSigDataID" SG_ 342 FrntRdrDetn116RdrDetnChks "0x77B";
BA_ "GenSigSendType" SG_ 342 FrntRdrDetn116RdrDetnCntr 0;
BA_ "GenSigFuncType" SG_ 342 FrntRdrDetn116RdrDetnCntr 16;
BA_ "GenSigSendType" SG_ 342 FrntRdrDetn116RdrDetnConf 0;
BA_ "GenSigStartValue" SG_ 342 FrntRdrDetn116RdrDetnElevn 15;
BA_ "GenSigSendType" SG_ 342 FrntRdrDetn116RdrDetnElevn 0;
BA_ "GenSigSendType" SG_ 342 FrntRdrDetn116RdrDetnPwr 0;
BA_ "GenSigStartValue" SG_ 342 FrntRdrDetn116RdrDetnRng 10050;
BA_ "GenSigSendType" SG_ 342 FrntRdrDetn116RdrDetnRng 0;
BA_ "GenSigStartValue" SG_ 342 FrntRdrDetn116RdrDetnRngV 4000;
BA_ "GenSigSendType" SG_ 342 FrntRdrDetn116RdrDetnRngV 0;
BA_ "GenSigStartValue" SG_ 342 FrntRdrDetn116RdrDetnSts 3;
BA_ "GenSigSendType" SG_ 342 FrntRdrDetn116RdrDetnSts 0;
BA_ "GenSigStartValue" SG_ 342 FrntRdrDetn117RdrDetnAzi 900;
BA_ "GenSigSendType" SG_ 342 FrntRdrDetn117RdrDetnAzi 0;
BA_ "GenSigSendType" SG_ 342 FrntRdrDetn117RdrDetnChks 0;
BA_ "GenSigFuncType" SG_ 342 FrntRdrDetn117RdrDetnChks 15;
BA_ "GenSigDataID" SG_ 342 FrntRdrDetn117RdrDetnChks "0x77C";
BA_ "GenSigSendType" SG_ 342 FrntRdrDetn117RdrDetnCntr 0;
BA_ "GenSigFuncType" SG_ 342 FrntRdrDetn117RdrDetnCntr 16;
BA_ "GenSigSendType" SG_ 342 FrntRdrDetn117RdrDetnConf 0;
BA_ "GenSigStartValue" SG_ 342 FrntRdrDetn117RdrDetnElevn 15;
BA_ "GenSigSendType" SG_ 342 FrntRdrDetn117RdrDetnElevn 0;
BA_ "GenSigSendType" SG_ 342 FrntRdrDetn117RdrDetnPwr 0;
BA_ "GenSigStartValue" SG_ 342 FrntRdrDetn117RdrDetnRng 10050;
BA_ "GenSigSendType" SG_ 342 FrntRdrDetn117RdrDetnRng 0;
BA_ "GenSigStartValue" SG_ 342 FrntRdrDetn117RdrDetnRngV 4000;
BA_ "GenSigSendType" SG_ 342 FrntRdrDetn117RdrDetnRngV 0;
BA_ "GenSigStartValue" SG_ 342 FrntRdrDetn117RdrDetnSts 3;
BA_ "GenSigSendType" SG_ 342 FrntRdrDetn117RdrDetnSts 0;
BA_ "GenSigStartValue" SG_ 342 FrntRdrDetn118RdrDetnAzi 900;
BA_ "GenSigSendType" SG_ 342 FrntRdrDetn118RdrDetnAzi 0;
BA_ "GenSigSendType" SG_ 342 FrntRdrDetn118RdrDetnChks 0;
BA_ "GenSigFuncType" SG_ 342 FrntRdrDetn118RdrDetnChks 15;
BA_ "GenSigDataID" SG_ 342 FrntRdrDetn118RdrDetnChks "0x77D";
BA_ "GenSigSendType" SG_ 342 FrntRdrDetn118RdrDetnCntr 0;
BA_ "GenSigFuncType" SG_ 342 FrntRdrDetn118RdrDetnCntr 16;
BA_ "GenSigSendType" SG_ 342 FrntRdrDetn118RdrDetnConf 0;
BA_ "GenSigStartValue" SG_ 342 FrntRdrDetn118RdrDetnElevn 15;
BA_ "GenSigSendType" SG_ 342 FrntRdrDetn118RdrDetnElevn 0;
BA_ "GenSigSendType" SG_ 342 FrntRdrDetn118RdrDetnPwr 0;
BA_ "GenSigStartValue" SG_ 342 FrntRdrDetn118RdrDetnRng 10050;
BA_ "GenSigSendType" SG_ 342 FrntRdrDetn118RdrDetnRng 0;
BA_ "GenSigStartValue" SG_ 342 FrntRdrDetn118RdrDetnRngV 4000;
BA_ "GenSigSendType" SG_ 342 FrntRdrDetn118RdrDetnRngV 0;
BA_ "GenSigStartValue" SG_ 342 FrntRdrDetn118RdrDetnSts 3;
BA_ "GenSigSendType" SG_ 342 FrntRdrDetn118RdrDetnSts 0;
BA_ "GenSigStartValue" SG_ 342 FrntRdrDetn119RdrDetnAzi 900;
BA_ "GenSigSendType" SG_ 342 FrntRdrDetn119RdrDetnAzi 0;
BA_ "GenSigSendType" SG_ 342 FrntRdrDetn119RdrDetnChks 0;
BA_ "GenSigFuncType" SG_ 342 FrntRdrDetn119RdrDetnChks 15;
BA_ "GenSigDataID" SG_ 342 FrntRdrDetn119RdrDetnChks "0x77E";
BA_ "GenSigSendType" SG_ 342 FrntRdrDetn119RdrDetnCntr 0;
BA_ "GenSigFuncType" SG_ 342 FrntRdrDetn119RdrDetnCntr 16;
BA_ "GenSigSendType" SG_ 342 FrntRdrDetn119RdrDetnConf 0;
BA_ "GenSigStartValue" SG_ 342 FrntRdrDetn119RdrDetnElevn 15;
BA_ "GenSigSendType" SG_ 342 FrntRdrDetn119RdrDetnElevn 0;
BA_ "GenSigSendType" SG_ 342 FrntRdrDetn119RdrDetnPwr 0;
BA_ "GenSigStartValue" SG_ 342 FrntRdrDetn119RdrDetnRng 10050;
BA_ "GenSigSendType" SG_ 342 FrntRdrDetn119RdrDetnRng 0;
BA_ "GenSigStartValue" SG_ 342 FrntRdrDetn119RdrDetnRngV 4000;
BA_ "GenSigSendType" SG_ 342 FrntRdrDetn119RdrDetnRngV 0;
BA_ "GenSigStartValue" SG_ 342 FrntRdrDetn119RdrDetnSts 3;
BA_ "GenSigSendType" SG_ 342 FrntRdrDetn119RdrDetnSts 0;
BA_ "GenSigStartValue" SG_ 342 FrntRdrDetn120RdrDetnAzi 900;
BA_ "GenSigSendType" SG_ 342 FrntRdrDetn120RdrDetnAzi 0;
BA_ "GenSigSendType" SG_ 342 FrntRdrDetn120RdrDetnChks 0;
BA_ "GenSigFuncType" SG_ 342 FrntRdrDetn120RdrDetnChks 15;
BA_ "GenSigDataID" SG_ 342 FrntRdrDetn120RdrDetnChks "0x77F";
BA_ "GenSigSendType" SG_ 342 FrntRdrDetn120RdrDetnCntr 0;
BA_ "GenSigFuncType" SG_ 342 FrntRdrDetn120RdrDetnCntr 16;
BA_ "GenSigSendType" SG_ 342 FrntRdrDetn120RdrDetnConf 0;
BA_ "GenSigStartValue" SG_ 342 FrntRdrDetn120RdrDetnElevn 15;
BA_ "GenSigSendType" SG_ 342 FrntRdrDetn120RdrDetnElevn 0;
BA_ "GenSigSendType" SG_ 342 FrntRdrDetn120RdrDetnPwr 0;
BA_ "GenSigStartValue" SG_ 342 FrntRdrDetn120RdrDetnRng 10050;
BA_ "GenSigSendType" SG_ 342 FrntRdrDetn120RdrDetnRng 0;
BA_ "GenSigStartValue" SG_ 342 FrntRdrDetn120RdrDetnRngV 4000;
BA_ "GenSigSendType" SG_ 342 FrntRdrDetn120RdrDetnRngV 0;
BA_ "GenSigStartValue" SG_ 342 FrntRdrDetn120RdrDetnSts 3;
BA_ "GenSigSendType" SG_ 342 FrntRdrDetn120RdrDetnSts 0;
// Frame: FLRSafetyCANFD2Frame21
BA_ "VFrameFormat" BO_ 344 14;
BA_ "GenMsgSendType" BO_ 344 0;
BA_ "GenMsgCycleTime" BO_ 344 50.000;
BA_ "GenSigStartValue" SG_ 344 FrntRdrDetn121RdrDetnAzi 900;
BA_ "GenSigSendType" SG_ 344 FrntRdrDetn121RdrDetnAzi 0;
BA_ "GenSigSendType" SG_ 344 FrntRdrDetn121RdrDetnChks 0;
BA_ "GenSigFuncType" SG_ 344 FrntRdrDetn121RdrDetnChks 15;
BA_ "GenSigDataID" SG_ 344 FrntRdrDetn121RdrDetnChks "0x780";
BA_ "GenSigSendType" SG_ 344 FrntRdrDetn121RdrDetnCntr 0;
BA_ "GenSigFuncType" SG_ 344 FrntRdrDetn121RdrDetnCntr 16;
BA_ "GenSigSendType" SG_ 344 FrntRdrDetn121RdrDetnConf 0;
BA_ "GenSigStartValue" SG_ 344 FrntRdrDetn121RdrDetnElevn 15;
BA_ "GenSigSendType" SG_ 344 FrntRdrDetn121RdrDetnElevn 0;
BA_ "GenSigSendType" SG_ 344 FrntRdrDetn121RdrDetnPwr 0;
BA_ "GenSigStartValue" SG_ 344 FrntRdrDetn121RdrDetnRng 10050;
BA_ "GenSigSendType" SG_ 344 FrntRdrDetn121RdrDetnRng 0;
BA_ "GenSigStartValue" SG_ 344 FrntRdrDetn121RdrDetnRngV 4000;
BA_ "GenSigSendType" SG_ 344 FrntRdrDetn121RdrDetnRngV 0;
BA_ "GenSigStartValue" SG_ 344 FrntRdrDetn121RdrDetnSts 3;
BA_ "GenSigSendType" SG_ 344 FrntRdrDetn121RdrDetnSts 0;
BA_ "GenSigStartValue" SG_ 344 FrntRdrDetn122RdrDetnAzi 900;
BA_ "GenSigSendType" SG_ 344 FrntRdrDetn122RdrDetnAzi 0;
BA_ "GenSigSendType" SG_ 344 FrntRdrDetn122RdrDetnChks 0;
BA_ "GenSigFuncType" SG_ 344 FrntRdrDetn122RdrDetnChks 15;
BA_ "GenSigDataID" SG_ 344 FrntRdrDetn122RdrDetnChks "0x781";
BA_ "GenSigSendType" SG_ 344 FrntRdrDetn122RdrDetnCntr 0;
BA_ "GenSigFuncType" SG_ 344 FrntRdrDetn122RdrDetnCntr 16;
BA_ "GenSigSendType" SG_ 344 FrntRdrDetn122RdrDetnConf 0;
BA_ "GenSigStartValue" SG_ 344 FrntRdrDetn122RdrDetnElevn 15;
BA_ "GenSigSendType" SG_ 344 FrntRdrDetn122RdrDetnElevn 0;
BA_ "GenSigSendType" SG_ 344 FrntRdrDetn122RdrDetnPwr 0;
BA_ "GenSigStartValue" SG_ 344 FrntRdrDetn122RdrDetnRng 10050;
BA_ "GenSigSendType" SG_ 344 FrntRdrDetn122RdrDetnRng 0;
BA_ "GenSigStartValue" SG_ 344 FrntRdrDetn122RdrDetnRngV 4000;
BA_ "GenSigSendType" SG_ 344 FrntRdrDetn122RdrDetnRngV 0;
BA_ "GenSigStartValue" SG_ 344 FrntRdrDetn122RdrDetnSts 3;
BA_ "GenSigSendType" SG_ 344 FrntRdrDetn122RdrDetnSts 0;
BA_ "GenSigStartValue" SG_ 344 FrntRdrDetn123RdrDetnAzi 900;
BA_ "GenSigSendType" SG_ 344 FrntRdrDetn123RdrDetnAzi 0;
BA_ "GenSigSendType" SG_ 344 FrntRdrDetn123RdrDetnChks 0;
BA_ "GenSigFuncType" SG_ 344 FrntRdrDetn123RdrDetnChks 15;
BA_ "GenSigDataID" SG_ 344 FrntRdrDetn123RdrDetnChks "0x782";
BA_ "GenSigSendType" SG_ 344 FrntRdrDetn123RdrDetnCntr 0;
BA_ "GenSigFuncType" SG_ 344 FrntRdrDetn123RdrDetnCntr 16;
BA_ "GenSigSendType" SG_ 344 FrntRdrDetn123RdrDetnConf 0;
BA_ "GenSigStartValue" SG_ 344 FrntRdrDetn123RdrDetnElevn 15;
BA_ "GenSigSendType" SG_ 344 FrntRdrDetn123RdrDetnElevn 0;
BA_ "GenSigSendType" SG_ 344 FrntRdrDetn123RdrDetnPwr 0;
BA_ "GenSigStartValue" SG_ 344 FrntRdrDetn123RdrDetnRng 10050;
BA_ "GenSigSendType" SG_ 344 FrntRdrDetn123RdrDetnRng 0;
BA_ "GenSigStartValue" SG_ 344 FrntRdrDetn123RdrDetnRngV 4000;
BA_ "GenSigSendType" SG_ 344 FrntRdrDetn123RdrDetnRngV 0;
BA_ "GenSigStartValue" SG_ 344 FrntRdrDetn123RdrDetnSts 3;
BA_ "GenSigSendType" SG_ 344 FrntRdrDetn123RdrDetnSts 0;
BA_ "GenSigStartValue" SG_ 344 FrntRdrDetn124RdrDetnAzi 900;
BA_ "GenSigSendType" SG_ 344 FrntRdrDetn124RdrDetnAzi 0;
BA_ "GenSigSendType" SG_ 344 FrntRdrDetn124RdrDetnChks 0;
BA_ "GenSigFuncType" SG_ 344 FrntRdrDetn124RdrDetnChks 15;
BA_ "GenSigDataID" SG_ 344 FrntRdrDetn124RdrDetnChks "0x783";
BA_ "GenSigSendType" SG_ 344 FrntRdrDetn124RdrDetnCntr 0;
BA_ "GenSigFuncType" SG_ 344 FrntRdrDetn124RdrDetnCntr 16;
BA_ "GenSigSendType" SG_ 344 FrntRdrDetn124RdrDetnConf 0;
BA_ "GenSigStartValue" SG_ 344 FrntRdrDetn124RdrDetnElevn 15;
BA_ "GenSigSendType" SG_ 344 FrntRdrDetn124RdrDetnElevn 0;
BA_ "GenSigSendType" SG_ 344 FrntRdrDetn124RdrDetnPwr 0;
BA_ "GenSigStartValue" SG_ 344 FrntRdrDetn124RdrDetnRng 10050;
BA_ "GenSigSendType" SG_ 344 FrntRdrDetn124RdrDetnRng 0;
BA_ "GenSigStartValue" SG_ 344 FrntRdrDetn124RdrDetnRngV 4000;
BA_ "GenSigSendType" SG_ 344 FrntRdrDetn124RdrDetnRngV 0;
BA_ "GenSigStartValue" SG_ 344 FrntRdrDetn124RdrDetnSts 3;
BA_ "GenSigSendType" SG_ 344 FrntRdrDetn124RdrDetnSts 0;
BA_ "GenSigStartValue" SG_ 344 FrntRdrDetn125RdrDetnAzi 900;
BA_ "GenSigSendType" SG_ 344 FrntRdrDetn125RdrDetnAzi 0;
BA_ "GenSigSendType" SG_ 344 FrntRdrDetn125RdrDetnChks 0;
BA_ "GenSigFuncType" SG_ 344 FrntRdrDetn125RdrDetnChks 15;
BA_ "GenSigDataID" SG_ 344 FrntRdrDetn125RdrDetnChks "0x784";
BA_ "GenSigSendType" SG_ 344 FrntRdrDetn125RdrDetnCntr 0;
BA_ "GenSigFuncType" SG_ 344 FrntRdrDetn125RdrDetnCntr 16;
BA_ "GenSigSendType" SG_ 344 FrntRdrDetn125RdrDetnConf 0;
BA_ "GenSigStartValue" SG_ 344 FrntRdrDetn125RdrDetnElevn 15;
BA_ "GenSigSendType" SG_ 344 FrntRdrDetn125RdrDetnElevn 0;
BA_ "GenSigSendType" SG_ 344 FrntRdrDetn125RdrDetnPwr 0;
BA_ "GenSigStartValue" SG_ 344 FrntRdrDetn125RdrDetnRng 10050;
BA_ "GenSigSendType" SG_ 344 FrntRdrDetn125RdrDetnRng 0;
BA_ "GenSigStartValue" SG_ 344 FrntRdrDetn125RdrDetnRngV 4000;
BA_ "GenSigSendType" SG_ 344 FrntRdrDetn125RdrDetnRngV 0;
BA_ "GenSigStartValue" SG_ 344 FrntRdrDetn125RdrDetnSts 3;
BA_ "GenSigSendType" SG_ 344 FrntRdrDetn125RdrDetnSts 0;
BA_ "GenSigStartValue" SG_ 344 FrntRdrDetn126RdrDetnAzi 900;
BA_ "GenSigSendType" SG_ 344 FrntRdrDetn126RdrDetnAzi 0;
BA_ "GenSigSendType" SG_ 344 FrntRdrDetn126RdrDetnChks 0;
BA_ "GenSigFuncType" SG_ 344 FrntRdrDetn126RdrDetnChks 15;
BA_ "GenSigDataID" SG_ 344 FrntRdrDetn126RdrDetnChks "0x785";
BA_ "GenSigSendType" SG_ 344 FrntRdrDetn126RdrDetnCntr 0;
BA_ "GenSigFuncType" SG_ 344 FrntRdrDetn126RdrDetnCntr 16;
BA_ "GenSigSendType" SG_ 344 FrntRdrDetn126RdrDetnConf 0;
BA_ "GenSigStartValue" SG_ 344 FrntRdrDetn126RdrDetnElevn 15;
BA_ "GenSigSendType" SG_ 344 FrntRdrDetn126RdrDetnElevn 0;
BA_ "GenSigSendType" SG_ 344 FrntRdrDetn126RdrDetnPwr 0;
BA_ "GenSigStartValue" SG_ 344 FrntRdrDetn126RdrDetnRng 10050;
BA_ "GenSigSendType" SG_ 344 FrntRdrDetn126RdrDetnRng 0;
BA_ "GenSigStartValue" SG_ 344 FrntRdrDetn126RdrDetnRngV 4000;
BA_ "GenSigSendType" SG_ 344 FrntRdrDetn126RdrDetnRngV 0;
BA_ "GenSigStartValue" SG_ 344 FrntRdrDetn126RdrDetnSts 3;
BA_ "GenSigSendType" SG_ 344 FrntRdrDetn126RdrDetnSts 0;
// Frame: FLRSafetyCANFD2Frame22
BA_ "VFrameFormat" BO_ 346 14;
BA_ "GenMsgSendType" BO_ 346 0;
BA_ "GenMsgCycleTime" BO_ 346 50.000;
BA_ "GenSigStartValue" SG_ 346 FrntRdrDetn127RdrDetnAzi 900;
BA_ "GenSigSendType" SG_ 346 FrntRdrDetn127RdrDetnAzi 0;
BA_ "GenSigSendType" SG_ 346 FrntRdrDetn127RdrDetnChks 0;
BA_ "GenSigFuncType" SG_ 346 FrntRdrDetn127RdrDetnChks 15;
BA_ "GenSigDataID" SG_ 346 FrntRdrDetn127RdrDetnChks "0x786";
BA_ "GenSigSendType" SG_ 346 FrntRdrDetn127RdrDetnCntr 0;
BA_ "GenSigFuncType" SG_ 346 FrntRdrDetn127RdrDetnCntr 16;
BA_ "GenSigSendType" SG_ 346 FrntRdrDetn127RdrDetnConf 0;
BA_ "GenSigStartValue" SG_ 346 FrntRdrDetn127RdrDetnElevn 15;
BA_ "GenSigSendType" SG_ 346 FrntRdrDetn127RdrDetnElevn 0;
BA_ "GenSigSendType" SG_ 346 FrntRdrDetn127RdrDetnPwr 0;
BA_ "GenSigStartValue" SG_ 346 FrntRdrDetn127RdrDetnRng 10050;
BA_ "GenSigSendType" SG_ 346 FrntRdrDetn127RdrDetnRng 0;
BA_ "GenSigStartValue" SG_ 346 FrntRdrDetn127RdrDetnRngV 4000;
BA_ "GenSigSendType" SG_ 346 FrntRdrDetn127RdrDetnRngV 0;
BA_ "GenSigStartValue" SG_ 346 FrntRdrDetn127RdrDetnSts 3;
BA_ "GenSigSendType" SG_ 346 FrntRdrDetn127RdrDetnSts 0;
BA_ "GenSigStartValue" SG_ 346 FrntRdrDetn128RdrDetnAzi 900;
BA_ "GenSigSendType" SG_ 346 FrntRdrDetn128RdrDetnAzi 0;
BA_ "GenSigSendType" SG_ 346 FrntRdrDetn128RdrDetnChks 0;
BA_ "GenSigFuncType" SG_ 346 FrntRdrDetn128RdrDetnChks 15;
BA_ "GenSigDataID" SG_ 346 FrntRdrDetn128RdrDetnChks "0x787";
BA_ "GenSigSendType" SG_ 346 FrntRdrDetn128RdrDetnCntr 0;
BA_ "GenSigFuncType" SG_ 346 FrntRdrDetn128RdrDetnCntr 16;
BA_ "GenSigSendType" SG_ 346 FrntRdrDetn128RdrDetnConf 0;
BA_ "GenSigStartValue" SG_ 346 FrntRdrDetn128RdrDetnElevn 15;
BA_ "GenSigSendType" SG_ 346 FrntRdrDetn128RdrDetnElevn 0;
BA_ "GenSigSendType" SG_ 346 FrntRdrDetn128RdrDetnPwr 0;
BA_ "GenSigStartValue" SG_ 346 FrntRdrDetn128RdrDetnRng 10050;
BA_ "GenSigSendType" SG_ 346 FrntRdrDetn128RdrDetnRng 0;
BA_ "GenSigStartValue" SG_ 346 FrntRdrDetn128RdrDetnRngV 4000;
BA_ "GenSigSendType" SG_ 346 FrntRdrDetn128RdrDetnRngV 0;
BA_ "GenSigStartValue" SG_ 346 FrntRdrDetn128RdrDetnSts 3;
BA_ "GenSigSendType" SG_ 346 FrntRdrDetn128RdrDetnSts 0;
BA_ "GenSigStartValue" SG_ 346 FrntRdrDetn129RdrDetnAzi 900;
BA_ "GenSigSendType" SG_ 346 FrntRdrDetn129RdrDetnAzi 0;
BA_ "GenSigSendType" SG_ 346 FrntRdrDetn129RdrDetnChks 0;
BA_ "GenSigFuncType" SG_ 346 FrntRdrDetn129RdrDetnChks 15;
BA_ "GenSigDataID" SG_ 346 FrntRdrDetn129RdrDetnChks "0x788";
BA_ "GenSigSendType" SG_ 346 FrntRdrDetn129RdrDetnCntr 0;
BA_ "GenSigFuncType" SG_ 346 FrntRdrDetn129RdrDetnCntr 16;
BA_ "GenSigSendType" SG_ 346 FrntRdrDetn129RdrDetnConf 0;
BA_ "GenSigStartValue" SG_ 346 FrntRdrDetn129RdrDetnElevn 15;
BA_ "GenSigSendType" SG_ 346 FrntRdrDetn129RdrDetnElevn 0;
BA_ "GenSigSendType" SG_ 346 FrntRdrDetn129RdrDetnPwr 0;
BA_ "GenSigStartValue" SG_ 346 FrntRdrDetn129RdrDetnRng 10050;
BA_ "GenSigSendType" SG_ 346 FrntRdrDetn129RdrDetnRng 0;
BA_ "GenSigStartValue" SG_ 346 FrntRdrDetn129RdrDetnRngV 4000;
BA_ "GenSigSendType" SG_ 346 FrntRdrDetn129RdrDetnRngV 0;
BA_ "GenSigStartValue" SG_ 346 FrntRdrDetn129RdrDetnSts 3;
BA_ "GenSigSendType" SG_ 346 FrntRdrDetn129RdrDetnSts 0;
BA_ "GenSigStartValue" SG_ 346 FrntRdrDetn130RdrDetnAzi 900;
BA_ "GenSigSendType" SG_ 346 FrntRdrDetn130RdrDetnAzi 0;
BA_ "GenSigSendType" SG_ 346 FrntRdrDetn130RdrDetnChks 0;
BA_ "GenSigFuncType" SG_ 346 FrntRdrDetn130RdrDetnChks 15;
BA_ "GenSigDataID" SG_ 346 FrntRdrDetn130RdrDetnChks "0x789";
BA_ "GenSigSendType" SG_ 346 FrntRdrDetn130RdrDetnCntr 0;
BA_ "GenSigFuncType" SG_ 346 FrntRdrDetn130RdrDetnCntr 16;
BA_ "GenSigSendType" SG_ 346 FrntRdrDetn130RdrDetnConf 0;
BA_ "GenSigStartValue" SG_ 346 FrntRdrDetn130RdrDetnElevn 15;
BA_ "GenSigSendType" SG_ 346 FrntRdrDetn130RdrDetnElevn 0;
BA_ "GenSigSendType" SG_ 346 FrntRdrDetn130RdrDetnPwr 0;
BA_ "GenSigStartValue" SG_ 346 FrntRdrDetn130RdrDetnRng 10050;
BA_ "GenSigSendType" SG_ 346 FrntRdrDetn130RdrDetnRng 0;
BA_ "GenSigStartValue" SG_ 346 FrntRdrDetn130RdrDetnRngV 4000;
BA_ "GenSigSendType" SG_ 346 FrntRdrDetn130RdrDetnRngV 0;
BA_ "GenSigStartValue" SG_ 346 FrntRdrDetn130RdrDetnSts 3;
BA_ "GenSigSendType" SG_ 346 FrntRdrDetn130RdrDetnSts 0;
BA_ "GenSigStartValue" SG_ 346 FrntRdrDetn131RdrDetnAzi 900;
BA_ "GenSigSendType" SG_ 346 FrntRdrDetn131RdrDetnAzi 0;
BA_ "GenSigSendType" SG_ 346 FrntRdrDetn131RdrDetnChks 0;
BA_ "GenSigFuncType" SG_ 346 FrntRdrDetn131RdrDetnChks 15;
BA_ "GenSigDataID" SG_ 346 FrntRdrDetn131RdrDetnChks "0x78A";
BA_ "GenSigSendType" SG_ 346 FrntRdrDetn131RdrDetnCntr 0;
BA_ "GenSigFuncType" SG_ 346 FrntRdrDetn131RdrDetnCntr 16;
BA_ "GenSigSendType" SG_ 346 FrntRdrDetn131RdrDetnConf 0;
BA_ "GenSigStartValue" SG_ 346 FrntRdrDetn131RdrDetnElevn 15;
BA_ "GenSigSendType" SG_ 346 FrntRdrDetn131RdrDetnElevn 0;
BA_ "GenSigSendType" SG_ 346 FrntRdrDetn131RdrDetnPwr 0;
BA_ "GenSigStartValue" SG_ 346 FrntRdrDetn131RdrDetnRng 10050;
BA_ "GenSigSendType" SG_ 346 FrntRdrDetn131RdrDetnRng 0;
BA_ "GenSigStartValue" SG_ 346 FrntRdrDetn131RdrDetnRngV 4000;
BA_ "GenSigSendType" SG_ 346 FrntRdrDetn131RdrDetnRngV 0;
BA_ "GenSigStartValue" SG_ 346 FrntRdrDetn131RdrDetnSts 3;
BA_ "GenSigSendType" SG_ 346 FrntRdrDetn131RdrDetnSts 0;
BA_ "GenSigStartValue" SG_ 346 FrntRdrDetn132RdrDetnAzi 900;
BA_ "GenSigSendType" SG_ 346 FrntRdrDetn132RdrDetnAzi 0;
BA_ "GenSigSendType" SG_ 346 FrntRdrDetn132RdrDetnChks 0;
BA_ "GenSigFuncType" SG_ 346 FrntRdrDetn132RdrDetnChks 15;
BA_ "GenSigDataID" SG_ 346 FrntRdrDetn132RdrDetnChks "0x78B";
BA_ "GenSigSendType" SG_ 346 FrntRdrDetn132RdrDetnCntr 0;
BA_ "GenSigFuncType" SG_ 346 FrntRdrDetn132RdrDetnCntr 16;
BA_ "GenSigSendType" SG_ 346 FrntRdrDetn132RdrDetnConf 0;
BA_ "GenSigStartValue" SG_ 346 FrntRdrDetn132RdrDetnElevn 15;
BA_ "GenSigSendType" SG_ 346 FrntRdrDetn132RdrDetnElevn 0;
BA_ "GenSigSendType" SG_ 346 FrntRdrDetn132RdrDetnPwr 0;
BA_ "GenSigStartValue" SG_ 346 FrntRdrDetn132RdrDetnRng 10050;
BA_ "GenSigSendType" SG_ 346 FrntRdrDetn132RdrDetnRng 0;
BA_ "GenSigStartValue" SG_ 346 FrntRdrDetn132RdrDetnRngV 4000;
BA_ "GenSigSendType" SG_ 346 FrntRdrDetn132RdrDetnRngV 0;
BA_ "GenSigStartValue" SG_ 346 FrntRdrDetn132RdrDetnSts 3;
BA_ "GenSigSendType" SG_ 346 FrntRdrDetn132RdrDetnSts 0;
// Frame: FLRSafetyCANFD2Frame23
BA_ "VFrameFormat" BO_ 348 14;
BA_ "GenMsgSendType" BO_ 348 0;
BA_ "GenMsgCycleTime" BO_ 348 50.000;
BA_ "GenSigStartValue" SG_ 348 FrntRdrDetn133RdrDetnAzi 900;
BA_ "GenSigSendType" SG_ 348 FrntRdrDetn133RdrDetnAzi 0;
BA_ "GenSigSendType" SG_ 348 FrntRdrDetn133RdrDetnChks 0;
BA_ "GenSigFuncType" SG_ 348 FrntRdrDetn133RdrDetnChks 15;
BA_ "GenSigDataID" SG_ 348 FrntRdrDetn133RdrDetnChks "0x78C";
BA_ "GenSigSendType" SG_ 348 FrntRdrDetn133RdrDetnCntr 0;
BA_ "GenSigFuncType" SG_ 348 FrntRdrDetn133RdrDetnCntr 16;
BA_ "GenSigSendType" SG_ 348 FrntRdrDetn133RdrDetnConf 0;
BA_ "GenSigStartValue" SG_ 348 FrntRdrDetn133RdrDetnElevn 15;
BA_ "GenSigSendType" SG_ 348 FrntRdrDetn133RdrDetnElevn 0;
BA_ "GenSigSendType" SG_ 348 FrntRdrDetn133RdrDetnPwr 0;
BA_ "GenSigStartValue" SG_ 348 FrntRdrDetn133RdrDetnRng 10050;
BA_ "GenSigSendType" SG_ 348 FrntRdrDetn133RdrDetnRng 0;
BA_ "GenSigStartValue" SG_ 348 FrntRdrDetn133RdrDetnRngV 4000;
BA_ "GenSigSendType" SG_ 348 FrntRdrDetn133RdrDetnRngV 0;
BA_ "GenSigStartValue" SG_ 348 FrntRdrDetn133RdrDetnSts 3;
BA_ "GenSigSendType" SG_ 348 FrntRdrDetn133RdrDetnSts 0;
BA_ "GenSigStartValue" SG_ 348 FrntRdrDetn134RdrDetnAzi 900;
BA_ "GenSigSendType" SG_ 348 FrntRdrDetn134RdrDetnAzi 0;
BA_ "GenSigSendType" SG_ 348 FrntRdrDetn134RdrDetnChks 0;
BA_ "GenSigFuncType" SG_ 348 FrntRdrDetn134RdrDetnChks 15;
BA_ "GenSigDataID" SG_ 348 FrntRdrDetn134RdrDetnChks "0x78D";
BA_ "GenSigSendType" SG_ 348 FrntRdrDetn134RdrDetnCntr 0;
BA_ "GenSigFuncType" SG_ 348 FrntRdrDetn134RdrDetnCntr 16;
BA_ "GenSigSendType" SG_ 348 FrntRdrDetn134RdrDetnConf 0;
BA_ "GenSigStartValue" SG_ 348 FrntRdrDetn134RdrDetnElevn 15;
BA_ "GenSigSendType" SG_ 348 FrntRdrDetn134RdrDetnElevn 0;
BA_ "GenSigSendType" SG_ 348 FrntRdrDetn134RdrDetnPwr 0;
BA_ "GenSigStartValue" SG_ 348 FrntRdrDetn134RdrDetnRng 10050;
BA_ "GenSigSendType" SG_ 348 FrntRdrDetn134RdrDetnRng 0;
BA_ "GenSigStartValue" SG_ 348 FrntRdrDetn134RdrDetnRngV 4000;
BA_ "GenSigSendType" SG_ 348 FrntRdrDetn134RdrDetnRngV 0;
BA_ "GenSigStartValue" SG_ 348 FrntRdrDetn134RdrDetnSts 3;
BA_ "GenSigSendType" SG_ 348 FrntRdrDetn134RdrDetnSts 0;
BA_ "GenSigStartValue" SG_ 348 FrntRdrDetn135RdrDetnAzi 900;
BA_ "GenSigSendType" SG_ 348 FrntRdrDetn135RdrDetnAzi 0;
BA_ "GenSigSendType" SG_ 348 FrntRdrDetn135RdrDetnChks 0;
BA_ "GenSigFuncType" SG_ 348 FrntRdrDetn135RdrDetnChks 15;
BA_ "GenSigDataID" SG_ 348 FrntRdrDetn135RdrDetnChks "0x78E";
BA_ "GenSigSendType" SG_ 348 FrntRdrDetn135RdrDetnCntr 0;
BA_ "GenSigFuncType" SG_ 348 FrntRdrDetn135RdrDetnCntr 16;
BA_ "GenSigSendType" SG_ 348 FrntRdrDetn135RdrDetnConf 0;
BA_ "GenSigStartValue" SG_ 348 FrntRdrDetn135RdrDetnElevn 15;
BA_ "GenSigSendType" SG_ 348 FrntRdrDetn135RdrDetnElevn 0;
BA_ "GenSigSendType" SG_ 348 FrntRdrDetn135RdrDetnPwr 0;
BA_ "GenSigStartValue" SG_ 348 FrntRdrDetn135RdrDetnRng 10050;
BA_ "GenSigSendType" SG_ 348 FrntRdrDetn135RdrDetnRng 0;
BA_ "GenSigStartValue" SG_ 348 FrntRdrDetn135RdrDetnRngV 4000;
BA_ "GenSigSendType" SG_ 348 FrntRdrDetn135RdrDetnRngV 0;
BA_ "GenSigStartValue" SG_ 348 FrntRdrDetn135RdrDetnSts 3;
BA_ "GenSigSendType" SG_ 348 FrntRdrDetn135RdrDetnSts 0;
BA_ "GenSigStartValue" SG_ 348 FrntRdrDetn136RdrDetnAzi 900;
BA_ "GenSigSendType" SG_ 348 FrntRdrDetn136RdrDetnAzi 0;
BA_ "GenSigSendType" SG_ 348 FrntRdrDetn136RdrDetnChks 0;
BA_ "GenSigFuncType" SG_ 348 FrntRdrDetn136RdrDetnChks 15;
BA_ "GenSigDataID" SG_ 348 FrntRdrDetn136RdrDetnChks "0x78F";
BA_ "GenSigSendType" SG_ 348 FrntRdrDetn136RdrDetnCntr 0;
BA_ "GenSigFuncType" SG_ 348 FrntRdrDetn136RdrDetnCntr 16;
BA_ "GenSigSendType" SG_ 348 FrntRdrDetn136RdrDetnConf 0;
BA_ "GenSigStartValue" SG_ 348 FrntRdrDetn136RdrDetnElevn 15;
BA_ "GenSigSendType" SG_ 348 FrntRdrDetn136RdrDetnElevn 0;
BA_ "GenSigSendType" SG_ 348 FrntRdrDetn136RdrDetnPwr 0;
BA_ "GenSigStartValue" SG_ 348 FrntRdrDetn136RdrDetnRng 10050;
BA_ "GenSigSendType" SG_ 348 FrntRdrDetn136RdrDetnRng 0;
BA_ "GenSigStartValue" SG_ 348 FrntRdrDetn136RdrDetnRngV 4000;
BA_ "GenSigSendType" SG_ 348 FrntRdrDetn136RdrDetnRngV 0;
BA_ "GenSigStartValue" SG_ 348 FrntRdrDetn136RdrDetnSts 3;
BA_ "GenSigSendType" SG_ 348 FrntRdrDetn136RdrDetnSts 0;
BA_ "GenSigStartValue" SG_ 348 FrntRdrDetn137RdrDetnAzi 900;
BA_ "GenSigSendType" SG_ 348 FrntRdrDetn137RdrDetnAzi 0;
BA_ "GenSigSendType" SG_ 348 FrntRdrDetn137RdrDetnChks 0;
BA_ "GenSigFuncType" SG_ 348 FrntRdrDetn137RdrDetnChks 15;
BA_ "GenSigDataID" SG_ 348 FrntRdrDetn137RdrDetnChks "0x790";
BA_ "GenSigSendType" SG_ 348 FrntRdrDetn137RdrDetnCntr 0;
BA_ "GenSigFuncType" SG_ 348 FrntRdrDetn137RdrDetnCntr 16;
BA_ "GenSigSendType" SG_ 348 FrntRdrDetn137RdrDetnConf 0;
BA_ "GenSigStartValue" SG_ 348 FrntRdrDetn137RdrDetnElevn 15;
BA_ "GenSigSendType" SG_ 348 FrntRdrDetn137RdrDetnElevn 0;
BA_ "GenSigSendType" SG_ 348 FrntRdrDetn137RdrDetnPwr 0;
BA_ "GenSigStartValue" SG_ 348 FrntRdrDetn137RdrDetnRng 10050;
BA_ "GenSigSendType" SG_ 348 FrntRdrDetn137RdrDetnRng 0;
BA_ "GenSigStartValue" SG_ 348 FrntRdrDetn137RdrDetnRngV 4000;
BA_ "GenSigSendType" SG_ 348 FrntRdrDetn137RdrDetnRngV 0;
BA_ "GenSigStartValue" SG_ 348 FrntRdrDetn137RdrDetnSts 3;
BA_ "GenSigSendType" SG_ 348 FrntRdrDetn137RdrDetnSts 0;
BA_ "GenSigStartValue" SG_ 348 FrntRdrDetn138RdrDetnAzi 900;
BA_ "GenSigSendType" SG_ 348 FrntRdrDetn138RdrDetnAzi 0;
BA_ "GenSigSendType" SG_ 348 FrntRdrDetn138RdrDetnChks 0;
BA_ "GenSigFuncType" SG_ 348 FrntRdrDetn138RdrDetnChks 15;
BA_ "GenSigDataID" SG_ 348 FrntRdrDetn138RdrDetnChks "0x791";
BA_ "GenSigSendType" SG_ 348 FrntRdrDetn138RdrDetnCntr 0;
BA_ "GenSigFuncType" SG_ 348 FrntRdrDetn138RdrDetnCntr 16;
BA_ "GenSigSendType" SG_ 348 FrntRdrDetn138RdrDetnConf 0;
BA_ "GenSigStartValue" SG_ 348 FrntRdrDetn138RdrDetnElevn 15;
BA_ "GenSigSendType" SG_ 348 FrntRdrDetn138RdrDetnElevn 0;
BA_ "GenSigSendType" SG_ 348 FrntRdrDetn138RdrDetnPwr 0;
BA_ "GenSigStartValue" SG_ 348 FrntRdrDetn138RdrDetnRng 10050;
BA_ "GenSigSendType" SG_ 348 FrntRdrDetn138RdrDetnRng 0;
BA_ "GenSigStartValue" SG_ 348 FrntRdrDetn138RdrDetnRngV 4000;
BA_ "GenSigSendType" SG_ 348 FrntRdrDetn138RdrDetnRngV 0;
BA_ "GenSigStartValue" SG_ 348 FrntRdrDetn138RdrDetnSts 3;
BA_ "GenSigSendType" SG_ 348 FrntRdrDetn138RdrDetnSts 0;
// Frame: FLRSafetyCANFD2Frame24
BA_ "VFrameFormat" BO_ 350 14;
BA_ "GenMsgSendType" BO_ 350 0;
BA_ "GenMsgCycleTime" BO_ 350 50.000;
BA_ "GenSigStartValue" SG_ 350 FrntRdrDetn139RdrDetnAzi 900;
BA_ "GenSigSendType" SG_ 350 FrntRdrDetn139RdrDetnAzi 0;
BA_ "GenSigSendType" SG_ 350 FrntRdrDetn139RdrDetnChks 0;
BA_ "GenSigFuncType" SG_ 350 FrntRdrDetn139RdrDetnChks 15;
BA_ "GenSigDataID" SG_ 350 FrntRdrDetn139RdrDetnChks "0x792";
BA_ "GenSigSendType" SG_ 350 FrntRdrDetn139RdrDetnCntr 0;
BA_ "GenSigFuncType" SG_ 350 FrntRdrDetn139RdrDetnCntr 16;
BA_ "GenSigSendType" SG_ 350 FrntRdrDetn139RdrDetnConf 0;
BA_ "GenSigStartValue" SG_ 350 FrntRdrDetn139RdrDetnElevn 15;
BA_ "GenSigSendType" SG_ 350 FrntRdrDetn139RdrDetnElevn 0;
BA_ "GenSigSendType" SG_ 350 FrntRdrDetn139RdrDetnPwr 0;
BA_ "GenSigStartValue" SG_ 350 FrntRdrDetn139RdrDetnRng 10050;
BA_ "GenSigSendType" SG_ 350 FrntRdrDetn139RdrDetnRng 0;
BA_ "GenSigStartValue" SG_ 350 FrntRdrDetn139RdrDetnRngV 4000;
BA_ "GenSigSendType" SG_ 350 FrntRdrDetn139RdrDetnRngV 0;
BA_ "GenSigStartValue" SG_ 350 FrntRdrDetn139RdrDetnSts 3;
BA_ "GenSigSendType" SG_ 350 FrntRdrDetn139RdrDetnSts 0;
BA_ "GenSigStartValue" SG_ 350 FrntRdrDetn140RdrDetnAzi 900;
BA_ "GenSigSendType" SG_ 350 FrntRdrDetn140RdrDetnAzi 0;
BA_ "GenSigSendType" SG_ 350 FrntRdrDetn140RdrDetnChks 0;
BA_ "GenSigFuncType" SG_ 350 FrntRdrDetn140RdrDetnChks 15;
BA_ "GenSigDataID" SG_ 350 FrntRdrDetn140RdrDetnChks "0x793";
BA_ "GenSigSendType" SG_ 350 FrntRdrDetn140RdrDetnCntr 0;
BA_ "GenSigFuncType" SG_ 350 FrntRdrDetn140RdrDetnCntr 16;
BA_ "GenSigSendType" SG_ 350 FrntRdrDetn140RdrDetnConf 0;
BA_ "GenSigStartValue" SG_ 350 FrntRdrDetn140RdrDetnElevn 15;
BA_ "GenSigSendType" SG_ 350 FrntRdrDetn140RdrDetnElevn 0;
BA_ "GenSigSendType" SG_ 350 FrntRdrDetn140RdrDetnPwr 0;
BA_ "GenSigStartValue" SG_ 350 FrntRdrDetn140RdrDetnRng 10050;
BA_ "GenSigSendType" SG_ 350 FrntRdrDetn140RdrDetnRng 0;
BA_ "GenSigStartValue" SG_ 350 FrntRdrDetn140RdrDetnRngV 4000;
BA_ "GenSigSendType" SG_ 350 FrntRdrDetn140RdrDetnRngV 0;
BA_ "GenSigStartValue" SG_ 350 FrntRdrDetn140RdrDetnSts 3;
BA_ "GenSigSendType" SG_ 350 FrntRdrDetn140RdrDetnSts 0;
BA_ "GenSigStartValue" SG_ 350 FrntRdrDetn141RdrDetnAzi 900;
BA_ "GenSigSendType" SG_ 350 FrntRdrDetn141RdrDetnAzi 0;
BA_ "GenSigSendType" SG_ 350 FrntRdrDetn141RdrDetnChks 0;
BA_ "GenSigFuncType" SG_ 350 FrntRdrDetn141RdrDetnChks 15;
BA_ "GenSigDataID" SG_ 350 FrntRdrDetn141RdrDetnChks "0x794";
BA_ "GenSigSendType" SG_ 350 FrntRdrDetn141RdrDetnCntr 0;
BA_ "GenSigFuncType" SG_ 350 FrntRdrDetn141RdrDetnCntr 16;
BA_ "GenSigSendType" SG_ 350 FrntRdrDetn141RdrDetnConf 0;
BA_ "GenSigStartValue" SG_ 350 FrntRdrDetn141RdrDetnElevn 15;
BA_ "GenSigSendType" SG_ 350 FrntRdrDetn141RdrDetnElevn 0;
BA_ "GenSigSendType" SG_ 350 FrntRdrDetn141RdrDetnPwr 0;
BA_ "GenSigStartValue" SG_ 350 FrntRdrDetn141RdrDetnRng 10050;
BA_ "GenSigSendType" SG_ 350 FrntRdrDetn141RdrDetnRng 0;
BA_ "GenSigStartValue" SG_ 350 FrntRdrDetn141RdrDetnRngV 4000;
BA_ "GenSigSendType" SG_ 350 FrntRdrDetn141RdrDetnRngV 0;
BA_ "GenSigStartValue" SG_ 350 FrntRdrDetn141RdrDetnSts 3;
BA_ "GenSigSendType" SG_ 350 FrntRdrDetn141RdrDetnSts 0;
BA_ "GenSigStartValue" SG_ 350 FrntRdrDetn142RdrDetnAzi 900;
BA_ "GenSigSendType" SG_ 350 FrntRdrDetn142RdrDetnAzi 0;
BA_ "GenSigSendType" SG_ 350 FrntRdrDetn142RdrDetnChks 0;
BA_ "GenSigFuncType" SG_ 350 FrntRdrDetn142RdrDetnChks 15;
BA_ "GenSigDataID" SG_ 350 FrntRdrDetn142RdrDetnChks "0x795";
BA_ "GenSigSendType" SG_ 350 FrntRdrDetn142RdrDetnCntr 0;
BA_ "GenSigFuncType" SG_ 350 FrntRdrDetn142RdrDetnCntr 16;
BA_ "GenSigSendType" SG_ 350 FrntRdrDetn142RdrDetnConf 0;
BA_ "GenSigStartValue" SG_ 350 FrntRdrDetn142RdrDetnElevn 15;
BA_ "GenSigSendType" SG_ 350 FrntRdrDetn142RdrDetnElevn 0;
BA_ "GenSigSendType" SG_ 350 FrntRdrDetn142RdrDetnPwr 0;
BA_ "GenSigStartValue" SG_ 350 FrntRdrDetn142RdrDetnRng 10050;
BA_ "GenSigSendType" SG_ 350 FrntRdrDetn142RdrDetnRng 0;
BA_ "GenSigStartValue" SG_ 350 FrntRdrDetn142RdrDetnRngV 4000;
BA_ "GenSigSendType" SG_ 350 FrntRdrDetn142RdrDetnRngV 0;
BA_ "GenSigStartValue" SG_ 350 FrntRdrDetn142RdrDetnSts 3;
BA_ "GenSigSendType" SG_ 350 FrntRdrDetn142RdrDetnSts 0;
BA_ "GenSigStartValue" SG_ 350 FrntRdrDetn143RdrDetnAzi 900;
BA_ "GenSigSendType" SG_ 350 FrntRdrDetn143RdrDetnAzi 0;
BA_ "GenSigSendType" SG_ 350 FrntRdrDetn143RdrDetnChks 0;
BA_ "GenSigFuncType" SG_ 350 FrntRdrDetn143RdrDetnChks 15;
BA_ "GenSigDataID" SG_ 350 FrntRdrDetn143RdrDetnChks "0x796";
BA_ "GenSigSendType" SG_ 350 FrntRdrDetn143RdrDetnCntr 0;
BA_ "GenSigFuncType" SG_ 350 FrntRdrDetn143RdrDetnCntr 16;
BA_ "GenSigSendType" SG_ 350 FrntRdrDetn143RdrDetnConf 0;
BA_ "GenSigStartValue" SG_ 350 FrntRdrDetn143RdrDetnElevn 15;
BA_ "GenSigSendType" SG_ 350 FrntRdrDetn143RdrDetnElevn 0;
BA_ "GenSigSendType" SG_ 350 FrntRdrDetn143RdrDetnPwr 0;
BA_ "GenSigStartValue" SG_ 350 FrntRdrDetn143RdrDetnRng 10050;
BA_ "GenSigSendType" SG_ 350 FrntRdrDetn143RdrDetnRng 0;
BA_ "GenSigStartValue" SG_ 350 FrntRdrDetn143RdrDetnRngV 4000;
BA_ "GenSigSendType" SG_ 350 FrntRdrDetn143RdrDetnRngV 0;
BA_ "GenSigStartValue" SG_ 350 FrntRdrDetn143RdrDetnSts 3;
BA_ "GenSigSendType" SG_ 350 FrntRdrDetn143RdrDetnSts 0;
BA_ "GenSigStartValue" SG_ 350 FrntRdrDetn144RdrDetnAzi 900;
BA_ "GenSigSendType" SG_ 350 FrntRdrDetn144RdrDetnAzi 0;
BA_ "GenSigSendType" SG_ 350 FrntRdrDetn144RdrDetnChks 0;
BA_ "GenSigFuncType" SG_ 350 FrntRdrDetn144RdrDetnChks 15;
BA_ "GenSigDataID" SG_ 350 FrntRdrDetn144RdrDetnChks "0x797";
BA_ "GenSigSendType" SG_ 350 FrntRdrDetn144RdrDetnCntr 0;
BA_ "GenSigFuncType" SG_ 350 FrntRdrDetn144RdrDetnCntr 16;
BA_ "GenSigSendType" SG_ 350 FrntRdrDetn144RdrDetnConf 0;
BA_ "GenSigStartValue" SG_ 350 FrntRdrDetn144RdrDetnElevn 15;
BA_ "GenSigSendType" SG_ 350 FrntRdrDetn144RdrDetnElevn 0;
BA_ "GenSigSendType" SG_ 350 FrntRdrDetn144RdrDetnPwr 0;
BA_ "GenSigStartValue" SG_ 350 FrntRdrDetn144RdrDetnRng 10050;
BA_ "GenSigSendType" SG_ 350 FrntRdrDetn144RdrDetnRng 0;
BA_ "GenSigStartValue" SG_ 350 FrntRdrDetn144RdrDetnRngV 4000;
BA_ "GenSigSendType" SG_ 350 FrntRdrDetn144RdrDetnRngV 0;
BA_ "GenSigStartValue" SG_ 350 FrntRdrDetn144RdrDetnSts 3;
BA_ "GenSigSendType" SG_ 350 FrntRdrDetn144RdrDetnSts 0;
// Frame: FLRSafetyCANFD2Frame25
BA_ "VFrameFormat" BO_ 352 14;
BA_ "GenMsgSendType" BO_ 352 0;
BA_ "GenMsgCycleTime" BO_ 352 50.000;
BA_ "GenSigStartValue" SG_ 352 FrntRdrDetn145RdrDetnAzi 900;
BA_ "GenSigSendType" SG_ 352 FrntRdrDetn145RdrDetnAzi 0;
BA_ "GenSigSendType" SG_ 352 FrntRdrDetn145RdrDetnChks 0;
BA_ "GenSigFuncType" SG_ 352 FrntRdrDetn145RdrDetnChks 15;
BA_ "GenSigDataID" SG_ 352 FrntRdrDetn145RdrDetnChks "0x798";
BA_ "GenSigSendType" SG_ 352 FrntRdrDetn145RdrDetnCntr 0;
BA_ "GenSigFuncType" SG_ 352 FrntRdrDetn145RdrDetnCntr 16;
BA_ "GenSigSendType" SG_ 352 FrntRdrDetn145RdrDetnConf 0;
BA_ "GenSigStartValue" SG_ 352 FrntRdrDetn145RdrDetnElevn 15;
BA_ "GenSigSendType" SG_ 352 FrntRdrDetn145RdrDetnElevn 0;
BA_ "GenSigSendType" SG_ 352 FrntRdrDetn145RdrDetnPwr 0;
BA_ "GenSigStartValue" SG_ 352 FrntRdrDetn145RdrDetnRng 10050;
BA_ "GenSigSendType" SG_ 352 FrntRdrDetn145RdrDetnRng 0;
BA_ "GenSigStartValue" SG_ 352 FrntRdrDetn145RdrDetnRngV 4000;
BA_ "GenSigSendType" SG_ 352 FrntRdrDetn145RdrDetnRngV 0;
BA_ "GenSigStartValue" SG_ 352 FrntRdrDetn145RdrDetnSts 3;
BA_ "GenSigSendType" SG_ 352 FrntRdrDetn145RdrDetnSts 0;
BA_ "GenSigStartValue" SG_ 352 FrntRdrDetn146RdrDetnAzi 900;
BA_ "GenSigSendType" SG_ 352 FrntRdrDetn146RdrDetnAzi 0;
BA_ "GenSigSendType" SG_ 352 FrntRdrDetn146RdrDetnChks 0;
BA_ "GenSigFuncType" SG_ 352 FrntRdrDetn146RdrDetnChks 15;
BA_ "GenSigDataID" SG_ 352 FrntRdrDetn146RdrDetnChks "0x799";
BA_ "GenSigSendType" SG_ 352 FrntRdrDetn146RdrDetnCntr 0;
BA_ "GenSigFuncType" SG_ 352 FrntRdrDetn146RdrDetnCntr 16;
BA_ "GenSigSendType" SG_ 352 FrntRdrDetn146RdrDetnConf 0;
BA_ "GenSigStartValue" SG_ 352 FrntRdrDetn146RdrDetnElevn 15;
BA_ "GenSigSendType" SG_ 352 FrntRdrDetn146RdrDetnElevn 0;
BA_ "GenSigSendType" SG_ 352 FrntRdrDetn146RdrDetnPwr 0;
BA_ "GenSigStartValue" SG_ 352 FrntRdrDetn146RdrDetnRng 10050;
BA_ "GenSigSendType" SG_ 352 FrntRdrDetn146RdrDetnRng 0;
BA_ "GenSigStartValue" SG_ 352 FrntRdrDetn146RdrDetnRngV 4000;
BA_ "GenSigSendType" SG_ 352 FrntRdrDetn146RdrDetnRngV 0;
BA_ "GenSigStartValue" SG_ 352 FrntRdrDetn146RdrDetnSts 3;
BA_ "GenSigSendType" SG_ 352 FrntRdrDetn146RdrDetnSts 0;
BA_ "GenSigStartValue" SG_ 352 FrntRdrDetn147RdrDetnAzi 900;
BA_ "GenSigSendType" SG_ 352 FrntRdrDetn147RdrDetnAzi 0;
BA_ "GenSigSendType" SG_ 352 FrntRdrDetn147RdrDetnChks 0;
BA_ "GenSigFuncType" SG_ 352 FrntRdrDetn147RdrDetnChks 15;
BA_ "GenSigDataID" SG_ 352 FrntRdrDetn147RdrDetnChks "0x79A";
BA_ "GenSigSendType" SG_ 352 FrntRdrDetn147RdrDetnCntr 0;
BA_ "GenSigFuncType" SG_ 352 FrntRdrDetn147RdrDetnCntr 16;
BA_ "GenSigSendType" SG_ 352 FrntRdrDetn147RdrDetnConf 0;
BA_ "GenSigStartValue" SG_ 352 FrntRdrDetn147RdrDetnElevn 15;
BA_ "GenSigSendType" SG_ 352 FrntRdrDetn147RdrDetnElevn 0;
BA_ "GenSigSendType" SG_ 352 FrntRdrDetn147RdrDetnPwr 0;
BA_ "GenSigStartValue" SG_ 352 FrntRdrDetn147RdrDetnRng 10050;
BA_ "GenSigSendType" SG_ 352 FrntRdrDetn147RdrDetnRng 0;
BA_ "GenSigStartValue" SG_ 352 FrntRdrDetn147RdrDetnRngV 4000;
BA_ "GenSigSendType" SG_ 352 FrntRdrDetn147RdrDetnRngV 0;
BA_ "GenSigStartValue" SG_ 352 FrntRdrDetn147RdrDetnSts 3;
BA_ "GenSigSendType" SG_ 352 FrntRdrDetn147RdrDetnSts 0;
BA_ "GenSigStartValue" SG_ 352 FrntRdrDetn148RdrDetnAzi 900;
BA_ "GenSigSendType" SG_ 352 FrntRdrDetn148RdrDetnAzi 0;
BA_ "GenSigSendType" SG_ 352 FrntRdrDetn148RdrDetnChks 0;
BA_ "GenSigFuncType" SG_ 352 FrntRdrDetn148RdrDetnChks 15;
BA_ "GenSigDataID" SG_ 352 FrntRdrDetn148RdrDetnChks "0x79B";
BA_ "GenSigSendType" SG_ 352 FrntRdrDetn148RdrDetnCntr 0;
BA_ "GenSigFuncType" SG_ 352 FrntRdrDetn148RdrDetnCntr 16;
BA_ "GenSigSendType" SG_ 352 FrntRdrDetn148RdrDetnConf 0;
BA_ "GenSigStartValue" SG_ 352 FrntRdrDetn148RdrDetnElevn 15;
BA_ "GenSigSendType" SG_ 352 FrntRdrDetn148RdrDetnElevn 0;
BA_ "GenSigSendType" SG_ 352 FrntRdrDetn148RdrDetnPwr 0;
BA_ "GenSigStartValue" SG_ 352 FrntRdrDetn148RdrDetnRng 10050;
BA_ "GenSigSendType" SG_ 352 FrntRdrDetn148RdrDetnRng 0;
BA_ "GenSigStartValue" SG_ 352 FrntRdrDetn148RdrDetnRngV 4000;
BA_ "GenSigSendType" SG_ 352 FrntRdrDetn148RdrDetnRngV 0;
BA_ "GenSigStartValue" SG_ 352 FrntRdrDetn148RdrDetnSts 3;
BA_ "GenSigSendType" SG_ 352 FrntRdrDetn148RdrDetnSts 0;
BA_ "GenSigStartValue" SG_ 352 FrntRdrDetn149RdrDetnAzi 900;
BA_ "GenSigSendType" SG_ 352 FrntRdrDetn149RdrDetnAzi 0;
BA_ "GenSigSendType" SG_ 352 FrntRdrDetn149RdrDetnChks 0;
BA_ "GenSigFuncType" SG_ 352 FrntRdrDetn149RdrDetnChks 15;
BA_ "GenSigDataID" SG_ 352 FrntRdrDetn149RdrDetnChks "0x79C";
BA_ "GenSigSendType" SG_ 352 FrntRdrDetn149RdrDetnCntr 0;
BA_ "GenSigFuncType" SG_ 352 FrntRdrDetn149RdrDetnCntr 16;
BA_ "GenSigSendType" SG_ 352 FrntRdrDetn149RdrDetnConf 0;
BA_ "GenSigStartValue" SG_ 352 FrntRdrDetn149RdrDetnElevn 15;
BA_ "GenSigSendType" SG_ 352 FrntRdrDetn149RdrDetnElevn 0;
BA_ "GenSigSendType" SG_ 352 FrntRdrDetn149RdrDetnPwr 0;
BA_ "GenSigStartValue" SG_ 352 FrntRdrDetn149RdrDetnRng 10050;
BA_ "GenSigSendType" SG_ 352 FrntRdrDetn149RdrDetnRng 0;
BA_ "GenSigStartValue" SG_ 352 FrntRdrDetn149RdrDetnRngV 4000;
BA_ "GenSigSendType" SG_ 352 FrntRdrDetn149RdrDetnRngV 0;
BA_ "GenSigStartValue" SG_ 352 FrntRdrDetn149RdrDetnSts 3;
BA_ "GenSigSendType" SG_ 352 FrntRdrDetn149RdrDetnSts 0;
BA_ "GenSigStartValue" SG_ 352 FrntRdrDetn150RdrDetnAzi 900;
BA_ "GenSigSendType" SG_ 352 FrntRdrDetn150RdrDetnAzi 0;
BA_ "GenSigSendType" SG_ 352 FrntRdrDetn150RdrDetnChks 0;
BA_ "GenSigFuncType" SG_ 352 FrntRdrDetn150RdrDetnChks 15;
BA_ "GenSigDataID" SG_ 352 FrntRdrDetn150RdrDetnChks "0x79D";
BA_ "GenSigSendType" SG_ 352 FrntRdrDetn150RdrDetnCntr 0;
BA_ "GenSigFuncType" SG_ 352 FrntRdrDetn150RdrDetnCntr 16;
BA_ "GenSigSendType" SG_ 352 FrntRdrDetn150RdrDetnConf 0;
BA_ "GenSigStartValue" SG_ 352 FrntRdrDetn150RdrDetnElevn 15;
BA_ "GenSigSendType" SG_ 352 FrntRdrDetn150RdrDetnElevn 0;
BA_ "GenSigSendType" SG_ 352 FrntRdrDetn150RdrDetnPwr 0;
BA_ "GenSigStartValue" SG_ 352 FrntRdrDetn150RdrDetnRng 10050;
BA_ "GenSigSendType" SG_ 352 FrntRdrDetn150RdrDetnRng 0;
BA_ "GenSigStartValue" SG_ 352 FrntRdrDetn150RdrDetnRngV 4000;
BA_ "GenSigSendType" SG_ 352 FrntRdrDetn150RdrDetnRngV 0;
BA_ "GenSigStartValue" SG_ 352 FrntRdrDetn150RdrDetnSts 3;
BA_ "GenSigSendType" SG_ 352 FrntRdrDetn150RdrDetnSts 0;
// Frame: FLRSafetyCANFD2Frame26
BA_ "VFrameFormat" BO_ 354 14;
BA_ "GenMsgSendType" BO_ 354 0;
BA_ "GenMsgCycleTime" BO_ 354 50.000;
BA_ "GenSigStartValue" SG_ 354 FrntRdrDetn151RdrDetnAzi 900;
BA_ "GenSigSendType" SG_ 354 FrntRdrDetn151RdrDetnAzi 0;
BA_ "GenSigSendType" SG_ 354 FrntRdrDetn151RdrDetnChks 0;
BA_ "GenSigFuncType" SG_ 354 FrntRdrDetn151RdrDetnChks 15;
BA_ "GenSigDataID" SG_ 354 FrntRdrDetn151RdrDetnChks "0x79E";
BA_ "GenSigSendType" SG_ 354 FrntRdrDetn151RdrDetnCntr 0;
BA_ "GenSigFuncType" SG_ 354 FrntRdrDetn151RdrDetnCntr 16;
BA_ "GenSigSendType" SG_ 354 FrntRdrDetn151RdrDetnConf 0;
BA_ "GenSigStartValue" SG_ 354 FrntRdrDetn151RdrDetnElevn 15;
BA_ "GenSigSendType" SG_ 354 FrntRdrDetn151RdrDetnElevn 0;
BA_ "GenSigSendType" SG_ 354 FrntRdrDetn151RdrDetnPwr 0;
BA_ "GenSigStartValue" SG_ 354 FrntRdrDetn151RdrDetnRng 10050;
BA_ "GenSigSendType" SG_ 354 FrntRdrDetn151RdrDetnRng 0;
BA_ "GenSigStartValue" SG_ 354 FrntRdrDetn151RdrDetnRngV 4000;
BA_ "GenSigSendType" SG_ 354 FrntRdrDetn151RdrDetnRngV 0;
BA_ "GenSigStartValue" SG_ 354 FrntRdrDetn151RdrDetnSts 3;
BA_ "GenSigSendType" SG_ 354 FrntRdrDetn151RdrDetnSts 0;
BA_ "GenSigStartValue" SG_ 354 FrntRdrDetn152RdrDetnAzi 900;
BA_ "GenSigSendType" SG_ 354 FrntRdrDetn152RdrDetnAzi 0;
BA_ "GenSigSendType" SG_ 354 FrntRdrDetn152RdrDetnChks 0;
BA_ "GenSigFuncType" SG_ 354 FrntRdrDetn152RdrDetnChks 15;
BA_ "GenSigDataID" SG_ 354 FrntRdrDetn152RdrDetnChks "0x79F";
BA_ "GenSigSendType" SG_ 354 FrntRdrDetn152RdrDetnCntr 0;
BA_ "GenSigFuncType" SG_ 354 FrntRdrDetn152RdrDetnCntr 16;
BA_ "GenSigSendType" SG_ 354 FrntRdrDetn152RdrDetnConf 0;
BA_ "GenSigStartValue" SG_ 354 FrntRdrDetn152RdrDetnElevn 15;
BA_ "GenSigSendType" SG_ 354 FrntRdrDetn152RdrDetnElevn 0;
BA_ "GenSigSendType" SG_ 354 FrntRdrDetn152RdrDetnPwr 0;
BA_ "GenSigStartValue" SG_ 354 FrntRdrDetn152RdrDetnRng 10050;
BA_ "GenSigSendType" SG_ 354 FrntRdrDetn152RdrDetnRng 0;
BA_ "GenSigStartValue" SG_ 354 FrntRdrDetn152RdrDetnRngV 4000;
BA_ "GenSigSendType" SG_ 354 FrntRdrDetn152RdrDetnRngV 0;
BA_ "GenSigStartValue" SG_ 354 FrntRdrDetn152RdrDetnSts 3;
BA_ "GenSigSendType" SG_ 354 FrntRdrDetn152RdrDetnSts 0;
BA_ "GenSigStartValue" SG_ 354 FrntRdrDetn153RdrDetnAzi 900;
BA_ "GenSigSendType" SG_ 354 FrntRdrDetn153RdrDetnAzi 0;
BA_ "GenSigSendType" SG_ 354 FrntRdrDetn153RdrDetnChks 0;
BA_ "GenSigFuncType" SG_ 354 FrntRdrDetn153RdrDetnChks 15;
BA_ "GenSigDataID" SG_ 354 FrntRdrDetn153RdrDetnChks "0x7A0";
BA_ "GenSigSendType" SG_ 354 FrntRdrDetn153RdrDetnCntr 0;
BA_ "GenSigFuncType" SG_ 354 FrntRdrDetn153RdrDetnCntr 16;
BA_ "GenSigSendType" SG_ 354 FrntRdrDetn153RdrDetnConf 0;
BA_ "GenSigStartValue" SG_ 354 FrntRdrDetn153RdrDetnElevn 15;
BA_ "GenSigSendType" SG_ 354 FrntRdrDetn153RdrDetnElevn 0;
BA_ "GenSigSendType" SG_ 354 FrntRdrDetn153RdrDetnPwr 0;
BA_ "GenSigStartValue" SG_ 354 FrntRdrDetn153RdrDetnRng 10050;
BA_ "GenSigSendType" SG_ 354 FrntRdrDetn153RdrDetnRng 0;
BA_ "GenSigStartValue" SG_ 354 FrntRdrDetn153RdrDetnRngV 4000;
BA_ "GenSigSendType" SG_ 354 FrntRdrDetn153RdrDetnRngV 0;
BA_ "GenSigStartValue" SG_ 354 FrntRdrDetn153RdrDetnSts 3;
BA_ "GenSigSendType" SG_ 354 FrntRdrDetn153RdrDetnSts 0;
BA_ "GenSigStartValue" SG_ 354 FrntRdrDetn154RdrDetnAzi 900;
BA_ "GenSigSendType" SG_ 354 FrntRdrDetn154RdrDetnAzi 0;
BA_ "GenSigSendType" SG_ 354 FrntRdrDetn154RdrDetnChks 0;
BA_ "GenSigFuncType" SG_ 354 FrntRdrDetn154RdrDetnChks 15;
BA_ "GenSigDataID" SG_ 354 FrntRdrDetn154RdrDetnChks "0x7A1";
BA_ "GenSigSendType" SG_ 354 FrntRdrDetn154RdrDetnCntr 0;
BA_ "GenSigFuncType" SG_ 354 FrntRdrDetn154RdrDetnCntr 16;
BA_ "GenSigSendType" SG_ 354 FrntRdrDetn154RdrDetnConf 0;
BA_ "GenSigStartValue" SG_ 354 FrntRdrDetn154RdrDetnElevn 15;
BA_ "GenSigSendType" SG_ 354 FrntRdrDetn154RdrDetnElevn 0;
BA_ "GenSigSendType" SG_ 354 FrntRdrDetn154RdrDetnPwr 0;
BA_ "GenSigStartValue" SG_ 354 FrntRdrDetn154RdrDetnRng 10050;
BA_ "GenSigSendType" SG_ 354 FrntRdrDetn154RdrDetnRng 0;
BA_ "GenSigStartValue" SG_ 354 FrntRdrDetn154RdrDetnRngV 4000;
BA_ "GenSigSendType" SG_ 354 FrntRdrDetn154RdrDetnRngV 0;
BA_ "GenSigStartValue" SG_ 354 FrntRdrDetn154RdrDetnSts 3;
BA_ "GenSigSendType" SG_ 354 FrntRdrDetn154RdrDetnSts 0;
BA_ "GenSigStartValue" SG_ 354 FrntRdrDetn155RdrDetnAzi 900;
BA_ "GenSigSendType" SG_ 354 FrntRdrDetn155RdrDetnAzi 0;
BA_ "GenSigSendType" SG_ 354 FrntRdrDetn155RdrDetnChks 0;
BA_ "GenSigFuncType" SG_ 354 FrntRdrDetn155RdrDetnChks 15;
BA_ "GenSigDataID" SG_ 354 FrntRdrDetn155RdrDetnChks "0x7A2";
BA_ "GenSigSendType" SG_ 354 FrntRdrDetn155RdrDetnCntr 0;
BA_ "GenSigFuncType" SG_ 354 FrntRdrDetn155RdrDetnCntr 16;
BA_ "GenSigSendType" SG_ 354 FrntRdrDetn155RdrDetnConf 0;
BA_ "GenSigStartValue" SG_ 354 FrntRdrDetn155RdrDetnElevn 15;
BA_ "GenSigSendType" SG_ 354 FrntRdrDetn155RdrDetnElevn 0;
BA_ "GenSigSendType" SG_ 354 FrntRdrDetn155RdrDetnPwr 0;
BA_ "GenSigStartValue" SG_ 354 FrntRdrDetn155RdrDetnRng 10050;
BA_ "GenSigSendType" SG_ 354 FrntRdrDetn155RdrDetnRng 0;
BA_ "GenSigStartValue" SG_ 354 FrntRdrDetn155RdrDetnRngV 4000;
BA_ "GenSigSendType" SG_ 354 FrntRdrDetn155RdrDetnRngV 0;
BA_ "GenSigStartValue" SG_ 354 FrntRdrDetn155RdrDetnSts 3;
BA_ "GenSigSendType" SG_ 354 FrntRdrDetn155RdrDetnSts 0;
BA_ "GenSigStartValue" SG_ 354 FrntRdrDetn156RdrDetnAzi 900;
BA_ "GenSigSendType" SG_ 354 FrntRdrDetn156RdrDetnAzi 0;
BA_ "GenSigSendType" SG_ 354 FrntRdrDetn156RdrDetnChks 0;
BA_ "GenSigFuncType" SG_ 354 FrntRdrDetn156RdrDetnChks 15;
BA_ "GenSigDataID" SG_ 354 FrntRdrDetn156RdrDetnChks "0x7A3";
BA_ "GenSigSendType" SG_ 354 FrntRdrDetn156RdrDetnCntr 0;
BA_ "GenSigFuncType" SG_ 354 FrntRdrDetn156RdrDetnCntr 16;
BA_ "GenSigSendType" SG_ 354 FrntRdrDetn156RdrDetnConf 0;
BA_ "GenSigStartValue" SG_ 354 FrntRdrDetn156RdrDetnElevn 15;
BA_ "GenSigSendType" SG_ 354 FrntRdrDetn156RdrDetnElevn 0;
BA_ "GenSigSendType" SG_ 354 FrntRdrDetn156RdrDetnPwr 0;
BA_ "GenSigStartValue" SG_ 354 FrntRdrDetn156RdrDetnRng 10050;
BA_ "GenSigSendType" SG_ 354 FrntRdrDetn156RdrDetnRng 0;
BA_ "GenSigStartValue" SG_ 354 FrntRdrDetn156RdrDetnRngV 4000;
BA_ "GenSigSendType" SG_ 354 FrntRdrDetn156RdrDetnRngV 0;
BA_ "GenSigStartValue" SG_ 354 FrntRdrDetn156RdrDetnSts 3;
BA_ "GenSigSendType" SG_ 354 FrntRdrDetn156RdrDetnSts 0;
// Frame: FLRSafetyCANFD2Frame27
BA_ "VFrameFormat" BO_ 356 14;
BA_ "GenMsgSendType" BO_ 356 0;
BA_ "GenMsgCycleTime" BO_ 356 50.000;
BA_ "GenSigStartValue" SG_ 356 FrntRdrDetn157RdrDetnAzi 900;
BA_ "GenSigSendType" SG_ 356 FrntRdrDetn157RdrDetnAzi 0;
BA_ "GenSigSendType" SG_ 356 FrntRdrDetn157RdrDetnChks 0;
BA_ "GenSigFuncType" SG_ 356 FrntRdrDetn157RdrDetnChks 15;
BA_ "GenSigDataID" SG_ 356 FrntRdrDetn157RdrDetnChks "0x7A4";
BA_ "GenSigSendType" SG_ 356 FrntRdrDetn157RdrDetnCntr 0;
BA_ "GenSigFuncType" SG_ 356 FrntRdrDetn157RdrDetnCntr 16;
BA_ "GenSigSendType" SG_ 356 FrntRdrDetn157RdrDetnConf 0;
BA_ "GenSigStartValue" SG_ 356 FrntRdrDetn157RdrDetnElevn 15;
BA_ "GenSigSendType" SG_ 356 FrntRdrDetn157RdrDetnElevn 0;
BA_ "GenSigSendType" SG_ 356 FrntRdrDetn157RdrDetnPwr 0;
BA_ "GenSigStartValue" SG_ 356 FrntRdrDetn157RdrDetnRng 10050;
BA_ "GenSigSendType" SG_ 356 FrntRdrDetn157RdrDetnRng 0;
BA_ "GenSigStartValue" SG_ 356 FrntRdrDetn157RdrDetnRngV 4000;
BA_ "GenSigSendType" SG_ 356 FrntRdrDetn157RdrDetnRngV 0;
BA_ "GenSigStartValue" SG_ 356 FrntRdrDetn157RdrDetnSts 3;
BA_ "GenSigSendType" SG_ 356 FrntRdrDetn157RdrDetnSts 0;
BA_ "GenSigStartValue" SG_ 356 FrntRdrDetn158RdrDetnAzi 900;
BA_ "GenSigSendType" SG_ 356 FrntRdrDetn158RdrDetnAzi 0;
BA_ "GenSigSendType" SG_ 356 FrntRdrDetn158RdrDetnChks 0;
BA_ "GenSigFuncType" SG_ 356 FrntRdrDetn158RdrDetnChks 15;
BA_ "GenSigDataID" SG_ 356 FrntRdrDetn158RdrDetnChks "0x7A5";
BA_ "GenSigSendType" SG_ 356 FrntRdrDetn158RdrDetnCntr 0;
BA_ "GenSigFuncType" SG_ 356 FrntRdrDetn158RdrDetnCntr 16;
BA_ "GenSigSendType" SG_ 356 FrntRdrDetn158RdrDetnConf 0;
BA_ "GenSigStartValue" SG_ 356 FrntRdrDetn158RdrDetnElevn 15;
BA_ "GenSigSendType" SG_ 356 FrntRdrDetn158RdrDetnElevn 0;
BA_ "GenSigSendType" SG_ 356 FrntRdrDetn158RdrDetnPwr 0;
BA_ "GenSigStartValue" SG_ 356 FrntRdrDetn158RdrDetnRng 10050;
BA_ "GenSigSendType" SG_ 356 FrntRdrDetn158RdrDetnRng 0;
BA_ "GenSigStartValue" SG_ 356 FrntRdrDetn158RdrDetnRngV 4000;
BA_ "GenSigSendType" SG_ 356 FrntRdrDetn158RdrDetnRngV 0;
BA_ "GenSigStartValue" SG_ 356 FrntRdrDetn158RdrDetnSts 3;
BA_ "GenSigSendType" SG_ 356 FrntRdrDetn158RdrDetnSts 0;
BA_ "GenSigStartValue" SG_ 356 FrntRdrDetn159RdrDetnAzi 900;
BA_ "GenSigSendType" SG_ 356 FrntRdrDetn159RdrDetnAzi 0;
BA_ "GenSigSendType" SG_ 356 FrntRdrDetn159RdrDetnChks 0;
BA_ "GenSigFuncType" SG_ 356 FrntRdrDetn159RdrDetnChks 15;
BA_ "GenSigDataID" SG_ 356 FrntRdrDetn159RdrDetnChks "0x7A6";
BA_ "GenSigSendType" SG_ 356 FrntRdrDetn159RdrDetnCntr 0;
BA_ "GenSigFuncType" SG_ 356 FrntRdrDetn159RdrDetnCntr 16;
BA_ "GenSigSendType" SG_ 356 FrntRdrDetn159RdrDetnConf 0;
BA_ "GenSigStartValue" SG_ 356 FrntRdrDetn159RdrDetnElevn 15;
BA_ "GenSigSendType" SG_ 356 FrntRdrDetn159RdrDetnElevn 0;
BA_ "GenSigSendType" SG_ 356 FrntRdrDetn159RdrDetnPwr 0;
BA_ "GenSigStartValue" SG_ 356 FrntRdrDetn159RdrDetnRng 10050;
BA_ "GenSigSendType" SG_ 356 FrntRdrDetn159RdrDetnRng 0;
BA_ "GenSigStartValue" SG_ 356 FrntRdrDetn159RdrDetnRngV 4000;
BA_ "GenSigSendType" SG_ 356 FrntRdrDetn159RdrDetnRngV 0;
BA_ "GenSigStartValue" SG_ 356 FrntRdrDetn159RdrDetnSts 3;
BA_ "GenSigSendType" SG_ 356 FrntRdrDetn159RdrDetnSts 0;
BA_ "GenSigStartValue" SG_ 356 FrntRdrDetn160RdrDetnAzi 900;
BA_ "GenSigSendType" SG_ 356 FrntRdrDetn160RdrDetnAzi 0;
BA_ "GenSigSendType" SG_ 356 FrntRdrDetn160RdrDetnChks 0;
BA_ "GenSigFuncType" SG_ 356 FrntRdrDetn160RdrDetnChks 15;
BA_ "GenSigDataID" SG_ 356 FrntRdrDetn160RdrDetnChks "0x7A7";
BA_ "GenSigSendType" SG_ 356 FrntRdrDetn160RdrDetnCntr 0;
BA_ "GenSigFuncType" SG_ 356 FrntRdrDetn160RdrDetnCntr 16;
BA_ "GenSigSendType" SG_ 356 FrntRdrDetn160RdrDetnConf 0;
BA_ "GenSigStartValue" SG_ 356 FrntRdrDetn160RdrDetnElevn 15;
BA_ "GenSigSendType" SG_ 356 FrntRdrDetn160RdrDetnElevn 0;
BA_ "GenSigSendType" SG_ 356 FrntRdrDetn160RdrDetnPwr 0;
BA_ "GenSigStartValue" SG_ 356 FrntRdrDetn160RdrDetnRng 10050;
BA_ "GenSigSendType" SG_ 356 FrntRdrDetn160RdrDetnRng 0;
BA_ "GenSigStartValue" SG_ 356 FrntRdrDetn160RdrDetnRngV 4000;
BA_ "GenSigSendType" SG_ 356 FrntRdrDetn160RdrDetnRngV 0;
BA_ "GenSigStartValue" SG_ 356 FrntRdrDetn160RdrDetnSts 3;
BA_ "GenSigSendType" SG_ 356 FrntRdrDetn160RdrDetnSts 0;
BA_ "GenSigStartValue" SG_ 356 FrntRdrDetn161RdrDetnAzi 900;
BA_ "GenSigSendType" SG_ 356 FrntRdrDetn161RdrDetnAzi 0;
BA_ "GenSigSendType" SG_ 356 FrntRdrDetn161RdrDetnChks 0;
BA_ "GenSigFuncType" SG_ 356 FrntRdrDetn161RdrDetnChks 15;
BA_ "GenSigDataID" SG_ 356 FrntRdrDetn161RdrDetnChks "0x7A8";
BA_ "GenSigSendType" SG_ 356 FrntRdrDetn161RdrDetnCntr 0;
BA_ "GenSigFuncType" SG_ 356 FrntRdrDetn161RdrDetnCntr 16;
BA_ "GenSigSendType" SG_ 356 FrntRdrDetn161RdrDetnConf 0;
BA_ "GenSigStartValue" SG_ 356 FrntRdrDetn161RdrDetnElevn 15;
BA_ "GenSigSendType" SG_ 356 FrntRdrDetn161RdrDetnElevn 0;
BA_ "GenSigSendType" SG_ 356 FrntRdrDetn161RdrDetnPwr 0;
BA_ "GenSigStartValue" SG_ 356 FrntRdrDetn161RdrDetnRng 10050;
BA_ "GenSigSendType" SG_ 356 FrntRdrDetn161RdrDetnRng 0;
BA_ "GenSigStartValue" SG_ 356 FrntRdrDetn161RdrDetnRngV 4000;
BA_ "GenSigSendType" SG_ 356 FrntRdrDetn161RdrDetnRngV 0;
BA_ "GenSigStartValue" SG_ 356 FrntRdrDetn161RdrDetnSts 3;
BA_ "GenSigSendType" SG_ 356 FrntRdrDetn161RdrDetnSts 0;
BA_ "GenSigStartValue" SG_ 356 FrntRdrDetn162RdrDetnAzi 900;
BA_ "GenSigSendType" SG_ 356 FrntRdrDetn162RdrDetnAzi 0;
BA_ "GenSigSendType" SG_ 356 FrntRdrDetn162RdrDetnChks 0;
BA_ "GenSigFuncType" SG_ 356 FrntRdrDetn162RdrDetnChks 15;
BA_ "GenSigDataID" SG_ 356 FrntRdrDetn162RdrDetnChks "0x7A9";
BA_ "GenSigSendType" SG_ 356 FrntRdrDetn162RdrDetnCntr 0;
BA_ "GenSigFuncType" SG_ 356 FrntRdrDetn162RdrDetnCntr 16;
BA_ "GenSigSendType" SG_ 356 FrntRdrDetn162RdrDetnConf 0;
BA_ "GenSigStartValue" SG_ 356 FrntRdrDetn162RdrDetnElevn 15;
BA_ "GenSigSendType" SG_ 356 FrntRdrDetn162RdrDetnElevn 0;
BA_ "GenSigSendType" SG_ 356 FrntRdrDetn162RdrDetnPwr 0;
BA_ "GenSigStartValue" SG_ 356 FrntRdrDetn162RdrDetnRng 10050;
BA_ "GenSigSendType" SG_ 356 FrntRdrDetn162RdrDetnRng 0;
BA_ "GenSigStartValue" SG_ 356 FrntRdrDetn162RdrDetnRngV 4000;
BA_ "GenSigSendType" SG_ 356 FrntRdrDetn162RdrDetnRngV 0;
BA_ "GenSigStartValue" SG_ 356 FrntRdrDetn162RdrDetnSts 3;
BA_ "GenSigSendType" SG_ 356 FrntRdrDetn162RdrDetnSts 0;
VAL_ 342 FrntRdrDetn115RdrDetnSts 0 "RdrDetnSts_Ukwn" 1 "RdrDetnSts_Movg" 2 "RdrDetnSts_Staty" 3 "RdrDetnSts_Invalid";
VAL_ 342 FrntRdrDetn116RdrDetnSts 0 "RdrDetnSts_Ukwn" 1 "RdrDetnSts_Movg" 2 "RdrDetnSts_Staty" 3 "RdrDetnSts_Invalid";
VAL_ 342 FrntRdrDetn117RdrDetnSts 0 "RdrDetnSts_Ukwn" 1 "RdrDetnSts_Movg" 2 "RdrDetnSts_Staty" 3 "RdrDetnSts_Invalid";
VAL_ 342 FrntRdrDetn118RdrDetnSts 0 "RdrDetnSts_Ukwn" 1 "RdrDetnSts_Movg" 2 "RdrDetnSts_Staty" 3 "RdrDetnSts_Invalid";
VAL_ 342 FrntRdrDetn119RdrDetnSts 0 "RdrDetnSts_Ukwn" 1 "RdrDetnSts_Movg" 2 "RdrDetnSts_Staty" 3 "RdrDetnSts_Invalid";
VAL_ 342 FrntRdrDetn120RdrDetnSts 0 "RdrDetnSts_Ukwn" 1 "RdrDetnSts_Movg" 2 "RdrDetnSts_Staty" 3 "RdrDetnSts_Invalid";
VAL_ 344 FrntRdrDetn121RdrDetnSts 0 "RdrDetnSts_Ukwn" 1 "RdrDetnSts_Movg" 2 "RdrDetnSts_Staty" 3 "RdrDetnSts_Invalid";
VAL_ 344 FrntRdrDetn122RdrDetnSts 0 "RdrDetnSts_Ukwn" 1 "RdrDetnSts_Movg" 2 "RdrDetnSts_Staty" 3 "RdrDetnSts_Invalid";
VAL_ 344 FrntRdrDetn123RdrDetnSts 0 "RdrDetnSts_Ukwn" 1 "RdrDetnSts_Movg" 2 "RdrDetnSts_Staty" 3 "RdrDetnSts_Invalid";
VAL_ 344 FrntRdrDetn124RdrDetnSts 0 "RdrDetnSts_Ukwn" 1 "RdrDetnSts_Movg" 2 "RdrDetnSts_Staty" 3 "RdrDetnSts_Invalid";
VAL_ 344 FrntRdrDetn125RdrDetnSts 0 "RdrDetnSts_Ukwn" 1 "RdrDetnSts_Movg" 2 "RdrDetnSts_Staty" 3 "RdrDetnSts_Invalid";
VAL_ 344 FrntRdrDetn126RdrDetnSts 0 "RdrDetnSts_Ukwn" 1 "RdrDetnSts_Movg" 2 "RdrDetnSts_Staty" 3 "RdrDetnSts_Invalid";
VAL_ 346 FrntRdrDetn127RdrDetnSts 0 "RdrDetnSts_Ukwn" 1 "RdrDetnSts_Movg" 2 "RdrDetnSts_Staty" 3 "RdrDetnSts_Invalid";
VAL_ 346 FrntRdrDetn128RdrDetnSts 0 "RdrDetnSts_Ukwn" 1 "RdrDetnSts_Movg" 2 "RdrDetnSts_Staty" 3 "RdrDetnSts_Invalid";
VAL_ 346 FrntRdrDetn129RdrDetnSts 0 "RdrDetnSts_Ukwn" 1 "RdrDetnSts_Movg" 2 "RdrDetnSts_Staty" 3 "RdrDetnSts_Invalid";
VAL_ 346 FrntRdrDetn130RdrDetnSts 0 "RdrDetnSts_Ukwn" 1 "RdrDetnSts_Movg" 2 "RdrDetnSts_Staty" 3 "RdrDetnSts_Invalid";
VAL_ 346 FrntRdrDetn131RdrDetnSts 0 "RdrDetnSts_Ukwn" 1 "RdrDetnSts_Movg" 2 "RdrDetnSts_Staty" 3 "RdrDetnSts_Invalid";
VAL_ 346 FrntRdrDetn132RdrDetnSts 0 "RdrDetnSts_Ukwn" 1 "RdrDetnSts_Movg" 2 "RdrDetnSts_Staty" 3 "RdrDetnSts_Invalid";
VAL_ 348 FrntRdrDetn133RdrDetnSts 0 "RdrDetnSts_Ukwn" 1 "RdrDetnSts_Movg" 2 "RdrDetnSts_Staty" 3 "RdrDetnSts_Invalid";
VAL_ 348 FrntRdrDetn134RdrDetnSts 0 "RdrDetnSts_Ukwn" 1 "RdrDetnSts_Movg" 2 "RdrDetnSts_Staty" 3 "RdrDetnSts_Invalid";
VAL_ 348 FrntRdrDetn135RdrDetnSts 0 "RdrDetnSts_Ukwn" 1 "RdrDetnSts_Movg" 2 "RdrDetnSts_Staty" 3 "RdrDetnSts_Invalid";
VAL_ 348 FrntRdrDetn136RdrDetnSts 0 "RdrDetnSts_Ukwn" 1 "RdrDetnSts_Movg" 2 "RdrDetnSts_Staty" 3 "RdrDetnSts_Invalid";
VAL_ 348 FrntRdrDetn137RdrDetnSts 0 "RdrDetnSts_Ukwn" 1 "RdrDetnSts_Movg" 2 "RdrDetnSts_Staty" 3 "RdrDetnSts_Invalid";
VAL_ 348 FrntRdrDetn138RdrDetnSts 0 "RdrDetnSts_Ukwn" 1 "RdrDetnSts_Movg" 2 "RdrDetnSts_Staty" 3 "RdrDetnSts_Invalid";
VAL_ 350 FrntRdrDetn139RdrDetnSts 0 "RdrDetnSts_Ukwn" 1 "RdrDetnSts_Movg" 2 "RdrDetnSts_Staty" 3 "RdrDetnSts_Invalid";
VAL_ 350 FrntRdrDetn140RdrDetnSts 0 "RdrDetnSts_Ukwn" 1 "RdrDetnSts_Movg" 2 "RdrDetnSts_Staty" 3 "RdrDetnSts_Invalid";
VAL_ 350 FrntRdrDetn141RdrDetnSts 0 "RdrDetnSts_Ukwn" 1 "RdrDetnSts_Movg" 2 "RdrDetnSts_Staty" 3 "RdrDetnSts_Invalid";
VAL_ 350 FrntRdrDetn142RdrDetnSts 0 "RdrDetnSts_Ukwn" 1 "RdrDetnSts_Movg" 2 "RdrDetnSts_Staty" 3 "RdrDetnSts_Invalid";
VAL_ 350 FrntRdrDetn143RdrDetnSts 0 "RdrDetnSts_Ukwn" 1 "RdrDetnSts_Movg" 2 "RdrDetnSts_Staty" 3 "RdrDetnSts_Invalid";
VAL_ 350 FrntRdrDetn144RdrDetnSts 0 "RdrDetnSts_Ukwn" 1 "RdrDetnSts_Movg" 2 "RdrDetnSts_Staty" 3 "RdrDetnSts_Invalid";
VAL_ 352 FrntRdrDetn145RdrDetnSts 0 "RdrDetnSts_Ukwn" 1 "RdrDetnSts_Movg" 2 "RdrDetnSts_Staty" 3 "RdrDetnSts_Invalid";
VAL_ 352 FrntRdrDetn146RdrDetnSts 0 "RdrDetnSts_Ukwn" 1 "RdrDetnSts_Movg" 2 "RdrDetnSts_Staty" 3 "RdrDetnSts_Invalid";
VAL_ 352 FrntRdrDetn147RdrDetnSts 0 "RdrDetnSts_Ukwn" 1 "RdrDetnSts_Movg" 2 "RdrDetnSts_Staty" 3 "RdrDetnSts_Invalid";
VAL_ 352 FrntRdrDetn148RdrDetnSts 0 "RdrDetnSts_Ukwn" 1 "RdrDetnSts_Movg" 2 "RdrDetnSts_Staty" 3 "RdrDetnSts_Invalid";
VAL_ 352 FrntRdrDetn149RdrDetnSts 0 "RdrDetnSts_Ukwn" 1 "RdrDetnSts_Movg" 2 "RdrDetnSts_Staty" 3 "RdrDetnSts_Invalid";
VAL_ 352 FrntRdrDetn150RdrDetnSts 0 "RdrDetnSts_Ukwn" 1 "RdrDetnSts_Movg" 2 "RdrDetnSts_Staty" 3 "RdrDetnSts_Invalid";
VAL_ 354 FrntRdrDetn151RdrDetnSts 0 "RdrDetnSts_Ukwn" 1 "RdrDetnSts_Movg" 2 "RdrDetnSts_Staty" 3 "RdrDetnSts_Invalid";
VAL_ 354 FrntRdrDetn152RdrDetnSts 0 "RdrDetnSts_Ukwn" 1 "RdrDetnSts_Movg" 2 "RdrDetnSts_Staty" 3 "RdrDetnSts_Invalid";
VAL_ 354 FrntRdrDetn153RdrDetnSts 0 "RdrDetnSts_Ukwn" 1 "RdrDetnSts_Movg" 2 "RdrDetnSts_Staty" 3 "RdrDetnSts_Invalid";
VAL_ 354 FrntRdrDetn154RdrDetnSts 0 "RdrDetnSts_Ukwn" 1 "RdrDetnSts_Movg" 2 "RdrDetnSts_Staty" 3 "RdrDetnSts_Invalid";
VAL_ 354 FrntRdrDetn155RdrDetnSts 0 "RdrDetnSts_Ukwn" 1 "RdrDetnSts_Movg" 2 "RdrDetnSts_Staty" 3 "RdrDetnSts_Invalid";
VAL_ 354 FrntRdrDetn156RdrDetnSts 0 "RdrDetnSts_Ukwn" 1 "RdrDetnSts_Movg" 2 "RdrDetnSts_Staty" 3 "RdrDetnSts_Invalid";
VAL_ 356 FrntRdrDetn157RdrDetnSts 0 "RdrDetnSts_Ukwn" 1 "RdrDetnSts_Movg" 2 "RdrDetnSts_Staty" 3 "RdrDetnSts_Invalid";
VAL_ 356 FrntRdrDetn158RdrDetnSts 0 "RdrDetnSts_Ukwn" 1 "RdrDetnSts_Movg" 2 "RdrDetnSts_Staty" 3 "RdrDetnSts_Invalid";
VAL_ 356 FrntRdrDetn159RdrDetnSts 0 "RdrDetnSts_Ukwn" 1 "RdrDetnSts_Movg" 2 "RdrDetnSts_Staty" 3 "RdrDetnSts_Invalid";
VAL_ 356 FrntRdrDetn160RdrDetnSts 0 "RdrDetnSts_Ukwn" 1 "RdrDetnSts_Movg" 2 "RdrDetnSts_Staty" 3 "RdrDetnSts_Invalid";
VAL_ 356 FrntRdrDetn161RdrDetnSts 0 "RdrDetnSts_Ukwn" 1 "RdrDetnSts_Movg" 2 "RdrDetnSts_Staty" 3 "RdrDetnSts_Invalid";
VAL_ 356 FrntRdrDetn162RdrDetnSts 0 "RdrDetnSts_Ukwn" 1 "RdrDetnSts_Movg" 2 "RdrDetnSts_Staty" 3 "RdrDetnSts_Invalid";
SIG_GROUP_ 342 FrntRdrDetn115 1 : FrntRdrDetn115RdrDetnAzi FrntRdrDetn115RdrDetnChks FrntRdrDetn115RdrDetnCntr FrntRdrDetn115RdrDetnConf FrntRdrDetn115RdrDetnElevn FrntRdrDetn115RdrDetnPwr FrntRdrDetn115RdrDetnRng FrntRdrDetn115RdrDetnRngV FrntRdrDetn115RdrDetnSts;
SIG_GROUP_ 342 FrntRdrDetn116 1 : FrntRdrDetn116RdrDetnAzi FrntRdrDetn116RdrDetnChks FrntRdrDetn116RdrDetnCntr FrntRdrDetn116RdrDetnConf FrntRdrDetn116RdrDetnElevn FrntRdrDetn116RdrDetnPwr FrntRdrDetn116RdrDetnRng FrntRdrDetn116RdrDetnRngV FrntRdrDetn116RdrDetnSts;
SIG_GROUP_ 342 FrntRdrDetn117 1 : FrntRdrDetn117RdrDetnAzi FrntRdrDetn117RdrDetnChks FrntRdrDetn117RdrDetnCntr FrntRdrDetn117RdrDetnConf FrntRdrDetn117RdrDetnElevn FrntRdrDetn117RdrDetnPwr FrntRdrDetn117RdrDetnRng FrntRdrDetn117RdrDetnRngV FrntRdrDetn117RdrDetnSts;
SIG_GROUP_ 342 FrntRdrDetn118 1 : FrntRdrDetn118RdrDetnAzi FrntRdrDetn118RdrDetnChks FrntRdrDetn118RdrDetnCntr FrntRdrDetn118RdrDetnConf FrntRdrDetn118RdrDetnElevn FrntRdrDetn118RdrDetnPwr FrntRdrDetn118RdrDetnRng FrntRdrDetn118RdrDetnRngV FrntRdrDetn118RdrDetnSts;
SIG_GROUP_ 342 FrntRdrDetn119 1 : FrntRdrDetn119RdrDetnAzi FrntRdrDetn119RdrDetnChks FrntRdrDetn119RdrDetnCntr FrntRdrDetn119RdrDetnConf FrntRdrDetn119RdrDetnElevn FrntRdrDetn119RdrDetnPwr FrntRdrDetn119RdrDetnRng FrntRdrDetn119RdrDetnRngV FrntRdrDetn119RdrDetnSts;
SIG_GROUP_ 342 FrntRdrDetn120 1 : FrntRdrDetn120RdrDetnAzi FrntRdrDetn120RdrDetnChks FrntRdrDetn120RdrDetnCntr FrntRdrDetn120RdrDetnConf FrntRdrDetn120RdrDetnElevn FrntRdrDetn120RdrDetnPwr FrntRdrDetn120RdrDetnRng FrntRdrDetn120RdrDetnRngV FrntRdrDetn120RdrDetnSts;
SIG_GROUP_ 344 FrntRdrDetn121 1 : FrntRdrDetn121RdrDetnAzi FrntRdrDetn121RdrDetnChks FrntRdrDetn121RdrDetnCntr FrntRdrDetn121RdrDetnConf FrntRdrDetn121RdrDetnElevn FrntRdrDetn121RdrDetnPwr FrntRdrDetn121RdrDetnRng FrntRdrDetn121RdrDetnRngV FrntRdrDetn121RdrDetnSts;
SIG_GROUP_ 344 FrntRdrDetn122 1 : FrntRdrDetn122RdrDetnAzi FrntRdrDetn122RdrDetnChks FrntRdrDetn122RdrDetnCntr FrntRdrDetn122RdrDetnConf FrntRdrDetn122RdrDetnElevn FrntRdrDetn122RdrDetnPwr FrntRdrDetn122RdrDetnRng FrntRdrDetn122RdrDetnRngV FrntRdrDetn122RdrDetnSts;
SIG_GROUP_ 344 FrntRdrDetn123 1 : FrntRdrDetn123RdrDetnAzi FrntRdrDetn123RdrDetnChks FrntRdrDetn123RdrDetnCntr FrntRdrDetn123RdrDetnConf FrntRdrDetn123RdrDetnElevn FrntRdrDetn123RdrDetnPwr FrntRdrDetn123RdrDetnRng FrntRdrDetn123RdrDetnRngV FrntRdrDetn123RdrDetnSts;
SIG_GROUP_ 344 FrntRdrDetn124 1 : FrntRdrDetn124RdrDetnAzi FrntRdrDetn124RdrDetnChks FrntRdrDetn124RdrDetnCntr FrntRdrDetn124RdrDetnConf FrntRdrDetn124RdrDetnElevn FrntRdrDetn124RdrDetnPwr FrntRdrDetn124RdrDetnRng FrntRdrDetn124RdrDetnRngV FrntRdrDetn124RdrDetnSts;
SIG_GROUP_ 344 FrntRdrDetn125 1 : FrntRdrDetn125RdrDetnAzi FrntRdrDetn125RdrDetnChks FrntRdrDetn125RdrDetnCntr FrntRdrDetn125RdrDetnConf FrntRdrDetn125RdrDetnElevn FrntRdrDetn125RdrDetnPwr FrntRdrDetn125RdrDetnRng FrntRdrDetn125RdrDetnRngV FrntRdrDetn125RdrDetnSts;
SIG_GROUP_ 344 FrntRdrDetn126 1 : FrntRdrDetn126RdrDetnAzi FrntRdrDetn126RdrDetnChks FrntRdrDetn126RdrDetnCntr FrntRdrDetn126RdrDetnConf FrntRdrDetn126RdrDetnElevn FrntRdrDetn126RdrDetnPwr FrntRdrDetn126RdrDetnRng FrntRdrDetn126RdrDetnRngV FrntRdrDetn126RdrDetnSts;
SIG_GROUP_ 346 FrntRdrDetn127 1 : FrntRdrDetn127RdrDetnAzi FrntRdrDetn127RdrDetnChks FrntRdrDetn127RdrDetnCntr FrntRdrDetn127RdrDetnConf FrntRdrDetn127RdrDetnElevn FrntRdrDetn127RdrDetnPwr FrntRdrDetn127RdrDetnRng FrntRdrDetn127RdrDetnRngV FrntRdrDetn127RdrDetnSts;
SIG_GROUP_ 346 FrntRdrDetn128 1 : FrntRdrDetn128RdrDetnAzi FrntRdrDetn128RdrDetnChks FrntRdrDetn128RdrDetnCntr FrntRdrDetn128RdrDetnConf FrntRdrDetn128RdrDetnElevn FrntRdrDetn128RdrDetnPwr FrntRdrDetn128RdrDetnRng FrntRdrDetn128RdrDetnRngV FrntRdrDetn128RdrDetnSts;
SIG_GROUP_ 346 FrntRdrDetn129 1 : FrntRdrDetn129RdrDetnAzi FrntRdrDetn129RdrDetnChks FrntRdrDetn129RdrDetnCntr FrntRdrDetn129RdrDetnConf FrntRdrDetn129RdrDetnElevn FrntRdrDetn129RdrDetnPwr FrntRdrDetn129RdrDetnRng FrntRdrDetn129RdrDetnRngV FrntRdrDetn129RdrDetnSts;
SIG_GROUP_ 346 FrntRdrDetn130 1 : FrntRdrDetn130RdrDetnAzi FrntRdrDetn130RdrDetnChks FrntRdrDetn130RdrDetnCntr FrntRdrDetn130RdrDetnConf FrntRdrDetn130RdrDetnElevn FrntRdrDetn130RdrDetnPwr FrntRdrDetn130RdrDetnRng FrntRdrDetn130RdrDetnRngV FrntRdrDetn130RdrDetnSts;
SIG_GROUP_ 346 FrntRdrDetn131 1 : FrntRdrDetn131RdrDetnAzi FrntRdrDetn131RdrDetnChks FrntRdrDetn131RdrDetnCntr FrntRdrDetn131RdrDetnConf FrntRdrDetn131RdrDetnElevn FrntRdrDetn131RdrDetnPwr FrntRdrDetn131RdrDetnRng FrntRdrDetn131RdrDetnRngV FrntRdrDetn131RdrDetnSts;
SIG_GROUP_ 346 FrntRdrDetn132 1 : FrntRdrDetn132RdrDetnAzi FrntRdrDetn132RdrDetnChks FrntRdrDetn132RdrDetnCntr FrntRdrDetn132RdrDetnConf FrntRdrDetn132RdrDetnElevn FrntRdrDetn132RdrDetnPwr FrntRdrDetn132RdrDetnRng FrntRdrDetn132RdrDetnRngV FrntRdrDetn132RdrDetnSts;
SIG_GROUP_ 348 FrntRdrDetn133 1 : FrntRdrDetn133RdrDetnAzi FrntRdrDetn133RdrDetnChks FrntRdrDetn133RdrDetnCntr FrntRdrDetn133RdrDetnConf FrntRdrDetn133RdrDetnElevn FrntRdrDetn133RdrDetnPwr FrntRdrDetn133RdrDetnRng FrntRdrDetn133RdrDetnRngV FrntRdrDetn133RdrDetnSts;
SIG_GROUP_ 348 FrntRdrDetn134 1 : FrntRdrDetn134RdrDetnAzi FrntRdrDetn134RdrDetnChks FrntRdrDetn134RdrDetnCntr FrntRdrDetn134RdrDetnConf FrntRdrDetn134RdrDetnElevn FrntRdrDetn134RdrDetnPwr FrntRdrDetn134RdrDetnRng FrntRdrDetn134RdrDetnRngV FrntRdrDetn134RdrDetnSts;
SIG_GROUP_ 348 FrntRdrDetn135 1 : FrntRdrDetn135RdrDetnAzi FrntRdrDetn135RdrDetnChks FrntRdrDetn135RdrDetnCntr FrntRdrDetn135RdrDetnConf FrntRdrDetn135RdrDetnElevn FrntRdrDetn135RdrDetnPwr FrntRdrDetn135RdrDetnRng FrntRdrDetn135RdrDetnRngV FrntRdrDetn135RdrDetnSts;
SIG_GROUP_ 348 FrntRdrDetn136 1 : FrntRdrDetn136RdrDetnAzi FrntRdrDetn136RdrDetnChks FrntRdrDetn136RdrDetnCntr FrntRdrDetn136RdrDetnConf FrntRdrDetn136RdrDetnElevn FrntRdrDetn136RdrDetnPwr FrntRdrDetn136RdrDetnRng FrntRdrDetn136RdrDetnRngV FrntRdrDetn136RdrDetnSts;
SIG_GROUP_ 348 FrntRdrDetn137 1 : FrntRdrDetn137RdrDetnAzi FrntRdrDetn137RdrDetnChks FrntRdrDetn137RdrDetnCntr FrntRdrDetn137RdrDetnConf FrntRdrDetn137RdrDetnElevn FrntRdrDetn137RdrDetnPwr FrntRdrDetn137RdrDetnRng FrntRdrDetn137RdrDetnRngV FrntRdrDetn137RdrDetnSts;
SIG_GROUP_ 348 FrntRdrDetn138 1 : FrntRdrDetn138RdrDetnAzi FrntRdrDetn138RdrDetnChks FrntRdrDetn138RdrDetnCntr FrntRdrDetn138RdrDetnConf FrntRdrDetn138RdrDetnElevn FrntRdrDetn138RdrDetnPwr FrntRdrDetn138RdrDetnRng FrntRdrDetn138RdrDetnRngV FrntRdrDetn138RdrDetnSts;
SIG_GROUP_ 350 FrntRdrDetn139 1 : FrntRdrDetn139RdrDetnAzi FrntRdrDetn139RdrDetnChks FrntRdrDetn139RdrDetnCntr FrntRdrDetn139RdrDetnConf FrntRdrDetn139RdrDetnElevn FrntRdrDetn139RdrDetnPwr FrntRdrDetn139RdrDetnRng FrntRdrDetn139RdrDetnRngV FrntRdrDetn139RdrDetnSts;
SIG_GROUP_ 350 FrntRdrDetn140 1 : FrntRdrDetn140RdrDetnAzi FrntRdrDetn140RdrDetnChks FrntRdrDetn140RdrDetnCntr FrntRdrDetn140RdrDetnConf FrntRdrDetn140RdrDetnElevn FrntRdrDetn140RdrDetnPwr FrntRdrDetn140RdrDetnRng FrntRdrDetn140RdrDetnRngV FrntRdrDetn140RdrDetnSts;
SIG_GROUP_ 350 FrntRdrDetn141 1 : FrntRdrDetn141RdrDetnAzi FrntRdrDetn141RdrDetnChks FrntRdrDetn141RdrDetnCntr FrntRdrDetn141RdrDetnConf FrntRdrDetn141RdrDetnElevn FrntRdrDetn141RdrDetnPwr FrntRdrDetn141RdrDetnRng FrntRdrDetn141RdrDetnRngV FrntRdrDetn141RdrDetnSts;
SIG_GROUP_ 350 FrntRdrDetn142 1 : FrntRdrDetn142RdrDetnAzi FrntRdrDetn142RdrDetnChks FrntRdrDetn142RdrDetnCntr FrntRdrDetn142RdrDetnConf FrntRdrDetn142RdrDetnElevn FrntRdrDetn142RdrDetnPwr FrntRdrDetn142RdrDetnRng FrntRdrDetn142RdrDetnRngV FrntRdrDetn142RdrDetnSts;
SIG_GROUP_ 350 FrntRdrDetn143 1 : FrntRdrDetn143RdrDetnAzi FrntRdrDetn143RdrDetnChks FrntRdrDetn143RdrDetnCntr FrntRdrDetn143RdrDetnConf FrntRdrDetn143RdrDetnElevn FrntRdrDetn143RdrDetnPwr FrntRdrDetn143RdrDetnRng FrntRdrDetn143RdrDetnRngV FrntRdrDetn143RdrDetnSts;
SIG_GROUP_ 350 FrntRdrDetn144 1 : FrntRdrDetn144RdrDetnAzi FrntRdrDetn144RdrDetnChks FrntRdrDetn144RdrDetnCntr FrntRdrDetn144RdrDetnConf FrntRdrDetn144RdrDetnElevn FrntRdrDetn144RdrDetnPwr FrntRdrDetn144RdrDetnRng FrntRdrDetn144RdrDetnRngV FrntRdrDetn144RdrDetnSts;
SIG_GROUP_ 352 FrntRdrDetn145 1 : FrntRdrDetn145RdrDetnAzi FrntRdrDetn145RdrDetnChks FrntRdrDetn145RdrDetnCntr FrntRdrDetn145RdrDetnConf FrntRdrDetn145RdrDetnElevn FrntRdrDetn145RdrDetnPwr FrntRdrDetn145RdrDetnRng FrntRdrDetn145RdrDetnRngV FrntRdrDetn145RdrDetnSts;
SIG_GROUP_ 352 FrntRdrDetn146 1 : FrntRdrDetn146RdrDetnAzi FrntRdrDetn146RdrDetnChks FrntRdrDetn146RdrDetnCntr FrntRdrDetn146RdrDetnConf FrntRdrDetn146RdrDetnElevn FrntRdrDetn146RdrDetnPwr FrntRdrDetn146RdrDetnRng FrntRdrDetn146RdrDetnRngV FrntRdrDetn146RdrDetnSts;
SIG_GROUP_ 352 FrntRdrDetn147 1 : FrntRdrDetn147RdrDetnAzi FrntRdrDetn147RdrDetnChks FrntRdrDetn147RdrDetnCntr FrntRdrDetn147RdrDetnConf FrntRdrDetn147RdrDetnElevn FrntRdrDetn147RdrDetnPwr FrntRdrDetn147RdrDetnRng FrntRdrDetn147RdrDetnRngV FrntRdrDetn147RdrDetnSts;
SIG_GROUP_ 352 FrntRdrDetn148 1 : FrntRdrDetn148RdrDetnAzi FrntRdrDetn148RdrDetnChks FrntRdrDetn148RdrDetnCntr FrntRdrDetn148RdrDetnConf FrntRdrDetn148RdrDetnElevn FrntRdrDetn148RdrDetnPwr FrntRdrDetn148RdrDetnRng FrntRdrDetn148RdrDetnRngV FrntRdrDetn148RdrDetnSts;
SIG_GROUP_ 352 FrntRdrDetn149 1 : FrntRdrDetn149RdrDetnAzi FrntRdrDetn149RdrDetnChks FrntRdrDetn149RdrDetnCntr FrntRdrDetn149RdrDetnConf FrntRdrDetn149RdrDetnElevn FrntRdrDetn149RdrDetnPwr FrntRdrDetn149RdrDetnRng FrntRdrDetn149RdrDetnRngV FrntRdrDetn149RdrDetnSts;
SIG_GROUP_ 352 FrntRdrDetn150 1 : FrntRdrDetn150RdrDetnAzi FrntRdrDetn150RdrDetnChks FrntRdrDetn150RdrDetnCntr FrntRdrDetn150RdrDetnConf FrntRdrDetn150RdrDetnElevn FrntRdrDetn150RdrDetnPwr FrntRdrDetn150RdrDetnRng FrntRdrDetn150RdrDetnRngV FrntRdrDetn150RdrDetnSts;
SIG_GROUP_ 354 FrntRdrDetn151 1 : FrntRdrDetn151RdrDetnAzi FrntRdrDetn151RdrDetnChks FrntRdrDetn151RdrDetnCntr FrntRdrDetn151RdrDetnConf FrntRdrDetn151RdrDetnElevn FrntRdrDetn151RdrDetnPwr FrntRdrDetn151RdrDetnRng FrntRdrDetn151RdrDetnRngV FrntRdrDetn151RdrDetnSts;
SIG_GROUP_ 354 FrntRdrDetn152 1 : FrntRdrDetn152RdrDetnAzi FrntRdrDetn152RdrDetnChks FrntRdrDetn152RdrDetnCntr FrntRdrDetn152RdrDetnConf FrntRdrDetn152RdrDetnElevn FrntRdrDetn152RdrDetnPwr FrntRdrDetn152RdrDetnRng FrntRdrDetn152RdrDetnRngV FrntRdrDetn152RdrDetnSts;
SIG_GROUP_ 354 FrntRdrDetn153 1 : FrntRdrDetn153RdrDetnAzi FrntRdrDetn153RdrDetnChks FrntRdrDetn153RdrDetnCntr FrntRdrDetn153RdrDetnConf FrntRdrDetn153RdrDetnElevn FrntRdrDetn153RdrDetnPwr FrntRdrDetn153RdrDetnRng FrntRdrDetn153RdrDetnRngV FrntRdrDetn153RdrDetnSts;
SIG_GROUP_ 354 FrntRdrDetn154 1 : FrntRdrDetn154RdrDetnAzi FrntRdrDetn154RdrDetnChks FrntRdrDetn154RdrDetnCntr FrntRdrDetn154RdrDetnConf FrntRdrDetn154RdrDetnElevn FrntRdrDetn154RdrDetnPwr FrntRdrDetn154RdrDetnRng FrntRdrDetn154RdrDetnRngV FrntRdrDetn154RdrDetnSts;
SIG_GROUP_ 354 FrntRdrDetn155 1 : FrntRdrDetn155RdrDetnAzi FrntRdrDetn155RdrDetnChks FrntRdrDetn155RdrDetnCntr FrntRdrDetn155RdrDetnConf FrntRdrDetn155RdrDetnElevn FrntRdrDetn155RdrDetnPwr FrntRdrDetn155RdrDetnRng FrntRdrDetn155RdrDetnRngV FrntRdrDetn155RdrDetnSts;
SIG_GROUP_ 354 FrntRdrDetn156 1 : FrntRdrDetn156RdrDetnAzi FrntRdrDetn156RdrDetnChks FrntRdrDetn156RdrDetnCntr FrntRdrDetn156RdrDetnConf FrntRdrDetn156RdrDetnElevn FrntRdrDetn156RdrDetnPwr FrntRdrDetn156RdrDetnRng FrntRdrDetn156RdrDetnRngV FrntRdrDetn156RdrDetnSts;
SIG_GROUP_ 356 FrntRdrDetn157 1 : FrntRdrDetn157RdrDetnAzi FrntRdrDetn157RdrDetnChks FrntRdrDetn157RdrDetnCntr FrntRdrDetn157RdrDetnConf FrntRdrDetn157RdrDetnElevn FrntRdrDetn157RdrDetnPwr FrntRdrDetn157RdrDetnRng FrntRdrDetn157RdrDetnRngV FrntRdrDetn157RdrDetnSts;
SIG_GROUP_ 356 FrntRdrDetn158 1 : FrntRdrDetn158RdrDetnAzi FrntRdrDetn158RdrDetnChks FrntRdrDetn158RdrDetnCntr FrntRdrDetn158RdrDetnConf FrntRdrDetn158RdrDetnElevn FrntRdrDetn158RdrDetnPwr FrntRdrDetn158RdrDetnRng FrntRdrDetn158RdrDetnRngV FrntRdrDetn158RdrDetnSts;
SIG_GROUP_ 356 FrntRdrDetn159 1 : FrntRdrDetn159RdrDetnAzi FrntRdrDetn159RdrDetnChks FrntRdrDetn159RdrDetnCntr FrntRdrDetn159RdrDetnConf FrntRdrDetn159RdrDetnElevn FrntRdrDetn159RdrDetnPwr FrntRdrDetn159RdrDetnRng FrntRdrDetn159RdrDetnRngV FrntRdrDetn159RdrDetnSts;
SIG_GROUP_ 356 FrntRdrDetn160 1 : FrntRdrDetn160RdrDetnAzi FrntRdrDetn160RdrDetnChks FrntRdrDetn160RdrDetnCntr FrntRdrDetn160RdrDetnConf FrntRdrDetn160RdrDetnElevn FrntRdrDetn160RdrDetnPwr FrntRdrDetn160RdrDetnRng FrntRdrDetn160RdrDetnRngV FrntRdrDetn160RdrDetnSts;
SIG_GROUP_ 356 FrntRdrDetn161 1 : FrntRdrDetn161RdrDetnAzi FrntRdrDetn161RdrDetnChks FrntRdrDetn161RdrDetnCntr FrntRdrDetn161RdrDetnConf FrntRdrDetn161RdrDetnElevn FrntRdrDetn161RdrDetnPwr FrntRdrDetn161RdrDetnRng FrntRdrDetn161RdrDetnRngV FrntRdrDetn161RdrDetnSts;
SIG_GROUP_ 356 FrntRdrDetn162 1 : FrntRdrDetn162RdrDetnAzi FrntRdrDetn162RdrDetnChks FrntRdrDetn162RdrDetnCntr FrntRdrDetn162RdrDetnConf FrntRdrDetn162RdrDetnElevn FrntRdrDetn162RdrDetnPwr FrntRdrDetn162RdrDetnRng FrntRdrDetn162RdrDetnRngV FrntRdrDetn162RdrDetnSts;
