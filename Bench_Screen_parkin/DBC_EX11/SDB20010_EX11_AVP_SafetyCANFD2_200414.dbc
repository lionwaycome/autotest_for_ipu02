// *************************************************************************** *
// *                                                                           *
// *                      Mentor Graphics Corporation                          *
// *                          All rights reserved                              *
// *                                                                           *
// *************************************************************************** *
// *                                                                           *
// * Description:         CANDB File                                           *
// * Generated at:        2020-04-14 13:13:01                                  *
// * System:              SDB20010                                             *
// * Variant:             EX11_AVP                                             *
// * Network:             SafetyCANFD2                                         *
// *                                                                           *
// *************************************************************************** *
// *                                                                           *
// *             THIS CONFIGURATION MIGHT CONTAIN SOME ERRORS                  *
// *              IF THE INPUT MODEL WAS NOT PROPERLY FORMED!                  *
// *                    Do Not Use this File directly!                         *
// *                                                                           *
// *************************************************************************** *
VERSION "SafetyCANFD2"

NS_ :

BS_:

BU_:  ASDM ETC FLC FLR PAS

BO_ 358 FLRSafetyCANFD2Frame28: 64 FLR
 SG_ FrntRdrDetn163_UB : 74|1@0+ (1,0) [0|1] "" ASDM,PAS
 SG_ FrntRdrDetn163RdrDetnAzi : 31|11@0+ (0.1,-90.0) [-90.0|90.0] "Deg" ASDM,PAS
 SG_ FrntRdrDetn163RdrDetnChks : 7|8@0+ (1.0,0.0) [0.0|255.0] "Unitless" ASDM,PAS
 SG_ FrntRdrDetn163RdrDetnCntr : 15|4@0+ (1.0,0.0) [0.0|15.0] "Unitless" ASDM,PAS
 SG_ FrntRdrDetn163RdrDetnConf : 71|7@0+ (1.0,0.0) [0.0|100.0] "%" ASDM,PAS
 SG_ FrntRdrDetn163RdrDetnElevn : 79|5@0+ (1.0,-15.0) [-15.0|15.0] "Deg" ASDM,PAS
 SG_ FrntRdrDetn163RdrDetnPwr : 8|9@0+ (0.1,0.0) [0.0|51.1] "dB" ASDM,PAS
 SG_ FrntRdrDetn163RdrDetnRng : 55|14@0+ (0.02,-1.0) [-1.0|200.0] "m" ASDM,PAS
 SG_ FrntRdrDetn163RdrDetnRngV : 36|13@0+ (0.02,-80.0) [-80.0|80.0] "m/s" ASDM,PAS
 SG_ FrntRdrDetn163RdrDetnSts : 11|2@0+ (1,0) [0|3] "" ASDM,PAS
 SG_ FrntRdrDetn164_UB : 154|1@0+ (1,0) [0|1] "" ASDM,PAS
 SG_ FrntRdrDetn164RdrDetnAzi : 119|11@0+ (0.1,-90.0) [-90.0|90.0] "Deg" ASDM,PAS
 SG_ FrntRdrDetn164RdrDetnChks : 87|8@0+ (1.0,0.0) [0.0|255.0] "Unitless" ASDM,PAS
 SG_ FrntRdrDetn164RdrDetnCntr : 95|4@0+ (1.0,0.0) [0.0|15.0] "Unitless" ASDM,PAS
 SG_ FrntRdrDetn164RdrDetnConf : 111|7@0+ (1.0,0.0) [0.0|100.0] "%" ASDM,PAS
 SG_ FrntRdrDetn164RdrDetnElevn : 159|5@0+ (1.0,-15.0) [-15.0|15.0] "Deg" ASDM,PAS
 SG_ FrntRdrDetn164RdrDetnPwr : 89|9@0+ (0.1,0.0) [0.0|51.1] "dB" ASDM,PAS
 SG_ FrntRdrDetn164RdrDetnRng : 143|14@0+ (0.02,-1.0) [-1.0|200.0] "m" ASDM,PAS
 SG_ FrntRdrDetn164RdrDetnRngV : 124|13@0+ (0.02,-80.0) [-80.0|80.0] "m/s" ASDM,PAS
 SG_ FrntRdrDetn164RdrDetnSts : 91|2@0+ (1,0) [0|3] "" ASDM,PAS
 SG_ FrntRdrDetn165_UB : 234|1@0+ (1,0) [0|1] "" ASDM,PAS
 SG_ FrntRdrDetn165RdrDetnAzi : 199|11@0+ (0.1,-90.0) [-90.0|90.0] "Deg" ASDM,PAS
 SG_ FrntRdrDetn165RdrDetnChks : 167|8@0+ (1.0,0.0) [0.0|255.0] "Unitless" ASDM,PAS
 SG_ FrntRdrDetn165RdrDetnCntr : 175|4@0+ (1.0,0.0) [0.0|15.0] "Unitless" ASDM,PAS
 SG_ FrntRdrDetn165RdrDetnConf : 191|7@0+ (1.0,0.0) [0.0|100.0] "%" ASDM,PAS
 SG_ FrntRdrDetn165RdrDetnElevn : 239|5@0+ (1.0,-15.0) [-15.0|15.0] "Deg" ASDM,PAS
 SG_ FrntRdrDetn165RdrDetnPwr : 169|9@0+ (0.1,0.0) [0.0|51.1] "dB" ASDM,PAS
 SG_ FrntRdrDetn165RdrDetnRng : 223|14@0+ (0.02,-1.0) [-1.0|200.0] "m" ASDM,PAS
 SG_ FrntRdrDetn165RdrDetnRngV : 204|13@0+ (0.02,-80.0) [-80.0|80.0] "m/s" ASDM,PAS
 SG_ FrntRdrDetn165RdrDetnSts : 171|2@0+ (1,0) [0|3] "" ASDM,PAS
 SG_ FrntRdrDetn166_UB : 314|1@0+ (1,0) [0|1] "" ASDM,PAS
 SG_ FrntRdrDetn166RdrDetnAzi : 287|11@0+ (0.1,-90.0) [-90.0|90.0] "Deg" ASDM,PAS
 SG_ FrntRdrDetn166RdrDetnChks : 247|8@0+ (1.0,0.0) [0.0|255.0] "Unitless" ASDM,PAS
 SG_ FrntRdrDetn166RdrDetnCntr : 255|4@0+ (1.0,0.0) [0.0|15.0] "Unitless" ASDM,PAS
 SG_ FrntRdrDetn166RdrDetnConf : 311|7@0+ (1.0,0.0) [0.0|100.0] "%" ASDM,PAS
 SG_ FrntRdrDetn166RdrDetnElevn : 319|5@0+ (1.0,-15.0) [-15.0|15.0] "Deg" ASDM,PAS
 SG_ FrntRdrDetn166RdrDetnPwr : 249|9@0+ (0.1,0.0) [0.0|51.1] "dB" ASDM,PAS
 SG_ FrntRdrDetn166RdrDetnRng : 271|14@0+ (0.02,-1.0) [-1.0|200.0] "m" ASDM,PAS
 SG_ FrntRdrDetn166RdrDetnRngV : 292|13@0+ (0.02,-80.0) [-80.0|80.0] "m/s" ASDM,PAS
 SG_ FrntRdrDetn166RdrDetnSts : 251|2@0+ (1,0) [0|3] "" ASDM,PAS
 SG_ FrntRdrDetn167_UB : 394|1@0+ (1,0) [0|1] "" ASDM,PAS
 SG_ FrntRdrDetn167RdrDetnAzi : 351|11@0+ (0.1,-90.0) [-90.0|90.0] "Deg" ASDM,PAS
 SG_ FrntRdrDetn167RdrDetnChks : 327|8@0+ (1.0,0.0) [0.0|255.0] "Unitless" ASDM,PAS
 SG_ FrntRdrDetn167RdrDetnCntr : 335|4@0+ (1.0,0.0) [0.0|15.0] "Unitless" ASDM,PAS
 SG_ FrntRdrDetn167RdrDetnConf : 391|7@0+ (1.0,0.0) [0.0|100.0] "%" ASDM,PAS
 SG_ FrntRdrDetn167RdrDetnElevn : 399|5@0+ (1.0,-15.0) [-15.0|15.0] "Deg" ASDM,PAS
 SG_ FrntRdrDetn167RdrDetnPwr : 329|9@0+ (0.1,0.0) [0.0|51.1] "dB" ASDM,PAS
 SG_ FrntRdrDetn167RdrDetnRng : 375|14@0+ (0.02,-1.0) [-1.0|200.0] "m" ASDM,PAS
 SG_ FrntRdrDetn167RdrDetnRngV : 356|13@0+ (0.02,-80.0) [-80.0|80.0] "m/s" ASDM,PAS
 SG_ FrntRdrDetn167RdrDetnSts : 331|2@0+ (1,0) [0|3] "" ASDM,PAS
 SG_ FrntRdrDetn168_UB : 474|1@0+ (1,0) [0|1] "" ASDM,PAS
 SG_ FrntRdrDetn168RdrDetnAzi : 447|11@0+ (0.1,-90.0) [-90.0|90.0] "Deg" ASDM,PAS
 SG_ FrntRdrDetn168RdrDetnChks : 407|8@0+ (1.0,0.0) [0.0|255.0] "Unitless" ASDM,PAS
 SG_ FrntRdrDetn168RdrDetnCntr : 415|4@0+ (1.0,0.0) [0.0|15.0] "Unitless" ASDM,PAS
 SG_ FrntRdrDetn168RdrDetnConf : 471|7@0+ (1.0,0.0) [0.0|100.0] "%" ASDM,PAS
 SG_ FrntRdrDetn168RdrDetnElevn : 479|5@0+ (1.0,-15.0) [-15.0|15.0] "Deg" ASDM,PAS
 SG_ FrntRdrDetn168RdrDetnPwr : 409|9@0+ (0.1,0.0) [0.0|51.1] "dB" ASDM,PAS
 SG_ FrntRdrDetn168RdrDetnRng : 431|14@0+ (0.02,-1.0) [-1.0|200.0] "m" ASDM,PAS
 SG_ FrntRdrDetn168RdrDetnRngV : 452|13@0+ (0.02,-80.0) [-80.0|80.0] "m/s" ASDM,PAS
 SG_ FrntRdrDetn168RdrDetnSts : 411|2@0+ (1,0) [0|3] "" ASDM,PAS

BO_ 360 FLRSafetyCANFD2Frame29: 64 FLR
 SG_ FrntRdrDetn169_UB : 74|1@0+ (1,0) [0|1] "" ASDM,PAS
 SG_ FrntRdrDetn169RdrDetnAzi : 31|11@0+ (0.1,-90.0) [-90.0|90.0] "Deg" ASDM,PAS
 SG_ FrntRdrDetn169RdrDetnChks : 7|8@0+ (1.0,0.0) [0.0|255.0] "Unitless" ASDM,PAS
 SG_ FrntRdrDetn169RdrDetnCntr : 15|4@0+ (1.0,0.0) [0.0|15.0] "Unitless" ASDM,PAS
 SG_ FrntRdrDetn169RdrDetnConf : 71|7@0+ (1.0,0.0) [0.0|100.0] "%" ASDM,PAS
 SG_ FrntRdrDetn169RdrDetnElevn : 79|5@0+ (1.0,-15.0) [-15.0|15.0] "Deg" ASDM,PAS
 SG_ FrntRdrDetn169RdrDetnPwr : 8|9@0+ (0.1,0.0) [0.0|51.1] "dB" ASDM,PAS
 SG_ FrntRdrDetn169RdrDetnRng : 55|14@0+ (0.02,-1.0) [-1.0|200.0] "m" ASDM,PAS
 SG_ FrntRdrDetn169RdrDetnRngV : 36|13@0+ (0.02,-80.0) [-80.0|80.0] "m/s" ASDM,PAS
 SG_ FrntRdrDetn169RdrDetnSts : 11|2@0+ (1,0) [0|3] "" ASDM,PAS
 SG_ FrntRdrDetn170_UB : 154|1@0+ (1,0) [0|1] "" ASDM,PAS
 SG_ FrntRdrDetn170RdrDetnAzi : 119|11@0+ (0.1,-90.0) [-90.0|90.0] "Deg" ASDM,PAS
 SG_ FrntRdrDetn170RdrDetnChks : 87|8@0+ (1.0,0.0) [0.0|255.0] "Unitless" ASDM,PAS
 SG_ FrntRdrDetn170RdrDetnCntr : 95|4@0+ (1.0,0.0) [0.0|15.0] "Unitless" ASDM,PAS
 SG_ FrntRdrDetn170RdrDetnConf : 111|7@0+ (1.0,0.0) [0.0|100.0] "%" ASDM,PAS
 SG_ FrntRdrDetn170RdrDetnElevn : 159|5@0+ (1.0,-15.0) [-15.0|15.0] "Deg" ASDM,PAS
 SG_ FrntRdrDetn170RdrDetnPwr : 89|9@0+ (0.1,0.0) [0.0|51.1] "dB" ASDM,PAS
 SG_ FrntRdrDetn170RdrDetnRng : 143|14@0+ (0.02,-1.0) [-1.0|200.0] "m" ASDM,PAS
 SG_ FrntRdrDetn170RdrDetnRngV : 124|13@0+ (0.02,-80.0) [-80.0|80.0] "m/s" ASDM,PAS
 SG_ FrntRdrDetn170RdrDetnSts : 91|2@0+ (1,0) [0|3] "" ASDM,PAS
 SG_ FrntRdrDetn171_UB : 234|1@0+ (1,0) [0|1] "" ASDM,PAS
 SG_ FrntRdrDetn171RdrDetnAzi : 199|11@0+ (0.1,-90.0) [-90.0|90.0] "Deg" ASDM,PAS
 SG_ FrntRdrDetn171RdrDetnChks : 167|8@0+ (1.0,0.0) [0.0|255.0] "Unitless" ASDM,PAS
 SG_ FrntRdrDetn171RdrDetnCntr : 175|4@0+ (1.0,0.0) [0.0|15.0] "Unitless" ASDM,PAS
 SG_ FrntRdrDetn171RdrDetnConf : 191|7@0+ (1.0,0.0) [0.0|100.0] "%" ASDM,PAS
 SG_ FrntRdrDetn171RdrDetnElevn : 239|5@0+ (1.0,-15.0) [-15.0|15.0] "Deg" ASDM,PAS
 SG_ FrntRdrDetn171RdrDetnPwr : 169|9@0+ (0.1,0.0) [0.0|51.1] "dB" ASDM,PAS
 SG_ FrntRdrDetn171RdrDetnRng : 223|14@0+ (0.02,-1.0) [-1.0|200.0] "m" ASDM,PAS
 SG_ FrntRdrDetn171RdrDetnRngV : 204|13@0+ (0.02,-80.0) [-80.0|80.0] "m/s" ASDM,PAS
 SG_ FrntRdrDetn171RdrDetnSts : 171|2@0+ (1,0) [0|3] "" ASDM,PAS
 SG_ FrntRdrDetn172_UB : 314|1@0+ (1,0) [0|1] "" ASDM,PAS
 SG_ FrntRdrDetn172RdrDetnAzi : 287|11@0+ (0.1,-90.0) [-90.0|90.0] "Deg" ASDM,PAS
 SG_ FrntRdrDetn172RdrDetnChks : 247|8@0+ (1.0,0.0) [0.0|255.0] "Unitless" ASDM,PAS
 SG_ FrntRdrDetn172RdrDetnCntr : 255|4@0+ (1.0,0.0) [0.0|15.0] "Unitless" ASDM,PAS
 SG_ FrntRdrDetn172RdrDetnConf : 311|7@0+ (1.0,0.0) [0.0|100.0] "%" ASDM,PAS
 SG_ FrntRdrDetn172RdrDetnElevn : 319|5@0+ (1.0,-15.0) [-15.0|15.0] "Deg" ASDM,PAS
 SG_ FrntRdrDetn172RdrDetnPwr : 249|9@0+ (0.1,0.0) [0.0|51.1] "dB" ASDM,PAS
 SG_ FrntRdrDetn172RdrDetnRng : 271|14@0+ (0.02,-1.0) [-1.0|200.0] "m" ASDM,PAS
 SG_ FrntRdrDetn172RdrDetnRngV : 292|13@0+ (0.02,-80.0) [-80.0|80.0] "m/s" ASDM,PAS
 SG_ FrntRdrDetn172RdrDetnSts : 251|2@0+ (1,0) [0|3] "" ASDM,PAS
 SG_ FrntRdrDetn173_UB : 394|1@0+ (1,0) [0|1] "" ASDM,PAS
 SG_ FrntRdrDetn173RdrDetnAzi : 351|11@0+ (0.1,-90.0) [-90.0|90.0] "Deg" ASDM,PAS
 SG_ FrntRdrDetn173RdrDetnChks : 327|8@0+ (1.0,0.0) [0.0|255.0] "Unitless" ASDM,PAS
 SG_ FrntRdrDetn173RdrDetnCntr : 335|4@0+ (1.0,0.0) [0.0|15.0] "Unitless" ASDM,PAS
 SG_ FrntRdrDetn173RdrDetnConf : 391|7@0+ (1.0,0.0) [0.0|100.0] "%" ASDM,PAS
 SG_ FrntRdrDetn173RdrDetnElevn : 399|5@0+ (1.0,-15.0) [-15.0|15.0] "Deg" ASDM,PAS
 SG_ FrntRdrDetn173RdrDetnPwr : 329|9@0+ (0.1,0.0) [0.0|51.1] "dB" ASDM,PAS
 SG_ FrntRdrDetn173RdrDetnRng : 375|14@0+ (0.02,-1.0) [-1.0|200.0] "m" ASDM,PAS
 SG_ FrntRdrDetn173RdrDetnRngV : 356|13@0+ (0.02,-80.0) [-80.0|80.0] "m/s" ASDM,PAS
 SG_ FrntRdrDetn173RdrDetnSts : 331|2@0+ (1,0) [0|3] "" ASDM,PAS
 SG_ FrntRdrDetn174_UB : 474|1@0+ (1,0) [0|1] "" ASDM,PAS
 SG_ FrntRdrDetn174RdrDetnAzi : 447|11@0+ (0.1,-90.0) [-90.0|90.0] "Deg" ASDM,PAS
 SG_ FrntRdrDetn174RdrDetnChks : 407|8@0+ (1.0,0.0) [0.0|255.0] "Unitless" ASDM,PAS
 SG_ FrntRdrDetn174RdrDetnCntr : 415|4@0+ (1.0,0.0) [0.0|15.0] "Unitless" ASDM,PAS
 SG_ FrntRdrDetn174RdrDetnConf : 471|7@0+ (1.0,0.0) [0.0|100.0] "%" ASDM,PAS
 SG_ FrntRdrDetn174RdrDetnElevn : 479|5@0+ (1.0,-15.0) [-15.0|15.0] "Deg" ASDM,PAS
 SG_ FrntRdrDetn174RdrDetnPwr : 409|9@0+ (0.1,0.0) [0.0|51.1] "dB" ASDM,PAS
 SG_ FrntRdrDetn174RdrDetnRng : 431|14@0+ (0.02,-1.0) [-1.0|200.0] "m" ASDM,PAS
 SG_ FrntRdrDetn174RdrDetnRngV : 452|13@0+ (0.02,-80.0) [-80.0|80.0] "m/s" ASDM,PAS
 SG_ FrntRdrDetn174RdrDetnSts : 411|2@0+ (1,0) [0|3] "" ASDM,PAS

BO_ 362 FLRSafetyCANFD2Frame30: 64 FLR
 SG_ FrntRdrDetn175_UB : 74|1@0+ (1,0) [0|1] "" ASDM,PAS
 SG_ FrntRdrDetn175RdrDetnAzi : 31|11@0+ (0.1,-90.0) [-90.0|90.0] "Deg" ASDM,PAS
 SG_ FrntRdrDetn175RdrDetnChks : 7|8@0+ (1.0,0.0) [0.0|255.0] "Unitless" ASDM,PAS
 SG_ FrntRdrDetn175RdrDetnCntr : 15|4@0+ (1.0,0.0) [0.0|15.0] "Unitless" ASDM,PAS
 SG_ FrntRdrDetn175RdrDetnConf : 71|7@0+ (1.0,0.0) [0.0|100.0] "%" ASDM,PAS
 SG_ FrntRdrDetn175RdrDetnElevn : 79|5@0+ (1.0,-15.0) [-15.0|15.0] "Deg" ASDM,PAS
 SG_ FrntRdrDetn175RdrDetnPwr : 8|9@0+ (0.1,0.0) [0.0|51.1] "dB" ASDM,PAS
 SG_ FrntRdrDetn175RdrDetnRng : 55|14@0+ (0.02,-1.0) [-1.0|200.0] "m" ASDM,PAS
 SG_ FrntRdrDetn175RdrDetnRngV : 36|13@0+ (0.02,-80.0) [-80.0|80.0] "m/s" ASDM,PAS
 SG_ FrntRdrDetn175RdrDetnSts : 11|2@0+ (1,0) [0|3] "" ASDM,PAS
 SG_ FrntRdrDetn176_UB : 154|1@0+ (1,0) [0|1] "" ASDM,PAS
 SG_ FrntRdrDetn176RdrDetnAzi : 119|11@0+ (0.1,-90.0) [-90.0|90.0] "Deg" ASDM,PAS
 SG_ FrntRdrDetn176RdrDetnChks : 87|8@0+ (1.0,0.0) [0.0|255.0] "Unitless" ASDM,PAS
 SG_ FrntRdrDetn176RdrDetnCntr : 95|4@0+ (1.0,0.0) [0.0|15.0] "Unitless" ASDM,PAS
 SG_ FrntRdrDetn176RdrDetnConf : 111|7@0+ (1.0,0.0) [0.0|100.0] "%" ASDM,PAS
 SG_ FrntRdrDetn176RdrDetnElevn : 159|5@0+ (1.0,-15.0) [-15.0|15.0] "Deg" ASDM,PAS
 SG_ FrntRdrDetn176RdrDetnPwr : 89|9@0+ (0.1,0.0) [0.0|51.1] "dB" ASDM,PAS
 SG_ FrntRdrDetn176RdrDetnRng : 143|14@0+ (0.02,-1.0) [-1.0|200.0] "m" ASDM,PAS
 SG_ FrntRdrDetn176RdrDetnRngV : 124|13@0+ (0.02,-80.0) [-80.0|80.0] "m/s" ASDM,PAS
 SG_ FrntRdrDetn176RdrDetnSts : 91|2@0+ (1,0) [0|3] "" ASDM,PAS
 SG_ FrntRdrDetn177_UB : 234|1@0+ (1,0) [0|1] "" ASDM,PAS
 SG_ FrntRdrDetn177RdrDetnAzi : 199|11@0+ (0.1,-90.0) [-90.0|90.0] "Deg" ASDM,PAS
 SG_ FrntRdrDetn177RdrDetnChks : 167|8@0+ (1.0,0.0) [0.0|255.0] "Unitless" ASDM,PAS
 SG_ FrntRdrDetn177RdrDetnCntr : 175|4@0+ (1.0,0.0) [0.0|15.0] "Unitless" ASDM,PAS
 SG_ FrntRdrDetn177RdrDetnConf : 191|7@0+ (1.0,0.0) [0.0|100.0] "%" ASDM,PAS
 SG_ FrntRdrDetn177RdrDetnElevn : 239|5@0+ (1.0,-15.0) [-15.0|15.0] "Deg" ASDM,PAS
 SG_ FrntRdrDetn177RdrDetnPwr : 169|9@0+ (0.1,0.0) [0.0|51.1] "dB" ASDM,PAS
 SG_ FrntRdrDetn177RdrDetnRng : 223|14@0+ (0.02,-1.0) [-1.0|200.0] "m" ASDM,PAS
 SG_ FrntRdrDetn177RdrDetnRngV : 204|13@0+ (0.02,-80.0) [-80.0|80.0] "m/s" ASDM,PAS
 SG_ FrntRdrDetn177RdrDetnSts : 171|2@0+ (1,0) [0|3] "" ASDM,PAS
 SG_ FrntRdrDetn178_UB : 314|1@0+ (1,0) [0|1] "" ASDM,PAS
 SG_ FrntRdrDetn178RdrDetnAzi : 287|11@0+ (0.1,-90.0) [-90.0|90.0] "Deg" ASDM,PAS
 SG_ FrntRdrDetn178RdrDetnChks : 247|8@0+ (1.0,0.0) [0.0|255.0] "Unitless" ASDM,PAS
 SG_ FrntRdrDetn178RdrDetnCntr : 255|4@0+ (1.0,0.0) [0.0|15.0] "Unitless" ASDM,PAS
 SG_ FrntRdrDetn178RdrDetnConf : 311|7@0+ (1.0,0.0) [0.0|100.0] "%" ASDM,PAS
 SG_ FrntRdrDetn178RdrDetnElevn : 319|5@0+ (1.0,-15.0) [-15.0|15.0] "Deg" ASDM,PAS
 SG_ FrntRdrDetn178RdrDetnPwr : 249|9@0+ (0.1,0.0) [0.0|51.1] "dB" ASDM,PAS
 SG_ FrntRdrDetn178RdrDetnRng : 271|14@0+ (0.02,-1.0) [-1.0|200.0] "m" ASDM,PAS
 SG_ FrntRdrDetn178RdrDetnRngV : 292|13@0+ (0.02,-80.0) [-80.0|80.0] "m/s" ASDM,PAS
 SG_ FrntRdrDetn178RdrDetnSts : 251|2@0+ (1,0) [0|3] "" ASDM,PAS
 SG_ FrntRdrDetn179_UB : 394|1@0+ (1,0) [0|1] "" ASDM,PAS
 SG_ FrntRdrDetn179RdrDetnAzi : 351|11@0+ (0.1,-90.0) [-90.0|90.0] "Deg" ASDM,PAS
 SG_ FrntRdrDetn179RdrDetnChks : 327|8@0+ (1.0,0.0) [0.0|255.0] "Unitless" ASDM,PAS
 SG_ FrntRdrDetn179RdrDetnCntr : 335|4@0+ (1.0,0.0) [0.0|15.0] "Unitless" ASDM,PAS
 SG_ FrntRdrDetn179RdrDetnConf : 391|7@0+ (1.0,0.0) [0.0|100.0] "%" ASDM,PAS
 SG_ FrntRdrDetn179RdrDetnElevn : 399|5@0+ (1.0,-15.0) [-15.0|15.0] "Deg" ASDM,PAS
 SG_ FrntRdrDetn179RdrDetnPwr : 329|9@0+ (0.1,0.0) [0.0|51.1] "dB" ASDM,PAS
 SG_ FrntRdrDetn179RdrDetnRng : 375|14@0+ (0.02,-1.0) [-1.0|200.0] "m" ASDM,PAS
 SG_ FrntRdrDetn179RdrDetnRngV : 356|13@0+ (0.02,-80.0) [-80.0|80.0] "m/s" ASDM,PAS
 SG_ FrntRdrDetn179RdrDetnSts : 331|2@0+ (1,0) [0|3] "" ASDM,PAS
 SG_ FrntRdrDetn180_UB : 474|1@0+ (1,0) [0|1] "" ASDM,PAS
 SG_ FrntRdrDetn180RdrDetnAzi : 447|11@0+ (0.1,-90.0) [-90.0|90.0] "Deg" ASDM,PAS
 SG_ FrntRdrDetn180RdrDetnChks : 407|8@0+ (1.0,0.0) [0.0|255.0] "Unitless" ASDM,PAS
 SG_ FrntRdrDetn180RdrDetnCntr : 415|4@0+ (1.0,0.0) [0.0|15.0] "Unitless" ASDM,PAS
 SG_ FrntRdrDetn180RdrDetnConf : 471|7@0+ (1.0,0.0) [0.0|100.0] "%" ASDM,PAS
 SG_ FrntRdrDetn180RdrDetnElevn : 479|5@0+ (1.0,-15.0) [-15.0|15.0] "Deg" ASDM,PAS
 SG_ FrntRdrDetn180RdrDetnPwr : 409|9@0+ (0.1,0.0) [0.0|51.1] "dB" ASDM,PAS
 SG_ FrntRdrDetn180RdrDetnRng : 431|14@0+ (0.02,-1.0) [-1.0|200.0] "m" ASDM,PAS
 SG_ FrntRdrDetn180RdrDetnRngV : 452|13@0+ (0.02,-80.0) [-80.0|80.0] "m/s" ASDM,PAS
 SG_ FrntRdrDetn180RdrDetnSts : 411|2@0+ (1,0) [0|3] "" ASDM,PAS

BO_ 364 FLRSafetyCANFD2Frame31: 64 FLR
 SG_ FrntRdrDetn181_UB : 74|1@0+ (1,0) [0|1] "" ASDM,PAS
 SG_ FrntRdrDetn181RdrDetnAzi : 31|11@0+ (0.1,-90.0) [-90.0|90.0] "Deg" ASDM,PAS
 SG_ FrntRdrDetn181RdrDetnChks : 7|8@0+ (1.0,0.0) [0.0|255.0] "Unitless" ASDM,PAS
 SG_ FrntRdrDetn181RdrDetnCntr : 15|4@0+ (1.0,0.0) [0.0|15.0] "Unitless" ASDM,PAS
 SG_ FrntRdrDetn181RdrDetnConf : 71|7@0+ (1.0,0.0) [0.0|100.0] "%" ASDM,PAS
 SG_ FrntRdrDetn181RdrDetnElevn : 79|5@0+ (1.0,-15.0) [-15.0|15.0] "Deg" ASDM,PAS
 SG_ FrntRdrDetn181RdrDetnPwr : 8|9@0+ (0.1,0.0) [0.0|51.1] "dB" ASDM,PAS
 SG_ FrntRdrDetn181RdrDetnRng : 55|14@0+ (0.02,-1.0) [-1.0|200.0] "m" ASDM,PAS
 SG_ FrntRdrDetn181RdrDetnRngV : 36|13@0+ (0.02,-80.0) [-80.0|80.0] "m/s" ASDM,PAS
 SG_ FrntRdrDetn181RdrDetnSts : 11|2@0+ (1,0) [0|3] "" ASDM,PAS
 SG_ FrntRdrDetn182_UB : 154|1@0+ (1,0) [0|1] "" ASDM,PAS
 SG_ FrntRdrDetn182RdrDetnAzi : 119|11@0+ (0.1,-90.0) [-90.0|90.0] "Deg" ASDM,PAS
 SG_ FrntRdrDetn182RdrDetnChks : 87|8@0+ (1.0,0.0) [0.0|255.0] "Unitless" ASDM,PAS
 SG_ FrntRdrDetn182RdrDetnCntr : 95|4@0+ (1.0,0.0) [0.0|15.0] "Unitless" ASDM,PAS
 SG_ FrntRdrDetn182RdrDetnConf : 111|7@0+ (1.0,0.0) [0.0|100.0] "%" ASDM,PAS
 SG_ FrntRdrDetn182RdrDetnElevn : 159|5@0+ (1.0,-15.0) [-15.0|15.0] "Deg" ASDM,PAS
 SG_ FrntRdrDetn182RdrDetnPwr : 89|9@0+ (0.1,0.0) [0.0|51.1] "dB" ASDM,PAS
 SG_ FrntRdrDetn182RdrDetnRng : 143|14@0+ (0.02,-1.0) [-1.0|200.0] "m" ASDM,PAS
 SG_ FrntRdrDetn182RdrDetnRngV : 124|13@0+ (0.02,-80.0) [-80.0|80.0] "m/s" ASDM,PAS
 SG_ FrntRdrDetn182RdrDetnSts : 91|2@0+ (1,0) [0|3] "" ASDM,PAS
 SG_ FrntRdrDetn183_UB : 234|1@0+ (1,0) [0|1] "" ASDM,PAS
 SG_ FrntRdrDetn183RdrDetnAzi : 199|11@0+ (0.1,-90.0) [-90.0|90.0] "Deg" ASDM,PAS
 SG_ FrntRdrDetn183RdrDetnChks : 167|8@0+ (1.0,0.0) [0.0|255.0] "Unitless" ASDM,PAS
 SG_ FrntRdrDetn183RdrDetnCntr : 175|4@0+ (1.0,0.0) [0.0|15.0] "Unitless" ASDM,PAS
 SG_ FrntRdrDetn183RdrDetnConf : 191|7@0+ (1.0,0.0) [0.0|100.0] "%" ASDM,PAS
 SG_ FrntRdrDetn183RdrDetnElevn : 239|5@0+ (1.0,-15.0) [-15.0|15.0] "Deg" ASDM,PAS
 SG_ FrntRdrDetn183RdrDetnPwr : 169|9@0+ (0.1,0.0) [0.0|51.1] "dB" ASDM,PAS
 SG_ FrntRdrDetn183RdrDetnRng : 223|14@0+ (0.02,-1.0) [-1.0|200.0] "m" ASDM,PAS
 SG_ FrntRdrDetn183RdrDetnRngV : 204|13@0+ (0.02,-80.0) [-80.0|80.0] "m/s" ASDM,PAS
 SG_ FrntRdrDetn183RdrDetnSts : 171|2@0+ (1,0) [0|3] "" ASDM,PAS
 SG_ FrntRdrDetn184_UB : 314|1@0+ (1,0) [0|1] "" ASDM,PAS
 SG_ FrntRdrDetn184RdrDetnAzi : 287|11@0+ (0.1,-90.0) [-90.0|90.0] "Deg" ASDM,PAS
 SG_ FrntRdrDetn184RdrDetnChks : 247|8@0+ (1.0,0.0) [0.0|255.0] "Unitless" ASDM,PAS
 SG_ FrntRdrDetn184RdrDetnCntr : 255|4@0+ (1.0,0.0) [0.0|15.0] "Unitless" ASDM,PAS
 SG_ FrntRdrDetn184RdrDetnConf : 311|7@0+ (1.0,0.0) [0.0|100.0] "%" ASDM,PAS
 SG_ FrntRdrDetn184RdrDetnElevn : 319|5@0+ (1.0,-15.0) [-15.0|15.0] "Deg" ASDM,PAS
 SG_ FrntRdrDetn184RdrDetnPwr : 249|9@0+ (0.1,0.0) [0.0|51.1] "dB" ASDM,PAS
 SG_ FrntRdrDetn184RdrDetnRng : 271|14@0+ (0.02,-1.0) [-1.0|200.0] "m" ASDM,PAS
 SG_ FrntRdrDetn184RdrDetnRngV : 292|13@0+ (0.02,-80.0) [-80.0|80.0] "m/s" ASDM,PAS
 SG_ FrntRdrDetn184RdrDetnSts : 251|2@0+ (1,0) [0|3] "" ASDM,PAS
 SG_ FrntRdrDetn185_UB : 394|1@0+ (1,0) [0|1] "" ASDM,PAS
 SG_ FrntRdrDetn185RdrDetnAzi : 351|11@0+ (0.1,-90.0) [-90.0|90.0] "Deg" ASDM,PAS
 SG_ FrntRdrDetn185RdrDetnChks : 327|8@0+ (1.0,0.0) [0.0|255.0] "Unitless" ASDM,PAS
 SG_ FrntRdrDetn185RdrDetnCntr : 335|4@0+ (1.0,0.0) [0.0|15.0] "Unitless" ASDM,PAS
 SG_ FrntRdrDetn185RdrDetnConf : 391|7@0+ (1.0,0.0) [0.0|100.0] "%" ASDM,PAS
 SG_ FrntRdrDetn185RdrDetnElevn : 399|5@0+ (1.0,-15.0) [-15.0|15.0] "Deg" ASDM,PAS
 SG_ FrntRdrDetn185RdrDetnPwr : 329|9@0+ (0.1,0.0) [0.0|51.1] "dB" ASDM,PAS
 SG_ FrntRdrDetn185RdrDetnRng : 375|14@0+ (0.02,-1.0) [-1.0|200.0] "m" ASDM,PAS
 SG_ FrntRdrDetn185RdrDetnRngV : 356|13@0+ (0.02,-80.0) [-80.0|80.0] "m/s" ASDM,PAS
 SG_ FrntRdrDetn185RdrDetnSts : 331|2@0+ (1,0) [0|3] "" ASDM,PAS
 SG_ FrntRdrDetn186_UB : 474|1@0+ (1,0) [0|1] "" ASDM,PAS
 SG_ FrntRdrDetn186RdrDetnAzi : 447|11@0+ (0.1,-90.0) [-90.0|90.0] "Deg" ASDM,PAS
 SG_ FrntRdrDetn186RdrDetnChks : 407|8@0+ (1.0,0.0) [0.0|255.0] "Unitless" ASDM,PAS
 SG_ FrntRdrDetn186RdrDetnCntr : 415|4@0+ (1.0,0.0) [0.0|15.0] "Unitless" ASDM,PAS
 SG_ FrntRdrDetn186RdrDetnConf : 471|7@0+ (1.0,0.0) [0.0|100.0] "%" ASDM,PAS
 SG_ FrntRdrDetn186RdrDetnElevn : 479|5@0+ (1.0,-15.0) [-15.0|15.0] "Deg" ASDM,PAS
 SG_ FrntRdrDetn186RdrDetnPwr : 409|9@0+ (0.1,0.0) [0.0|51.1] "dB" ASDM,PAS
 SG_ FrntRdrDetn186RdrDetnRng : 431|14@0+ (0.02,-1.0) [-1.0|200.0] "m" ASDM,PAS
 SG_ FrntRdrDetn186RdrDetnRngV : 452|13@0+ (0.02,-80.0) [-80.0|80.0] "m/s" ASDM,PAS
 SG_ FrntRdrDetn186RdrDetnSts : 411|2@0+ (1,0) [0|3] "" ASDM,PAS

BO_ 366 FLRSafetyCANFD2Frame32: 64 FLR
 SG_ FrntRdrDetn187_UB : 74|1@0+ (1,0) [0|1] "" ASDM,PAS
 SG_ FrntRdrDetn187RdrDetnAzi : 31|11@0+ (0.1,-90.0) [-90.0|90.0] "Deg" ASDM,PAS
 SG_ FrntRdrDetn187RdrDetnChks : 7|8@0+ (1.0,0.0) [0.0|255.0] "Unitless" ASDM,PAS
 SG_ FrntRdrDetn187RdrDetnCntr : 15|4@0+ (1.0,0.0) [0.0|15.0] "Unitless" ASDM,PAS
 SG_ FrntRdrDetn187RdrDetnConf : 71|7@0+ (1.0,0.0) [0.0|100.0] "%" ASDM,PAS
 SG_ FrntRdrDetn187RdrDetnElevn : 79|5@0+ (1.0,-15.0) [-15.0|15.0] "Deg" ASDM,PAS
 SG_ FrntRdrDetn187RdrDetnPwr : 8|9@0+ (0.1,0.0) [0.0|51.1] "dB" ASDM,PAS
 SG_ FrntRdrDetn187RdrDetnRng : 55|14@0+ (0.02,-1.0) [-1.0|200.0] "m" ASDM,PAS
 SG_ FrntRdrDetn187RdrDetnRngV : 36|13@0+ (0.02,-80.0) [-80.0|80.0] "m/s" ASDM,PAS
 SG_ FrntRdrDetn187RdrDetnSts : 11|2@0+ (1,0) [0|3] "" ASDM,PAS
 SG_ FrntRdrDetn188_UB : 154|1@0+ (1,0) [0|1] "" ASDM,PAS
 SG_ FrntRdrDetn188RdrDetnAzi : 119|11@0+ (0.1,-90.0) [-90.0|90.0] "Deg" ASDM,PAS
 SG_ FrntRdrDetn188RdrDetnChks : 87|8@0+ (1.0,0.0) [0.0|255.0] "Unitless" ASDM,PAS
 SG_ FrntRdrDetn188RdrDetnCntr : 95|4@0+ (1.0,0.0) [0.0|15.0] "Unitless" ASDM,PAS
 SG_ FrntRdrDetn188RdrDetnConf : 111|7@0+ (1.0,0.0) [0.0|100.0] "%" ASDM,PAS
 SG_ FrntRdrDetn188RdrDetnElevn : 159|5@0+ (1.0,-15.0) [-15.0|15.0] "Deg" ASDM,PAS
 SG_ FrntRdrDetn188RdrDetnPwr : 89|9@0+ (0.1,0.0) [0.0|51.1] "dB" ASDM,PAS
 SG_ FrntRdrDetn188RdrDetnRng : 143|14@0+ (0.02,-1.0) [-1.0|200.0] "m" ASDM,PAS
 SG_ FrntRdrDetn188RdrDetnRngV : 124|13@0+ (0.02,-80.0) [-80.0|80.0] "m/s" ASDM,PAS
 SG_ FrntRdrDetn188RdrDetnSts : 91|2@0+ (1,0) [0|3] "" ASDM,PAS
 SG_ FrntRdrDetn189_UB : 234|1@0+ (1,0) [0|1] "" ASDM,PAS
 SG_ FrntRdrDetn189RdrDetnAzi : 199|11@0+ (0.1,-90.0) [-90.0|90.0] "Deg" ASDM,PAS
 SG_ FrntRdrDetn189RdrDetnChks : 167|8@0+ (1.0,0.0) [0.0|255.0] "Unitless" ASDM,PAS
 SG_ FrntRdrDetn189RdrDetnCntr : 175|4@0+ (1.0,0.0) [0.0|15.0] "Unitless" ASDM,PAS
 SG_ FrntRdrDetn189RdrDetnConf : 191|7@0+ (1.0,0.0) [0.0|100.0] "%" ASDM,PAS
 SG_ FrntRdrDetn189RdrDetnElevn : 239|5@0+ (1.0,-15.0) [-15.0|15.0] "Deg" ASDM,PAS
 SG_ FrntRdrDetn189RdrDetnPwr : 169|9@0+ (0.1,0.0) [0.0|51.1] "dB" ASDM,PAS
 SG_ FrntRdrDetn189RdrDetnRng : 223|14@0+ (0.02,-1.0) [-1.0|200.0] "m" ASDM,PAS
 SG_ FrntRdrDetn189RdrDetnRngV : 204|13@0+ (0.02,-80.0) [-80.0|80.0] "m/s" ASDM,PAS
 SG_ FrntRdrDetn189RdrDetnSts : 171|2@0+ (1,0) [0|3] "" ASDM,PAS
 SG_ FrntRdrDetn190_UB : 314|1@0+ (1,0) [0|1] "" ASDM,PAS
 SG_ FrntRdrDetn190RdrDetnAzi : 287|11@0+ (0.1,-90.0) [-90.0|90.0] "Deg" ASDM,PAS
 SG_ FrntRdrDetn190RdrDetnChks : 247|8@0+ (1.0,0.0) [0.0|255.0] "Unitless" ASDM,PAS
 SG_ FrntRdrDetn190RdrDetnCntr : 255|4@0+ (1.0,0.0) [0.0|15.0] "Unitless" ASDM,PAS
 SG_ FrntRdrDetn190RdrDetnConf : 311|7@0+ (1.0,0.0) [0.0|100.0] "%" ASDM,PAS
 SG_ FrntRdrDetn190RdrDetnElevn : 319|5@0+ (1.0,-15.0) [-15.0|15.0] "Deg" ASDM,PAS
 SG_ FrntRdrDetn190RdrDetnPwr : 249|9@0+ (0.1,0.0) [0.0|51.1] "dB" ASDM,PAS
 SG_ FrntRdrDetn190RdrDetnRng : 271|14@0+ (0.02,-1.0) [-1.0|200.0] "m" ASDM,PAS
 SG_ FrntRdrDetn190RdrDetnRngV : 292|13@0+ (0.02,-80.0) [-80.0|80.0] "m/s" ASDM,PAS
 SG_ FrntRdrDetn190RdrDetnSts : 251|2@0+ (1,0) [0|3] "" ASDM,PAS
 SG_ FrntRdrDetn191_UB : 394|1@0+ (1,0) [0|1] "" ASDM,PAS
 SG_ FrntRdrDetn191RdrDetnAzi : 351|11@0+ (0.1,-90.0) [-90.0|90.0] "Deg" ASDM,PAS
 SG_ FrntRdrDetn191RdrDetnChks : 327|8@0+ (1.0,0.0) [0.0|255.0] "Unitless" ASDM,PAS
 SG_ FrntRdrDetn191RdrDetnCntr : 335|4@0+ (1.0,0.0) [0.0|15.0] "Unitless" ASDM,PAS
 SG_ FrntRdrDetn191RdrDetnConf : 391|7@0+ (1.0,0.0) [0.0|100.0] "%" ASDM,PAS
 SG_ FrntRdrDetn191RdrDetnElevn : 399|5@0+ (1.0,-15.0) [-15.0|15.0] "Deg" ASDM,PAS
 SG_ FrntRdrDetn191RdrDetnPwr : 329|9@0+ (0.1,0.0) [0.0|51.1] "dB" ASDM,PAS
 SG_ FrntRdrDetn191RdrDetnRng : 375|14@0+ (0.02,-1.0) [-1.0|200.0] "m" ASDM,PAS
 SG_ FrntRdrDetn191RdrDetnRngV : 356|13@0+ (0.02,-80.0) [-80.0|80.0] "m/s" ASDM,PAS
 SG_ FrntRdrDetn191RdrDetnSts : 331|2@0+ (1,0) [0|3] "" ASDM,PAS
 SG_ FrntRdrDetn192_UB : 474|1@0+ (1,0) [0|1] "" ASDM,PAS
 SG_ FrntRdrDetn192RdrDetnAzi : 447|11@0+ (0.1,-90.0) [-90.0|90.0] "Deg" ASDM,PAS
 SG_ FrntRdrDetn192RdrDetnChks : 407|8@0+ (1.0,0.0) [0.0|255.0] "Unitless" ASDM,PAS
 SG_ FrntRdrDetn192RdrDetnCntr : 415|4@0+ (1.0,0.0) [0.0|15.0] "Unitless" ASDM,PAS
 SG_ FrntRdrDetn192RdrDetnConf : 471|7@0+ (1.0,0.0) [0.0|100.0] "%" ASDM,PAS
 SG_ FrntRdrDetn192RdrDetnElevn : 479|5@0+ (1.0,-15.0) [-15.0|15.0] "Deg" ASDM,PAS
 SG_ FrntRdrDetn192RdrDetnPwr : 409|9@0+ (0.1,0.0) [0.0|51.1] "dB" ASDM,PAS
 SG_ FrntRdrDetn192RdrDetnRng : 431|14@0+ (0.02,-1.0) [-1.0|200.0] "m" ASDM,PAS
 SG_ FrntRdrDetn192RdrDetnRngV : 452|13@0+ (0.02,-80.0) [-80.0|80.0] "m/s" ASDM,PAS
 SG_ FrntRdrDetn192RdrDetnSts : 411|2@0+ (1,0) [0|3] "" ASDM,PAS

BO_ 368 FLRSafetyCANFD2Frame33: 64 FLR
 SG_ FrntRdrDetn193_UB : 74|1@0+ (1,0) [0|1] "" ASDM,PAS
 SG_ FrntRdrDetn193RdrDetnAzi : 31|11@0+ (0.1,-90.0) [-90.0|90.0] "Deg" ASDM,PAS
 SG_ FrntRdrDetn193RdrDetnChks : 7|8@0+ (1.0,0.0) [0.0|255.0] "Unitless" ASDM,PAS
 SG_ FrntRdrDetn193RdrDetnCntr : 15|4@0+ (1.0,0.0) [0.0|15.0] "Unitless" ASDM,PAS
 SG_ FrntRdrDetn193RdrDetnConf : 71|7@0+ (1.0,0.0) [0.0|100.0] "%" ASDM,PAS
 SG_ FrntRdrDetn193RdrDetnElevn : 79|5@0+ (1.0,-15.0) [-15.0|15.0] "Deg" ASDM,PAS
 SG_ FrntRdrDetn193RdrDetnPwr : 8|9@0+ (0.1,0.0) [0.0|51.1] "dB" ASDM,PAS
 SG_ FrntRdrDetn193RdrDetnRng : 55|14@0+ (0.02,-1.0) [-1.0|200.0] "m" ASDM,PAS
 SG_ FrntRdrDetn193RdrDetnRngV : 36|13@0+ (0.02,-80.0) [-80.0|80.0] "m/s" ASDM,PAS
 SG_ FrntRdrDetn193RdrDetnSts : 11|2@0+ (1,0) [0|3] "" ASDM,PAS
 SG_ FrntRdrDetn194_UB : 154|1@0+ (1,0) [0|1] "" ASDM,PAS
 SG_ FrntRdrDetn194RdrDetnAzi : 119|11@0+ (0.1,-90.0) [-90.0|90.0] "Deg" ASDM,PAS
 SG_ FrntRdrDetn194RdrDetnChks : 87|8@0+ (1.0,0.0) [0.0|255.0] "Unitless" ASDM,PAS
 SG_ FrntRdrDetn194RdrDetnCntr : 95|4@0+ (1.0,0.0) [0.0|15.0] "Unitless" ASDM,PAS
 SG_ FrntRdrDetn194RdrDetnConf : 111|7@0+ (1.0,0.0) [0.0|100.0] "%" ASDM,PAS
 SG_ FrntRdrDetn194RdrDetnElevn : 159|5@0+ (1.0,-15.0) [-15.0|15.0] "Deg" ASDM,PAS
 SG_ FrntRdrDetn194RdrDetnPwr : 89|9@0+ (0.1,0.0) [0.0|51.1] "dB" ASDM,PAS
 SG_ FrntRdrDetn194RdrDetnRng : 143|14@0+ (0.02,-1.0) [-1.0|200.0] "m" ASDM,PAS
 SG_ FrntRdrDetn194RdrDetnRngV : 124|13@0+ (0.02,-80.0) [-80.0|80.0] "m/s" ASDM,PAS
 SG_ FrntRdrDetn194RdrDetnSts : 91|2@0+ (1,0) [0|3] "" ASDM,PAS
 SG_ FrntRdrDetn195_UB : 234|1@0+ (1,0) [0|1] "" ASDM,PAS
 SG_ FrntRdrDetn195RdrDetnAzi : 199|11@0+ (0.1,-90.0) [-90.0|90.0] "Deg" ASDM,PAS
 SG_ FrntRdrDetn195RdrDetnChks : 167|8@0+ (1.0,0.0) [0.0|255.0] "Unitless" ASDM,PAS
 SG_ FrntRdrDetn195RdrDetnCntr : 175|4@0+ (1.0,0.0) [0.0|15.0] "Unitless" ASDM,PAS
 SG_ FrntRdrDetn195RdrDetnConf : 191|7@0+ (1.0,0.0) [0.0|100.0] "%" ASDM,PAS
 SG_ FrntRdrDetn195RdrDetnElevn : 239|5@0+ (1.0,-15.0) [-15.0|15.0] "Deg" ASDM,PAS
 SG_ FrntRdrDetn195RdrDetnPwr : 169|9@0+ (0.1,0.0) [0.0|51.1] "dB" ASDM,PAS
 SG_ FrntRdrDetn195RdrDetnRng : 223|14@0+ (0.02,-1.0) [-1.0|200.0] "m" ASDM,PAS
 SG_ FrntRdrDetn195RdrDetnRngV : 204|13@0+ (0.02,-80.0) [-80.0|80.0] "m/s" ASDM,PAS
 SG_ FrntRdrDetn195RdrDetnSts : 171|2@0+ (1,0) [0|3] "" ASDM,PAS
 SG_ FrntRdrDetn196_UB : 314|1@0+ (1,0) [0|1] "" ASDM,PAS
 SG_ FrntRdrDetn196RdrDetnAzi : 287|11@0+ (0.1,-90.0) [-90.0|90.0] "Deg" ASDM,PAS
 SG_ FrntRdrDetn196RdrDetnChks : 247|8@0+ (1.0,0.0) [0.0|255.0] "Unitless" ASDM,PAS
 SG_ FrntRdrDetn196RdrDetnCntr : 255|4@0+ (1.0,0.0) [0.0|15.0] "Unitless" ASDM,PAS
 SG_ FrntRdrDetn196RdrDetnConf : 311|7@0+ (1.0,0.0) [0.0|100.0] "%" ASDM,PAS
 SG_ FrntRdrDetn196RdrDetnElevn : 319|5@0+ (1.0,-15.0) [-15.0|15.0] "Deg" ASDM,PAS
 SG_ FrntRdrDetn196RdrDetnPwr : 249|9@0+ (0.1,0.0) [0.0|51.1] "dB" ASDM,PAS
 SG_ FrntRdrDetn196RdrDetnRng : 271|14@0+ (0.02,-1.0) [-1.0|200.0] "m" ASDM,PAS
 SG_ FrntRdrDetn196RdrDetnRngV : 292|13@0+ (0.02,-80.0) [-80.0|80.0] "m/s" ASDM,PAS
 SG_ FrntRdrDetn196RdrDetnSts : 251|2@0+ (1,0) [0|3] "" ASDM,PAS
 SG_ FrntRdrDetn197_UB : 394|1@0+ (1,0) [0|1] "" ASDM,PAS
 SG_ FrntRdrDetn197RdrDetnAzi : 351|11@0+ (0.1,-90.0) [-90.0|90.0] "Deg" ASDM,PAS
 SG_ FrntRdrDetn197RdrDetnChks : 327|8@0+ (1.0,0.0) [0.0|255.0] "Unitless" ASDM,PAS
 SG_ FrntRdrDetn197RdrDetnCntr : 335|4@0+ (1.0,0.0) [0.0|15.0] "Unitless" ASDM,PAS
 SG_ FrntRdrDetn197RdrDetnConf : 391|7@0+ (1.0,0.0) [0.0|100.0] "%" ASDM,PAS
 SG_ FrntRdrDetn197RdrDetnElevn : 399|5@0+ (1.0,-15.0) [-15.0|15.0] "Deg" ASDM,PAS
 SG_ FrntRdrDetn197RdrDetnPwr : 329|9@0+ (0.1,0.0) [0.0|51.1] "dB" ASDM,PAS
 SG_ FrntRdrDetn197RdrDetnRng : 375|14@0+ (0.02,-1.0) [-1.0|200.0] "m" ASDM,PAS
 SG_ FrntRdrDetn197RdrDetnRngV : 356|13@0+ (0.02,-80.0) [-80.0|80.0] "m/s" ASDM,PAS
 SG_ FrntRdrDetn197RdrDetnSts : 331|2@0+ (1,0) [0|3] "" ASDM,PAS
 SG_ FrntRdrDetn198_UB : 474|1@0+ (1,0) [0|1] "" ASDM,PAS
 SG_ FrntRdrDetn198RdrDetnAzi : 447|11@0+ (0.1,-90.0) [-90.0|90.0] "Deg" ASDM,PAS
 SG_ FrntRdrDetn198RdrDetnChks : 407|8@0+ (1.0,0.0) [0.0|255.0] "Unitless" ASDM,PAS
 SG_ FrntRdrDetn198RdrDetnCntr : 415|4@0+ (1.0,0.0) [0.0|15.0] "Unitless" ASDM,PAS
 SG_ FrntRdrDetn198RdrDetnConf : 471|7@0+ (1.0,0.0) [0.0|100.0] "%" ASDM,PAS
 SG_ FrntRdrDetn198RdrDetnElevn : 479|5@0+ (1.0,-15.0) [-15.0|15.0] "Deg" ASDM,PAS
 SG_ FrntRdrDetn198RdrDetnPwr : 409|9@0+ (0.1,0.0) [0.0|51.1] "dB" ASDM,PAS
 SG_ FrntRdrDetn198RdrDetnRng : 431|14@0+ (0.02,-1.0) [-1.0|200.0] "m" ASDM,PAS
 SG_ FrntRdrDetn198RdrDetnRngV : 452|13@0+ (0.02,-80.0) [-80.0|80.0] "m/s" ASDM,PAS
 SG_ FrntRdrDetn198RdrDetnSts : 411|2@0+ (1,0) [0|3] "" ASDM,PAS

BO_ 370 FLRSafetyCANFD2Frame34: 64 FLR
 SG_ FrntRdrDetn199_UB : 74|1@0+ (1,0) [0|1] "" ASDM,PAS
 SG_ FrntRdrDetn199RdrDetnAzi : 31|11@0+ (0.1,-90.0) [-90.0|90.0] "Deg" ASDM,PAS
 SG_ FrntRdrDetn199RdrDetnChks : 7|8@0+ (1.0,0.0) [0.0|255.0] "Unitless" ASDM,PAS
 SG_ FrntRdrDetn199RdrDetnCntr : 15|4@0+ (1.0,0.0) [0.0|15.0] "Unitless" ASDM,PAS
 SG_ FrntRdrDetn199RdrDetnConf : 71|7@0+ (1.0,0.0) [0.0|100.0] "%" ASDM,PAS
 SG_ FrntRdrDetn199RdrDetnElevn : 79|5@0+ (1.0,-15.0) [-15.0|15.0] "Deg" ASDM,PAS
 SG_ FrntRdrDetn199RdrDetnPwr : 8|9@0+ (0.1,0.0) [0.0|51.1] "dB" ASDM,PAS
 SG_ FrntRdrDetn199RdrDetnRng : 55|14@0+ (0.02,-1.0) [-1.0|200.0] "m" ASDM,PAS
 SG_ FrntRdrDetn199RdrDetnRngV : 36|13@0+ (0.02,-80.0) [-80.0|80.0] "m/s" ASDM,PAS
 SG_ FrntRdrDetn199RdrDetnSts : 11|2@0+ (1,0) [0|3] "" ASDM,PAS
 SG_ FrntRdrDetn200_UB : 154|1@0+ (1,0) [0|1] "" ASDM,PAS
 SG_ FrntRdrDetn200RdrDetnAzi : 119|11@0+ (0.1,-90.0) [-90.0|90.0] "Deg" ASDM,PAS
 SG_ FrntRdrDetn200RdrDetnChks : 87|8@0+ (1.0,0.0) [0.0|255.0] "Unitless" ASDM,PAS
 SG_ FrntRdrDetn200RdrDetnCntr : 95|4@0+ (1.0,0.0) [0.0|15.0] "Unitless" ASDM,PAS
 SG_ FrntRdrDetn200RdrDetnConf : 111|7@0+ (1.0,0.0) [0.0|100.0] "%" ASDM,PAS
 SG_ FrntRdrDetn200RdrDetnElevn : 159|5@0+ (1.0,-15.0) [-15.0|15.0] "Deg" ASDM,PAS
 SG_ FrntRdrDetn200RdrDetnPwr : 89|9@0+ (0.1,0.0) [0.0|51.1] "dB" ASDM,PAS
 SG_ FrntRdrDetn200RdrDetnRng : 143|14@0+ (0.02,-1.0) [-1.0|200.0] "m" ASDM,PAS
 SG_ FrntRdrDetn200RdrDetnRngV : 124|13@0+ (0.02,-80.0) [-80.0|80.0] "m/s" ASDM,PAS
 SG_ FrntRdrDetn200RdrDetnSts : 91|2@0+ (1,0) [0|3] "" ASDM,PAS

BO_ 372 FLRSafetyCANFD2Frame35: 64 FLR
 SG_ FrntRdrObj1_UB : 291|1@0+ (1,0) [0|1] "" ASDM,PAS
 SG_ FrntRdrObj1Heading : 287|12@0+ (0.1,-180.0) [-180.0|180.0] "Deg" ASDM,PAS
 SG_ FrntRdrObj1ObjBoxCenterLat : 23|9@0+ (0.1,-25.0) [-25.0|25.0] "m" ASDM,PAS
 SG_ FrntRdrObj1ObjBoxCenterLgt : 30|9@0+ (0.1,-25.0) [-25.0|25.0] "m" ASDM,PAS
 SG_ FrntRdrObj1ObservationHist : 63|32@0+ (1.0,0.0) [0.0|4294967295.0] "Unitless" ASDM,PAS
 SG_ FrntRdrObj1RdrObjAx : 7|8@0- (0.1,0.0) [-12.8|12.700000000000001] "m/s^2" ASDM,PAS
 SG_ FrntRdrObj1RdrObjAy : 15|8@0- (0.1,0.0) [-12.8|12.700000000000001] "m/s^2" ASDM,PAS
 SG_ FrntRdrObj1RdrObjBoxLength : 37|9@0+ (0.1,0.0) [0.0|50.0] "m" ASDM,PAS
 SG_ FrntRdrObj1RdrObjBoxWidth : 44|9@0+ (0.1,0.0) [0.0|50.0] "m" ASDM,PAS
 SG_ FrntRdrObj1RdrObjChks : 95|8@0+ (1.0,0.0) [0.0|255.0] "Unitless" ASDM,PAS
 SG_ FrntRdrObj1RdrObjCntr : 103|4@0+ (1.0,0.0) [0.0|15.0] "Unitless" ASDM,PAS
 SG_ FrntRdrObj1RdrObjCoastCnt : 279|5@0+ (1.0,0.0) [0.0|31.0] "Unitless" ASDM,PAS
 SG_ FrntRdrObj1RdrObjConf : 99|4@0+ (7.0,0.0) [0.0|105.0] "%" ASDM,PAS
 SG_ FrntRdrObj1RdrObjDx : 191|13@0+ (0.05,-200.0) [-200.0|200.0] "m" ASDM,PAS
 SG_ FrntRdrObj1RdrObjDxStdDe : 111|8@0+ (0.05,0.0) [0.0|12.700000000000001] "m" ASDM,PAS
 SG_ FrntRdrObj1RdrObjDy : 119|13@0+ (0.05,-200.0) [-200.0|200.0] "m" ASDM,PAS
 SG_ FrntRdrObj1RdrObjDyStdDe : 183|8@0+ (0.05,0.0) [0.0|12.700000000000001] "m" ASDM,PAS
 SG_ FrntRdrObj1RdrObjElevnConf : 223|4@0+ (7.0,0.0) [0.0|105.0] "%" ASDM,PAS
 SG_ FrntRdrObj1RdrObjElevnSts : 153|2@0+ (1,0) [0|3] "" ASDM,PAS
 SG_ FrntRdrObj1RdrObjID : 167|8@0+ (1.0,0.0) [0.0|255.0] "Unitless" ASDM,PAS
 SG_ FrntRdrObj1RdrObjIsInFreeSpace : 192|1@0+ (1,0) [0|1] "" ASDM,PAS
 SG_ FrntRdrObj1RdrObjMirrProblty : 219|4@0+ (7.0,0.0) [0.0|105.0] "%" ASDM,PAS
 SG_ FrntRdrObj1RdrObjMtnPat : 122|3@0+ (1,0) [0|7] "" ASDM,PAS
 SG_ FrntRdrObj1RdrObjNotRealProblty : 231|4@0+ (7.0,0.0) [0.0|105.0] "%" ASDM,PAS
 SG_ FrntRdrObj1RdrObjStatyCnt : 239|7@0+ (1.0,0.0) [0.0|127.0] "Unitless" ASDM,PAS
 SG_ FrntRdrObj1RdrObjTiAlv : 247|7@0+ (1.0,0.0) [0.0|127.0] "Unitless" ASDM,PAS
 SG_ FrntRdrObj1RdrObjTrackSts : 194|2@0+ (1,0) [0|3] "" ASDM,PAS
 SG_ FrntRdrObj1RdrObjTyp : 51|4@0+ (1,0) [0|15] "" ASDM,PAS
 SG_ FrntRdrObj1RdrObjTypConfBike : 175|4@0+ (7.0,0.0) [0.0|105.0] "%" ASDM,PAS
 SG_ FrntRdrObj1RdrObjTypConfPed : 171|4@0+ (7.0,0.0) [0.0|105.0] "%" ASDM,PAS
 SG_ FrntRdrObj1RdrObjTypConfVeh : 227|4@0+ (7.0,0.0) [0.0|105.0] "%" ASDM,PAS
 SG_ FrntRdrObj1RdrObjVx : 255|14@0+ (0.02,-128.0) [-128.0|128.0] "m/s" ASDM,PAS
 SG_ FrntRdrObj1RdrObjVxStdDe : 271|6@0+ (0.05,0.0) [0.0|2.0] "m/s" ASDM,PAS
 SG_ FrntRdrObj1RdrObjVy : 207|14@0+ (0.02,-128.0) [-128.0|128.0] "m/s" ASDM,PAS
 SG_ FrntRdrObj1RdrObjVyStdDe : 159|6@0+ (0.05,0.0) [0.0|2.0] "m/s" ASDM,PAS
 SG_ FrntRdrObj1RelVx : 135|12@0+ (0.02,-35.6) [-35.6|35.6] "m/s" ASDM,PAS
 SG_ FrntRdrObj1RelVy : 139|12@0+ (0.02,-35.6) [-35.6|35.6] "m/s" ASDM,PAS

BO_ 374 FLRSafetyCANFD2Frame36: 64 FLR
 SG_ FrntRdrObj2_UB : 291|1@0+ (1,0) [0|1] "" ASDM,PAS
 SG_ FrntRdrObj2Heading : 287|12@0+ (0.1,-180.0) [-180.0|180.0] "Deg" ASDM,PAS
 SG_ FrntRdrObj2ObjBoxCenterLat : 23|9@0+ (0.1,-25.0) [-25.0|25.0] "m" ASDM,PAS
 SG_ FrntRdrObj2ObjBoxCenterLgt : 30|9@0+ (0.1,-25.0) [-25.0|25.0] "m" ASDM,PAS
 SG_ FrntRdrObj2ObservationHist : 63|32@0+ (1.0,0.0) [0.0|4294967295.0] "Unitless" ASDM,PAS
 SG_ FrntRdrObj2RdrObjAx : 7|8@0- (0.1,0.0) [-12.8|12.700000000000001] "m/s^2" ASDM,PAS
 SG_ FrntRdrObj2RdrObjAy : 15|8@0- (0.1,0.0) [-12.8|12.700000000000001] "m/s^2" ASDM,PAS
 SG_ FrntRdrObj2RdrObjBoxLength : 37|9@0+ (0.1,0.0) [0.0|50.0] "m" ASDM,PAS
 SG_ FrntRdrObj2RdrObjBoxWidth : 44|9@0+ (0.1,0.0) [0.0|50.0] "m" ASDM,PAS
 SG_ FrntRdrObj2RdrObjChks : 95|8@0+ (1.0,0.0) [0.0|255.0] "Unitless" ASDM,PAS
 SG_ FrntRdrObj2RdrObjCntr : 103|4@0+ (1.0,0.0) [0.0|15.0] "Unitless" ASDM,PAS
 SG_ FrntRdrObj2RdrObjCoastCnt : 279|5@0+ (1.0,0.0) [0.0|31.0] "Unitless" ASDM,PAS
 SG_ FrntRdrObj2RdrObjConf : 99|4@0+ (7.0,0.0) [0.0|105.0] "%" ASDM,PAS
 SG_ FrntRdrObj2RdrObjDx : 191|13@0+ (0.05,-200.0) [-200.0|200.0] "m" ASDM,PAS
 SG_ FrntRdrObj2RdrObjDxStdDe : 111|8@0+ (0.05,0.0) [0.0|12.700000000000001] "m" ASDM,PAS
 SG_ FrntRdrObj2RdrObjDy : 119|13@0+ (0.05,-200.0) [-200.0|200.0] "m" ASDM,PAS
 SG_ FrntRdrObj2RdrObjDyStdDe : 183|8@0+ (0.05,0.0) [0.0|12.700000000000001] "m" ASDM,PAS
 SG_ FrntRdrObj2RdrObjElevnConf : 223|4@0+ (7.0,0.0) [0.0|105.0] "%" ASDM,PAS
 SG_ FrntRdrObj2RdrObjElevnSts : 153|2@0+ (1,0) [0|3] "" ASDM,PAS
 SG_ FrntRdrObj2RdrObjID : 167|8@0+ (1.0,0.0) [0.0|255.0] "Unitless" ASDM,PAS
 SG_ FrntRdrObj2RdrObjIsInFreeSpace : 192|1@0+ (1,0) [0|1] "" ASDM,PAS
 SG_ FrntRdrObj2RdrObjMirrProblty : 219|4@0+ (7.0,0.0) [0.0|105.0] "%" ASDM,PAS
 SG_ FrntRdrObj2RdrObjMtnPat : 122|3@0+ (1,0) [0|7] "" ASDM,PAS
 SG_ FrntRdrObj2RdrObjNotRealProblty : 231|4@0+ (7.0,0.0) [0.0|105.0] "%" ASDM,PAS
 SG_ FrntRdrObj2RdrObjStatyCnt : 239|7@0+ (1.0,0.0) [0.0|127.0] "Unitless" ASDM,PAS
 SG_ FrntRdrObj2RdrObjTiAlv : 247|7@0+ (1.0,0.0) [0.0|127.0] "Unitless" ASDM,PAS
 SG_ FrntRdrObj2RdrObjTrackSts : 194|2@0+ (1,0) [0|3] "" ASDM,PAS
 SG_ FrntRdrObj2RdrObjTyp : 51|4@0+ (1,0) [0|15] "" ASDM,PAS
 SG_ FrntRdrObj2RdrObjTypConfBike : 175|4@0+ (7.0,0.0) [0.0|105.0] "%" ASDM,PAS
 SG_ FrntRdrObj2RdrObjTypConfPed : 171|4@0+ (7.0,0.0) [0.0|105.0] "%" ASDM,PAS
 SG_ FrntRdrObj2RdrObjTypConfVeh : 227|4@0+ (7.0,0.0) [0.0|105.0] "%" ASDM,PAS
 SG_ FrntRdrObj2RdrObjVx : 255|14@0+ (0.02,-128.0) [-128.0|128.0] "m/s" ASDM,PAS
 SG_ FrntRdrObj2RdrObjVxStdDe : 271|6@0+ (0.05,0.0) [0.0|2.0] "m/s" ASDM,PAS
 SG_ FrntRdrObj2RdrObjVy : 207|14@0+ (0.02,-128.0) [-128.0|128.0] "m/s" ASDM,PAS
 SG_ FrntRdrObj2RdrObjVyStdDe : 159|6@0+ (0.05,0.0) [0.0|2.0] "m/s" ASDM,PAS
 SG_ FrntRdrObj2RelVx : 135|12@0+ (0.02,-35.6) [-35.6|35.6] "m/s" ASDM,PAS
 SG_ FrntRdrObj2RelVy : 139|12@0+ (0.02,-35.6) [-35.6|35.6] "m/s" ASDM,PAS

BO_ 376 FLRSafetyCANFD2Frame37: 64 FLR
 SG_ FrntRdrObj3_UB : 291|1@0+ (1,0) [0|1] "" ASDM,PAS
 SG_ FrntRdrObj3Heading : 287|12@0+ (0.1,-180.0) [-180.0|180.0] "Deg" ASDM,PAS
 SG_ FrntRdrObj3ObjBoxCenterLat : 23|9@0+ (0.1,-25.0) [-25.0|25.0] "m" ASDM,PAS
 SG_ FrntRdrObj3ObjBoxCenterLgt : 30|9@0+ (0.1,-25.0) [-25.0|25.0] "m" ASDM,PAS
 SG_ FrntRdrObj3ObservationHist : 63|32@0+ (1.0,0.0) [0.0|4294967295.0] "Unitless" ASDM,PAS
 SG_ FrntRdrObj3RdrObjAx : 7|8@0- (0.1,0.0) [-12.8|12.700000000000001] "m/s^2" ASDM,PAS
 SG_ FrntRdrObj3RdrObjAy : 15|8@0- (0.1,0.0) [-12.8|12.700000000000001] "m/s^2" ASDM,PAS
 SG_ FrntRdrObj3RdrObjBoxLength : 37|9@0+ (0.1,0.0) [0.0|50.0] "m" ASDM,PAS
 SG_ FrntRdrObj3RdrObjBoxWidth : 44|9@0+ (0.1,0.0) [0.0|50.0] "m" ASDM,PAS
 SG_ FrntRdrObj3RdrObjChks : 95|8@0+ (1.0,0.0) [0.0|255.0] "Unitless" ASDM,PAS
 SG_ FrntRdrObj3RdrObjCntr : 103|4@0+ (1.0,0.0) [0.0|15.0] "Unitless" ASDM,PAS
 SG_ FrntRdrObj3RdrObjCoastCnt : 279|5@0+ (1.0,0.0) [0.0|31.0] "Unitless" ASDM,PAS
 SG_ FrntRdrObj3RdrObjConf : 99|4@0+ (7.0,0.0) [0.0|105.0] "%" ASDM,PAS
 SG_ FrntRdrObj3RdrObjDx : 191|13@0+ (0.05,-200.0) [-200.0|200.0] "m" ASDM,PAS
 SG_ FrntRdrObj3RdrObjDxStdDe : 111|8@0+ (0.05,0.0) [0.0|12.700000000000001] "m" ASDM,PAS
 SG_ FrntRdrObj3RdrObjDy : 119|13@0+ (0.05,-200.0) [-200.0|200.0] "m" ASDM,PAS
 SG_ FrntRdrObj3RdrObjDyStdDe : 183|8@0+ (0.05,0.0) [0.0|12.700000000000001] "m" ASDM,PAS
 SG_ FrntRdrObj3RdrObjElevnConf : 223|4@0+ (7.0,0.0) [0.0|105.0] "%" ASDM,PAS
 SG_ FrntRdrObj3RdrObjElevnSts : 153|2@0+ (1,0) [0|3] "" ASDM,PAS
 SG_ FrntRdrObj3RdrObjID : 167|8@0+ (1.0,0.0) [0.0|255.0] "Unitless" ASDM,PAS
 SG_ FrntRdrObj3RdrObjIsInFreeSpace : 192|1@0+ (1,0) [0|1] "" ASDM,PAS
 SG_ FrntRdrObj3RdrObjMirrProblty : 219|4@0+ (7.0,0.0) [0.0|105.0] "%" ASDM,PAS
 SG_ FrntRdrObj3RdrObjMtnPat : 122|3@0+ (1,0) [0|7] "" ASDM,PAS
 SG_ FrntRdrObj3RdrObjNotRealProblty : 231|4@0+ (7.0,0.0) [0.0|105.0] "%" ASDM,PAS
 SG_ FrntRdrObj3RdrObjStatyCnt : 239|7@0+ (1.0,0.0) [0.0|127.0] "Unitless" ASDM,PAS
 SG_ FrntRdrObj3RdrObjTiAlv : 247|7@0+ (1.0,0.0) [0.0|127.0] "Unitless" ASDM,PAS
 SG_ FrntRdrObj3RdrObjTrackSts : 194|2@0+ (1,0) [0|3] "" ASDM,PAS
 SG_ FrntRdrObj3RdrObjTyp : 51|4@0+ (1,0) [0|15] "" ASDM,PAS
 SG_ FrntRdrObj3RdrObjTypConfBike : 175|4@0+ (7.0,0.0) [0.0|105.0] "%" ASDM,PAS
 SG_ FrntRdrObj3RdrObjTypConfPed : 171|4@0+ (7.0,0.0) [0.0|105.0] "%" ASDM,PAS
 SG_ FrntRdrObj3RdrObjTypConfVeh : 227|4@0+ (7.0,0.0) [0.0|105.0] "%" ASDM,PAS
 SG_ FrntRdrObj3RdrObjVx : 255|14@0+ (0.02,-128.0) [-128.0|128.0] "m/s" ASDM,PAS
 SG_ FrntRdrObj3RdrObjVxStdDe : 271|6@0+ (0.05,0.0) [0.0|2.0] "m/s" ASDM,PAS
 SG_ FrntRdrObj3RdrObjVy : 207|14@0+ (0.02,-128.0) [-128.0|128.0] "m/s" ASDM,PAS
 SG_ FrntRdrObj3RdrObjVyStdDe : 159|6@0+ (0.05,0.0) [0.0|2.0] "m/s" ASDM,PAS
 SG_ FrntRdrObj3RelVx : 135|12@0+ (0.02,-35.6) [-35.6|35.6] "m/s" ASDM,PAS
 SG_ FrntRdrObj3RelVy : 139|12@0+ (0.02,-35.6) [-35.6|35.6] "m/s" ASDM,PAS

CM_ SG_ 358 FrntRdrDetn163RdrDetnAzi "Refer to the data element description in FrntRdrDetn1 with the same data element name.";
CM_ SG_ 358 FrntRdrDetn163RdrDetnChks "Refer to the data element description in FrntRdrDetn1 with the same data element name.";
CM_ SG_ 358 FrntRdrDetn163RdrDetnCntr "Refer to the data element description in FrntRdrDetn1 with the same data element name.";
CM_ SG_ 358 FrntRdrDetn163RdrDetnConf "Refer to the data element description in FrntRdrDetn1 with the same data element name.";
CM_ SG_ 358 FrntRdrDetn163RdrDetnElevn "Refer to the data element description in FrntRdrDetn1 with the same data element name.";
CM_ SG_ 358 FrntRdrDetn163RdrDetnPwr "Refer to the data element description in FrntRdrDetn1 with the same data element name.";
CM_ SG_ 358 FrntRdrDetn163RdrDetnRng "Refer to the data element description in FrntRdrDetn1 with the same data element name.";
CM_ SG_ 358 FrntRdrDetn163RdrDetnRngV "Refer to the data element description in FrntRdrDetn1 with the same data element name.";
CM_ SG_ 358 FrntRdrDetn163RdrDetnSts "Refer to the data element description in FrntRdrDetn1 with the same data element name.";
CM_ SG_ 358 FrntRdrDetn164RdrDetnAzi "Refer to the data element description in FrntRdrDetn1 with the same data element name.";
CM_ SG_ 358 FrntRdrDetn164RdrDetnChks "Refer to the data element description in FrntRdrDetn1 with the same data element name.";
CM_ SG_ 358 FrntRdrDetn164RdrDetnCntr "Refer to the data element description in FrntRdrDetn1 with the same data element name.";
CM_ SG_ 358 FrntRdrDetn164RdrDetnConf "Refer to the data element description in FrntRdrDetn1 with the same data element name.";
CM_ SG_ 358 FrntRdrDetn164RdrDetnElevn "Refer to the data element description in FrntRdrDetn1 with the same data element name.";
CM_ SG_ 358 FrntRdrDetn164RdrDetnPwr "Refer to the data element description in FrntRdrDetn1 with the same data element name.";
CM_ SG_ 358 FrntRdrDetn164RdrDetnRng "Refer to the data element description in FrntRdrDetn1 with the same data element name.";
CM_ SG_ 358 FrntRdrDetn164RdrDetnRngV "Refer to the data element description in FrntRdrDetn1 with the same data element name.";
CM_ SG_ 358 FrntRdrDetn164RdrDetnSts "Refer to the data element description in FrntRdrDetn1 with the same data element name.";
CM_ SG_ 358 FrntRdrDetn165RdrDetnAzi "Refer to the data element description in FrntRdrDetn1 with the same data element name.";
CM_ SG_ 358 FrntRdrDetn165RdrDetnChks "Refer to the data element description in FrntRdrDetn1 with the same data element name.";
CM_ SG_ 358 FrntRdrDetn165RdrDetnCntr "Refer to the data element description in FrntRdrDetn1 with the same data element name.";
CM_ SG_ 358 FrntRdrDetn165RdrDetnConf "Refer to the data element description in FrntRdrDetn1 with the same data element name.";
CM_ SG_ 358 FrntRdrDetn165RdrDetnElevn "Refer to the data element description in FrntRdrDetn1 with the same data element name.";
CM_ SG_ 358 FrntRdrDetn165RdrDetnPwr "Refer to the data element description in FrntRdrDetn1 with the same data element name.";
CM_ SG_ 358 FrntRdrDetn165RdrDetnRng "Refer to the data element description in FrntRdrDetn1 with the same data element name.";
CM_ SG_ 358 FrntRdrDetn165RdrDetnRngV "Refer to the data element description in FrntRdrDetn1 with the same data element name.";
CM_ SG_ 358 FrntRdrDetn165RdrDetnSts "Refer to the data element description in FrntRdrDetn1 with the same data element name.";
CM_ SG_ 358 FrntRdrDetn166RdrDetnAzi "Refer to the data element description in FrntRdrDetn1 with the same data element name.";
CM_ SG_ 358 FrntRdrDetn166RdrDetnChks "Refer to the data element description in FrntRdrDetn1 with the same data element name.";
CM_ SG_ 358 FrntRdrDetn166RdrDetnCntr "Refer to the data element description in FrntRdrDetn1 with the same data element name.";
CM_ SG_ 358 FrntRdrDetn166RdrDetnConf "Refer to the data element description in FrntRdrDetn1 with the same data element name.";
CM_ SG_ 358 FrntRdrDetn166RdrDetnElevn "Refer to the data element description in FrntRdrDetn1 with the same data element name.";
CM_ SG_ 358 FrntRdrDetn166RdrDetnPwr "Refer to the data element description in FrntRdrDetn1 with the same data element name.";
CM_ SG_ 358 FrntRdrDetn166RdrDetnRng "Refer to the data element description in FrntRdrDetn1 with the same data element name.";
CM_ SG_ 358 FrntRdrDetn166RdrDetnRngV "Refer to the data element description in FrntRdrDetn1 with the same data element name.";
CM_ SG_ 358 FrntRdrDetn166RdrDetnSts "Refer to the data element description in FrntRdrDetn1 with the same data element name.";
CM_ SG_ 358 FrntRdrDetn167RdrDetnAzi "Refer to the data element description in FrntRdrDetn1 with the same data element name.";
CM_ SG_ 358 FrntRdrDetn167RdrDetnChks "Refer to the data element description in FrntRdrDetn1 with the same data element name.";
CM_ SG_ 358 FrntRdrDetn167RdrDetnCntr "Refer to the data element description in FrntRdrDetn1 with the same data element name.";
CM_ SG_ 358 FrntRdrDetn167RdrDetnConf "Refer to the data element description in FrntRdrDetn1 with the same data element name.";
CM_ SG_ 358 FrntRdrDetn167RdrDetnElevn "Refer to the data element description in FrntRdrDetn1 with the same data element name.";
CM_ SG_ 358 FrntRdrDetn167RdrDetnPwr "Refer to the data element description in FrntRdrDetn1 with the same data element name.";
CM_ SG_ 358 FrntRdrDetn167RdrDetnRng "Refer to the data element description in FrntRdrDetn1 with the same data element name.";
CM_ SG_ 358 FrntRdrDetn167RdrDetnRngV "Refer to the data element description in FrntRdrDetn1 with the same data element name.";
CM_ SG_ 358 FrntRdrDetn167RdrDetnSts "Refer to the data element description in FrntRdrDetn1 with the same data element name.";
CM_ SG_ 358 FrntRdrDetn168RdrDetnAzi "Refer to the data element description in FrntRdrDetn1 with the same data element name.";
CM_ SG_ 358 FrntRdrDetn168RdrDetnChks "Refer to the data element description in FrntRdrDetn1 with the same data element name.";
CM_ SG_ 358 FrntRdrDetn168RdrDetnCntr "Refer to the data element description in FrntRdrDetn1 with the same data element name.";
CM_ SG_ 358 FrntRdrDetn168RdrDetnConf "Refer to the data element description in FrntRdrDetn1 with the same data element name.";
CM_ SG_ 358 FrntRdrDetn168RdrDetnElevn "Refer to the data element description in FrntRdrDetn1 with the same data element name.";
CM_ SG_ 358 FrntRdrDetn168RdrDetnPwr "Refer to the data element description in FrntRdrDetn1 with the same data element name.";
CM_ SG_ 358 FrntRdrDetn168RdrDetnRng "Refer to the data element description in FrntRdrDetn1 with the same data element name.";
CM_ SG_ 358 FrntRdrDetn168RdrDetnRngV "Refer to the data element description in FrntRdrDetn1 with the same data element name.";
CM_ SG_ 358 FrntRdrDetn168RdrDetnSts "Refer to the data element description in FrntRdrDetn1 with the same data element name.";
CM_ SG_ 360 FrntRdrDetn169RdrDetnAzi "Refer to the data element description in FrntRdrDetn1 with the same data element name.";
CM_ SG_ 360 FrntRdrDetn169RdrDetnChks "Refer to the data element description in FrntRdrDetn1 with the same data element name.";
CM_ SG_ 360 FrntRdrDetn169RdrDetnCntr "Refer to the data element description in FrntRdrDetn1 with the same data element name.";
CM_ SG_ 360 FrntRdrDetn169RdrDetnConf "Refer to the data element description in FrntRdrDetn1 with the same data element name.";
CM_ SG_ 360 FrntRdrDetn169RdrDetnElevn "Refer to the data element description in FrntRdrDetn1 with the same data element name.";
CM_ SG_ 360 FrntRdrDetn169RdrDetnPwr "Refer to the data element description in FrntRdrDetn1 with the same data element name.";
CM_ SG_ 360 FrntRdrDetn169RdrDetnRng "Refer to the data element description in FrntRdrDetn1 with the same data element name.";
CM_ SG_ 360 FrntRdrDetn169RdrDetnRngV "Refer to the data element description in FrntRdrDetn1 with the same data element name.";
CM_ SG_ 360 FrntRdrDetn169RdrDetnSts "Refer to the data element description in FrntRdrDetn1 with the same data element name.";
CM_ SG_ 360 FrntRdrDetn170RdrDetnAzi "Refer to the data element description in FrntRdrDetn1 with the same data element name.";
CM_ SG_ 360 FrntRdrDetn170RdrDetnChks "Refer to the data element description in FrntRdrDetn1 with the same data element name.";
CM_ SG_ 360 FrntRdrDetn170RdrDetnCntr "Refer to the data element description in FrntRdrDetn1 with the same data element name.";
CM_ SG_ 360 FrntRdrDetn170RdrDetnConf "Refer to the data element description in FrntRdrDetn1 with the same data element name.";
CM_ SG_ 360 FrntRdrDetn170RdrDetnElevn "Refer to the data element description in FrntRdrDetn1 with the same data element name.";
CM_ SG_ 360 FrntRdrDetn170RdrDetnPwr "Refer to the data element description in FrntRdrDetn1 with the same data element name.";
CM_ SG_ 360 FrntRdrDetn170RdrDetnRng "Refer to the data element description in FrntRdrDetn1 with the same data element name.";
CM_ SG_ 360 FrntRdrDetn170RdrDetnRngV "Refer to the data element description in FrntRdrDetn1 with the same data element name.";
CM_ SG_ 360 FrntRdrDetn170RdrDetnSts "Refer to the data element description in FrntRdrDetn1 with the same data element name.";
CM_ SG_ 360 FrntRdrDetn171RdrDetnAzi "Refer to the data element description in FrntRdrDetn1 with the same data element name.";
CM_ SG_ 360 FrntRdrDetn171RdrDetnChks "Refer to the data element description in FrntRdrDetn1 with the same data element name.";
CM_ SG_ 360 FrntRdrDetn171RdrDetnCntr "Refer to the data element description in FrntRdrDetn1 with the same data element name.";
CM_ SG_ 360 FrntRdrDetn171RdrDetnConf "Refer to the data element description in FrntRdrDetn1 with the same data element name.";
CM_ SG_ 360 FrntRdrDetn171RdrDetnElevn "Refer to the data element description in FrntRdrDetn1 with the same data element name.";
CM_ SG_ 360 FrntRdrDetn171RdrDetnPwr "Refer to the data element description in FrntRdrDetn1 with the same data element name.";
CM_ SG_ 360 FrntRdrDetn171RdrDetnRng "Refer to the data element description in FrntRdrDetn1 with the same data element name.";
CM_ SG_ 360 FrntRdrDetn171RdrDetnRngV "Refer to the data element description in FrntRdrDetn1 with the same data element name.";
CM_ SG_ 360 FrntRdrDetn171RdrDetnSts "Refer to the data element description in FrntRdrDetn1 with the same data element name.";
CM_ SG_ 360 FrntRdrDetn172RdrDetnAzi "Refer to the data element description in FrntRdrDetn1 with the same data element name.";
CM_ SG_ 360 FrntRdrDetn172RdrDetnChks "Refer to the data element description in FrntRdrDetn1 with the same data element name.";
CM_ SG_ 360 FrntRdrDetn172RdrDetnCntr "Refer to the data element description in FrntRdrDetn1 with the same data element name.";
CM_ SG_ 360 FrntRdrDetn172RdrDetnConf "Refer to the data element description in FrntRdrDetn1 with the same data element name.";
CM_ SG_ 360 FrntRdrDetn172RdrDetnElevn "Refer to the data element description in FrntRdrDetn1 with the same data element name.";
CM_ SG_ 360 FrntRdrDetn172RdrDetnPwr "Refer to the data element description in FrntRdrDetn1 with the same data element name.";
CM_ SG_ 360 FrntRdrDetn172RdrDetnRng "Refer to the data element description in FrntRdrDetn1 with the same data element name.";
CM_ SG_ 360 FrntRdrDetn172RdrDetnRngV "Refer to the data element description in FrntRdrDetn1 with the same data element name.";
CM_ SG_ 360 FrntRdrDetn172RdrDetnSts "Refer to the data element description in FrntRdrDetn1 with the same data element name.";
CM_ SG_ 360 FrntRdrDetn173RdrDetnAzi "Refer to the data element description in FrntRdrDetn1 with the same data element name.";
CM_ SG_ 360 FrntRdrDetn173RdrDetnChks "Refer to the data element description in FrntRdrDetn1 with the same data element name.";
CM_ SG_ 360 FrntRdrDetn173RdrDetnCntr "Refer to the data element description in FrntRdrDetn1 with the same data element name.";
CM_ SG_ 360 FrntRdrDetn173RdrDetnConf "Refer to the data element description in FrntRdrDetn1 with the same data element name.";
CM_ SG_ 360 FrntRdrDetn173RdrDetnElevn "Refer to the data element description in FrntRdrDetn1 with the same data element name.";
CM_ SG_ 360 FrntRdrDetn173RdrDetnPwr "Refer to the data element description in FrntRdrDetn1 with the same data element name.";
CM_ SG_ 360 FrntRdrDetn173RdrDetnRng "Refer to the data element description in FrntRdrDetn1 with the same data element name.";
CM_ SG_ 360 FrntRdrDetn173RdrDetnRngV "Refer to the data element description in FrntRdrDetn1 with the same data element name.";
CM_ SG_ 360 FrntRdrDetn173RdrDetnSts "Refer to the data element description in FrntRdrDetn1 with the same data element name.";
CM_ SG_ 360 FrntRdrDetn174RdrDetnAzi "Refer to the data element description in FrntRdrDetn1 with the same data element name.";
CM_ SG_ 360 FrntRdrDetn174RdrDetnChks "Refer to the data element description in FrntRdrDetn1 with the same data element name.";
CM_ SG_ 360 FrntRdrDetn174RdrDetnCntr "Refer to the data element description in FrntRdrDetn1 with the same data element name.";
CM_ SG_ 360 FrntRdrDetn174RdrDetnConf "Refer to the data element description in FrntRdrDetn1 with the same data element name.";
CM_ SG_ 360 FrntRdrDetn174RdrDetnElevn "Refer to the data element description in FrntRdrDetn1 with the same data element name.";
CM_ SG_ 360 FrntRdrDetn174RdrDetnPwr "Refer to the data element description in FrntRdrDetn1 with the same data element name.";
CM_ SG_ 360 FrntRdrDetn174RdrDetnRng "Refer to the data element description in FrntRdrDetn1 with the same data element name.";
CM_ SG_ 360 FrntRdrDetn174RdrDetnRngV "Refer to the data element description in FrntRdrDetn1 with the same data element name.";
CM_ SG_ 360 FrntRdrDetn174RdrDetnSts "Refer to the data element description in FrntRdrDetn1 with the same data element name.";
CM_ SG_ 362 FrntRdrDetn175RdrDetnAzi "Refer to the data element description in FrntRdrDetn1 with the same data element name.";
CM_ SG_ 362 FrntRdrDetn175RdrDetnChks "Refer to the data element description in FrntRdrDetn1 with the same data element name.";
CM_ SG_ 362 FrntRdrDetn175RdrDetnCntr "Refer to the data element description in FrntRdrDetn1 with the same data element name.";
CM_ SG_ 362 FrntRdrDetn175RdrDetnConf "Refer to the data element description in FrntRdrDetn1 with the same data element name.";
CM_ SG_ 362 FrntRdrDetn175RdrDetnElevn "Refer to the data element description in FrntRdrDetn1 with the same data element name.";
CM_ SG_ 362 FrntRdrDetn175RdrDetnPwr "Refer to the data element description in FrntRdrDetn1 with the same data element name.";
CM_ SG_ 362 FrntRdrDetn175RdrDetnRng "Refer to the data element description in FrntRdrDetn1 with the same data element name.";
CM_ SG_ 362 FrntRdrDetn175RdrDetnRngV "Refer to the data element description in FrntRdrDetn1 with the same data element name.";
CM_ SG_ 362 FrntRdrDetn175RdrDetnSts "Refer to the data element description in FrntRdrDetn1 with the same data element name.";
CM_ SG_ 362 FrntRdrDetn176RdrDetnAzi "Refer to the data element description in FrntRdrDetn1 with the same data element name.";
CM_ SG_ 362 FrntRdrDetn176RdrDetnChks "Refer to the data element description in FrntRdrDetn1 with the same data element name.";
CM_ SG_ 362 FrntRdrDetn176RdrDetnCntr "Refer to the data element description in FrntRdrDetn1 with the same data element name.";
CM_ SG_ 362 FrntRdrDetn176RdrDetnConf "Refer to the data element description in FrntRdrDetn1 with the same data element name.";
CM_ SG_ 362 FrntRdrDetn176RdrDetnElevn "Refer to the data element description in FrntRdrDetn1 with the same data element name.";
CM_ SG_ 362 FrntRdrDetn176RdrDetnPwr "Refer to the data element description in FrntRdrDetn1 with the same data element name.";
CM_ SG_ 362 FrntRdrDetn176RdrDetnRng "Refer to the data element description in FrntRdrDetn1 with the same data element name.";
CM_ SG_ 362 FrntRdrDetn176RdrDetnRngV "Refer to the data element description in FrntRdrDetn1 with the same data element name.";
CM_ SG_ 362 FrntRdrDetn176RdrDetnSts "Refer to the data element description in FrntRdrDetn1 with the same data element name.";
CM_ SG_ 362 FrntRdrDetn177RdrDetnAzi "Refer to the data element description in FrntRdrDetn1 with the same data element name.";
CM_ SG_ 362 FrntRdrDetn177RdrDetnChks "Refer to the data element description in FrntRdrDetn1 with the same data element name.";
CM_ SG_ 362 FrntRdrDetn177RdrDetnCntr "Refer to the data element description in FrntRdrDetn1 with the same data element name.";
CM_ SG_ 362 FrntRdrDetn177RdrDetnConf "Refer to the data element description in FrntRdrDetn1 with the same data element name.";
CM_ SG_ 362 FrntRdrDetn177RdrDetnElevn "Refer to the data element description in FrntRdrDetn1 with the same data element name.";
CM_ SG_ 362 FrntRdrDetn177RdrDetnPwr "Refer to the data element description in FrntRdrDetn1 with the same data element name.";
CM_ SG_ 362 FrntRdrDetn177RdrDetnRng "Refer to the data element description in FrntRdrDetn1 with the same data element name.";
CM_ SG_ 362 FrntRdrDetn177RdrDetnRngV "Refer to the data element description in FrntRdrDetn1 with the same data element name.";
CM_ SG_ 362 FrntRdrDetn177RdrDetnSts "Refer to the data element description in FrntRdrDetn1 with the same data element name.";
CM_ SG_ 362 FrntRdrDetn178RdrDetnAzi "Refer to the data element description in FrntRdrDetn1 with the same data element name.";
CM_ SG_ 362 FrntRdrDetn178RdrDetnChks "Refer to the data element description in FrntRdrDetn1 with the same data element name.";
CM_ SG_ 362 FrntRdrDetn178RdrDetnCntr "Refer to the data element description in FrntRdrDetn1 with the same data element name.";
CM_ SG_ 362 FrntRdrDetn178RdrDetnConf "Refer to the data element description in FrntRdrDetn1 with the same data element name.";
CM_ SG_ 362 FrntRdrDetn178RdrDetnElevn "Refer to the data element description in FrntRdrDetn1 with the same data element name.";
CM_ SG_ 362 FrntRdrDetn178RdrDetnPwr "Refer to the data element description in FrntRdrDetn1 with the same data element name.";
CM_ SG_ 362 FrntRdrDetn178RdrDetnRng "Refer to the data element description in FrntRdrDetn1 with the same data element name.";
CM_ SG_ 362 FrntRdrDetn178RdrDetnRngV "Refer to the data element description in FrntRdrDetn1 with the same data element name.";
CM_ SG_ 362 FrntRdrDetn178RdrDetnSts "Refer to the data element description in FrntRdrDetn1 with the same data element name.";
CM_ SG_ 362 FrntRdrDetn179RdrDetnAzi "Refer to the data element description in FrntRdrDetn1 with the same data element name.";
CM_ SG_ 362 FrntRdrDetn179RdrDetnChks "Refer to the data element description in FrntRdrDetn1 with the same data element name.";
CM_ SG_ 362 FrntRdrDetn179RdrDetnCntr "Refer to the data element description in FrntRdrDetn1 with the same data element name.";
CM_ SG_ 362 FrntRdrDetn179RdrDetnConf "Refer to the data element description in FrntRdrDetn1 with the same data element name.";
CM_ SG_ 362 FrntRdrDetn179RdrDetnElevn "Refer to the data element description in FrntRdrDetn1 with the same data element name.";
CM_ SG_ 362 FrntRdrDetn179RdrDetnPwr "Refer to the data element description in FrntRdrDetn1 with the same data element name.";
CM_ SG_ 362 FrntRdrDetn179RdrDetnRng "Refer to the data element description in FrntRdrDetn1 with the same data element name.";
CM_ SG_ 362 FrntRdrDetn179RdrDetnRngV "Refer to the data element description in FrntRdrDetn1 with the same data element name.";
CM_ SG_ 362 FrntRdrDetn179RdrDetnSts "Refer to the data element description in FrntRdrDetn1 with the same data element name.";
CM_ SG_ 362 FrntRdrDetn180RdrDetnAzi "Refer to the data element description in FrntRdrDetn1 with the same data element name.";
CM_ SG_ 362 FrntRdrDetn180RdrDetnChks "Refer to the data element description in FrntRdrDetn1 with the same data element name.";
CM_ SG_ 362 FrntRdrDetn180RdrDetnCntr "Refer to the data element description in FrntRdrDetn1 with the same data element name.";
CM_ SG_ 362 FrntRdrDetn180RdrDetnConf "Refer to the data element description in FrntRdrDetn1 with the same data element name.";
CM_ SG_ 362 FrntRdrDetn180RdrDetnElevn "Refer to the data element description in FrntRdrDetn1 with the same data element name.";
CM_ SG_ 362 FrntRdrDetn180RdrDetnPwr "Refer to the data element description in FrntRdrDetn1 with the same data element name.";
CM_ SG_ 362 FrntRdrDetn180RdrDetnRng "Refer to the data element description in FrntRdrDetn1 with the same data element name.";
CM_ SG_ 362 FrntRdrDetn180RdrDetnRngV "Refer to the data element description in FrntRdrDetn1 with the same data element name.";
CM_ SG_ 362 FrntRdrDetn180RdrDetnSts "Refer to the data element description in FrntRdrDetn1 with the same data element name.";
CM_ SG_ 364 FrntRdrDetn181RdrDetnAzi "Refer to the data element description in FrntRdrDetn1 with the same data element name.";
CM_ SG_ 364 FrntRdrDetn181RdrDetnChks "Refer to the data element description in FrntRdrDetn1 with the same data element name.";
CM_ SG_ 364 FrntRdrDetn181RdrDetnCntr "Refer to the data element description in FrntRdrDetn1 with the same data element name.";
CM_ SG_ 364 FrntRdrDetn181RdrDetnConf "Refer to the data element description in FrntRdrDetn1 with the same data element name.";
CM_ SG_ 364 FrntRdrDetn181RdrDetnElevn "Refer to the data element description in FrntRdrDetn1 with the same data element name.";
CM_ SG_ 364 FrntRdrDetn181RdrDetnPwr "Refer to the data element description in FrntRdrDetn1 with the same data element name.";
CM_ SG_ 364 FrntRdrDetn181RdrDetnRng "Refer to the data element description in FrntRdrDetn1 with the same data element name.";
CM_ SG_ 364 FrntRdrDetn181RdrDetnRngV "Refer to the data element description in FrntRdrDetn1 with the same data element name.";
CM_ SG_ 364 FrntRdrDetn181RdrDetnSts "Refer to the data element description in FrntRdrDetn1 with the same data element name.";
CM_ SG_ 364 FrntRdrDetn182RdrDetnAzi "Refer to the data element description in FrntRdrDetn1 with the same data element name.";
CM_ SG_ 364 FrntRdrDetn182RdrDetnChks "Refer to the data element description in FrntRdrDetn1 with the same data element name.";
CM_ SG_ 364 FrntRdrDetn182RdrDetnCntr "Refer to the data element description in FrntRdrDetn1 with the same data element name.";
CM_ SG_ 364 FrntRdrDetn182RdrDetnConf "Refer to the data element description in FrntRdrDetn1 with the same data element name.";
CM_ SG_ 364 FrntRdrDetn182RdrDetnElevn "Refer to the data element description in FrntRdrDetn1 with the same data element name.";
CM_ SG_ 364 FrntRdrDetn182RdrDetnPwr "Refer to the data element description in FrntRdrDetn1 with the same data element name.";
CM_ SG_ 364 FrntRdrDetn182RdrDetnRng "Refer to the data element description in FrntRdrDetn1 with the same data element name.";
CM_ SG_ 364 FrntRdrDetn182RdrDetnRngV "Refer to the data element description in FrntRdrDetn1 with the same data element name.";
CM_ SG_ 364 FrntRdrDetn182RdrDetnSts "Refer to the data element description in FrntRdrDetn1 with the same data element name.";
CM_ SG_ 364 FrntRdrDetn183RdrDetnAzi "Refer to the data element description in FrntRdrDetn1 with the same data element name.";
CM_ SG_ 364 FrntRdrDetn183RdrDetnChks "Refer to the data element description in FrntRdrDetn1 with the same data element name.";
CM_ SG_ 364 FrntRdrDetn183RdrDetnCntr "Refer to the data element description in FrntRdrDetn1 with the same data element name.";
CM_ SG_ 364 FrntRdrDetn183RdrDetnConf "Refer to the data element description in FrntRdrDetn1 with the same data element name.";
CM_ SG_ 364 FrntRdrDetn183RdrDetnElevn "Refer to the data element description in FrntRdrDetn1 with the same data element name.";
CM_ SG_ 364 FrntRdrDetn183RdrDetnPwr "Refer to the data element description in FrntRdrDetn1 with the same data element name.";
CM_ SG_ 364 FrntRdrDetn183RdrDetnRng "Refer to the data element description in FrntRdrDetn1 with the same data element name.";
CM_ SG_ 364 FrntRdrDetn183RdrDetnRngV "Refer to the data element description in FrntRdrDetn1 with the same data element name.";
CM_ SG_ 364 FrntRdrDetn183RdrDetnSts "Refer to the data element description in FrntRdrDetn1 with the same data element name.";
CM_ SG_ 364 FrntRdrDetn184RdrDetnAzi "Refer to the data element description in FrntRdrDetn1 with the same data element name.";
CM_ SG_ 364 FrntRdrDetn184RdrDetnChks "Refer to the data element description in FrntRdrDetn1 with the same data element name.";
CM_ SG_ 364 FrntRdrDetn184RdrDetnCntr "Refer to the data element description in FrntRdrDetn1 with the same data element name.";
CM_ SG_ 364 FrntRdrDetn184RdrDetnConf "Refer to the data element description in FrntRdrDetn1 with the same data element name.";
CM_ SG_ 364 FrntRdrDetn184RdrDetnElevn "Refer to the data element description in FrntRdrDetn1 with the same data element name.";
CM_ SG_ 364 FrntRdrDetn184RdrDetnPwr "Refer to the data element description in FrntRdrDetn1 with the same data element name.";
CM_ SG_ 364 FrntRdrDetn184RdrDetnRng "Refer to the data element description in FrntRdrDetn1 with the same data element name.";
CM_ SG_ 364 FrntRdrDetn184RdrDetnRngV "Refer to the data element description in FrntRdrDetn1 with the same data element name.";
CM_ SG_ 364 FrntRdrDetn184RdrDetnSts "Refer to the data element description in FrntRdrDetn1 with the same data element name.";
CM_ SG_ 364 FrntRdrDetn185RdrDetnAzi "Refer to the data element description in FrntRdrDetn1 with the same data element name.";
CM_ SG_ 364 FrntRdrDetn185RdrDetnChks "Refer to the data element description in FrntRdrDetn1 with the same data element name.";
CM_ SG_ 364 FrntRdrDetn185RdrDetnCntr "Refer to the data element description in FrntRdrDetn1 with the same data element name.";
CM_ SG_ 364 FrntRdrDetn185RdrDetnConf "Refer to the data element description in FrntRdrDetn1 with the same data element name.";
CM_ SG_ 364 FrntRdrDetn185RdrDetnElevn "Refer to the data element description in FrntRdrDetn1 with the same data element name.";
CM_ SG_ 364 FrntRdrDetn185RdrDetnPwr "Refer to the data element description in FrntRdrDetn1 with the same data element name.";
CM_ SG_ 364 FrntRdrDetn185RdrDetnRng "Refer to the data element description in FrntRdrDetn1 with the same data element name.";
CM_ SG_ 364 FrntRdrDetn185RdrDetnRngV "Refer to the data element description in FrntRdrDetn1 with the same data element name.";
CM_ SG_ 364 FrntRdrDetn185RdrDetnSts "Refer to the data element description in FrntRdrDetn1 with the same data element name.";
CM_ SG_ 364 FrntRdrDetn186RdrDetnAzi "Refer to the data element description in FrntRdrDetn1 with the same data element name.";
CM_ SG_ 364 FrntRdrDetn186RdrDetnChks "Refer to the data element description in FrntRdrDetn1 with the same data element name.";
CM_ SG_ 364 FrntRdrDetn186RdrDetnCntr "Refer to the data element description in FrntRdrDetn1 with the same data element name.";
CM_ SG_ 364 FrntRdrDetn186RdrDetnConf "Refer to the data element description in FrntRdrDetn1 with the same data element name.";
CM_ SG_ 364 FrntRdrDetn186RdrDetnElevn "Refer to the data element description in FrntRdrDetn1 with the same data element name.";
CM_ SG_ 364 FrntRdrDetn186RdrDetnPwr "Refer to the data element description in FrntRdrDetn1 with the same data element name.";
CM_ SG_ 364 FrntRdrDetn186RdrDetnRng "Refer to the data element description in FrntRdrDetn1 with the same data element name.";
CM_ SG_ 364 FrntRdrDetn186RdrDetnRngV "Refer to the data element description in FrntRdrDetn1 with the same data element name.";
CM_ SG_ 364 FrntRdrDetn186RdrDetnSts "Refer to the data element description in FrntRdrDetn1 with the same data element name.";
CM_ SG_ 366 FrntRdrDetn187RdrDetnAzi "Refer to the data element description in FrntRdrDetn1 with the same data element name.";
CM_ SG_ 366 FrntRdrDetn187RdrDetnChks "Refer to the data element description in FrntRdrDetn1 with the same data element name.";
CM_ SG_ 366 FrntRdrDetn187RdrDetnCntr "Refer to the data element description in FrntRdrDetn1 with the same data element name.";
CM_ SG_ 366 FrntRdrDetn187RdrDetnConf "Refer to the data element description in FrntRdrDetn1 with the same data element name.";
CM_ SG_ 366 FrntRdrDetn187RdrDetnElevn "Refer to the data element description in FrntRdrDetn1 with the same data element name.";
CM_ SG_ 366 FrntRdrDetn187RdrDetnPwr "Refer to the data element description in FrntRdrDetn1 with the same data element name.";
CM_ SG_ 366 FrntRdrDetn187RdrDetnRng "Refer to the data element description in FrntRdrDetn1 with the same data element name.";
CM_ SG_ 366 FrntRdrDetn187RdrDetnRngV "Refer to the data element description in FrntRdrDetn1 with the same data element name.";
CM_ SG_ 366 FrntRdrDetn187RdrDetnSts "Refer to the data element description in FrntRdrDetn1 with the same data element name.";
CM_ SG_ 366 FrntRdrDetn188RdrDetnAzi "Refer to the data element description in FrntRdrDetn1 with the same data element name.";
CM_ SG_ 366 FrntRdrDetn188RdrDetnChks "Refer to the data element description in FrntRdrDetn1 with the same data element name.";
CM_ SG_ 366 FrntRdrDetn188RdrDetnCntr "Refer to the data element description in FrntRdrDetn1 with the same data element name.";
CM_ SG_ 366 FrntRdrDetn188RdrDetnConf "Refer to the data element description in FrntRdrDetn1 with the same data element name.";
CM_ SG_ 366 FrntRdrDetn188RdrDetnElevn "Refer to the data element description in FrntRdrDetn1 with the same data element name.";
CM_ SG_ 366 FrntRdrDetn188RdrDetnPwr "Refer to the data element description in FrntRdrDetn1 with the same data element name.";
CM_ SG_ 366 FrntRdrDetn188RdrDetnRng "Refer to the data element description in FrntRdrDetn1 with the same data element name.";
CM_ SG_ 366 FrntRdrDetn188RdrDetnRngV "Refer to the data element description in FrntRdrDetn1 with the same data element name.";
CM_ SG_ 366 FrntRdrDetn188RdrDetnSts "Refer to the data element description in FrntRdrDetn1 with the same data element name.";
CM_ SG_ 366 FrntRdrDetn189RdrDetnAzi "Refer to the data element description in FrntRdrDetn1 with the same data element name.";
CM_ SG_ 366 FrntRdrDetn189RdrDetnChks "Refer to the data element description in FrntRdrDetn1 with the same data element name.";
CM_ SG_ 366 FrntRdrDetn189RdrDetnCntr "Refer to the data element description in FrntRdrDetn1 with the same data element name.";
CM_ SG_ 366 FrntRdrDetn189RdrDetnConf "Refer to the data element description in FrntRdrDetn1 with the same data element name.";
CM_ SG_ 366 FrntRdrDetn189RdrDetnElevn "Refer to the data element description in FrntRdrDetn1 with the same data element name.";
CM_ SG_ 366 FrntRdrDetn189RdrDetnPwr "Refer to the data element description in FrntRdrDetn1 with the same data element name.";
CM_ SG_ 366 FrntRdrDetn189RdrDetnRng "Refer to the data element description in FrntRdrDetn1 with the same data element name.";
CM_ SG_ 366 FrntRdrDetn189RdrDetnRngV "Refer to the data element description in FrntRdrDetn1 with the same data element name.";
CM_ SG_ 366 FrntRdrDetn189RdrDetnSts "Refer to the data element description in FrntRdrDetn1 with the same data element name.";
CM_ SG_ 366 FrntRdrDetn190RdrDetnAzi "Refer to the data element description in FrntRdrDetn1 with the same data element name.";
CM_ SG_ 366 FrntRdrDetn190RdrDetnChks "Refer to the data element description in FrntRdrDetn1 with the same data element name.";
CM_ SG_ 366 FrntRdrDetn190RdrDetnCntr "Refer to the data element description in FrntRdrDetn1 with the same data element name.";
CM_ SG_ 366 FrntRdrDetn190RdrDetnConf "Refer to the data element description in FrntRdrDetn1 with the same data element name.";
CM_ SG_ 366 FrntRdrDetn190RdrDetnElevn "Refer to the data element description in FrntRdrDetn1 with the same data element name.";
CM_ SG_ 366 FrntRdrDetn190RdrDetnPwr "Refer to the data element description in FrntRdrDetn1 with the same data element name.";
CM_ SG_ 366 FrntRdrDetn190RdrDetnRng "Refer to the data element description in FrntRdrDetn1 with the same data element name.";
CM_ SG_ 366 FrntRdrDetn190RdrDetnRngV "Refer to the data element description in FrntRdrDetn1 with the same data element name.";
CM_ SG_ 366 FrntRdrDetn190RdrDetnSts "Refer to the data element description in FrntRdrDetn1 with the same data element name.";
CM_ SG_ 366 FrntRdrDetn191RdrDetnAzi "Refer to the data element description in FrntRdrDetn1 with the same data element name.";
CM_ SG_ 366 FrntRdrDetn191RdrDetnChks "Refer to the data element description in FrntRdrDetn1 with the same data element name.";
CM_ SG_ 366 FrntRdrDetn191RdrDetnCntr "Refer to the data element description in FrntRdrDetn1 with the same data element name.";
CM_ SG_ 366 FrntRdrDetn191RdrDetnConf "Refer to the data element description in FrntRdrDetn1 with the same data element name.";
CM_ SG_ 366 FrntRdrDetn191RdrDetnElevn "Refer to the data element description in FrntRdrDetn1 with the same data element name.";
CM_ SG_ 366 FrntRdrDetn191RdrDetnPwr "Refer to the data element description in FrntRdrDetn1 with the same data element name.";
CM_ SG_ 366 FrntRdrDetn191RdrDetnRng "Refer to the data element description in FrntRdrDetn1 with the same data element name.";
CM_ SG_ 366 FrntRdrDetn191RdrDetnRngV "Refer to the data element description in FrntRdrDetn1 with the same data element name.";
CM_ SG_ 366 FrntRdrDetn191RdrDetnSts "Refer to the data element description in FrntRdrDetn1 with the same data element name.";
CM_ SG_ 366 FrntRdrDetn192RdrDetnAzi "Refer to the data element description in FrntRdrDetn1 with the same data element name.";
CM_ SG_ 366 FrntRdrDetn192RdrDetnChks "Refer to the data element description in FrntRdrDetn1 with the same data element name.";
CM_ SG_ 366 FrntRdrDetn192RdrDetnCntr "Refer to the data element description in FrntRdrDetn1 with the same data element name.";
CM_ SG_ 366 FrntRdrDetn192RdrDetnConf "Refer to the data element description in FrntRdrDetn1 with the same data element name.";
CM_ SG_ 366 FrntRdrDetn192RdrDetnElevn "Refer to the data element description in FrntRdrDetn1 with the same data element name.";
CM_ SG_ 366 FrntRdrDetn192RdrDetnPwr "Refer to the data element description in FrntRdrDetn1 with the same data element name.";
CM_ SG_ 366 FrntRdrDetn192RdrDetnRng "Refer to the data element description in FrntRdrDetn1 with the same data element name.";
CM_ SG_ 366 FrntRdrDetn192RdrDetnRngV "Refer to the data element description in FrntRdrDetn1 with the same data element name.";
CM_ SG_ 366 FrntRdrDetn192RdrDetnSts "Refer to the data element description in FrntRdrDetn1 with the same data element name.";
CM_ SG_ 368 FrntRdrDetn193RdrDetnAzi "Refer to the data element description in FrntRdrDetn1 with the same data element name.";
CM_ SG_ 368 FrntRdrDetn193RdrDetnChks "Refer to the data element description in FrntRdrDetn1 with the same data element name.";
CM_ SG_ 368 FrntRdrDetn193RdrDetnCntr "Refer to the data element description in FrntRdrDetn1 with the same data element name.";
CM_ SG_ 368 FrntRdrDetn193RdrDetnConf "Refer to the data element description in FrntRdrDetn1 with the same data element name.";
CM_ SG_ 368 FrntRdrDetn193RdrDetnElevn "Refer to the data element description in FrntRdrDetn1 with the same data element name.";
CM_ SG_ 368 FrntRdrDetn193RdrDetnPwr "Refer to the data element description in FrntRdrDetn1 with the same data element name.";
CM_ SG_ 368 FrntRdrDetn193RdrDetnRng "Refer to the data element description in FrntRdrDetn1 with the same data element name.";
CM_ SG_ 368 FrntRdrDetn193RdrDetnRngV "Refer to the data element description in FrntRdrDetn1 with the same data element name.";
CM_ SG_ 368 FrntRdrDetn193RdrDetnSts "Refer to the data element description in FrntRdrDetn1 with the same data element name.";
CM_ SG_ 368 FrntRdrDetn194RdrDetnAzi "Refer to the data element description in FrntRdrDetn1 with the same data element name.";
CM_ SG_ 368 FrntRdrDetn194RdrDetnChks "Refer to the data element description in FrntRdrDetn1 with the same data element name.";
CM_ SG_ 368 FrntRdrDetn194RdrDetnCntr "Refer to the data element description in FrntRdrDetn1 with the same data element name.";
CM_ SG_ 368 FrntRdrDetn194RdrDetnConf "Refer to the data element description in FrntRdrDetn1 with the same data element name.";
CM_ SG_ 368 FrntRdrDetn194RdrDetnElevn "Refer to the data element description in FrntRdrDetn1 with the same data element name.";
CM_ SG_ 368 FrntRdrDetn194RdrDetnPwr "Refer to the data element description in FrntRdrDetn1 with the same data element name.";
CM_ SG_ 368 FrntRdrDetn194RdrDetnRng "Refer to the data element description in FrntRdrDetn1 with the same data element name.";
CM_ SG_ 368 FrntRdrDetn194RdrDetnRngV "Refer to the data element description in FrntRdrDetn1 with the same data element name.";
CM_ SG_ 368 FrntRdrDetn194RdrDetnSts "Refer to the data element description in FrntRdrDetn1 with the same data element name.";
CM_ SG_ 368 FrntRdrDetn195RdrDetnAzi "Refer to the data element description in FrntRdrDetn1 with the same data element name.";
CM_ SG_ 368 FrntRdrDetn195RdrDetnChks "Refer to the data element description in FrntRdrDetn1 with the same data element name.";
CM_ SG_ 368 FrntRdrDetn195RdrDetnCntr "Refer to the data element description in FrntRdrDetn1 with the same data element name.";
CM_ SG_ 368 FrntRdrDetn195RdrDetnConf "Refer to the data element description in FrntRdrDetn1 with the same data element name.";
CM_ SG_ 368 FrntRdrDetn195RdrDetnElevn "Refer to the data element description in FrntRdrDetn1 with the same data element name.";
CM_ SG_ 368 FrntRdrDetn195RdrDetnPwr "Refer to the data element description in FrntRdrDetn1 with the same data element name.";
CM_ SG_ 368 FrntRdrDetn195RdrDetnRng "Refer to the data element description in FrntRdrDetn1 with the same data element name.";
CM_ SG_ 368 FrntRdrDetn195RdrDetnRngV "Refer to the data element description in FrntRdrDetn1 with the same data element name.";
CM_ SG_ 368 FrntRdrDetn195RdrDetnSts "Refer to the data element description in FrntRdrDetn1 with the same data element name.";
CM_ SG_ 368 FrntRdrDetn196RdrDetnAzi "Refer to the data element description in FrntRdrDetn1 with the same data element name.";
CM_ SG_ 368 FrntRdrDetn196RdrDetnChks "Refer to the data element description in FrntRdrDetn1 with the same data element name.";
CM_ SG_ 368 FrntRdrDetn196RdrDetnCntr "Refer to the data element description in FrntRdrDetn1 with the same data element name.";
CM_ SG_ 368 FrntRdrDetn196RdrDetnConf "Refer to the data element description in FrntRdrDetn1 with the same data element name.";
CM_ SG_ 368 FrntRdrDetn196RdrDetnElevn "Refer to the data element description in FrntRdrDetn1 with the same data element name.";
CM_ SG_ 368 FrntRdrDetn196RdrDetnPwr "Refer to the data element description in FrntRdrDetn1 with the same data element name.";
CM_ SG_ 368 FrntRdrDetn196RdrDetnRng "Refer to the data element description in FrntRdrDetn1 with the same data element name.";
CM_ SG_ 368 FrntRdrDetn196RdrDetnRngV "Refer to the data element description in FrntRdrDetn1 with the same data element name.";
CM_ SG_ 368 FrntRdrDetn196RdrDetnSts "Refer to the data element description in FrntRdrDetn1 with the same data element name.";
CM_ SG_ 368 FrntRdrDetn197RdrDetnAzi "Refer to the data element description in FrntRdrDetn1 with the same data element name.";
CM_ SG_ 368 FrntRdrDetn197RdrDetnChks "Refer to the data element description in FrntRdrDetn1 with the same data element name.";
CM_ SG_ 368 FrntRdrDetn197RdrDetnCntr "Refer to the data element description in FrntRdrDetn1 with the same data element name.";
CM_ SG_ 368 FrntRdrDetn197RdrDetnConf "Refer to the data element description in FrntRdrDetn1 with the same data element name.";
CM_ SG_ 368 FrntRdrDetn197RdrDetnElevn "Refer to the data element description in FrntRdrDetn1 with the same data element name.";
CM_ SG_ 368 FrntRdrDetn197RdrDetnPwr "Refer to the data element description in FrntRdrDetn1 with the same data element name.";
CM_ SG_ 368 FrntRdrDetn197RdrDetnRng "Refer to the data element description in FrntRdrDetn1 with the same data element name.";
CM_ SG_ 368 FrntRdrDetn197RdrDetnRngV "Refer to the data element description in FrntRdrDetn1 with the same data element name.";
CM_ SG_ 368 FrntRdrDetn197RdrDetnSts "Refer to the data element description in FrntRdrDetn1 with the same data element name.";
CM_ SG_ 368 FrntRdrDetn198RdrDetnAzi "Refer to the data element description in FrntRdrDetn1 with the same data element name.";
CM_ SG_ 368 FrntRdrDetn198RdrDetnChks "Refer to the data element description in FrntRdrDetn1 with the same data element name.";
CM_ SG_ 368 FrntRdrDetn198RdrDetnCntr "Refer to the data element description in FrntRdrDetn1 with the same data element name.";
CM_ SG_ 368 FrntRdrDetn198RdrDetnConf "Refer to the data element description in FrntRdrDetn1 with the same data element name.";
CM_ SG_ 368 FrntRdrDetn198RdrDetnElevn "Refer to the data element description in FrntRdrDetn1 with the same data element name.";
CM_ SG_ 368 FrntRdrDetn198RdrDetnPwr "Refer to the data element description in FrntRdrDetn1 with the same data element name.";
CM_ SG_ 368 FrntRdrDetn198RdrDetnRng "Refer to the data element description in FrntRdrDetn1 with the same data element name.";
CM_ SG_ 368 FrntRdrDetn198RdrDetnRngV "Refer to the data element description in FrntRdrDetn1 with the same data element name.";
CM_ SG_ 368 FrntRdrDetn198RdrDetnSts "Refer to the data element description in FrntRdrDetn1 with the same data element name.";
CM_ SG_ 370 FrntRdrDetn199RdrDetnAzi "Refer to the data element description in FrntRdrDetn1 with the same data element name.";
CM_ SG_ 370 FrntRdrDetn199RdrDetnChks "Refer to the data element description in FrntRdrDetn1 with the same data element name.";
CM_ SG_ 370 FrntRdrDetn199RdrDetnCntr "Refer to the data element description in FrntRdrDetn1 with the same data element name.";
CM_ SG_ 370 FrntRdrDetn199RdrDetnConf "Refer to the data element description in FrntRdrDetn1 with the same data element name.";
CM_ SG_ 370 FrntRdrDetn199RdrDetnElevn "Refer to the data element description in FrntRdrDetn1 with the same data element name.";
CM_ SG_ 370 FrntRdrDetn199RdrDetnPwr "Refer to the data element description in FrntRdrDetn1 with the same data element name.";
CM_ SG_ 370 FrntRdrDetn199RdrDetnRng "Refer to the data element description in FrntRdrDetn1 with the same data element name.";
CM_ SG_ 370 FrntRdrDetn199RdrDetnRngV "Refer to the data element description in FrntRdrDetn1 with the same data element name.";
CM_ SG_ 370 FrntRdrDetn199RdrDetnSts "Refer to the data element description in FrntRdrDetn1 with the same data element name.";
CM_ SG_ 370 FrntRdrDetn200RdrDetnAzi "Refer to the data element description in FrntRdrDetn1 with the same data element name.";
CM_ SG_ 370 FrntRdrDetn200RdrDetnChks "Refer to the data element description in FrntRdrDetn1 with the same data element name.";
CM_ SG_ 370 FrntRdrDetn200RdrDetnCntr "Refer to the data element description in FrntRdrDetn1 with the same data element name.";
CM_ SG_ 370 FrntRdrDetn200RdrDetnConf "Refer to the data element description in FrntRdrDetn1 with the same data element name.";
CM_ SG_ 370 FrntRdrDetn200RdrDetnElevn "Refer to the data element description in FrntRdrDetn1 with the same data element name.";
CM_ SG_ 370 FrntRdrDetn200RdrDetnPwr "Refer to the data element description in FrntRdrDetn1 with the same data element name.";
CM_ SG_ 370 FrntRdrDetn200RdrDetnRng "Refer to the data element description in FrntRdrDetn1 with the same data element name.";
CM_ SG_ 370 FrntRdrDetn200RdrDetnRngV "Refer to the data element description in FrntRdrDetn1 with the same data element name.";
CM_ SG_ 370 FrntRdrDetn200RdrDetnSts "Refer to the data element description in FrntRdrDetn1 with the same data element name.";
CM_ SG_ 372 FrntRdrObj1Heading "Reserve";
CM_ SG_ 372 FrntRdrObj1ObjBoxCenterLat "Box center y coordinate (relative closest point)";
CM_ SG_ 372 FrntRdrObj1ObjBoxCenterLgt "Box center x coordinate (relative closest point)";
CM_ SG_ 372 FrntRdrObj1ObservationHist "Reserve";
CM_ SG_ 372 FrntRdrObj1RdrObjAx "Longitudinal acceleration";
CM_ SG_ 372 FrntRdrObj1RdrObjAy "Lateral acceleration";
CM_ SG_ 372 FrntRdrObj1RdrObjBoxLength "Box length (box extent that is parallel to objects heading angle)";
CM_ SG_ 372 FrntRdrObj1RdrObjBoxWidth "Box width (box extent that is perpendicular to objects heading angle)";
CM_ SG_ 372 FrntRdrObj1RdrObjChks "CRC";
CM_ SG_ 372 FrntRdrObj1RdrObjCntr "Counter";
CM_ SG_ 372 FrntRdrObj1RdrObjCoastCnt "Number of cycles during which the object is not associated to anything";
CM_ SG_ 372 FrntRdrObj1RdrObjConf "Confidence";
CM_ SG_ 372 FrntRdrObj1RdrObjDx "Longitudinal position";
CM_ SG_ 372 FrntRdrObj1RdrObjDxStdDe " Standard deviation longitudinal position";
CM_ SG_ 372 FrntRdrObj1RdrObjDy "Lateral position";
CM_ SG_ 372 FrntRdrObj1RdrObjDyStdDe "Standard deviation lateral position";
CM_ SG_ 372 FrntRdrObj1RdrObjElevnConf "Elevation confidence";
CM_ SG_ 372 FrntRdrObj1RdrObjElevnSts "Elevation Status";
CM_ SG_ 372 FrntRdrObj1RdrObjID "Object ID";
CM_ SG_ 372 FrntRdrObj1RdrObjIsInFreeSpace "Indication if the object is inside freespace";
CM_ SG_ 372 FrntRdrObj1RdrObjMirrProblty "Probability of mirrored object";
CM_ SG_ 372 FrntRdrObj1RdrObjMtnPat "Object Motion Pattern (crossing, receding and oncoming) is not used here, as reserved)";
CM_ SG_ 372 FrntRdrObj1RdrObjNotRealProblty "Probability of ghost track";
CM_ SG_ 372 FrntRdrObj1RdrObjStatyCnt "Stationary Count";
CM_ SG_ 372 FrntRdrObj1RdrObjTiAlv "Lifetime";
CM_ SG_ 372 FrntRdrObj1RdrObjTrackSts "Track Status 0. it is not a valid track 1. the track has been updated 2. the track is new 3. the track is coasted (means the result is a prediction and that there was no detected measurement in the current look interval";
CM_ SG_ 372 FrntRdrObj1RdrObjTyp "Classification object (Only 0 Unkown, 4 Pedestrain, 9 Bicycle and 10 Vehicle of unknown class are used actually in radar, the other types are not used but the datatype is designed so that it can be reused with camera";
CM_ SG_ 372 FrntRdrObj1RdrObjTypConfBike "Confidence of tracked object type classification bike";
CM_ SG_ 372 FrntRdrObj1RdrObjTypConfPed "Confidence of tracked object type classification pedestrian";
CM_ SG_ 372 FrntRdrObj1RdrObjTypConfVeh "Confidence of tracked object type classification vehicle";
CM_ SG_ 372 FrntRdrObj1RdrObjVx "Longitudinal velocity";
CM_ SG_ 372 FrntRdrObj1RdrObjVxStdDe " Standard deviation longitudinal velocity";
CM_ SG_ 372 FrntRdrObj1RdrObjVy "Lateral velocity";
CM_ SG_ 372 FrntRdrObj1RdrObjVyStdDe " Standard deviation lateral velocity";
CM_ SG_ 372 FrntRdrObj1RelVx "Reserve";
CM_ SG_ 372 FrntRdrObj1RelVy "Reserve";
CM_ SG_ 374 FrntRdrObj2Heading "Refer to the data element description in FrntRdrObj1 with the same data element name.";
CM_ SG_ 374 FrntRdrObj2ObjBoxCenterLat "Refer to the data element description in FrntRdrObj1 with the same data element name.";
CM_ SG_ 374 FrntRdrObj2ObjBoxCenterLgt "Refer to the data element description in FrntRdrObj1 with the same data element name.";
CM_ SG_ 374 FrntRdrObj2ObservationHist "Refer to the data element description in FrntRdrObj1 with the same data element name.";
CM_ SG_ 374 FrntRdrObj2RdrObjAx "Refer to the data element description in FrntRdrObj1 with the same data element name.";
CM_ SG_ 374 FrntRdrObj2RdrObjAy "Refer to the data element description in FrntRdrObj1 with the same data element name.";
CM_ SG_ 374 FrntRdrObj2RdrObjBoxLength "Refer to the data element description in FrntRdrObj1 with the same data element name.";
CM_ SG_ 374 FrntRdrObj2RdrObjBoxWidth "Refer to the data element description in FrntRdrObj1 with the same data element name.";
CM_ SG_ 374 FrntRdrObj2RdrObjChks "Refer to the data element description in FrntRdrObj1 with the same data element name.";
CM_ SG_ 374 FrntRdrObj2RdrObjCntr "Refer to the data element description in FrntRdrObj1 with the same data element name.";
CM_ SG_ 374 FrntRdrObj2RdrObjCoastCnt "Refer to the data element description in FrntRdrObj1 with the same data element name.";
CM_ SG_ 374 FrntRdrObj2RdrObjConf "Refer to the data element description in FrntRdrObj1 with the same data element name.";
CM_ SG_ 374 FrntRdrObj2RdrObjDx "Refer to the data element description in FrntRdrObj1 with the same data element name.";
CM_ SG_ 374 FrntRdrObj2RdrObjDxStdDe "Refer to the data element description in FrntRdrObj1 with the same data element name.";
CM_ SG_ 374 FrntRdrObj2RdrObjDy "Refer to the data element description in FrntRdrObj1 with the same data element name.";
CM_ SG_ 374 FrntRdrObj2RdrObjDyStdDe "Refer to the data element description in FrntRdrObj1 with the same data element name.";
CM_ SG_ 374 FrntRdrObj2RdrObjElevnConf "Refer to the data element description in FrntRdrObj1 with the same data element name.";
CM_ SG_ 374 FrntRdrObj2RdrObjElevnSts "Refer to the data element description in FrntRdrObj1 with the same data element name.";
CM_ SG_ 374 FrntRdrObj2RdrObjID "Refer to the data element description in FrntRdrObj1 with the same data element name.";
CM_ SG_ 374 FrntRdrObj2RdrObjIsInFreeSpace "Refer to the data element description in FrntRdrObj1 with the same data element name.";
CM_ SG_ 374 FrntRdrObj2RdrObjMirrProblty "Refer to the data element description in FrntRdrObj1 with the same data element name.";
CM_ SG_ 374 FrntRdrObj2RdrObjMtnPat "Refer to the data element description in FrntRdrObj1 with the same data element name.";
CM_ SG_ 374 FrntRdrObj2RdrObjNotRealProblty "Refer to the data element description in FrntRdrObj1 with the same data element name.";
CM_ SG_ 374 FrntRdrObj2RdrObjStatyCnt "Refer to the data element description in FrntRdrObj1 with the same data element name.";
CM_ SG_ 374 FrntRdrObj2RdrObjTiAlv "Refer to the data element description in FrntRdrObj1 with the same data element name.";
CM_ SG_ 374 FrntRdrObj2RdrObjTrackSts "Refer to the data element description in FrntRdrObj1 with the same data element name.";
CM_ SG_ 374 FrntRdrObj2RdrObjTyp "Refer to the data element description in FrntRdrObj1 with the same data element name.";
CM_ SG_ 374 FrntRdrObj2RdrObjTypConfBike "Refer to the data element description in FrntRdrObj1 with the same data element name.";
CM_ SG_ 374 FrntRdrObj2RdrObjTypConfPed "Refer to the data element description in FrntRdrObj1 with the same data element name.";
CM_ SG_ 374 FrntRdrObj2RdrObjTypConfVeh "Refer to the data element description in FrntRdrObj1 with the same data element name.";
CM_ SG_ 374 FrntRdrObj2RdrObjVx "Refer to the data element description in FrntRdrObj1 with the same data element name.";
CM_ SG_ 374 FrntRdrObj2RdrObjVxStdDe "Refer to the data element description in FrntRdrObj1 with the same data element name.";
CM_ SG_ 374 FrntRdrObj2RdrObjVy "Refer to the data element description in FrntRdrObj1 with the same data element name.";
CM_ SG_ 374 FrntRdrObj2RdrObjVyStdDe "Refer to the data element description in FrntRdrObj1 with the same data element name.";
CM_ SG_ 374 FrntRdrObj2RelVx "Refer to the data element description in FrntRdrObj1 with the same data element name.";
CM_ SG_ 374 FrntRdrObj2RelVy "Refer to the data element description in FrntRdrObj1 with the same data element name.";
CM_ SG_ 376 FrntRdrObj3Heading "Refer to the data element description in FrntRdrObj1 with the same data element name.";
CM_ SG_ 376 FrntRdrObj3ObjBoxCenterLat "Refer to the data element description in FrntRdrObj1 with the same data element name.";
CM_ SG_ 376 FrntRdrObj3ObjBoxCenterLgt "Refer to the data element description in FrntRdrObj1 with the same data element name.";
CM_ SG_ 376 FrntRdrObj3ObservationHist "Refer to the data element description in FrntRdrObj1 with the same data element name.";
CM_ SG_ 376 FrntRdrObj3RdrObjAx "Refer to the data element description in FrntRdrObj1 with the same data element name.";
CM_ SG_ 376 FrntRdrObj3RdrObjAy "Refer to the data element description in FrntRdrObj1 with the same data element name.";
CM_ SG_ 376 FrntRdrObj3RdrObjBoxLength "Refer to the data element description in FrntRdrObj1 with the same data element name.";
CM_ SG_ 376 FrntRdrObj3RdrObjBoxWidth "Refer to the data element description in FrntRdrObj1 with the same data element name.";
CM_ SG_ 376 FrntRdrObj3RdrObjChks "Refer to the data element description in FrntRdrObj1 with the same data element name.";
CM_ SG_ 376 FrntRdrObj3RdrObjCntr "Refer to the data element description in FrntRdrObj1 with the same data element name.";
CM_ SG_ 376 FrntRdrObj3RdrObjCoastCnt "Refer to the data element description in FrntRdrObj1 with the same data element name.";
CM_ SG_ 376 FrntRdrObj3RdrObjConf "Refer to the data element description in FrntRdrObj1 with the same data element name.";
CM_ SG_ 376 FrntRdrObj3RdrObjDx "Refer to the data element description in FrntRdrObj1 with the same data element name.";
CM_ SG_ 376 FrntRdrObj3RdrObjDxStdDe "Refer to the data element description in FrntRdrObj1 with the same data element name.";
CM_ SG_ 376 FrntRdrObj3RdrObjDy "Refer to the data element description in FrntRdrObj1 with the same data element name.";
CM_ SG_ 376 FrntRdrObj3RdrObjDyStdDe "Refer to the data element description in FrntRdrObj1 with the same data element name.";
CM_ SG_ 376 FrntRdrObj3RdrObjElevnConf "Refer to the data element description in FrntRdrObj1 with the same data element name.";
CM_ SG_ 376 FrntRdrObj3RdrObjElevnSts "Refer to the data element description in FrntRdrObj1 with the same data element name.";
CM_ SG_ 376 FrntRdrObj3RdrObjID "Refer to the data element description in FrntRdrObj1 with the same data element name.";
CM_ SG_ 376 FrntRdrObj3RdrObjIsInFreeSpace "Refer to the data element description in FrntRdrObj1 with the same data element name.";
CM_ SG_ 376 FrntRdrObj3RdrObjMirrProblty "Refer to the data element description in FrntRdrObj1 with the same data element name.";
CM_ SG_ 376 FrntRdrObj3RdrObjMtnPat "Refer to the data element description in FrntRdrObj1 with the same data element name.";
CM_ SG_ 376 FrntRdrObj3RdrObjNotRealProblty "Refer to the data element description in FrntRdrObj1 with the same data element name.";
CM_ SG_ 376 FrntRdrObj3RdrObjStatyCnt "Refer to the data element description in FrntRdrObj1 with the same data element name.";
CM_ SG_ 376 FrntRdrObj3RdrObjTiAlv "Refer to the data element description in FrntRdrObj1 with the same data element name.";
CM_ SG_ 376 FrntRdrObj3RdrObjTrackSts "Refer to the data element description in FrntRdrObj1 with the same data element name.";
CM_ SG_ 376 FrntRdrObj3RdrObjTyp "Refer to the data element description in FrntRdrObj1 with the same data element name.";
CM_ SG_ 376 FrntRdrObj3RdrObjTypConfBike "Refer to the data element description in FrntRdrObj1 with the same data element name.";
CM_ SG_ 376 FrntRdrObj3RdrObjTypConfPed "Refer to the data element description in FrntRdrObj1 with the same data element name.";
CM_ SG_ 376 FrntRdrObj3RdrObjTypConfVeh "Refer to the data element description in FrntRdrObj1 with the same data element name.";
CM_ SG_ 376 FrntRdrObj3RdrObjVx "Refer to the data element description in FrntRdrObj1 with the same data element name.";
CM_ SG_ 376 FrntRdrObj3RdrObjVxStdDe "Refer to the data element description in FrntRdrObj1 with the same data element name.";
CM_ SG_ 376 FrntRdrObj3RdrObjVy "Refer to the data element description in FrntRdrObj1 with the same data element name.";
CM_ SG_ 376 FrntRdrObj3RdrObjVyStdDe "Refer to the data element description in FrntRdrObj1 with the same data element name.";
CM_ SG_ 376 FrntRdrObj3RelVx "Refer to the data element description in FrntRdrObj1 with the same data element name.";
CM_ SG_ 376 FrntRdrObj3RelVy "Refer to the data element description in FrntRdrObj1 with the same data element name.";
BA_DEF_ BO_ "VFrameFormat" ENUM "StandardCAN","ExtendedCAN","reserved","J1939PG","reserved","reserved","reserved","reserved","reserved","reserved","reserved","reserved","reserved","reserved","StandardCAN_FD","ExtendedCAN_FD";
BA_DEF_ BO_ "CANFD_BRS" ENUM "0","1";
BA_DEF_ BO_ "GenMsgSendType" ENUM "cyclic", "spontaneous", "not-used", "not-used", "not-used", "cyclicAndSpontaneous", "not-used", "cyclicIfActive", "NoMsgSendType"; // [us]
BA_DEF_ BO_ "GenMsgCycleTime" INT 0 65536; // [ms]
BA_DEF_ BO_ "GenMsgStartDelayTime" INT 0 65536; // [ms]
BA_DEF_ BO_ "GenMsgDelayTime" INT 0 65536; // [ms]
BA_DEF_ SG_ "GenSigSendType" ENUM "Cyclic","OnWrite","OnWriteWithRepetition","OnChange","OnChangeWithRepetition","IfActive","IfActiveWithRepetition","NoSigSendType";
BA_DEF_ SG_ "GenSigStartValue" HEX 0 80000000;
BA_DEF_ BO_ "GenMsgILSupport" ENUM "No","Yes";
BA_DEF_ BO_ "NmAsrMessage" ENUM "No","Yes";
BA_DEF_ SG_ "GenSigFuncType" ENUM "NoFunction","n/a","n/a","n/a","n/a","n/a","n/a","n/a","n/a","n/a","n/a","n/a","n/a","n/a","n/a","CHK","CNTR","n/a","n/a","n/a","CNTR_AR_01","CRC_AR_01_BOTH","CRC_AR_01_ALT","CRC_AR_01_LOW","CRC_AR_01_NIBBLE","CNTR_AR_04","CRC_AR_04A","CNTR_AR_05","CRC_AR_05";
BA_DEF_ SG_ "GenSigDataID" STRING;

BA_DEF_DEF_ "VFrameFormat" "J1939PG";
BA_DEF_DEF_ "CANFD_BRS" "1";
BA_DEF_DEF_ "GenSigStartValue" 0;
BA_DEF_DEF_ "GenSigSendType" "NoSigSendType";
BA_DEF_DEF_ "GenMsgCycleTime" 0;
BA_DEF_DEF_ "GenMsgDelayTime" 0;
BA_DEF_DEF_ "GenMsgStartDelayTime" 0;
BA_DEF_DEF_ "GenMsgSendType" "NoMsgSendType";
BA_DEF_DEF_ "GenMsgILSupport" "Yes";
BA_DEF_DEF_ "NmAsrMessage" "No";
BA_DEF_DEF_ "GenSigFuncType" "NoFunction";
BA_DEF_DEF_ "GenSigDataID" "";
// Frame: FLRSafetyCANFD2Frame28
BA_ "VFrameFormat" BO_ 358 14;
BA_ "GenMsgSendType" BO_ 358 0;
BA_ "GenMsgCycleTime" BO_ 358 50.000;
BA_ "GenSigStartValue" SG_ 358 FrntRdrDetn163RdrDetnAzi 900;
BA_ "GenSigSendType" SG_ 358 FrntRdrDetn163RdrDetnAzi 0;
BA_ "GenSigSendType" SG_ 358 FrntRdrDetn163RdrDetnChks 0;
BA_ "GenSigFuncType" SG_ 358 FrntRdrDetn163RdrDetnChks 15;
BA_ "GenSigDataID" SG_ 358 FrntRdrDetn163RdrDetnChks "0x7AA";
BA_ "GenSigSendType" SG_ 358 FrntRdrDetn163RdrDetnCntr 0;
BA_ "GenSigFuncType" SG_ 358 FrntRdrDetn163RdrDetnCntr 16;
BA_ "GenSigSendType" SG_ 358 FrntRdrDetn163RdrDetnConf 0;
BA_ "GenSigStartValue" SG_ 358 FrntRdrDetn163RdrDetnElevn 15;
BA_ "GenSigSendType" SG_ 358 FrntRdrDetn163RdrDetnElevn 0;
BA_ "GenSigSendType" SG_ 358 FrntRdrDetn163RdrDetnPwr 0;
BA_ "GenSigStartValue" SG_ 358 FrntRdrDetn163RdrDetnRng 10050;
BA_ "GenSigSendType" SG_ 358 FrntRdrDetn163RdrDetnRng 0;
BA_ "GenSigStartValue" SG_ 358 FrntRdrDetn163RdrDetnRngV 4000;
BA_ "GenSigSendType" SG_ 358 FrntRdrDetn163RdrDetnRngV 0;
BA_ "GenSigStartValue" SG_ 358 FrntRdrDetn163RdrDetnSts 3;
BA_ "GenSigSendType" SG_ 358 FrntRdrDetn163RdrDetnSts 0;
BA_ "GenSigStartValue" SG_ 358 FrntRdrDetn164RdrDetnAzi 900;
BA_ "GenSigSendType" SG_ 358 FrntRdrDetn164RdrDetnAzi 0;
BA_ "GenSigSendType" SG_ 358 FrntRdrDetn164RdrDetnChks 0;
BA_ "GenSigFuncType" SG_ 358 FrntRdrDetn164RdrDetnChks 15;
BA_ "GenSigDataID" SG_ 358 FrntRdrDetn164RdrDetnChks "0x7AB";
BA_ "GenSigSendType" SG_ 358 FrntRdrDetn164RdrDetnCntr 0;
BA_ "GenSigFuncType" SG_ 358 FrntRdrDetn164RdrDetnCntr 16;
BA_ "GenSigSendType" SG_ 358 FrntRdrDetn164RdrDetnConf 0;
BA_ "GenSigStartValue" SG_ 358 FrntRdrDetn164RdrDetnElevn 15;
BA_ "GenSigSendType" SG_ 358 FrntRdrDetn164RdrDetnElevn 0;
BA_ "GenSigSendType" SG_ 358 FrntRdrDetn164RdrDetnPwr 0;
BA_ "GenSigStartValue" SG_ 358 FrntRdrDetn164RdrDetnRng 10050;
BA_ "GenSigSendType" SG_ 358 FrntRdrDetn164RdrDetnRng 0;
BA_ "GenSigStartValue" SG_ 358 FrntRdrDetn164RdrDetnRngV 4000;
BA_ "GenSigSendType" SG_ 358 FrntRdrDetn164RdrDetnRngV 0;
BA_ "GenSigStartValue" SG_ 358 FrntRdrDetn164RdrDetnSts 3;
BA_ "GenSigSendType" SG_ 358 FrntRdrDetn164RdrDetnSts 0;
BA_ "GenSigStartValue" SG_ 358 FrntRdrDetn165RdrDetnAzi 900;
BA_ "GenSigSendType" SG_ 358 FrntRdrDetn165RdrDetnAzi 0;
BA_ "GenSigSendType" SG_ 358 FrntRdrDetn165RdrDetnChks 0;
BA_ "GenSigFuncType" SG_ 358 FrntRdrDetn165RdrDetnChks 15;
BA_ "GenSigDataID" SG_ 358 FrntRdrDetn165RdrDetnChks "0x7AC";
BA_ "GenSigSendType" SG_ 358 FrntRdrDetn165RdrDetnCntr 0;
BA_ "GenSigFuncType" SG_ 358 FrntRdrDetn165RdrDetnCntr 16;
BA_ "GenSigSendType" SG_ 358 FrntRdrDetn165RdrDetnConf 0;
BA_ "GenSigStartValue" SG_ 358 FrntRdrDetn165RdrDetnElevn 15;
BA_ "GenSigSendType" SG_ 358 FrntRdrDetn165RdrDetnElevn 0;
BA_ "GenSigSendType" SG_ 358 FrntRdrDetn165RdrDetnPwr 0;
BA_ "GenSigStartValue" SG_ 358 FrntRdrDetn165RdrDetnRng 10050;
BA_ "GenSigSendType" SG_ 358 FrntRdrDetn165RdrDetnRng 0;
BA_ "GenSigStartValue" SG_ 358 FrntRdrDetn165RdrDetnRngV 4000;
BA_ "GenSigSendType" SG_ 358 FrntRdrDetn165RdrDetnRngV 0;
BA_ "GenSigStartValue" SG_ 358 FrntRdrDetn165RdrDetnSts 3;
BA_ "GenSigSendType" SG_ 358 FrntRdrDetn165RdrDetnSts 0;
BA_ "GenSigStartValue" SG_ 358 FrntRdrDetn166RdrDetnAzi 900;
BA_ "GenSigSendType" SG_ 358 FrntRdrDetn166RdrDetnAzi 0;
BA_ "GenSigSendType" SG_ 358 FrntRdrDetn166RdrDetnChks 0;
BA_ "GenSigFuncType" SG_ 358 FrntRdrDetn166RdrDetnChks 15;
BA_ "GenSigDataID" SG_ 358 FrntRdrDetn166RdrDetnChks "0x7AD";
BA_ "GenSigSendType" SG_ 358 FrntRdrDetn166RdrDetnCntr 0;
BA_ "GenSigFuncType" SG_ 358 FrntRdrDetn166RdrDetnCntr 16;
BA_ "GenSigSendType" SG_ 358 FrntRdrDetn166RdrDetnConf 0;
BA_ "GenSigStartValue" SG_ 358 FrntRdrDetn166RdrDetnElevn 15;
BA_ "GenSigSendType" SG_ 358 FrntRdrDetn166RdrDetnElevn 0;
BA_ "GenSigSendType" SG_ 358 FrntRdrDetn166RdrDetnPwr 0;
BA_ "GenSigStartValue" SG_ 358 FrntRdrDetn166RdrDetnRng 10050;
BA_ "GenSigSendType" SG_ 358 FrntRdrDetn166RdrDetnRng 0;
BA_ "GenSigStartValue" SG_ 358 FrntRdrDetn166RdrDetnRngV 4000;
BA_ "GenSigSendType" SG_ 358 FrntRdrDetn166RdrDetnRngV 0;
BA_ "GenSigStartValue" SG_ 358 FrntRdrDetn166RdrDetnSts 3;
BA_ "GenSigSendType" SG_ 358 FrntRdrDetn166RdrDetnSts 0;
BA_ "GenSigStartValue" SG_ 358 FrntRdrDetn167RdrDetnAzi 900;
BA_ "GenSigSendType" SG_ 358 FrntRdrDetn167RdrDetnAzi 0;
BA_ "GenSigSendType" SG_ 358 FrntRdrDetn167RdrDetnChks 0;
BA_ "GenSigFuncType" SG_ 358 FrntRdrDetn167RdrDetnChks 15;
BA_ "GenSigDataID" SG_ 358 FrntRdrDetn167RdrDetnChks "0x7AE";
BA_ "GenSigSendType" SG_ 358 FrntRdrDetn167RdrDetnCntr 0;
BA_ "GenSigFuncType" SG_ 358 FrntRdrDetn167RdrDetnCntr 16;
BA_ "GenSigSendType" SG_ 358 FrntRdrDetn167RdrDetnConf 0;
BA_ "GenSigStartValue" SG_ 358 FrntRdrDetn167RdrDetnElevn 15;
BA_ "GenSigSendType" SG_ 358 FrntRdrDetn167RdrDetnElevn 0;
BA_ "GenSigSendType" SG_ 358 FrntRdrDetn167RdrDetnPwr 0;
BA_ "GenSigStartValue" SG_ 358 FrntRdrDetn167RdrDetnRng 10050;
BA_ "GenSigSendType" SG_ 358 FrntRdrDetn167RdrDetnRng 0;
BA_ "GenSigStartValue" SG_ 358 FrntRdrDetn167RdrDetnRngV 4000;
BA_ "GenSigSendType" SG_ 358 FrntRdrDetn167RdrDetnRngV 0;
BA_ "GenSigStartValue" SG_ 358 FrntRdrDetn167RdrDetnSts 3;
BA_ "GenSigSendType" SG_ 358 FrntRdrDetn167RdrDetnSts 0;
BA_ "GenSigStartValue" SG_ 358 FrntRdrDetn168RdrDetnAzi 900;
BA_ "GenSigSendType" SG_ 358 FrntRdrDetn168RdrDetnAzi 0;
BA_ "GenSigSendType" SG_ 358 FrntRdrDetn168RdrDetnChks 0;
BA_ "GenSigFuncType" SG_ 358 FrntRdrDetn168RdrDetnChks 15;
BA_ "GenSigDataID" SG_ 358 FrntRdrDetn168RdrDetnChks "0x7AF";
BA_ "GenSigSendType" SG_ 358 FrntRdrDetn168RdrDetnCntr 0;
BA_ "GenSigFuncType" SG_ 358 FrntRdrDetn168RdrDetnCntr 16;
BA_ "GenSigSendType" SG_ 358 FrntRdrDetn168RdrDetnConf 0;
BA_ "GenSigStartValue" SG_ 358 FrntRdrDetn168RdrDetnElevn 15;
BA_ "GenSigSendType" SG_ 358 FrntRdrDetn168RdrDetnElevn 0;
BA_ "GenSigSendType" SG_ 358 FrntRdrDetn168RdrDetnPwr 0;
BA_ "GenSigStartValue" SG_ 358 FrntRdrDetn168RdrDetnRng 10050;
BA_ "GenSigSendType" SG_ 358 FrntRdrDetn168RdrDetnRng 0;
BA_ "GenSigStartValue" SG_ 358 FrntRdrDetn168RdrDetnRngV 4000;
BA_ "GenSigSendType" SG_ 358 FrntRdrDetn168RdrDetnRngV 0;
BA_ "GenSigStartValue" SG_ 358 FrntRdrDetn168RdrDetnSts 3;
BA_ "GenSigSendType" SG_ 358 FrntRdrDetn168RdrDetnSts 0;
// Frame: FLRSafetyCANFD2Frame29
BA_ "VFrameFormat" BO_ 360 14;
BA_ "GenMsgSendType" BO_ 360 0;
BA_ "GenMsgCycleTime" BO_ 360 50.000;
BA_ "GenSigStartValue" SG_ 360 FrntRdrDetn169RdrDetnAzi 900;
BA_ "GenSigSendType" SG_ 360 FrntRdrDetn169RdrDetnAzi 0;
BA_ "GenSigSendType" SG_ 360 FrntRdrDetn169RdrDetnChks 0;
BA_ "GenSigFuncType" SG_ 360 FrntRdrDetn169RdrDetnChks 15;
BA_ "GenSigDataID" SG_ 360 FrntRdrDetn169RdrDetnChks "0x7B0";
BA_ "GenSigSendType" SG_ 360 FrntRdrDetn169RdrDetnCntr 0;
BA_ "GenSigFuncType" SG_ 360 FrntRdrDetn169RdrDetnCntr 16;
BA_ "GenSigSendType" SG_ 360 FrntRdrDetn169RdrDetnConf 0;
BA_ "GenSigStartValue" SG_ 360 FrntRdrDetn169RdrDetnElevn 15;
BA_ "GenSigSendType" SG_ 360 FrntRdrDetn169RdrDetnElevn 0;
BA_ "GenSigSendType" SG_ 360 FrntRdrDetn169RdrDetnPwr 0;
BA_ "GenSigStartValue" SG_ 360 FrntRdrDetn169RdrDetnRng 10050;
BA_ "GenSigSendType" SG_ 360 FrntRdrDetn169RdrDetnRng 0;
BA_ "GenSigStartValue" SG_ 360 FrntRdrDetn169RdrDetnRngV 4000;
BA_ "GenSigSendType" SG_ 360 FrntRdrDetn169RdrDetnRngV 0;
BA_ "GenSigStartValue" SG_ 360 FrntRdrDetn169RdrDetnSts 3;
BA_ "GenSigSendType" SG_ 360 FrntRdrDetn169RdrDetnSts 0;
BA_ "GenSigStartValue" SG_ 360 FrntRdrDetn170RdrDetnAzi 900;
BA_ "GenSigSendType" SG_ 360 FrntRdrDetn170RdrDetnAzi 0;
BA_ "GenSigSendType" SG_ 360 FrntRdrDetn170RdrDetnChks 0;
BA_ "GenSigFuncType" SG_ 360 FrntRdrDetn170RdrDetnChks 15;
BA_ "GenSigDataID" SG_ 360 FrntRdrDetn170RdrDetnChks "0x7B1";
BA_ "GenSigSendType" SG_ 360 FrntRdrDetn170RdrDetnCntr 0;
BA_ "GenSigFuncType" SG_ 360 FrntRdrDetn170RdrDetnCntr 16;
BA_ "GenSigSendType" SG_ 360 FrntRdrDetn170RdrDetnConf 0;
BA_ "GenSigStartValue" SG_ 360 FrntRdrDetn170RdrDetnElevn 15;
BA_ "GenSigSendType" SG_ 360 FrntRdrDetn170RdrDetnElevn 0;
BA_ "GenSigSendType" SG_ 360 FrntRdrDetn170RdrDetnPwr 0;
BA_ "GenSigStartValue" SG_ 360 FrntRdrDetn170RdrDetnRng 10050;
BA_ "GenSigSendType" SG_ 360 FrntRdrDetn170RdrDetnRng 0;
BA_ "GenSigStartValue" SG_ 360 FrntRdrDetn170RdrDetnRngV 4000;
BA_ "GenSigSendType" SG_ 360 FrntRdrDetn170RdrDetnRngV 0;
BA_ "GenSigStartValue" SG_ 360 FrntRdrDetn170RdrDetnSts 3;
BA_ "GenSigSendType" SG_ 360 FrntRdrDetn170RdrDetnSts 0;
BA_ "GenSigStartValue" SG_ 360 FrntRdrDetn171RdrDetnAzi 900;
BA_ "GenSigSendType" SG_ 360 FrntRdrDetn171RdrDetnAzi 0;
BA_ "GenSigSendType" SG_ 360 FrntRdrDetn171RdrDetnChks 0;
BA_ "GenSigFuncType" SG_ 360 FrntRdrDetn171RdrDetnChks 15;
BA_ "GenSigDataID" SG_ 360 FrntRdrDetn171RdrDetnChks "0x7B2";
BA_ "GenSigSendType" SG_ 360 FrntRdrDetn171RdrDetnCntr 0;
BA_ "GenSigFuncType" SG_ 360 FrntRdrDetn171RdrDetnCntr 16;
BA_ "GenSigSendType" SG_ 360 FrntRdrDetn171RdrDetnConf 0;
BA_ "GenSigStartValue" SG_ 360 FrntRdrDetn171RdrDetnElevn 15;
BA_ "GenSigSendType" SG_ 360 FrntRdrDetn171RdrDetnElevn 0;
BA_ "GenSigSendType" SG_ 360 FrntRdrDetn171RdrDetnPwr 0;
BA_ "GenSigStartValue" SG_ 360 FrntRdrDetn171RdrDetnRng 10050;
BA_ "GenSigSendType" SG_ 360 FrntRdrDetn171RdrDetnRng 0;
BA_ "GenSigStartValue" SG_ 360 FrntRdrDetn171RdrDetnRngV 4000;
BA_ "GenSigSendType" SG_ 360 FrntRdrDetn171RdrDetnRngV 0;
BA_ "GenSigStartValue" SG_ 360 FrntRdrDetn171RdrDetnSts 3;
BA_ "GenSigSendType" SG_ 360 FrntRdrDetn171RdrDetnSts 0;
BA_ "GenSigStartValue" SG_ 360 FrntRdrDetn172RdrDetnAzi 900;
BA_ "GenSigSendType" SG_ 360 FrntRdrDetn172RdrDetnAzi 0;
BA_ "GenSigSendType" SG_ 360 FrntRdrDetn172RdrDetnChks 0;
BA_ "GenSigFuncType" SG_ 360 FrntRdrDetn172RdrDetnChks 15;
BA_ "GenSigDataID" SG_ 360 FrntRdrDetn172RdrDetnChks "0x7B3";
BA_ "GenSigSendType" SG_ 360 FrntRdrDetn172RdrDetnCntr 0;
BA_ "GenSigFuncType" SG_ 360 FrntRdrDetn172RdrDetnCntr 16;
BA_ "GenSigSendType" SG_ 360 FrntRdrDetn172RdrDetnConf 0;
BA_ "GenSigStartValue" SG_ 360 FrntRdrDetn172RdrDetnElevn 15;
BA_ "GenSigSendType" SG_ 360 FrntRdrDetn172RdrDetnElevn 0;
BA_ "GenSigSendType" SG_ 360 FrntRdrDetn172RdrDetnPwr 0;
BA_ "GenSigStartValue" SG_ 360 FrntRdrDetn172RdrDetnRng 10050;
BA_ "GenSigSendType" SG_ 360 FrntRdrDetn172RdrDetnRng 0;
BA_ "GenSigStartValue" SG_ 360 FrntRdrDetn172RdrDetnRngV 4000;
BA_ "GenSigSendType" SG_ 360 FrntRdrDetn172RdrDetnRngV 0;
BA_ "GenSigStartValue" SG_ 360 FrntRdrDetn172RdrDetnSts 3;
BA_ "GenSigSendType" SG_ 360 FrntRdrDetn172RdrDetnSts 0;
BA_ "GenSigStartValue" SG_ 360 FrntRdrDetn173RdrDetnAzi 900;
BA_ "GenSigSendType" SG_ 360 FrntRdrDetn173RdrDetnAzi 0;
BA_ "GenSigSendType" SG_ 360 FrntRdrDetn173RdrDetnChks 0;
BA_ "GenSigFuncType" SG_ 360 FrntRdrDetn173RdrDetnChks 15;
BA_ "GenSigDataID" SG_ 360 FrntRdrDetn173RdrDetnChks "0x7B4";
BA_ "GenSigSendType" SG_ 360 FrntRdrDetn173RdrDetnCntr 0;
BA_ "GenSigFuncType" SG_ 360 FrntRdrDetn173RdrDetnCntr 16;
BA_ "GenSigSendType" SG_ 360 FrntRdrDetn173RdrDetnConf 0;
BA_ "GenSigStartValue" SG_ 360 FrntRdrDetn173RdrDetnElevn 15;
BA_ "GenSigSendType" SG_ 360 FrntRdrDetn173RdrDetnElevn 0;
BA_ "GenSigSendType" SG_ 360 FrntRdrDetn173RdrDetnPwr 0;
BA_ "GenSigStartValue" SG_ 360 FrntRdrDetn173RdrDetnRng 10050;
BA_ "GenSigSendType" SG_ 360 FrntRdrDetn173RdrDetnRng 0;
BA_ "GenSigStartValue" SG_ 360 FrntRdrDetn173RdrDetnRngV 4000;
BA_ "GenSigSendType" SG_ 360 FrntRdrDetn173RdrDetnRngV 0;
BA_ "GenSigStartValue" SG_ 360 FrntRdrDetn173RdrDetnSts 3;
BA_ "GenSigSendType" SG_ 360 FrntRdrDetn173RdrDetnSts 0;
BA_ "GenSigStartValue" SG_ 360 FrntRdrDetn174RdrDetnAzi 900;
BA_ "GenSigSendType" SG_ 360 FrntRdrDetn174RdrDetnAzi 0;
BA_ "GenSigSendType" SG_ 360 FrntRdrDetn174RdrDetnChks 0;
BA_ "GenSigFuncType" SG_ 360 FrntRdrDetn174RdrDetnChks 15;
BA_ "GenSigDataID" SG_ 360 FrntRdrDetn174RdrDetnChks "0x7B5";
BA_ "GenSigSendType" SG_ 360 FrntRdrDetn174RdrDetnCntr 0;
BA_ "GenSigFuncType" SG_ 360 FrntRdrDetn174RdrDetnCntr 16;
BA_ "GenSigSendType" SG_ 360 FrntRdrDetn174RdrDetnConf 0;
BA_ "GenSigStartValue" SG_ 360 FrntRdrDetn174RdrDetnElevn 15;
BA_ "GenSigSendType" SG_ 360 FrntRdrDetn174RdrDetnElevn 0;
BA_ "GenSigSendType" SG_ 360 FrntRdrDetn174RdrDetnPwr 0;
BA_ "GenSigStartValue" SG_ 360 FrntRdrDetn174RdrDetnRng 10050;
BA_ "GenSigSendType" SG_ 360 FrntRdrDetn174RdrDetnRng 0;
BA_ "GenSigStartValue" SG_ 360 FrntRdrDetn174RdrDetnRngV 4000;
BA_ "GenSigSendType" SG_ 360 FrntRdrDetn174RdrDetnRngV 0;
BA_ "GenSigStartValue" SG_ 360 FrntRdrDetn174RdrDetnSts 3;
BA_ "GenSigSendType" SG_ 360 FrntRdrDetn174RdrDetnSts 0;
// Frame: FLRSafetyCANFD2Frame30
BA_ "VFrameFormat" BO_ 362 14;
BA_ "GenMsgSendType" BO_ 362 0;
BA_ "GenMsgCycleTime" BO_ 362 50.000;
BA_ "GenSigStartValue" SG_ 362 FrntRdrDetn175RdrDetnAzi 900;
BA_ "GenSigSendType" SG_ 362 FrntRdrDetn175RdrDetnAzi 0;
BA_ "GenSigSendType" SG_ 362 FrntRdrDetn175RdrDetnChks 0;
BA_ "GenSigFuncType" SG_ 362 FrntRdrDetn175RdrDetnChks 15;
BA_ "GenSigDataID" SG_ 362 FrntRdrDetn175RdrDetnChks "0x7B6";
BA_ "GenSigSendType" SG_ 362 FrntRdrDetn175RdrDetnCntr 0;
BA_ "GenSigFuncType" SG_ 362 FrntRdrDetn175RdrDetnCntr 16;
BA_ "GenSigSendType" SG_ 362 FrntRdrDetn175RdrDetnConf 0;
BA_ "GenSigStartValue" SG_ 362 FrntRdrDetn175RdrDetnElevn 15;
BA_ "GenSigSendType" SG_ 362 FrntRdrDetn175RdrDetnElevn 0;
BA_ "GenSigSendType" SG_ 362 FrntRdrDetn175RdrDetnPwr 0;
BA_ "GenSigStartValue" SG_ 362 FrntRdrDetn175RdrDetnRng 10050;
BA_ "GenSigSendType" SG_ 362 FrntRdrDetn175RdrDetnRng 0;
BA_ "GenSigStartValue" SG_ 362 FrntRdrDetn175RdrDetnRngV 4000;
BA_ "GenSigSendType" SG_ 362 FrntRdrDetn175RdrDetnRngV 0;
BA_ "GenSigStartValue" SG_ 362 FrntRdrDetn175RdrDetnSts 3;
BA_ "GenSigSendType" SG_ 362 FrntRdrDetn175RdrDetnSts 0;
BA_ "GenSigStartValue" SG_ 362 FrntRdrDetn176RdrDetnAzi 900;
BA_ "GenSigSendType" SG_ 362 FrntRdrDetn176RdrDetnAzi 0;
BA_ "GenSigSendType" SG_ 362 FrntRdrDetn176RdrDetnChks 0;
BA_ "GenSigFuncType" SG_ 362 FrntRdrDetn176RdrDetnChks 15;
BA_ "GenSigDataID" SG_ 362 FrntRdrDetn176RdrDetnChks "0x7B7";
BA_ "GenSigSendType" SG_ 362 FrntRdrDetn176RdrDetnCntr 0;
BA_ "GenSigFuncType" SG_ 362 FrntRdrDetn176RdrDetnCntr 16;
BA_ "GenSigSendType" SG_ 362 FrntRdrDetn176RdrDetnConf 0;
BA_ "GenSigStartValue" SG_ 362 FrntRdrDetn176RdrDetnElevn 15;
BA_ "GenSigSendType" SG_ 362 FrntRdrDetn176RdrDetnElevn 0;
BA_ "GenSigSendType" SG_ 362 FrntRdrDetn176RdrDetnPwr 0;
BA_ "GenSigStartValue" SG_ 362 FrntRdrDetn176RdrDetnRng 10050;
BA_ "GenSigSendType" SG_ 362 FrntRdrDetn176RdrDetnRng 0;
BA_ "GenSigStartValue" SG_ 362 FrntRdrDetn176RdrDetnRngV 4000;
BA_ "GenSigSendType" SG_ 362 FrntRdrDetn176RdrDetnRngV 0;
BA_ "GenSigStartValue" SG_ 362 FrntRdrDetn176RdrDetnSts 3;
BA_ "GenSigSendType" SG_ 362 FrntRdrDetn176RdrDetnSts 0;
BA_ "GenSigStartValue" SG_ 362 FrntRdrDetn177RdrDetnAzi 900;
BA_ "GenSigSendType" SG_ 362 FrntRdrDetn177RdrDetnAzi 0;
BA_ "GenSigSendType" SG_ 362 FrntRdrDetn177RdrDetnChks 0;
BA_ "GenSigFuncType" SG_ 362 FrntRdrDetn177RdrDetnChks 15;
BA_ "GenSigDataID" SG_ 362 FrntRdrDetn177RdrDetnChks "0x7B8";
BA_ "GenSigSendType" SG_ 362 FrntRdrDetn177RdrDetnCntr 0;
BA_ "GenSigFuncType" SG_ 362 FrntRdrDetn177RdrDetnCntr 16;
BA_ "GenSigSendType" SG_ 362 FrntRdrDetn177RdrDetnConf 0;
BA_ "GenSigStartValue" SG_ 362 FrntRdrDetn177RdrDetnElevn 15;
BA_ "GenSigSendType" SG_ 362 FrntRdrDetn177RdrDetnElevn 0;
BA_ "GenSigSendType" SG_ 362 FrntRdrDetn177RdrDetnPwr 0;
BA_ "GenSigStartValue" SG_ 362 FrntRdrDetn177RdrDetnRng 10050;
BA_ "GenSigSendType" SG_ 362 FrntRdrDetn177RdrDetnRng 0;
BA_ "GenSigStartValue" SG_ 362 FrntRdrDetn177RdrDetnRngV 4000;
BA_ "GenSigSendType" SG_ 362 FrntRdrDetn177RdrDetnRngV 0;
BA_ "GenSigStartValue" SG_ 362 FrntRdrDetn177RdrDetnSts 3;
BA_ "GenSigSendType" SG_ 362 FrntRdrDetn177RdrDetnSts 0;
BA_ "GenSigStartValue" SG_ 362 FrntRdrDetn178RdrDetnAzi 900;
BA_ "GenSigSendType" SG_ 362 FrntRdrDetn178RdrDetnAzi 0;
BA_ "GenSigSendType" SG_ 362 FrntRdrDetn178RdrDetnChks 0;
BA_ "GenSigFuncType" SG_ 362 FrntRdrDetn178RdrDetnChks 15;
BA_ "GenSigDataID" SG_ 362 FrntRdrDetn178RdrDetnChks "0x7B9";
BA_ "GenSigSendType" SG_ 362 FrntRdrDetn178RdrDetnCntr 0;
BA_ "GenSigFuncType" SG_ 362 FrntRdrDetn178RdrDetnCntr 16;
BA_ "GenSigSendType" SG_ 362 FrntRdrDetn178RdrDetnConf 0;
BA_ "GenSigStartValue" SG_ 362 FrntRdrDetn178RdrDetnElevn 15;
BA_ "GenSigSendType" SG_ 362 FrntRdrDetn178RdrDetnElevn 0;
BA_ "GenSigSendType" SG_ 362 FrntRdrDetn178RdrDetnPwr 0;
BA_ "GenSigStartValue" SG_ 362 FrntRdrDetn178RdrDetnRng 10050;
BA_ "GenSigSendType" SG_ 362 FrntRdrDetn178RdrDetnRng 0;
BA_ "GenSigStartValue" SG_ 362 FrntRdrDetn178RdrDetnRngV 4000;
BA_ "GenSigSendType" SG_ 362 FrntRdrDetn178RdrDetnRngV 0;
BA_ "GenSigStartValue" SG_ 362 FrntRdrDetn178RdrDetnSts 3;
BA_ "GenSigSendType" SG_ 362 FrntRdrDetn178RdrDetnSts 0;
BA_ "GenSigStartValue" SG_ 362 FrntRdrDetn179RdrDetnAzi 900;
BA_ "GenSigSendType" SG_ 362 FrntRdrDetn179RdrDetnAzi 0;
BA_ "GenSigSendType" SG_ 362 FrntRdrDetn179RdrDetnChks 0;
BA_ "GenSigFuncType" SG_ 362 FrntRdrDetn179RdrDetnChks 15;
BA_ "GenSigDataID" SG_ 362 FrntRdrDetn179RdrDetnChks "0x7BA";
BA_ "GenSigSendType" SG_ 362 FrntRdrDetn179RdrDetnCntr 0;
BA_ "GenSigFuncType" SG_ 362 FrntRdrDetn179RdrDetnCntr 16;
BA_ "GenSigSendType" SG_ 362 FrntRdrDetn179RdrDetnConf 0;
BA_ "GenSigStartValue" SG_ 362 FrntRdrDetn179RdrDetnElevn 15;
BA_ "GenSigSendType" SG_ 362 FrntRdrDetn179RdrDetnElevn 0;
BA_ "GenSigSendType" SG_ 362 FrntRdrDetn179RdrDetnPwr 0;
BA_ "GenSigStartValue" SG_ 362 FrntRdrDetn179RdrDetnRng 10050;
BA_ "GenSigSendType" SG_ 362 FrntRdrDetn179RdrDetnRng 0;
BA_ "GenSigStartValue" SG_ 362 FrntRdrDetn179RdrDetnRngV 4000;
BA_ "GenSigSendType" SG_ 362 FrntRdrDetn179RdrDetnRngV 0;
BA_ "GenSigStartValue" SG_ 362 FrntRdrDetn179RdrDetnSts 3;
BA_ "GenSigSendType" SG_ 362 FrntRdrDetn179RdrDetnSts 0;
BA_ "GenSigStartValue" SG_ 362 FrntRdrDetn180RdrDetnAzi 900;
BA_ "GenSigSendType" SG_ 362 FrntRdrDetn180RdrDetnAzi 0;
BA_ "GenSigSendType" SG_ 362 FrntRdrDetn180RdrDetnChks 0;
BA_ "GenSigFuncType" SG_ 362 FrntRdrDetn180RdrDetnChks 15;
BA_ "GenSigDataID" SG_ 362 FrntRdrDetn180RdrDetnChks "0x7BB";
BA_ "GenSigSendType" SG_ 362 FrntRdrDetn180RdrDetnCntr 0;
BA_ "GenSigFuncType" SG_ 362 FrntRdrDetn180RdrDetnCntr 16;
BA_ "GenSigSendType" SG_ 362 FrntRdrDetn180RdrDetnConf 0;
BA_ "GenSigStartValue" SG_ 362 FrntRdrDetn180RdrDetnElevn 15;
BA_ "GenSigSendType" SG_ 362 FrntRdrDetn180RdrDetnElevn 0;
BA_ "GenSigSendType" SG_ 362 FrntRdrDetn180RdrDetnPwr 0;
BA_ "GenSigStartValue" SG_ 362 FrntRdrDetn180RdrDetnRng 10050;
BA_ "GenSigSendType" SG_ 362 FrntRdrDetn180RdrDetnRng 0;
BA_ "GenSigStartValue" SG_ 362 FrntRdrDetn180RdrDetnRngV 4000;
BA_ "GenSigSendType" SG_ 362 FrntRdrDetn180RdrDetnRngV 0;
BA_ "GenSigStartValue" SG_ 362 FrntRdrDetn180RdrDetnSts 3;
BA_ "GenSigSendType" SG_ 362 FrntRdrDetn180RdrDetnSts 0;
// Frame: FLRSafetyCANFD2Frame31
BA_ "VFrameFormat" BO_ 364 14;
BA_ "GenMsgSendType" BO_ 364 0;
BA_ "GenMsgCycleTime" BO_ 364 50.000;
BA_ "GenSigStartValue" SG_ 364 FrntRdrDetn181RdrDetnAzi 900;
BA_ "GenSigSendType" SG_ 364 FrntRdrDetn181RdrDetnAzi 0;
BA_ "GenSigSendType" SG_ 364 FrntRdrDetn181RdrDetnChks 0;
BA_ "GenSigFuncType" SG_ 364 FrntRdrDetn181RdrDetnChks 15;
BA_ "GenSigDataID" SG_ 364 FrntRdrDetn181RdrDetnChks "0x7BC";
BA_ "GenSigSendType" SG_ 364 FrntRdrDetn181RdrDetnCntr 0;
BA_ "GenSigFuncType" SG_ 364 FrntRdrDetn181RdrDetnCntr 16;
BA_ "GenSigSendType" SG_ 364 FrntRdrDetn181RdrDetnConf 0;
BA_ "GenSigStartValue" SG_ 364 FrntRdrDetn181RdrDetnElevn 15;
BA_ "GenSigSendType" SG_ 364 FrntRdrDetn181RdrDetnElevn 0;
BA_ "GenSigSendType" SG_ 364 FrntRdrDetn181RdrDetnPwr 0;
BA_ "GenSigStartValue" SG_ 364 FrntRdrDetn181RdrDetnRng 10050;
BA_ "GenSigSendType" SG_ 364 FrntRdrDetn181RdrDetnRng 0;
BA_ "GenSigStartValue" SG_ 364 FrntRdrDetn181RdrDetnRngV 4000;
BA_ "GenSigSendType" SG_ 364 FrntRdrDetn181RdrDetnRngV 0;
BA_ "GenSigStartValue" SG_ 364 FrntRdrDetn181RdrDetnSts 3;
BA_ "GenSigSendType" SG_ 364 FrntRdrDetn181RdrDetnSts 0;
BA_ "GenSigStartValue" SG_ 364 FrntRdrDetn182RdrDetnAzi 900;
BA_ "GenSigSendType" SG_ 364 FrntRdrDetn182RdrDetnAzi 0;
BA_ "GenSigSendType" SG_ 364 FrntRdrDetn182RdrDetnChks 0;
BA_ "GenSigFuncType" SG_ 364 FrntRdrDetn182RdrDetnChks 15;
BA_ "GenSigDataID" SG_ 364 FrntRdrDetn182RdrDetnChks "0x7BD";
BA_ "GenSigSendType" SG_ 364 FrntRdrDetn182RdrDetnCntr 0;
BA_ "GenSigFuncType" SG_ 364 FrntRdrDetn182RdrDetnCntr 16;
BA_ "GenSigSendType" SG_ 364 FrntRdrDetn182RdrDetnConf 0;
BA_ "GenSigStartValue" SG_ 364 FrntRdrDetn182RdrDetnElevn 15;
BA_ "GenSigSendType" SG_ 364 FrntRdrDetn182RdrDetnElevn 0;
BA_ "GenSigSendType" SG_ 364 FrntRdrDetn182RdrDetnPwr 0;
BA_ "GenSigStartValue" SG_ 364 FrntRdrDetn182RdrDetnRng 10050;
BA_ "GenSigSendType" SG_ 364 FrntRdrDetn182RdrDetnRng 0;
BA_ "GenSigStartValue" SG_ 364 FrntRdrDetn182RdrDetnRngV 4000;
BA_ "GenSigSendType" SG_ 364 FrntRdrDetn182RdrDetnRngV 0;
BA_ "GenSigStartValue" SG_ 364 FrntRdrDetn182RdrDetnSts 3;
BA_ "GenSigSendType" SG_ 364 FrntRdrDetn182RdrDetnSts 0;
BA_ "GenSigStartValue" SG_ 364 FrntRdrDetn183RdrDetnAzi 900;
BA_ "GenSigSendType" SG_ 364 FrntRdrDetn183RdrDetnAzi 0;
BA_ "GenSigSendType" SG_ 364 FrntRdrDetn183RdrDetnChks 0;
BA_ "GenSigFuncType" SG_ 364 FrntRdrDetn183RdrDetnChks 15;
BA_ "GenSigDataID" SG_ 364 FrntRdrDetn183RdrDetnChks "0x7BE";
BA_ "GenSigSendType" SG_ 364 FrntRdrDetn183RdrDetnCntr 0;
BA_ "GenSigFuncType" SG_ 364 FrntRdrDetn183RdrDetnCntr 16;
BA_ "GenSigSendType" SG_ 364 FrntRdrDetn183RdrDetnConf 0;
BA_ "GenSigStartValue" SG_ 364 FrntRdrDetn183RdrDetnElevn 15;
BA_ "GenSigSendType" SG_ 364 FrntRdrDetn183RdrDetnElevn 0;
BA_ "GenSigSendType" SG_ 364 FrntRdrDetn183RdrDetnPwr 0;
BA_ "GenSigStartValue" SG_ 364 FrntRdrDetn183RdrDetnRng 10050;
BA_ "GenSigSendType" SG_ 364 FrntRdrDetn183RdrDetnRng 0;
BA_ "GenSigStartValue" SG_ 364 FrntRdrDetn183RdrDetnRngV 4000;
BA_ "GenSigSendType" SG_ 364 FrntRdrDetn183RdrDetnRngV 0;
BA_ "GenSigStartValue" SG_ 364 FrntRdrDetn183RdrDetnSts 3;
BA_ "GenSigSendType" SG_ 364 FrntRdrDetn183RdrDetnSts 0;
BA_ "GenSigStartValue" SG_ 364 FrntRdrDetn184RdrDetnAzi 900;
BA_ "GenSigSendType" SG_ 364 FrntRdrDetn184RdrDetnAzi 0;
BA_ "GenSigSendType" SG_ 364 FrntRdrDetn184RdrDetnChks 0;
BA_ "GenSigFuncType" SG_ 364 FrntRdrDetn184RdrDetnChks 15;
BA_ "GenSigDataID" SG_ 364 FrntRdrDetn184RdrDetnChks "0x7BF";
BA_ "GenSigSendType" SG_ 364 FrntRdrDetn184RdrDetnCntr 0;
BA_ "GenSigFuncType" SG_ 364 FrntRdrDetn184RdrDetnCntr 16;
BA_ "GenSigSendType" SG_ 364 FrntRdrDetn184RdrDetnConf 0;
BA_ "GenSigStartValue" SG_ 364 FrntRdrDetn184RdrDetnElevn 15;
BA_ "GenSigSendType" SG_ 364 FrntRdrDetn184RdrDetnElevn 0;
BA_ "GenSigSendType" SG_ 364 FrntRdrDetn184RdrDetnPwr 0;
BA_ "GenSigStartValue" SG_ 364 FrntRdrDetn184RdrDetnRng 10050;
BA_ "GenSigSendType" SG_ 364 FrntRdrDetn184RdrDetnRng 0;
BA_ "GenSigStartValue" SG_ 364 FrntRdrDetn184RdrDetnRngV 4000;
BA_ "GenSigSendType" SG_ 364 FrntRdrDetn184RdrDetnRngV 0;
BA_ "GenSigStartValue" SG_ 364 FrntRdrDetn184RdrDetnSts 3;
BA_ "GenSigSendType" SG_ 364 FrntRdrDetn184RdrDetnSts 0;
BA_ "GenSigStartValue" SG_ 364 FrntRdrDetn185RdrDetnAzi 900;
BA_ "GenSigSendType" SG_ 364 FrntRdrDetn185RdrDetnAzi 0;
BA_ "GenSigSendType" SG_ 364 FrntRdrDetn185RdrDetnChks 0;
BA_ "GenSigFuncType" SG_ 364 FrntRdrDetn185RdrDetnChks 15;
BA_ "GenSigDataID" SG_ 364 FrntRdrDetn185RdrDetnChks "0x7C0";
BA_ "GenSigSendType" SG_ 364 FrntRdrDetn185RdrDetnCntr 0;
BA_ "GenSigFuncType" SG_ 364 FrntRdrDetn185RdrDetnCntr 16;
BA_ "GenSigSendType" SG_ 364 FrntRdrDetn185RdrDetnConf 0;
BA_ "GenSigStartValue" SG_ 364 FrntRdrDetn185RdrDetnElevn 15;
BA_ "GenSigSendType" SG_ 364 FrntRdrDetn185RdrDetnElevn 0;
BA_ "GenSigSendType" SG_ 364 FrntRdrDetn185RdrDetnPwr 0;
BA_ "GenSigStartValue" SG_ 364 FrntRdrDetn185RdrDetnRng 10050;
BA_ "GenSigSendType" SG_ 364 FrntRdrDetn185RdrDetnRng 0;
BA_ "GenSigStartValue" SG_ 364 FrntRdrDetn185RdrDetnRngV 4000;
BA_ "GenSigSendType" SG_ 364 FrntRdrDetn185RdrDetnRngV 0;
BA_ "GenSigStartValue" SG_ 364 FrntRdrDetn185RdrDetnSts 3;
BA_ "GenSigSendType" SG_ 364 FrntRdrDetn185RdrDetnSts 0;
BA_ "GenSigStartValue" SG_ 364 FrntRdrDetn186RdrDetnAzi 900;
BA_ "GenSigSendType" SG_ 364 FrntRdrDetn186RdrDetnAzi 0;
BA_ "GenSigSendType" SG_ 364 FrntRdrDetn186RdrDetnChks 0;
BA_ "GenSigFuncType" SG_ 364 FrntRdrDetn186RdrDetnChks 15;
BA_ "GenSigDataID" SG_ 364 FrntRdrDetn186RdrDetnChks "0x7C1";
BA_ "GenSigSendType" SG_ 364 FrntRdrDetn186RdrDetnCntr 0;
BA_ "GenSigFuncType" SG_ 364 FrntRdrDetn186RdrDetnCntr 16;
BA_ "GenSigSendType" SG_ 364 FrntRdrDetn186RdrDetnConf 0;
BA_ "GenSigStartValue" SG_ 364 FrntRdrDetn186RdrDetnElevn 15;
BA_ "GenSigSendType" SG_ 364 FrntRdrDetn186RdrDetnElevn 0;
BA_ "GenSigSendType" SG_ 364 FrntRdrDetn186RdrDetnPwr 0;
BA_ "GenSigStartValue" SG_ 364 FrntRdrDetn186RdrDetnRng 10050;
BA_ "GenSigSendType" SG_ 364 FrntRdrDetn186RdrDetnRng 0;
BA_ "GenSigStartValue" SG_ 364 FrntRdrDetn186RdrDetnRngV 4000;
BA_ "GenSigSendType" SG_ 364 FrntRdrDetn186RdrDetnRngV 0;
BA_ "GenSigStartValue" SG_ 364 FrntRdrDetn186RdrDetnSts 3;
BA_ "GenSigSendType" SG_ 364 FrntRdrDetn186RdrDetnSts 0;
// Frame: FLRSafetyCANFD2Frame32
BA_ "VFrameFormat" BO_ 366 14;
BA_ "GenMsgSendType" BO_ 366 0;
BA_ "GenMsgCycleTime" BO_ 366 50.000;
BA_ "GenSigStartValue" SG_ 366 FrntRdrDetn187RdrDetnAzi 900;
BA_ "GenSigSendType" SG_ 366 FrntRdrDetn187RdrDetnAzi 0;
BA_ "GenSigSendType" SG_ 366 FrntRdrDetn187RdrDetnChks 0;
BA_ "GenSigFuncType" SG_ 366 FrntRdrDetn187RdrDetnChks 15;
BA_ "GenSigDataID" SG_ 366 FrntRdrDetn187RdrDetnChks "0x7C2";
BA_ "GenSigSendType" SG_ 366 FrntRdrDetn187RdrDetnCntr 0;
BA_ "GenSigFuncType" SG_ 366 FrntRdrDetn187RdrDetnCntr 16;
BA_ "GenSigSendType" SG_ 366 FrntRdrDetn187RdrDetnConf 0;
BA_ "GenSigStartValue" SG_ 366 FrntRdrDetn187RdrDetnElevn 15;
BA_ "GenSigSendType" SG_ 366 FrntRdrDetn187RdrDetnElevn 0;
BA_ "GenSigSendType" SG_ 366 FrntRdrDetn187RdrDetnPwr 0;
BA_ "GenSigStartValue" SG_ 366 FrntRdrDetn187RdrDetnRng 10050;
BA_ "GenSigSendType" SG_ 366 FrntRdrDetn187RdrDetnRng 0;
BA_ "GenSigStartValue" SG_ 366 FrntRdrDetn187RdrDetnRngV 4000;
BA_ "GenSigSendType" SG_ 366 FrntRdrDetn187RdrDetnRngV 0;
BA_ "GenSigStartValue" SG_ 366 FrntRdrDetn187RdrDetnSts 3;
BA_ "GenSigSendType" SG_ 366 FrntRdrDetn187RdrDetnSts 0;
BA_ "GenSigStartValue" SG_ 366 FrntRdrDetn188RdrDetnAzi 900;
BA_ "GenSigSendType" SG_ 366 FrntRdrDetn188RdrDetnAzi 0;
BA_ "GenSigSendType" SG_ 366 FrntRdrDetn188RdrDetnChks 0;
BA_ "GenSigFuncType" SG_ 366 FrntRdrDetn188RdrDetnChks 15;
BA_ "GenSigDataID" SG_ 366 FrntRdrDetn188RdrDetnChks "0x7C3";
BA_ "GenSigSendType" SG_ 366 FrntRdrDetn188RdrDetnCntr 0;
BA_ "GenSigFuncType" SG_ 366 FrntRdrDetn188RdrDetnCntr 16;
BA_ "GenSigSendType" SG_ 366 FrntRdrDetn188RdrDetnConf 0;
BA_ "GenSigStartValue" SG_ 366 FrntRdrDetn188RdrDetnElevn 15;
BA_ "GenSigSendType" SG_ 366 FrntRdrDetn188RdrDetnElevn 0;
BA_ "GenSigSendType" SG_ 366 FrntRdrDetn188RdrDetnPwr 0;
BA_ "GenSigStartValue" SG_ 366 FrntRdrDetn188RdrDetnRng 10050;
BA_ "GenSigSendType" SG_ 366 FrntRdrDetn188RdrDetnRng 0;
BA_ "GenSigStartValue" SG_ 366 FrntRdrDetn188RdrDetnRngV 4000;
BA_ "GenSigSendType" SG_ 366 FrntRdrDetn188RdrDetnRngV 0;
BA_ "GenSigStartValue" SG_ 366 FrntRdrDetn188RdrDetnSts 3;
BA_ "GenSigSendType" SG_ 366 FrntRdrDetn188RdrDetnSts 0;
BA_ "GenSigStartValue" SG_ 366 FrntRdrDetn189RdrDetnAzi 900;
BA_ "GenSigSendType" SG_ 366 FrntRdrDetn189RdrDetnAzi 0;
BA_ "GenSigSendType" SG_ 366 FrntRdrDetn189RdrDetnChks 0;
BA_ "GenSigFuncType" SG_ 366 FrntRdrDetn189RdrDetnChks 15;
BA_ "GenSigDataID" SG_ 366 FrntRdrDetn189RdrDetnChks "0x7C4";
BA_ "GenSigSendType" SG_ 366 FrntRdrDetn189RdrDetnCntr 0;
BA_ "GenSigFuncType" SG_ 366 FrntRdrDetn189RdrDetnCntr 16;
BA_ "GenSigSendType" SG_ 366 FrntRdrDetn189RdrDetnConf 0;
BA_ "GenSigStartValue" SG_ 366 FrntRdrDetn189RdrDetnElevn 15;
BA_ "GenSigSendType" SG_ 366 FrntRdrDetn189RdrDetnElevn 0;
BA_ "GenSigSendType" SG_ 366 FrntRdrDetn189RdrDetnPwr 0;
BA_ "GenSigStartValue" SG_ 366 FrntRdrDetn189RdrDetnRng 10050;
BA_ "GenSigSendType" SG_ 366 FrntRdrDetn189RdrDetnRng 0;
BA_ "GenSigStartValue" SG_ 366 FrntRdrDetn189RdrDetnRngV 4000;
BA_ "GenSigSendType" SG_ 366 FrntRdrDetn189RdrDetnRngV 0;
BA_ "GenSigStartValue" SG_ 366 FrntRdrDetn189RdrDetnSts 3;
BA_ "GenSigSendType" SG_ 366 FrntRdrDetn189RdrDetnSts 0;
BA_ "GenSigStartValue" SG_ 366 FrntRdrDetn190RdrDetnAzi 900;
BA_ "GenSigSendType" SG_ 366 FrntRdrDetn190RdrDetnAzi 0;
BA_ "GenSigSendType" SG_ 366 FrntRdrDetn190RdrDetnChks 0;
BA_ "GenSigFuncType" SG_ 366 FrntRdrDetn190RdrDetnChks 15;
BA_ "GenSigDataID" SG_ 366 FrntRdrDetn190RdrDetnChks "0x7C5";
BA_ "GenSigSendType" SG_ 366 FrntRdrDetn190RdrDetnCntr 0;
BA_ "GenSigFuncType" SG_ 366 FrntRdrDetn190RdrDetnCntr 16;
BA_ "GenSigSendType" SG_ 366 FrntRdrDetn190RdrDetnConf 0;
BA_ "GenSigStartValue" SG_ 366 FrntRdrDetn190RdrDetnElevn 15;
BA_ "GenSigSendType" SG_ 366 FrntRdrDetn190RdrDetnElevn 0;
BA_ "GenSigSendType" SG_ 366 FrntRdrDetn190RdrDetnPwr 0;
BA_ "GenSigStartValue" SG_ 366 FrntRdrDetn190RdrDetnRng 10050;
BA_ "GenSigSendType" SG_ 366 FrntRdrDetn190RdrDetnRng 0;
BA_ "GenSigStartValue" SG_ 366 FrntRdrDetn190RdrDetnRngV 4000;
BA_ "GenSigSendType" SG_ 366 FrntRdrDetn190RdrDetnRngV 0;
BA_ "GenSigStartValue" SG_ 366 FrntRdrDetn190RdrDetnSts 3;
BA_ "GenSigSendType" SG_ 366 FrntRdrDetn190RdrDetnSts 0;
BA_ "GenSigStartValue" SG_ 366 FrntRdrDetn191RdrDetnAzi 900;
BA_ "GenSigSendType" SG_ 366 FrntRdrDetn191RdrDetnAzi 0;
BA_ "GenSigSendType" SG_ 366 FrntRdrDetn191RdrDetnChks 0;
BA_ "GenSigFuncType" SG_ 366 FrntRdrDetn191RdrDetnChks 15;
BA_ "GenSigDataID" SG_ 366 FrntRdrDetn191RdrDetnChks "0x7C6";
BA_ "GenSigSendType" SG_ 366 FrntRdrDetn191RdrDetnCntr 0;
BA_ "GenSigFuncType" SG_ 366 FrntRdrDetn191RdrDetnCntr 16;
BA_ "GenSigSendType" SG_ 366 FrntRdrDetn191RdrDetnConf 0;
BA_ "GenSigStartValue" SG_ 366 FrntRdrDetn191RdrDetnElevn 15;
BA_ "GenSigSendType" SG_ 366 FrntRdrDetn191RdrDetnElevn 0;
BA_ "GenSigSendType" SG_ 366 FrntRdrDetn191RdrDetnPwr 0;
BA_ "GenSigStartValue" SG_ 366 FrntRdrDetn191RdrDetnRng 10050;
BA_ "GenSigSendType" SG_ 366 FrntRdrDetn191RdrDetnRng 0;
BA_ "GenSigStartValue" SG_ 366 FrntRdrDetn191RdrDetnRngV 4000;
BA_ "GenSigSendType" SG_ 366 FrntRdrDetn191RdrDetnRngV 0;
BA_ "GenSigStartValue" SG_ 366 FrntRdrDetn191RdrDetnSts 3;
BA_ "GenSigSendType" SG_ 366 FrntRdrDetn191RdrDetnSts 0;
BA_ "GenSigStartValue" SG_ 366 FrntRdrDetn192RdrDetnAzi 900;
BA_ "GenSigSendType" SG_ 366 FrntRdrDetn192RdrDetnAzi 0;
BA_ "GenSigSendType" SG_ 366 FrntRdrDetn192RdrDetnChks 0;
BA_ "GenSigFuncType" SG_ 366 FrntRdrDetn192RdrDetnChks 15;
BA_ "GenSigDataID" SG_ 366 FrntRdrDetn192RdrDetnChks "0x7C7";
BA_ "GenSigSendType" SG_ 366 FrntRdrDetn192RdrDetnCntr 0;
BA_ "GenSigFuncType" SG_ 366 FrntRdrDetn192RdrDetnCntr 16;
BA_ "GenSigSendType" SG_ 366 FrntRdrDetn192RdrDetnConf 0;
BA_ "GenSigStartValue" SG_ 366 FrntRdrDetn192RdrDetnElevn 15;
BA_ "GenSigSendType" SG_ 366 FrntRdrDetn192RdrDetnElevn 0;
BA_ "GenSigSendType" SG_ 366 FrntRdrDetn192RdrDetnPwr 0;
BA_ "GenSigStartValue" SG_ 366 FrntRdrDetn192RdrDetnRng 10050;
BA_ "GenSigSendType" SG_ 366 FrntRdrDetn192RdrDetnRng 0;
BA_ "GenSigStartValue" SG_ 366 FrntRdrDetn192RdrDetnRngV 4000;
BA_ "GenSigSendType" SG_ 366 FrntRdrDetn192RdrDetnRngV 0;
BA_ "GenSigStartValue" SG_ 366 FrntRdrDetn192RdrDetnSts 3;
BA_ "GenSigSendType" SG_ 366 FrntRdrDetn192RdrDetnSts 0;
// Frame: FLRSafetyCANFD2Frame33
BA_ "VFrameFormat" BO_ 368 14;
BA_ "GenMsgSendType" BO_ 368 0;
BA_ "GenMsgCycleTime" BO_ 368 50.000;
BA_ "GenSigStartValue" SG_ 368 FrntRdrDetn193RdrDetnAzi 900;
BA_ "GenSigSendType" SG_ 368 FrntRdrDetn193RdrDetnAzi 0;
BA_ "GenSigSendType" SG_ 368 FrntRdrDetn193RdrDetnChks 0;
BA_ "GenSigFuncType" SG_ 368 FrntRdrDetn193RdrDetnChks 15;
BA_ "GenSigDataID" SG_ 368 FrntRdrDetn193RdrDetnChks "0x7C8";
BA_ "GenSigSendType" SG_ 368 FrntRdrDetn193RdrDetnCntr 0;
BA_ "GenSigFuncType" SG_ 368 FrntRdrDetn193RdrDetnCntr 16;
BA_ "GenSigSendType" SG_ 368 FrntRdrDetn193RdrDetnConf 0;
BA_ "GenSigStartValue" SG_ 368 FrntRdrDetn193RdrDetnElevn 15;
BA_ "GenSigSendType" SG_ 368 FrntRdrDetn193RdrDetnElevn 0;
BA_ "GenSigSendType" SG_ 368 FrntRdrDetn193RdrDetnPwr 0;
BA_ "GenSigStartValue" SG_ 368 FrntRdrDetn193RdrDetnRng 10050;
BA_ "GenSigSendType" SG_ 368 FrntRdrDetn193RdrDetnRng 0;
BA_ "GenSigStartValue" SG_ 368 FrntRdrDetn193RdrDetnRngV 4000;
BA_ "GenSigSendType" SG_ 368 FrntRdrDetn193RdrDetnRngV 0;
BA_ "GenSigStartValue" SG_ 368 FrntRdrDetn193RdrDetnSts 3;
BA_ "GenSigSendType" SG_ 368 FrntRdrDetn193RdrDetnSts 0;
BA_ "GenSigStartValue" SG_ 368 FrntRdrDetn194RdrDetnAzi 900;
BA_ "GenSigSendType" SG_ 368 FrntRdrDetn194RdrDetnAzi 0;
BA_ "GenSigSendType" SG_ 368 FrntRdrDetn194RdrDetnChks 0;
BA_ "GenSigFuncType" SG_ 368 FrntRdrDetn194RdrDetnChks 15;
BA_ "GenSigDataID" SG_ 368 FrntRdrDetn194RdrDetnChks "0x7C9";
BA_ "GenSigSendType" SG_ 368 FrntRdrDetn194RdrDetnCntr 0;
BA_ "GenSigFuncType" SG_ 368 FrntRdrDetn194RdrDetnCntr 16;
BA_ "GenSigSendType" SG_ 368 FrntRdrDetn194RdrDetnConf 0;
BA_ "GenSigStartValue" SG_ 368 FrntRdrDetn194RdrDetnElevn 15;
BA_ "GenSigSendType" SG_ 368 FrntRdrDetn194RdrDetnElevn 0;
BA_ "GenSigSendType" SG_ 368 FrntRdrDetn194RdrDetnPwr 0;
BA_ "GenSigStartValue" SG_ 368 FrntRdrDetn194RdrDetnRng 10050;
BA_ "GenSigSendType" SG_ 368 FrntRdrDetn194RdrDetnRng 0;
BA_ "GenSigStartValue" SG_ 368 FrntRdrDetn194RdrDetnRngV 4000;
BA_ "GenSigSendType" SG_ 368 FrntRdrDetn194RdrDetnRngV 0;
BA_ "GenSigStartValue" SG_ 368 FrntRdrDetn194RdrDetnSts 3;
BA_ "GenSigSendType" SG_ 368 FrntRdrDetn194RdrDetnSts 0;
BA_ "GenSigStartValue" SG_ 368 FrntRdrDetn195RdrDetnAzi 900;
BA_ "GenSigSendType" SG_ 368 FrntRdrDetn195RdrDetnAzi 0;
BA_ "GenSigSendType" SG_ 368 FrntRdrDetn195RdrDetnChks 0;
BA_ "GenSigFuncType" SG_ 368 FrntRdrDetn195RdrDetnChks 15;
BA_ "GenSigDataID" SG_ 368 FrntRdrDetn195RdrDetnChks "0x7CA";
BA_ "GenSigSendType" SG_ 368 FrntRdrDetn195RdrDetnCntr 0;
BA_ "GenSigFuncType" SG_ 368 FrntRdrDetn195RdrDetnCntr 16;
BA_ "GenSigSendType" SG_ 368 FrntRdrDetn195RdrDetnConf 0;
BA_ "GenSigStartValue" SG_ 368 FrntRdrDetn195RdrDetnElevn 15;
BA_ "GenSigSendType" SG_ 368 FrntRdrDetn195RdrDetnElevn 0;
BA_ "GenSigSendType" SG_ 368 FrntRdrDetn195RdrDetnPwr 0;
BA_ "GenSigStartValue" SG_ 368 FrntRdrDetn195RdrDetnRng 10050;
BA_ "GenSigSendType" SG_ 368 FrntRdrDetn195RdrDetnRng 0;
BA_ "GenSigStartValue" SG_ 368 FrntRdrDetn195RdrDetnRngV 4000;
BA_ "GenSigSendType" SG_ 368 FrntRdrDetn195RdrDetnRngV 0;
BA_ "GenSigStartValue" SG_ 368 FrntRdrDetn195RdrDetnSts 3;
BA_ "GenSigSendType" SG_ 368 FrntRdrDetn195RdrDetnSts 0;
BA_ "GenSigStartValue" SG_ 368 FrntRdrDetn196RdrDetnAzi 900;
BA_ "GenSigSendType" SG_ 368 FrntRdrDetn196RdrDetnAzi 0;
BA_ "GenSigSendType" SG_ 368 FrntRdrDetn196RdrDetnChks 0;
BA_ "GenSigFuncType" SG_ 368 FrntRdrDetn196RdrDetnChks 15;
BA_ "GenSigDataID" SG_ 368 FrntRdrDetn196RdrDetnChks "0x7CB";
BA_ "GenSigSendType" SG_ 368 FrntRdrDetn196RdrDetnCntr 0;
BA_ "GenSigFuncType" SG_ 368 FrntRdrDetn196RdrDetnCntr 16;
BA_ "GenSigSendType" SG_ 368 FrntRdrDetn196RdrDetnConf 0;
BA_ "GenSigStartValue" SG_ 368 FrntRdrDetn196RdrDetnElevn 15;
BA_ "GenSigSendType" SG_ 368 FrntRdrDetn196RdrDetnElevn 0;
BA_ "GenSigSendType" SG_ 368 FrntRdrDetn196RdrDetnPwr 0;
BA_ "GenSigStartValue" SG_ 368 FrntRdrDetn196RdrDetnRng 10050;
BA_ "GenSigSendType" SG_ 368 FrntRdrDetn196RdrDetnRng 0;
BA_ "GenSigStartValue" SG_ 368 FrntRdrDetn196RdrDetnRngV 4000;
BA_ "GenSigSendType" SG_ 368 FrntRdrDetn196RdrDetnRngV 0;
BA_ "GenSigStartValue" SG_ 368 FrntRdrDetn196RdrDetnSts 3;
BA_ "GenSigSendType" SG_ 368 FrntRdrDetn196RdrDetnSts 0;
BA_ "GenSigStartValue" SG_ 368 FrntRdrDetn197RdrDetnAzi 900;
BA_ "GenSigSendType" SG_ 368 FrntRdrDetn197RdrDetnAzi 0;
BA_ "GenSigSendType" SG_ 368 FrntRdrDetn197RdrDetnChks 0;
BA_ "GenSigFuncType" SG_ 368 FrntRdrDetn197RdrDetnChks 15;
BA_ "GenSigDataID" SG_ 368 FrntRdrDetn197RdrDetnChks "0x7CC";
BA_ "GenSigSendType" SG_ 368 FrntRdrDetn197RdrDetnCntr 0;
BA_ "GenSigFuncType" SG_ 368 FrntRdrDetn197RdrDetnCntr 16;
BA_ "GenSigSendType" SG_ 368 FrntRdrDetn197RdrDetnConf 0;
BA_ "GenSigStartValue" SG_ 368 FrntRdrDetn197RdrDetnElevn 15;
BA_ "GenSigSendType" SG_ 368 FrntRdrDetn197RdrDetnElevn 0;
BA_ "GenSigSendType" SG_ 368 FrntRdrDetn197RdrDetnPwr 0;
BA_ "GenSigStartValue" SG_ 368 FrntRdrDetn197RdrDetnRng 10050;
BA_ "GenSigSendType" SG_ 368 FrntRdrDetn197RdrDetnRng 0;
BA_ "GenSigStartValue" SG_ 368 FrntRdrDetn197RdrDetnRngV 4000;
BA_ "GenSigSendType" SG_ 368 FrntRdrDetn197RdrDetnRngV 0;
BA_ "GenSigStartValue" SG_ 368 FrntRdrDetn197RdrDetnSts 3;
BA_ "GenSigSendType" SG_ 368 FrntRdrDetn197RdrDetnSts 0;
BA_ "GenSigStartValue" SG_ 368 FrntRdrDetn198RdrDetnAzi 900;
BA_ "GenSigSendType" SG_ 368 FrntRdrDetn198RdrDetnAzi 0;
BA_ "GenSigSendType" SG_ 368 FrntRdrDetn198RdrDetnChks 0;
BA_ "GenSigFuncType" SG_ 368 FrntRdrDetn198RdrDetnChks 15;
BA_ "GenSigDataID" SG_ 368 FrntRdrDetn198RdrDetnChks "0x7CD";
BA_ "GenSigSendType" SG_ 368 FrntRdrDetn198RdrDetnCntr 0;
BA_ "GenSigFuncType" SG_ 368 FrntRdrDetn198RdrDetnCntr 16;
BA_ "GenSigSendType" SG_ 368 FrntRdrDetn198RdrDetnConf 0;
BA_ "GenSigStartValue" SG_ 368 FrntRdrDetn198RdrDetnElevn 15;
BA_ "GenSigSendType" SG_ 368 FrntRdrDetn198RdrDetnElevn 0;
BA_ "GenSigSendType" SG_ 368 FrntRdrDetn198RdrDetnPwr 0;
BA_ "GenSigStartValue" SG_ 368 FrntRdrDetn198RdrDetnRng 10050;
BA_ "GenSigSendType" SG_ 368 FrntRdrDetn198RdrDetnRng 0;
BA_ "GenSigStartValue" SG_ 368 FrntRdrDetn198RdrDetnRngV 4000;
BA_ "GenSigSendType" SG_ 368 FrntRdrDetn198RdrDetnRngV 0;
BA_ "GenSigStartValue" SG_ 368 FrntRdrDetn198RdrDetnSts 3;
BA_ "GenSigSendType" SG_ 368 FrntRdrDetn198RdrDetnSts 0;
// Frame: FLRSafetyCANFD2Frame34
BA_ "VFrameFormat" BO_ 370 14;
BA_ "GenMsgSendType" BO_ 370 0;
BA_ "GenMsgCycleTime" BO_ 370 50.000;
BA_ "GenSigStartValue" SG_ 370 FrntRdrDetn199RdrDetnAzi 900;
BA_ "GenSigSendType" SG_ 370 FrntRdrDetn199RdrDetnAzi 0;
BA_ "GenSigSendType" SG_ 370 FrntRdrDetn199RdrDetnChks 0;
BA_ "GenSigFuncType" SG_ 370 FrntRdrDetn199RdrDetnChks 15;
BA_ "GenSigDataID" SG_ 370 FrntRdrDetn199RdrDetnChks "0x7CE";
BA_ "GenSigSendType" SG_ 370 FrntRdrDetn199RdrDetnCntr 0;
BA_ "GenSigFuncType" SG_ 370 FrntRdrDetn199RdrDetnCntr 16;
BA_ "GenSigSendType" SG_ 370 FrntRdrDetn199RdrDetnConf 0;
BA_ "GenSigStartValue" SG_ 370 FrntRdrDetn199RdrDetnElevn 15;
BA_ "GenSigSendType" SG_ 370 FrntRdrDetn199RdrDetnElevn 0;
BA_ "GenSigSendType" SG_ 370 FrntRdrDetn199RdrDetnPwr 0;
BA_ "GenSigStartValue" SG_ 370 FrntRdrDetn199RdrDetnRng 10050;
BA_ "GenSigSendType" SG_ 370 FrntRdrDetn199RdrDetnRng 0;
BA_ "GenSigStartValue" SG_ 370 FrntRdrDetn199RdrDetnRngV 4000;
BA_ "GenSigSendType" SG_ 370 FrntRdrDetn199RdrDetnRngV 0;
BA_ "GenSigStartValue" SG_ 370 FrntRdrDetn199RdrDetnSts 3;
BA_ "GenSigSendType" SG_ 370 FrntRdrDetn199RdrDetnSts 0;
BA_ "GenSigStartValue" SG_ 370 FrntRdrDetn200RdrDetnAzi 900;
BA_ "GenSigSendType" SG_ 370 FrntRdrDetn200RdrDetnAzi 0;
BA_ "GenSigSendType" SG_ 370 FrntRdrDetn200RdrDetnChks 0;
BA_ "GenSigFuncType" SG_ 370 FrntRdrDetn200RdrDetnChks 15;
BA_ "GenSigDataID" SG_ 370 FrntRdrDetn200RdrDetnChks "0x7CF";
BA_ "GenSigSendType" SG_ 370 FrntRdrDetn200RdrDetnCntr 0;
BA_ "GenSigFuncType" SG_ 370 FrntRdrDetn200RdrDetnCntr 16;
BA_ "GenSigSendType" SG_ 370 FrntRdrDetn200RdrDetnConf 0;
BA_ "GenSigStartValue" SG_ 370 FrntRdrDetn200RdrDetnElevn 15;
BA_ "GenSigSendType" SG_ 370 FrntRdrDetn200RdrDetnElevn 0;
BA_ "GenSigSendType" SG_ 370 FrntRdrDetn200RdrDetnPwr 0;
BA_ "GenSigStartValue" SG_ 370 FrntRdrDetn200RdrDetnRng 10050;
BA_ "GenSigSendType" SG_ 370 FrntRdrDetn200RdrDetnRng 0;
BA_ "GenSigStartValue" SG_ 370 FrntRdrDetn200RdrDetnRngV 4000;
BA_ "GenSigSendType" SG_ 370 FrntRdrDetn200RdrDetnRngV 0;
BA_ "GenSigStartValue" SG_ 370 FrntRdrDetn200RdrDetnSts 3;
BA_ "GenSigSendType" SG_ 370 FrntRdrDetn200RdrDetnSts 0;
// Frame: FLRSafetyCANFD2Frame35
BA_ "VFrameFormat" BO_ 372 14;
BA_ "GenMsgSendType" BO_ 372 0;
BA_ "GenMsgCycleTime" BO_ 372 50.000;
BA_ "GenSigStartValue" SG_ 372 FrntRdrObj1Heading 1800;
BA_ "GenSigSendType" SG_ 372 FrntRdrObj1Heading 0;
BA_ "GenSigStartValue" SG_ 372 FrntRdrObj1ObjBoxCenterLat 250;
BA_ "GenSigSendType" SG_ 372 FrntRdrObj1ObjBoxCenterLat 0;
BA_ "GenSigStartValue" SG_ 372 FrntRdrObj1ObjBoxCenterLgt 250;
BA_ "GenSigSendType" SG_ 372 FrntRdrObj1ObjBoxCenterLgt 0;
BA_ "GenSigSendType" SG_ 372 FrntRdrObj1ObservationHist 0;
BA_ "GenSigSendType" SG_ 372 FrntRdrObj1RdrObjAx 0;
BA_ "GenSigSendType" SG_ 372 FrntRdrObj1RdrObjAy 0;
BA_ "GenSigSendType" SG_ 372 FrntRdrObj1RdrObjBoxLength 0;
BA_ "GenSigSendType" SG_ 372 FrntRdrObj1RdrObjBoxWidth 0;
BA_ "GenSigSendType" SG_ 372 FrntRdrObj1RdrObjChks 0;
BA_ "GenSigFuncType" SG_ 372 FrntRdrObj1RdrObjChks 15;
BA_ "GenSigDataID" SG_ 372 FrntRdrObj1RdrObjChks "0x7D0";
BA_ "GenSigSendType" SG_ 372 FrntRdrObj1RdrObjCntr 0;
BA_ "GenSigFuncType" SG_ 372 FrntRdrObj1RdrObjCntr 16;
BA_ "GenSigStartValue" SG_ 372 FrntRdrObj1RdrObjCoastCnt 31;
BA_ "GenSigSendType" SG_ 372 FrntRdrObj1RdrObjCoastCnt 0;
BA_ "GenSigSendType" SG_ 372 FrntRdrObj1RdrObjConf 0;
BA_ "GenSigSendType" SG_ 372 FrntRdrObj1RdrObjDx 0;
BA_ "GenSigSendType" SG_ 372 FrntRdrObj1RdrObjDxStdDe 0;
BA_ "GenSigStartValue" SG_ 372 FrntRdrObj1RdrObjDy 4000;
BA_ "GenSigSendType" SG_ 372 FrntRdrObj1RdrObjDy 0;
BA_ "GenSigSendType" SG_ 372 FrntRdrObj1RdrObjDyStdDe 0;
BA_ "GenSigSendType" SG_ 372 FrntRdrObj1RdrObjElevnConf 0;
BA_ "GenSigSendType" SG_ 372 FrntRdrObj1RdrObjElevnSts 0;
BA_ "GenSigSendType" SG_ 372 FrntRdrObj1RdrObjID 0;
BA_ "GenSigSendType" SG_ 372 FrntRdrObj1RdrObjIsInFreeSpace 0;
BA_ "GenSigSendType" SG_ 372 FrntRdrObj1RdrObjMirrProblty 0;
BA_ "GenSigSendType" SG_ 372 FrntRdrObj1RdrObjMtnPat 0;
BA_ "GenSigSendType" SG_ 372 FrntRdrObj1RdrObjNotRealProblty 0;
BA_ "GenSigSendType" SG_ 372 FrntRdrObj1RdrObjStatyCnt 0;
BA_ "GenSigSendType" SG_ 372 FrntRdrObj1RdrObjTiAlv 0;
BA_ "GenSigSendType" SG_ 372 FrntRdrObj1RdrObjTrackSts 0;
BA_ "GenSigSendType" SG_ 372 FrntRdrObj1RdrObjTyp 0;
BA_ "GenSigSendType" SG_ 372 FrntRdrObj1RdrObjTypConfBike 0;
BA_ "GenSigSendType" SG_ 372 FrntRdrObj1RdrObjTypConfPed 0;
BA_ "GenSigSendType" SG_ 372 FrntRdrObj1RdrObjTypConfVeh 0;
BA_ "GenSigStartValue" SG_ 372 FrntRdrObj1RdrObjVx 6400;
BA_ "GenSigSendType" SG_ 372 FrntRdrObj1RdrObjVx 0;
BA_ "GenSigSendType" SG_ 372 FrntRdrObj1RdrObjVxStdDe 0;
BA_ "GenSigStartValue" SG_ 372 FrntRdrObj1RdrObjVy 6400;
BA_ "GenSigSendType" SG_ 372 FrntRdrObj1RdrObjVy 0;
BA_ "GenSigSendType" SG_ 372 FrntRdrObj1RdrObjVyStdDe 0;
BA_ "GenSigStartValue" SG_ 372 FrntRdrObj1RelVx 1780;
BA_ "GenSigSendType" SG_ 372 FrntRdrObj1RelVx 0;
BA_ "GenSigStartValue" SG_ 372 FrntRdrObj1RelVy 1780;
BA_ "GenSigSendType" SG_ 372 FrntRdrObj1RelVy 0;
// Frame: FLRSafetyCANFD2Frame36
BA_ "VFrameFormat" BO_ 374 14;
BA_ "GenMsgSendType" BO_ 374 0;
BA_ "GenMsgCycleTime" BO_ 374 50.000;
BA_ "GenSigStartValue" SG_ 374 FrntRdrObj2Heading 1800;
BA_ "GenSigSendType" SG_ 374 FrntRdrObj2Heading 0;
BA_ "GenSigStartValue" SG_ 374 FrntRdrObj2ObjBoxCenterLat 250;
BA_ "GenSigSendType" SG_ 374 FrntRdrObj2ObjBoxCenterLat 0;
BA_ "GenSigStartValue" SG_ 374 FrntRdrObj2ObjBoxCenterLgt 250;
BA_ "GenSigSendType" SG_ 374 FrntRdrObj2ObjBoxCenterLgt 0;
BA_ "GenSigSendType" SG_ 374 FrntRdrObj2ObservationHist 0;
BA_ "GenSigSendType" SG_ 374 FrntRdrObj2RdrObjAx 0;
BA_ "GenSigSendType" SG_ 374 FrntRdrObj2RdrObjAy 0;
BA_ "GenSigSendType" SG_ 374 FrntRdrObj2RdrObjBoxLength 0;
BA_ "GenSigSendType" SG_ 374 FrntRdrObj2RdrObjBoxWidth 0;
BA_ "GenSigSendType" SG_ 374 FrntRdrObj2RdrObjChks 0;
BA_ "GenSigFuncType" SG_ 374 FrntRdrObj2RdrObjChks 15;
BA_ "GenSigDataID" SG_ 374 FrntRdrObj2RdrObjChks "0x7D1";
BA_ "GenSigSendType" SG_ 374 FrntRdrObj2RdrObjCntr 0;
BA_ "GenSigFuncType" SG_ 374 FrntRdrObj2RdrObjCntr 16;
BA_ "GenSigStartValue" SG_ 374 FrntRdrObj2RdrObjCoastCnt 31;
BA_ "GenSigSendType" SG_ 374 FrntRdrObj2RdrObjCoastCnt 0;
BA_ "GenSigSendType" SG_ 374 FrntRdrObj2RdrObjConf 0;
BA_ "GenSigSendType" SG_ 374 FrntRdrObj2RdrObjDx 0;
BA_ "GenSigSendType" SG_ 374 FrntRdrObj2RdrObjDxStdDe 0;
BA_ "GenSigStartValue" SG_ 374 FrntRdrObj2RdrObjDy 4000;
BA_ "GenSigSendType" SG_ 374 FrntRdrObj2RdrObjDy 0;
BA_ "GenSigSendType" SG_ 374 FrntRdrObj2RdrObjDyStdDe 0;
BA_ "GenSigSendType" SG_ 374 FrntRdrObj2RdrObjElevnConf 0;
BA_ "GenSigSendType" SG_ 374 FrntRdrObj2RdrObjElevnSts 0;
BA_ "GenSigSendType" SG_ 374 FrntRdrObj2RdrObjID 0;
BA_ "GenSigSendType" SG_ 374 FrntRdrObj2RdrObjIsInFreeSpace 0;
BA_ "GenSigSendType" SG_ 374 FrntRdrObj2RdrObjMirrProblty 0;
BA_ "GenSigSendType" SG_ 374 FrntRdrObj2RdrObjMtnPat 0;
BA_ "GenSigSendType" SG_ 374 FrntRdrObj2RdrObjNotRealProblty 0;
BA_ "GenSigSendType" SG_ 374 FrntRdrObj2RdrObjStatyCnt 0;
BA_ "GenSigSendType" SG_ 374 FrntRdrObj2RdrObjTiAlv 0;
BA_ "GenSigSendType" SG_ 374 FrntRdrObj2RdrObjTrackSts 0;
BA_ "GenSigSendType" SG_ 374 FrntRdrObj2RdrObjTyp 0;
BA_ "GenSigSendType" SG_ 374 FrntRdrObj2RdrObjTypConfBike 0;
BA_ "GenSigSendType" SG_ 374 FrntRdrObj2RdrObjTypConfPed 0;
BA_ "GenSigSendType" SG_ 374 FrntRdrObj2RdrObjTypConfVeh 0;
BA_ "GenSigStartValue" SG_ 374 FrntRdrObj2RdrObjVx 6400;
BA_ "GenSigSendType" SG_ 374 FrntRdrObj2RdrObjVx 0;
BA_ "GenSigSendType" SG_ 374 FrntRdrObj2RdrObjVxStdDe 0;
BA_ "GenSigStartValue" SG_ 374 FrntRdrObj2RdrObjVy 6400;
BA_ "GenSigSendType" SG_ 374 FrntRdrObj2RdrObjVy 0;
BA_ "GenSigSendType" SG_ 374 FrntRdrObj2RdrObjVyStdDe 0;
BA_ "GenSigStartValue" SG_ 374 FrntRdrObj2RelVx 1780;
BA_ "GenSigSendType" SG_ 374 FrntRdrObj2RelVx 0;
BA_ "GenSigStartValue" SG_ 374 FrntRdrObj2RelVy 1780;
BA_ "GenSigSendType" SG_ 374 FrntRdrObj2RelVy 0;
// Frame: FLRSafetyCANFD2Frame37
BA_ "VFrameFormat" BO_ 376 14;
BA_ "GenMsgSendType" BO_ 376 0;
BA_ "GenMsgCycleTime" BO_ 376 50.000;
BA_ "GenSigStartValue" SG_ 376 FrntRdrObj3Heading 1800;
BA_ "GenSigSendType" SG_ 376 FrntRdrObj3Heading 0;
BA_ "GenSigStartValue" SG_ 376 FrntRdrObj3ObjBoxCenterLat 250;
BA_ "GenSigSendType" SG_ 376 FrntRdrObj3ObjBoxCenterLat 0;
BA_ "GenSigStartValue" SG_ 376 FrntRdrObj3ObjBoxCenterLgt 250;
BA_ "GenSigSendType" SG_ 376 FrntRdrObj3ObjBoxCenterLgt 0;
BA_ "GenSigSendType" SG_ 376 FrntRdrObj3ObservationHist 0;
BA_ "GenSigSendType" SG_ 376 FrntRdrObj3RdrObjAx 0;
BA_ "GenSigSendType" SG_ 376 FrntRdrObj3RdrObjAy 0;
BA_ "GenSigSendType" SG_ 376 FrntRdrObj3RdrObjBoxLength 0;
BA_ "GenSigSendType" SG_ 376 FrntRdrObj3RdrObjBoxWidth 0;
BA_ "GenSigSendType" SG_ 376 FrntRdrObj3RdrObjChks 0;
BA_ "GenSigFuncType" SG_ 376 FrntRdrObj3RdrObjChks 15;
BA_ "GenSigDataID" SG_ 376 FrntRdrObj3RdrObjChks "0x7D2";
BA_ "GenSigSendType" SG_ 376 FrntRdrObj3RdrObjCntr 0;
BA_ "GenSigFuncType" SG_ 376 FrntRdrObj3RdrObjCntr 16;
BA_ "GenSigStartValue" SG_ 376 FrntRdrObj3RdrObjCoastCnt 31;
BA_ "GenSigSendType" SG_ 376 FrntRdrObj3RdrObjCoastCnt 0;
BA_ "GenSigSendType" SG_ 376 FrntRdrObj3RdrObjConf 0;
BA_ "GenSigSendType" SG_ 376 FrntRdrObj3RdrObjDx 0;
BA_ "GenSigSendType" SG_ 376 FrntRdrObj3RdrObjDxStdDe 0;
BA_ "GenSigStartValue" SG_ 376 FrntRdrObj3RdrObjDy 4000;
BA_ "GenSigSendType" SG_ 376 FrntRdrObj3RdrObjDy 0;
BA_ "GenSigSendType" SG_ 376 FrntRdrObj3RdrObjDyStdDe 0;
BA_ "GenSigSendType" SG_ 376 FrntRdrObj3RdrObjElevnConf 0;
BA_ "GenSigSendType" SG_ 376 FrntRdrObj3RdrObjElevnSts 0;
BA_ "GenSigSendType" SG_ 376 FrntRdrObj3RdrObjID 0;
BA_ "GenSigSendType" SG_ 376 FrntRdrObj3RdrObjIsInFreeSpace 0;
BA_ "GenSigSendType" SG_ 376 FrntRdrObj3RdrObjMirrProblty 0;
BA_ "GenSigSendType" SG_ 376 FrntRdrObj3RdrObjMtnPat 0;
BA_ "GenSigSendType" SG_ 376 FrntRdrObj3RdrObjNotRealProblty 0;
BA_ "GenSigSendType" SG_ 376 FrntRdrObj3RdrObjStatyCnt 0;
BA_ "GenSigSendType" SG_ 376 FrntRdrObj3RdrObjTiAlv 0;
BA_ "GenSigSendType" SG_ 376 FrntRdrObj3RdrObjTrackSts 0;
BA_ "GenSigSendType" SG_ 376 FrntRdrObj3RdrObjTyp 0;
BA_ "GenSigSendType" SG_ 376 FrntRdrObj3RdrObjTypConfBike 0;
BA_ "GenSigSendType" SG_ 376 FrntRdrObj3RdrObjTypConfPed 0;
BA_ "GenSigSendType" SG_ 376 FrntRdrObj3RdrObjTypConfVeh 0;
BA_ "GenSigStartValue" SG_ 376 FrntRdrObj3RdrObjVx 6400;
BA_ "GenSigSendType" SG_ 376 FrntRdrObj3RdrObjVx 0;
BA_ "GenSigSendType" SG_ 376 FrntRdrObj3RdrObjVxStdDe 0;
BA_ "GenSigStartValue" SG_ 376 FrntRdrObj3RdrObjVy 6400;
BA_ "GenSigSendType" SG_ 376 FrntRdrObj3RdrObjVy 0;
BA_ "GenSigSendType" SG_ 376 FrntRdrObj3RdrObjVyStdDe 0;
BA_ "GenSigStartValue" SG_ 376 FrntRdrObj3RelVx 1780;
BA_ "GenSigSendType" SG_ 376 FrntRdrObj3RelVx 0;
BA_ "GenSigStartValue" SG_ 376 FrntRdrObj3RelVy 1780;
BA_ "GenSigSendType" SG_ 376 FrntRdrObj3RelVy 0;
VAL_ 358 FrntRdrDetn163RdrDetnSts 0 "RdrDetnSts_Ukwn" 1 "RdrDetnSts_Movg" 2 "RdrDetnSts_Staty" 3 "RdrDetnSts_Invalid";
VAL_ 358 FrntRdrDetn164RdrDetnSts 0 "RdrDetnSts_Ukwn" 1 "RdrDetnSts_Movg" 2 "RdrDetnSts_Staty" 3 "RdrDetnSts_Invalid";
VAL_ 358 FrntRdrDetn165RdrDetnSts 0 "RdrDetnSts_Ukwn" 1 "RdrDetnSts_Movg" 2 "RdrDetnSts_Staty" 3 "RdrDetnSts_Invalid";
VAL_ 358 FrntRdrDetn166RdrDetnSts 0 "RdrDetnSts_Ukwn" 1 "RdrDetnSts_Movg" 2 "RdrDetnSts_Staty" 3 "RdrDetnSts_Invalid";
VAL_ 358 FrntRdrDetn167RdrDetnSts 0 "RdrDetnSts_Ukwn" 1 "RdrDetnSts_Movg" 2 "RdrDetnSts_Staty" 3 "RdrDetnSts_Invalid";
VAL_ 358 FrntRdrDetn168RdrDetnSts 0 "RdrDetnSts_Ukwn" 1 "RdrDetnSts_Movg" 2 "RdrDetnSts_Staty" 3 "RdrDetnSts_Invalid";
VAL_ 360 FrntRdrDetn169RdrDetnSts 0 "RdrDetnSts_Ukwn" 1 "RdrDetnSts_Movg" 2 "RdrDetnSts_Staty" 3 "RdrDetnSts_Invalid";
VAL_ 360 FrntRdrDetn170RdrDetnSts 0 "RdrDetnSts_Ukwn" 1 "RdrDetnSts_Movg" 2 "RdrDetnSts_Staty" 3 "RdrDetnSts_Invalid";
VAL_ 360 FrntRdrDetn171RdrDetnSts 0 "RdrDetnSts_Ukwn" 1 "RdrDetnSts_Movg" 2 "RdrDetnSts_Staty" 3 "RdrDetnSts_Invalid";
VAL_ 360 FrntRdrDetn172RdrDetnSts 0 "RdrDetnSts_Ukwn" 1 "RdrDetnSts_Movg" 2 "RdrDetnSts_Staty" 3 "RdrDetnSts_Invalid";
VAL_ 360 FrntRdrDetn173RdrDetnSts 0 "RdrDetnSts_Ukwn" 1 "RdrDetnSts_Movg" 2 "RdrDetnSts_Staty" 3 "RdrDetnSts_Invalid";
VAL_ 360 FrntRdrDetn174RdrDetnSts 0 "RdrDetnSts_Ukwn" 1 "RdrDetnSts_Movg" 2 "RdrDetnSts_Staty" 3 "RdrDetnSts_Invalid";
VAL_ 362 FrntRdrDetn175RdrDetnSts 0 "RdrDetnSts_Ukwn" 1 "RdrDetnSts_Movg" 2 "RdrDetnSts_Staty" 3 "RdrDetnSts_Invalid";
VAL_ 362 FrntRdrDetn176RdrDetnSts 0 "RdrDetnSts_Ukwn" 1 "RdrDetnSts_Movg" 2 "RdrDetnSts_Staty" 3 "RdrDetnSts_Invalid";
VAL_ 362 FrntRdrDetn177RdrDetnSts 0 "RdrDetnSts_Ukwn" 1 "RdrDetnSts_Movg" 2 "RdrDetnSts_Staty" 3 "RdrDetnSts_Invalid";
VAL_ 362 FrntRdrDetn178RdrDetnSts 0 "RdrDetnSts_Ukwn" 1 "RdrDetnSts_Movg" 2 "RdrDetnSts_Staty" 3 "RdrDetnSts_Invalid";
VAL_ 362 FrntRdrDetn179RdrDetnSts 0 "RdrDetnSts_Ukwn" 1 "RdrDetnSts_Movg" 2 "RdrDetnSts_Staty" 3 "RdrDetnSts_Invalid";
VAL_ 362 FrntRdrDetn180RdrDetnSts 0 "RdrDetnSts_Ukwn" 1 "RdrDetnSts_Movg" 2 "RdrDetnSts_Staty" 3 "RdrDetnSts_Invalid";
VAL_ 364 FrntRdrDetn181RdrDetnSts 0 "RdrDetnSts_Ukwn" 1 "RdrDetnSts_Movg" 2 "RdrDetnSts_Staty" 3 "RdrDetnSts_Invalid";
VAL_ 364 FrntRdrDetn182RdrDetnSts 0 "RdrDetnSts_Ukwn" 1 "RdrDetnSts_Movg" 2 "RdrDetnSts_Staty" 3 "RdrDetnSts_Invalid";
VAL_ 364 FrntRdrDetn183RdrDetnSts 0 "RdrDetnSts_Ukwn" 1 "RdrDetnSts_Movg" 2 "RdrDetnSts_Staty" 3 "RdrDetnSts_Invalid";
VAL_ 364 FrntRdrDetn184RdrDetnSts 0 "RdrDetnSts_Ukwn" 1 "RdrDetnSts_Movg" 2 "RdrDetnSts_Staty" 3 "RdrDetnSts_Invalid";
VAL_ 364 FrntRdrDetn185RdrDetnSts 0 "RdrDetnSts_Ukwn" 1 "RdrDetnSts_Movg" 2 "RdrDetnSts_Staty" 3 "RdrDetnSts_Invalid";
VAL_ 364 FrntRdrDetn186RdrDetnSts 0 "RdrDetnSts_Ukwn" 1 "RdrDetnSts_Movg" 2 "RdrDetnSts_Staty" 3 "RdrDetnSts_Invalid";
VAL_ 366 FrntRdrDetn187RdrDetnSts 0 "RdrDetnSts_Ukwn" 1 "RdrDetnSts_Movg" 2 "RdrDetnSts_Staty" 3 "RdrDetnSts_Invalid";
VAL_ 366 FrntRdrDetn188RdrDetnSts 0 "RdrDetnSts_Ukwn" 1 "RdrDetnSts_Movg" 2 "RdrDetnSts_Staty" 3 "RdrDetnSts_Invalid";
VAL_ 366 FrntRdrDetn189RdrDetnSts 0 "RdrDetnSts_Ukwn" 1 "RdrDetnSts_Movg" 2 "RdrDetnSts_Staty" 3 "RdrDetnSts_Invalid";
VAL_ 366 FrntRdrDetn190RdrDetnSts 0 "RdrDetnSts_Ukwn" 1 "RdrDetnSts_Movg" 2 "RdrDetnSts_Staty" 3 "RdrDetnSts_Invalid";
VAL_ 366 FrntRdrDetn191RdrDetnSts 0 "RdrDetnSts_Ukwn" 1 "RdrDetnSts_Movg" 2 "RdrDetnSts_Staty" 3 "RdrDetnSts_Invalid";
VAL_ 366 FrntRdrDetn192RdrDetnSts 0 "RdrDetnSts_Ukwn" 1 "RdrDetnSts_Movg" 2 "RdrDetnSts_Staty" 3 "RdrDetnSts_Invalid";
VAL_ 368 FrntRdrDetn193RdrDetnSts 0 "RdrDetnSts_Ukwn" 1 "RdrDetnSts_Movg" 2 "RdrDetnSts_Staty" 3 "RdrDetnSts_Invalid";
VAL_ 368 FrntRdrDetn194RdrDetnSts 0 "RdrDetnSts_Ukwn" 1 "RdrDetnSts_Movg" 2 "RdrDetnSts_Staty" 3 "RdrDetnSts_Invalid";
VAL_ 368 FrntRdrDetn195RdrDetnSts 0 "RdrDetnSts_Ukwn" 1 "RdrDetnSts_Movg" 2 "RdrDetnSts_Staty" 3 "RdrDetnSts_Invalid";
VAL_ 368 FrntRdrDetn196RdrDetnSts 0 "RdrDetnSts_Ukwn" 1 "RdrDetnSts_Movg" 2 "RdrDetnSts_Staty" 3 "RdrDetnSts_Invalid";
VAL_ 368 FrntRdrDetn197RdrDetnSts 0 "RdrDetnSts_Ukwn" 1 "RdrDetnSts_Movg" 2 "RdrDetnSts_Staty" 3 "RdrDetnSts_Invalid";
VAL_ 368 FrntRdrDetn198RdrDetnSts 0 "RdrDetnSts_Ukwn" 1 "RdrDetnSts_Movg" 2 "RdrDetnSts_Staty" 3 "RdrDetnSts_Invalid";
VAL_ 370 FrntRdrDetn199RdrDetnSts 0 "RdrDetnSts_Ukwn" 1 "RdrDetnSts_Movg" 2 "RdrDetnSts_Staty" 3 "RdrDetnSts_Invalid";
VAL_ 370 FrntRdrDetn200RdrDetnSts 0 "RdrDetnSts_Ukwn" 1 "RdrDetnSts_Movg" 2 "RdrDetnSts_Staty" 3 "RdrDetnSts_Invalid";
VAL_ 372 FrntRdrObj1RdrObjElevnSts 0 "RdrObjElevnSts_Unknown" 1 "RdrObjElevnSts_OverRidable" 2 "RdrObjElevnSts_Rlv" 3 "RdrObjElevnSts_UnderRidable";
VAL_ 372 FrntRdrObj1RdrObjIsInFreeSpace 0 "YesNo2_No" 1 "YesNo2_Yes";
VAL_ 372 FrntRdrObj1RdrObjMtnPat 0 "RdrObjMtnPat_Ukwn" 1 "RdrObjMtnPat_Staty" 2 "RdrObjMtnPat_StatyFromMovg" 3 "RdrObjMtnPat_Movg" 4 "RdrObjMtnPat_Receding" 5 "RdrObjMtnPat_Oncoming" 6 "RdrObjMtnPat_CrossingFromLe" 7 "RdrObjMtnPat_CrossingFromRi";
VAL_ 372 FrntRdrObj1RdrObjTrackSts 0 "RdrObjTrackSts_Invld" 1 "RdrObjTrackSts_Updated" 2 "RdrObjTrackSts_New" 3 "RdrObjTrackSts_Coasted";
VAL_ 372 FrntRdrObj1RdrObjTyp 0 "RdrObjTyp_Ukwn" 1 "RdrObjTyp_Car" 2 "RdrObjTyp_MotorCycle" 3 "RdrObjTyp_Truck" 4 "RdrObjTyp_Ped" 5 "RdrObjTyp_ObstdVert1" 6 "RdrObjTyp_ObstdVert2" 7 "RdrObjTyp_Anim" 8 "RdrObjTyp_ObjGen" 9 "RdrObjTyp_Bicycle" 10 "RdrObjTyp_VehofUkwnClass" 11 "RdrObjTyp_Reserved";
VAL_ 374 FrntRdrObj2RdrObjElevnSts 0 "RdrObjElevnSts_Unknown" 1 "RdrObjElevnSts_OverRidable" 2 "RdrObjElevnSts_Rlv" 3 "RdrObjElevnSts_UnderRidable";
VAL_ 374 FrntRdrObj2RdrObjIsInFreeSpace 0 "YesNo2_No" 1 "YesNo2_Yes";
VAL_ 374 FrntRdrObj2RdrObjMtnPat 0 "RdrObjMtnPat_Ukwn" 1 "RdrObjMtnPat_Staty" 2 "RdrObjMtnPat_StatyFromMovg" 3 "RdrObjMtnPat_Movg" 4 "RdrObjMtnPat_Receding" 5 "RdrObjMtnPat_Oncoming" 6 "RdrObjMtnPat_CrossingFromLe" 7 "RdrObjMtnPat_CrossingFromRi";
VAL_ 374 FrntRdrObj2RdrObjTrackSts 0 "RdrObjTrackSts_Invld" 1 "RdrObjTrackSts_Updated" 2 "RdrObjTrackSts_New" 3 "RdrObjTrackSts_Coasted";
VAL_ 374 FrntRdrObj2RdrObjTyp 0 "RdrObjTyp_Ukwn" 1 "RdrObjTyp_Car" 2 "RdrObjTyp_MotorCycle" 3 "RdrObjTyp_Truck" 4 "RdrObjTyp_Ped" 5 "RdrObjTyp_ObstdVert1" 6 "RdrObjTyp_ObstdVert2" 7 "RdrObjTyp_Anim" 8 "RdrObjTyp_ObjGen" 9 "RdrObjTyp_Bicycle" 10 "RdrObjTyp_VehofUkwnClass" 11 "RdrObjTyp_Reserved";
VAL_ 376 FrntRdrObj3RdrObjElevnSts 0 "RdrObjElevnSts_Unknown" 1 "RdrObjElevnSts_OverRidable" 2 "RdrObjElevnSts_Rlv" 3 "RdrObjElevnSts_UnderRidable";
VAL_ 376 FrntRdrObj3RdrObjIsInFreeSpace 0 "YesNo2_No" 1 "YesNo2_Yes";
VAL_ 376 FrntRdrObj3RdrObjMtnPat 0 "RdrObjMtnPat_Ukwn" 1 "RdrObjMtnPat_Staty" 2 "RdrObjMtnPat_StatyFromMovg" 3 "RdrObjMtnPat_Movg" 4 "RdrObjMtnPat_Receding" 5 "RdrObjMtnPat_Oncoming" 6 "RdrObjMtnPat_CrossingFromLe" 7 "RdrObjMtnPat_CrossingFromRi";
VAL_ 376 FrntRdrObj3RdrObjTrackSts 0 "RdrObjTrackSts_Invld" 1 "RdrObjTrackSts_Updated" 2 "RdrObjTrackSts_New" 3 "RdrObjTrackSts_Coasted";
VAL_ 376 FrntRdrObj3RdrObjTyp 0 "RdrObjTyp_Ukwn" 1 "RdrObjTyp_Car" 2 "RdrObjTyp_MotorCycle" 3 "RdrObjTyp_Truck" 4 "RdrObjTyp_Ped" 5 "RdrObjTyp_ObstdVert1" 6 "RdrObjTyp_ObstdVert2" 7 "RdrObjTyp_Anim" 8 "RdrObjTyp_ObjGen" 9 "RdrObjTyp_Bicycle" 10 "RdrObjTyp_VehofUkwnClass" 11 "RdrObjTyp_Reserved";
SIG_GROUP_ 358 FrntRdrDetn163 1 : FrntRdrDetn163RdrDetnAzi FrntRdrDetn163RdrDetnChks FrntRdrDetn163RdrDetnCntr FrntRdrDetn163RdrDetnConf FrntRdrDetn163RdrDetnElevn FrntRdrDetn163RdrDetnPwr FrntRdrDetn163RdrDetnRng FrntRdrDetn163RdrDetnRngV FrntRdrDetn163RdrDetnSts;
SIG_GROUP_ 358 FrntRdrDetn164 1 : FrntRdrDetn164RdrDetnAzi FrntRdrDetn164RdrDetnChks FrntRdrDetn164RdrDetnCntr FrntRdrDetn164RdrDetnConf FrntRdrDetn164RdrDetnElevn FrntRdrDetn164RdrDetnPwr FrntRdrDetn164RdrDetnRng FrntRdrDetn164RdrDetnRngV FrntRdrDetn164RdrDetnSts;
SIG_GROUP_ 358 FrntRdrDetn165 1 : FrntRdrDetn165RdrDetnAzi FrntRdrDetn165RdrDetnChks FrntRdrDetn165RdrDetnCntr FrntRdrDetn165RdrDetnConf FrntRdrDetn165RdrDetnElevn FrntRdrDetn165RdrDetnPwr FrntRdrDetn165RdrDetnRng FrntRdrDetn165RdrDetnRngV FrntRdrDetn165RdrDetnSts;
SIG_GROUP_ 358 FrntRdrDetn166 1 : FrntRdrDetn166RdrDetnAzi FrntRdrDetn166RdrDetnChks FrntRdrDetn166RdrDetnCntr FrntRdrDetn166RdrDetnConf FrntRdrDetn166RdrDetnElevn FrntRdrDetn166RdrDetnPwr FrntRdrDetn166RdrDetnRng FrntRdrDetn166RdrDetnRngV FrntRdrDetn166RdrDetnSts;
SIG_GROUP_ 358 FrntRdrDetn167 1 : FrntRdrDetn167RdrDetnAzi FrntRdrDetn167RdrDetnChks FrntRdrDetn167RdrDetnCntr FrntRdrDetn167RdrDetnConf FrntRdrDetn167RdrDetnElevn FrntRdrDetn167RdrDetnPwr FrntRdrDetn167RdrDetnRng FrntRdrDetn167RdrDetnRngV FrntRdrDetn167RdrDetnSts;
SIG_GROUP_ 358 FrntRdrDetn168 1 : FrntRdrDetn168RdrDetnAzi FrntRdrDetn168RdrDetnChks FrntRdrDetn168RdrDetnCntr FrntRdrDetn168RdrDetnConf FrntRdrDetn168RdrDetnElevn FrntRdrDetn168RdrDetnPwr FrntRdrDetn168RdrDetnRng FrntRdrDetn168RdrDetnRngV FrntRdrDetn168RdrDetnSts;
SIG_GROUP_ 360 FrntRdrDetn169 1 : FrntRdrDetn169RdrDetnAzi FrntRdrDetn169RdrDetnChks FrntRdrDetn169RdrDetnCntr FrntRdrDetn169RdrDetnConf FrntRdrDetn169RdrDetnElevn FrntRdrDetn169RdrDetnPwr FrntRdrDetn169RdrDetnRng FrntRdrDetn169RdrDetnRngV FrntRdrDetn169RdrDetnSts;
SIG_GROUP_ 360 FrntRdrDetn170 1 : FrntRdrDetn170RdrDetnAzi FrntRdrDetn170RdrDetnChks FrntRdrDetn170RdrDetnCntr FrntRdrDetn170RdrDetnConf FrntRdrDetn170RdrDetnElevn FrntRdrDetn170RdrDetnPwr FrntRdrDetn170RdrDetnRng FrntRdrDetn170RdrDetnRngV FrntRdrDetn170RdrDetnSts;
SIG_GROUP_ 360 FrntRdrDetn171 1 : FrntRdrDetn171RdrDetnAzi FrntRdrDetn171RdrDetnChks FrntRdrDetn171RdrDetnCntr FrntRdrDetn171RdrDetnConf FrntRdrDetn171RdrDetnElevn FrntRdrDetn171RdrDetnPwr FrntRdrDetn171RdrDetnRng FrntRdrDetn171RdrDetnRngV FrntRdrDetn171RdrDetnSts;
SIG_GROUP_ 360 FrntRdrDetn172 1 : FrntRdrDetn172RdrDetnAzi FrntRdrDetn172RdrDetnChks FrntRdrDetn172RdrDetnCntr FrntRdrDetn172RdrDetnConf FrntRdrDetn172RdrDetnElevn FrntRdrDetn172RdrDetnPwr FrntRdrDetn172RdrDetnRng FrntRdrDetn172RdrDetnRngV FrntRdrDetn172RdrDetnSts;
SIG_GROUP_ 360 FrntRdrDetn173 1 : FrntRdrDetn173RdrDetnAzi FrntRdrDetn173RdrDetnChks FrntRdrDetn173RdrDetnCntr FrntRdrDetn173RdrDetnConf FrntRdrDetn173RdrDetnElevn FrntRdrDetn173RdrDetnPwr FrntRdrDetn173RdrDetnRng FrntRdrDetn173RdrDetnRngV FrntRdrDetn173RdrDetnSts;
SIG_GROUP_ 360 FrntRdrDetn174 1 : FrntRdrDetn174RdrDetnAzi FrntRdrDetn174RdrDetnChks FrntRdrDetn174RdrDetnCntr FrntRdrDetn174RdrDetnConf FrntRdrDetn174RdrDetnElevn FrntRdrDetn174RdrDetnPwr FrntRdrDetn174RdrDetnRng FrntRdrDetn174RdrDetnRngV FrntRdrDetn174RdrDetnSts;
SIG_GROUP_ 362 FrntRdrDetn175 1 : FrntRdrDetn175RdrDetnAzi FrntRdrDetn175RdrDetnChks FrntRdrDetn175RdrDetnCntr FrntRdrDetn175RdrDetnConf FrntRdrDetn175RdrDetnElevn FrntRdrDetn175RdrDetnPwr FrntRdrDetn175RdrDetnRng FrntRdrDetn175RdrDetnRngV FrntRdrDetn175RdrDetnSts;
SIG_GROUP_ 362 FrntRdrDetn176 1 : FrntRdrDetn176RdrDetnAzi FrntRdrDetn176RdrDetnChks FrntRdrDetn176RdrDetnCntr FrntRdrDetn176RdrDetnConf FrntRdrDetn176RdrDetnElevn FrntRdrDetn176RdrDetnPwr FrntRdrDetn176RdrDetnRng FrntRdrDetn176RdrDetnRngV FrntRdrDetn176RdrDetnSts;
SIG_GROUP_ 362 FrntRdrDetn177 1 : FrntRdrDetn177RdrDetnAzi FrntRdrDetn177RdrDetnChks FrntRdrDetn177RdrDetnCntr FrntRdrDetn177RdrDetnConf FrntRdrDetn177RdrDetnElevn FrntRdrDetn177RdrDetnPwr FrntRdrDetn177RdrDetnRng FrntRdrDetn177RdrDetnRngV FrntRdrDetn177RdrDetnSts;
SIG_GROUP_ 362 FrntRdrDetn178 1 : FrntRdrDetn178RdrDetnAzi FrntRdrDetn178RdrDetnChks FrntRdrDetn178RdrDetnCntr FrntRdrDetn178RdrDetnConf FrntRdrDetn178RdrDetnElevn FrntRdrDetn178RdrDetnPwr FrntRdrDetn178RdrDetnRng FrntRdrDetn178RdrDetnRngV FrntRdrDetn178RdrDetnSts;
SIG_GROUP_ 362 FrntRdrDetn179 1 : FrntRdrDetn179RdrDetnAzi FrntRdrDetn179RdrDetnChks FrntRdrDetn179RdrDetnCntr FrntRdrDetn179RdrDetnConf FrntRdrDetn179RdrDetnElevn FrntRdrDetn179RdrDetnPwr FrntRdrDetn179RdrDetnRng FrntRdrDetn179RdrDetnRngV FrntRdrDetn179RdrDetnSts;
SIG_GROUP_ 362 FrntRdrDetn180 1 : FrntRdrDetn180RdrDetnAzi FrntRdrDetn180RdrDetnChks FrntRdrDetn180RdrDetnCntr FrntRdrDetn180RdrDetnConf FrntRdrDetn180RdrDetnElevn FrntRdrDetn180RdrDetnPwr FrntRdrDetn180RdrDetnRng FrntRdrDetn180RdrDetnRngV FrntRdrDetn180RdrDetnSts;
SIG_GROUP_ 364 FrntRdrDetn181 1 : FrntRdrDetn181RdrDetnAzi FrntRdrDetn181RdrDetnChks FrntRdrDetn181RdrDetnCntr FrntRdrDetn181RdrDetnConf FrntRdrDetn181RdrDetnElevn FrntRdrDetn181RdrDetnPwr FrntRdrDetn181RdrDetnRng FrntRdrDetn181RdrDetnRngV FrntRdrDetn181RdrDetnSts;
SIG_GROUP_ 364 FrntRdrDetn182 1 : FrntRdrDetn182RdrDetnAzi FrntRdrDetn182RdrDetnChks FrntRdrDetn182RdrDetnCntr FrntRdrDetn182RdrDetnConf FrntRdrDetn182RdrDetnElevn FrntRdrDetn182RdrDetnPwr FrntRdrDetn182RdrDetnRng FrntRdrDetn182RdrDetnRngV FrntRdrDetn182RdrDetnSts;
SIG_GROUP_ 364 FrntRdrDetn183 1 : FrntRdrDetn183RdrDetnAzi FrntRdrDetn183RdrDetnChks FrntRdrDetn183RdrDetnCntr FrntRdrDetn183RdrDetnConf FrntRdrDetn183RdrDetnElevn FrntRdrDetn183RdrDetnPwr FrntRdrDetn183RdrDetnRng FrntRdrDetn183RdrDetnRngV FrntRdrDetn183RdrDetnSts;
SIG_GROUP_ 364 FrntRdrDetn184 1 : FrntRdrDetn184RdrDetnAzi FrntRdrDetn184RdrDetnChks FrntRdrDetn184RdrDetnCntr FrntRdrDetn184RdrDetnConf FrntRdrDetn184RdrDetnElevn FrntRdrDetn184RdrDetnPwr FrntRdrDetn184RdrDetnRng FrntRdrDetn184RdrDetnRngV FrntRdrDetn184RdrDetnSts;
SIG_GROUP_ 364 FrntRdrDetn185 1 : FrntRdrDetn185RdrDetnAzi FrntRdrDetn185RdrDetnChks FrntRdrDetn185RdrDetnCntr FrntRdrDetn185RdrDetnConf FrntRdrDetn185RdrDetnElevn FrntRdrDetn185RdrDetnPwr FrntRdrDetn185RdrDetnRng FrntRdrDetn185RdrDetnRngV FrntRdrDetn185RdrDetnSts;
SIG_GROUP_ 364 FrntRdrDetn186 1 : FrntRdrDetn186RdrDetnAzi FrntRdrDetn186RdrDetnChks FrntRdrDetn186RdrDetnCntr FrntRdrDetn186RdrDetnConf FrntRdrDetn186RdrDetnElevn FrntRdrDetn186RdrDetnPwr FrntRdrDetn186RdrDetnRng FrntRdrDetn186RdrDetnRngV FrntRdrDetn186RdrDetnSts;
SIG_GROUP_ 366 FrntRdrDetn187 1 : FrntRdrDetn187RdrDetnAzi FrntRdrDetn187RdrDetnChks FrntRdrDetn187RdrDetnCntr FrntRdrDetn187RdrDetnConf FrntRdrDetn187RdrDetnElevn FrntRdrDetn187RdrDetnPwr FrntRdrDetn187RdrDetnRng FrntRdrDetn187RdrDetnRngV FrntRdrDetn187RdrDetnSts;
SIG_GROUP_ 366 FrntRdrDetn188 1 : FrntRdrDetn188RdrDetnAzi FrntRdrDetn188RdrDetnChks FrntRdrDetn188RdrDetnCntr FrntRdrDetn188RdrDetnConf FrntRdrDetn188RdrDetnElevn FrntRdrDetn188RdrDetnPwr FrntRdrDetn188RdrDetnRng FrntRdrDetn188RdrDetnRngV FrntRdrDetn188RdrDetnSts;
SIG_GROUP_ 366 FrntRdrDetn189 1 : FrntRdrDetn189RdrDetnAzi FrntRdrDetn189RdrDetnChks FrntRdrDetn189RdrDetnCntr FrntRdrDetn189RdrDetnConf FrntRdrDetn189RdrDetnElevn FrntRdrDetn189RdrDetnPwr FrntRdrDetn189RdrDetnRng FrntRdrDetn189RdrDetnRngV FrntRdrDetn189RdrDetnSts;
SIG_GROUP_ 366 FrntRdrDetn190 1 : FrntRdrDetn190RdrDetnAzi FrntRdrDetn190RdrDetnChks FrntRdrDetn190RdrDetnCntr FrntRdrDetn190RdrDetnConf FrntRdrDetn190RdrDetnElevn FrntRdrDetn190RdrDetnPwr FrntRdrDetn190RdrDetnRng FrntRdrDetn190RdrDetnRngV FrntRdrDetn190RdrDetnSts;
SIG_GROUP_ 366 FrntRdrDetn191 1 : FrntRdrDetn191RdrDetnAzi FrntRdrDetn191RdrDetnChks FrntRdrDetn191RdrDetnCntr FrntRdrDetn191RdrDetnConf FrntRdrDetn191RdrDetnElevn FrntRdrDetn191RdrDetnPwr FrntRdrDetn191RdrDetnRng FrntRdrDetn191RdrDetnRngV FrntRdrDetn191RdrDetnSts;
SIG_GROUP_ 366 FrntRdrDetn192 1 : FrntRdrDetn192RdrDetnAzi FrntRdrDetn192RdrDetnChks FrntRdrDetn192RdrDetnCntr FrntRdrDetn192RdrDetnConf FrntRdrDetn192RdrDetnElevn FrntRdrDetn192RdrDetnPwr FrntRdrDetn192RdrDetnRng FrntRdrDetn192RdrDetnRngV FrntRdrDetn192RdrDetnSts;
SIG_GROUP_ 368 FrntRdrDetn193 1 : FrntRdrDetn193RdrDetnAzi FrntRdrDetn193RdrDetnChks FrntRdrDetn193RdrDetnCntr FrntRdrDetn193RdrDetnConf FrntRdrDetn193RdrDetnElevn FrntRdrDetn193RdrDetnPwr FrntRdrDetn193RdrDetnRng FrntRdrDetn193RdrDetnRngV FrntRdrDetn193RdrDetnSts;
SIG_GROUP_ 368 FrntRdrDetn194 1 : FrntRdrDetn194RdrDetnAzi FrntRdrDetn194RdrDetnChks FrntRdrDetn194RdrDetnCntr FrntRdrDetn194RdrDetnConf FrntRdrDetn194RdrDetnElevn FrntRdrDetn194RdrDetnPwr FrntRdrDetn194RdrDetnRng FrntRdrDetn194RdrDetnRngV FrntRdrDetn194RdrDetnSts;
SIG_GROUP_ 368 FrntRdrDetn195 1 : FrntRdrDetn195RdrDetnAzi FrntRdrDetn195RdrDetnChks FrntRdrDetn195RdrDetnCntr FrntRdrDetn195RdrDetnConf FrntRdrDetn195RdrDetnElevn FrntRdrDetn195RdrDetnPwr FrntRdrDetn195RdrDetnRng FrntRdrDetn195RdrDetnRngV FrntRdrDetn195RdrDetnSts;
SIG_GROUP_ 368 FrntRdrDetn196 1 : FrntRdrDetn196RdrDetnAzi FrntRdrDetn196RdrDetnChks FrntRdrDetn196RdrDetnCntr FrntRdrDetn196RdrDetnConf FrntRdrDetn196RdrDetnElevn FrntRdrDetn196RdrDetnPwr FrntRdrDetn196RdrDetnRng FrntRdrDetn196RdrDetnRngV FrntRdrDetn196RdrDetnSts;
SIG_GROUP_ 368 FrntRdrDetn197 1 : FrntRdrDetn197RdrDetnAzi FrntRdrDetn197RdrDetnChks FrntRdrDetn197RdrDetnCntr FrntRdrDetn197RdrDetnConf FrntRdrDetn197RdrDetnElevn FrntRdrDetn197RdrDetnPwr FrntRdrDetn197RdrDetnRng FrntRdrDetn197RdrDetnRngV FrntRdrDetn197RdrDetnSts;
SIG_GROUP_ 368 FrntRdrDetn198 1 : FrntRdrDetn198RdrDetnAzi FrntRdrDetn198RdrDetnChks FrntRdrDetn198RdrDetnCntr FrntRdrDetn198RdrDetnConf FrntRdrDetn198RdrDetnElevn FrntRdrDetn198RdrDetnPwr FrntRdrDetn198RdrDetnRng FrntRdrDetn198RdrDetnRngV FrntRdrDetn198RdrDetnSts;
SIG_GROUP_ 370 FrntRdrDetn199 1 : FrntRdrDetn199RdrDetnAzi FrntRdrDetn199RdrDetnChks FrntRdrDetn199RdrDetnCntr FrntRdrDetn199RdrDetnConf FrntRdrDetn199RdrDetnElevn FrntRdrDetn199RdrDetnPwr FrntRdrDetn199RdrDetnRng FrntRdrDetn199RdrDetnRngV FrntRdrDetn199RdrDetnSts;
SIG_GROUP_ 370 FrntRdrDetn200 1 : FrntRdrDetn200RdrDetnAzi FrntRdrDetn200RdrDetnChks FrntRdrDetn200RdrDetnCntr FrntRdrDetn200RdrDetnConf FrntRdrDetn200RdrDetnElevn FrntRdrDetn200RdrDetnPwr FrntRdrDetn200RdrDetnRng FrntRdrDetn200RdrDetnRngV FrntRdrDetn200RdrDetnSts;
SIG_GROUP_ 372 FrntRdrObj1 1 : FrntRdrObj1Heading FrntRdrObj1ObjBoxCenterLat FrntRdrObj1ObjBoxCenterLgt FrntRdrObj1ObservationHist FrntRdrObj1RdrObjAx FrntRdrObj1RdrObjAy FrntRdrObj1RdrObjBoxLength FrntRdrObj1RdrObjBoxWidth FrntRdrObj1RdrObjChks FrntRdrObj1RdrObjCntr FrntRdrObj1RdrObjCoastCnt FrntRdrObj1RdrObjConf FrntRdrObj1RdrObjDx FrntRdrObj1RdrObjDxStdDe FrntRdrObj1RdrObjDy FrntRdrObj1RdrObjDyStdDe FrntRdrObj1RdrObjElevnConf FrntRdrObj1RdrObjElevnSts FrntRdrObj1RdrObjID FrntRdrObj1RdrObjIsInFreeSpace FrntRdrObj1RdrObjMirrProblty FrntRdrObj1RdrObjMtnPat FrntRdrObj1RdrObjNotRealProblty FrntRdrObj1RdrObjStatyCnt FrntRdrObj1RdrObjTiAlv FrntRdrObj1RdrObjTrackSts FrntRdrObj1RdrObjTyp FrntRdrObj1RdrObjTypConfBike FrntRdrObj1RdrObjTypConfPed FrntRdrObj1RdrObjTypConfVeh FrntRdrObj1RdrObjVx FrntRdrObj1RdrObjVxStdDe FrntRdrObj1RdrObjVy FrntRdrObj1RdrObjVyStdDe FrntRdrObj1RelVx FrntRdrObj1RelVy;
SIG_GROUP_ 374 FrntRdrObj2 1 : FrntRdrObj2Heading FrntRdrObj2ObjBoxCenterLat FrntRdrObj2ObjBoxCenterLgt FrntRdrObj2ObservationHist FrntRdrObj2RdrObjAx FrntRdrObj2RdrObjAy FrntRdrObj2RdrObjBoxLength FrntRdrObj2RdrObjBoxWidth FrntRdrObj2RdrObjChks FrntRdrObj2RdrObjCntr FrntRdrObj2RdrObjCoastCnt FrntRdrObj2RdrObjConf FrntRdrObj2RdrObjDx FrntRdrObj2RdrObjDxStdDe FrntRdrObj2RdrObjDy FrntRdrObj2RdrObjDyStdDe FrntRdrObj2RdrObjElevnConf FrntRdrObj2RdrObjElevnSts FrntRdrObj2RdrObjID FrntRdrObj2RdrObjIsInFreeSpace FrntRdrObj2RdrObjMirrProblty FrntRdrObj2RdrObjMtnPat FrntRdrObj2RdrObjNotRealProblty FrntRdrObj2RdrObjStatyCnt FrntRdrObj2RdrObjTiAlv FrntRdrObj2RdrObjTrackSts FrntRdrObj2RdrObjTyp FrntRdrObj2RdrObjTypConfBike FrntRdrObj2RdrObjTypConfPed FrntRdrObj2RdrObjTypConfVeh FrntRdrObj2RdrObjVx FrntRdrObj2RdrObjVxStdDe FrntRdrObj2RdrObjVy FrntRdrObj2RdrObjVyStdDe FrntRdrObj2RelVx FrntRdrObj2RelVy;
SIG_GROUP_ 376 FrntRdrObj3 1 : FrntRdrObj3Heading FrntRdrObj3ObjBoxCenterLat FrntRdrObj3ObjBoxCenterLgt FrntRdrObj3ObservationHist FrntRdrObj3RdrObjAx FrntRdrObj3RdrObjAy FrntRdrObj3RdrObjBoxLength FrntRdrObj3RdrObjBoxWidth FrntRdrObj3RdrObjChks FrntRdrObj3RdrObjCntr FrntRdrObj3RdrObjCoastCnt FrntRdrObj3RdrObjConf FrntRdrObj3RdrObjDx FrntRdrObj3RdrObjDxStdDe FrntRdrObj3RdrObjDy FrntRdrObj3RdrObjDyStdDe FrntRdrObj3RdrObjElevnConf FrntRdrObj3RdrObjElevnSts FrntRdrObj3RdrObjID FrntRdrObj3RdrObjIsInFreeSpace FrntRdrObj3RdrObjMirrProblty FrntRdrObj3RdrObjMtnPat FrntRdrObj3RdrObjNotRealProblty FrntRdrObj3RdrObjStatyCnt FrntRdrObj3RdrObjTiAlv FrntRdrObj3RdrObjTrackSts FrntRdrObj3RdrObjTyp FrntRdrObj3RdrObjTypConfBike FrntRdrObj3RdrObjTypConfPed FrntRdrObj3RdrObjTypConfVeh FrntRdrObj3RdrObjVx FrntRdrObj3RdrObjVxStdDe FrntRdrObj3RdrObjVy FrntRdrObj3RdrObjVyStdDe FrntRdrObj3RelVx FrntRdrObj3RelVy;
