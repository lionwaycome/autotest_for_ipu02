/* generated by ASAP2 Updater - ASAP2 Tool-Set Version 13.0.20 */ ASAP2_VERSION 1 71
/begin PROJECT IPU02 ""
/begin MODULE CPP ""
/begin MOD_PAR "" /end MOD_PAR
/begin MOD_COMMON "" BYTE_ORDER MSB_LAST ALIGNMENT_BYTE 1 ALIGNMENT_WORD 2 ALIGNMENT_LONG 4 ALIGNMENT_FLOAT16_IEEE 2 ALIGNMENT_FLOAT32_IEEE 4 ALIGNMENT_FLOAT64_IEEE 8 ALIGNMENT_INT64 8 /end MOD_COMMON
/begin IF_DATA XCP
 /begin PROTOCOL_LAYER 0x0100 0x07D0 0x2710 0x00 0x00 0x00 0x00 0x00 0x40 0x40 BYTE_ORDER_MSB_LAST ADDRESS_GRANULARITY_BYTE OPTIONAL_CMD ALLOC_ODT_ENTRY OPTIONAL_CMD ALLOC_ODT OPTIONAL_CMD ALLOC_DAQ OPTIONAL_CMD FREE_DAQ OPTIONAL_CMD GET_DAQ_RESOLUTION_INFO OPTIONAL_CMD GET_DAQ_PROCESSOR_INFO OPTIONAL_CMD GET_DAQ_CLOCK OPTIONAL_CMD START_STOP_SYNCH OPTIONAL_CMD START_STOP_DAQ_LIST OPTIONAL_CMD GET_DAQ_LIST_MODE OPTIONAL_CMD SET_DAQ_LIST_MODE OPTIONAL_CMD WRITE_DAQ OPTIONAL_CMD SET_DAQ_PTR OPTIONAL_CMD CLEAR_DAQ_LIST OPTIONAL_CMD UPLOAD OPTIONAL_CMD SET_MTA OPTIONAL_CMD GET_ID OPTIONAL_CMD GET_COMM_MODE_INFO COMMUNICATION_MODE_SUPPORTED BLOCK MASTER 0x05 0x00 /end PROTOCOL_LAYER
 /begin DAQ DYNAMIC 0x00 0x03 0x00 OPTIMISATION_TYPE_DEFAULT ADDRESS_EXTENSION_FREE IDENTIFICATION_FIELD_TYPE_ABSOLUTE GRANULARITY_ODT_ENTRY_SIZE_DAQ_BYTE 0x3F OVERLOAD_INDICATION_PID PRESCALER_SUPPORTED /begin EVENT "DAQ10MS" "DAQ10MS" 0x01 DAQ 0x00 0x01 0x07 0x00 /end EVENT /begin EVENT "DAQ20MS" "DAQ20MS" 0x02 DAQ 0x00 0x02 0x07 0x00 /end EVENT /begin EVENT "DAQ50MS" "DAQ50MS" 0x03 DAQ 0x00 0x05 0x07 0x00 /end EVENT /end DAQ
 /begin PAG 0x00 /end PAG
 /begin PGM PGM_MODE_ABSOLUTE 0x00 0x00 /end PGM
 /begin XCP_ON_CAN 0x0100 CAN_ID_MASTER 0x400005F0 CAN_ID_SLAVE 0x400005F1 BAUDRATE 0x07A120 SAMPLE_POINT 0x4B SAMPLE_RATE SINGLE BTL_CYCLES 0x08 SJW 0x02 SYNC_EDGE SINGLE MAX_DLC_REQUIRED /end XCP_ON_CAN
/end IF_DATA
/begin MEASUREMENT APAHandShakeStatus "" UBYTE NO_COMPU_METHOD 0 0 0 255 ECU_ADDRESS 0xA552A163 FORMAT "%.15" /end MEASUREMENT
/begin MEASUREMENT APA_Interrupt_status "" UBYTE NO_COMPU_METHOD 0 0 0 255 ECU_ADDRESS 0xA552A168 FORMAT "%.15" /end MEASUREMENT
/begin MEASUREMENT APP_APA_RESPONSE_Socto30_T_Local.apaParkMode "" UWORD NO_COMPU_METHOD 0 0 0 65535 ECU_ADDRESS 0xA5529838 FORMAT "%.15" /end MEASUREMENT
/begin MEASUREMENT APP_APA_RESPONSE_Socto30_T_Local.apaStatusResp "" UWORD NO_COMPU_METHOD 0 0 0 65535 ECU_ADDRESS 0xA552983E FORMAT "%.15" /end MEASUREMENT
/begin MEASUREMENT APSModuleCurrentStatus_Match_ALG "" SBYTE APSModuleCurrentStatus_Match_ALG.CONVERSION 0 0 -128 127 ECU_ADDRESS 0xA53254A2 FORMAT "%.15" /end MEASUREMENT
/begin MEASUREMENT APSReversibleInterruptSts "" UBYTE NO_COMPU_METHOD 0 0 0 255 ECU_ADDRESS 0xA552A16F FORMAT "%.15" /end MEASUREMENT
/begin MEASUREMENT APSSysIRReversibleInterruptSts "" UBYTE NO_COMPU_METHOD 0 0 0 255 ECU_ADDRESS 0xA552A171 FORMAT "%.15" /end MEASUREMENT
/begin MEASUREMENT APS_HK_success_flag "" UBYTE NO_COMPU_METHOD 0 0 0 255 ECU_ADDRESS 0xA552A196 FORMAT "%.15" /end MEASUREMENT
/begin MEASUREMENT ApaInteractiveSignal_13_T_Local.APAInterruptSelection "" UBYTE NO_COMPU_METHOD 0 0 0 255 ECU_ADDRESS 0xA552B5F2 FORMAT "%.15" /end MEASUREMENT
/begin MEASUREMENT ApaInteractiveSignal_13_T_Local.APAParkSubFuncType "" UBYTE NO_COMPU_METHOD 0 0 0 255 ECU_ADDRESS 0xA552B5F1 FORMAT "%.15" /end MEASUREMENT
/begin MEASUREMENT ApaInteractiveSignal_13_T_Local.APAParkTypeInOrOut "" UBYTE NO_COMPU_METHOD 0 0 0 255 ECU_ADDRESS 0xA552B5EF FORMAT "%.15" /end MEASUREMENT
/begin MEASUREMENT ApaInteractiveSignal_13_T_Local.APAPrkgTypAutBtn "" UBYTE NO_COMPU_METHOD 0 0 0 255 ECU_ADDRESS 0xA552B5EE FORMAT "%.15" /end MEASUREMENT
/begin MEASUREMENT ApaInteractiveSignal_13_T_Local.APASoftKeyStatus "" UBYTE NO_COMPU_METHOD 0 0 0 255 ECU_ADDRESS 0xA552B5F0 FORMAT "%.15" /end MEASUREMENT
/begin MEASUREMENT AppRpaResponse_Socto30_T_Local.RPP_ilabel "" ULONG NO_COMPU_METHOD 0 0 0 4294967295 ECU_ADDRESS 0xA552B244 FORMAT "%.15" /end MEASUREMENT
/begin MEASUREMENT HPAModuleCurrentStatus_Match_ALG "" SBYTE HPAModuleCurrentStatus_Match_ALG.CONVERSION 0 0 -128 127 ECU_ADDRESS 0xA5529788 FORMAT "%.15" /end MEASUREMENT
/begin MEASUREMENT HPP_APP_HPP_RESPONSE_Socto30_T.hppLocationStatus "" UWORD NO_COMPU_METHOD 0 0 0 65535 ECU_ADDRESS 0xA5529AA4 FORMAT "%.15" /end MEASUREMENT
/begin MEASUREMENT HPP_APP_HPP_RESPONSE_Socto30_T.hppRemoteActiveReq "" UWORD NO_COMPU_METHOD 0 0 0 65535 ECU_ADDRESS 0xA5529AAA FORMAT "%.15" /end MEASUREMENT
/begin MEASUREMENT HPP_APP_HPP_RESPONSE_Socto30_T.hppRemoteConnectReq "" UWORD NO_COMPU_METHOD 0 0 0 65535 ECU_ADDRESS 0xA5529AA6 FORMAT "%.15" /end MEASUREMENT
/begin MEASUREMENT HPP_APP_HPP_RESPONSE_Socto30_T.hppSystemStatusResp "" UWORD NO_COMPU_METHOD 0 0 0 65535 ECU_ADDRESS 0xA5529A96 FORMAT "%.15" /end MEASUREMENT
/begin MEASUREMENT MAP_APP_APA_RESPONSE_Socto30_T.apaParkMode "" UWORD NO_COMPU_METHOD 0 0 0 65535 ECU_ADDRESS 0xA5529904 FORMAT "%.15" /end MEASUREMENT
/begin MEASUREMENT MAP_APP_APA_RESPONSE_Socto30_T.apaParkOutMode "" UWORD NO_COMPU_METHOD 0 0 0 65535 ECU_ADDRESS 0xA5529908 FORMAT "%.15" /end MEASUREMENT
/begin MEASUREMENT MAP_APP_APA_RESPONSE_Socto30_T.apaTargetSlot.apaSlotA_x "" SWORD NO_COMPU_METHOD 0 0 -32768 32767 ECU_ADDRESS 0xA5529914 FORMAT "%.15" /end MEASUREMENT
/begin MEASUREMENT MAP_APP_APA_RESPONSE_Socto30_T.apaTargetSlot.apaSlotA_y "" SWORD NO_COMPU_METHOD 0 0 -32768 32767 ECU_ADDRESS 0xA5529916 FORMAT "%.15" /end MEASUREMENT
/begin MEASUREMENT MAP_APP_APA_RESPONSE_Socto30_T.apaTargetSlot.apaSlotB_x "" SWORD NO_COMPU_METHOD 0 0 -32768 32767 ECU_ADDRESS 0xA5529918 FORMAT "%.15" /end MEASUREMENT
/begin MEASUREMENT MAP_APP_APA_RESPONSE_Socto30_T.apaTargetSlot.apaSlotB_y "" SWORD NO_COMPU_METHOD 0 0 -32768 32767 ECU_ADDRESS 0xA552991A FORMAT "%.15" /end MEASUREMENT
/begin MEASUREMENT MAP_APP_APA_RESPONSE_Socto30_T.apaTargetSlot.apaSlotC_x "" SWORD NO_COMPU_METHOD 0 0 -32768 32767 ECU_ADDRESS 0xA552991C FORMAT "%.15" /end MEASUREMENT
/begin MEASUREMENT MAP_APP_APA_RESPONSE_Socto30_T.apaTargetSlot.apaSlotC_y "" SWORD NO_COMPU_METHOD 0 0 -32768 32767 ECU_ADDRESS 0xA552991E FORMAT "%.15" /end MEASUREMENT
/begin MEASUREMENT MAP_APP_APA_RESPONSE_Socto30_T.apaTargetSlot.apaSlotD_x "" SWORD NO_COMPU_METHOD 0 0 -32768 32767 ECU_ADDRESS 0xA5529920 FORMAT "%.15" /end MEASUREMENT
/begin MEASUREMENT MAP_APP_APA_RESPONSE_Socto30_T.apaTargetSlot.apaSlotD_y "" SWORD NO_COMPU_METHOD 0 0 -32768 32767 ECU_ADDRESS 0xA5529922 FORMAT "%.15" /end MEASUREMENT
/begin MEASUREMENT MCU_APA_REQUEST_30toSoc_T_Local.apaParkMode "" UWORD NO_COMPU_METHOD 0 0 0 65535 ECU_ADDRESS 0xA552A4A0 FORMAT "%.15" /end MEASUREMENT
/begin MEASUREMENT MCU_APA_REQUEST_30toSoc_T_Local.apaParkModeReq "" UWORD NO_COMPU_METHOD 0 0 0 65535 ECU_ADDRESS 0xA552A4B0 FORMAT "%.15" /end MEASUREMENT
/begin MEASUREMENT MCU_APA_REQUEST_30toSoc_T_Local.apaParkOutMode "" UWORD NO_COMPU_METHOD 0 0 0 65535 ECU_ADDRESS 0xA552A4A4 FORMAT "%.15" /end MEASUREMENT
/begin MEASUREMENT MCU_APA_REQUEST_30toSoc_T_Local.apaSlotInfoReq "" UWORD NO_COMPU_METHOD 0 0 0 65535 ECU_ADDRESS 0xA552A4AC FORMAT "%.15" /end MEASUREMENT
/begin MEASUREMENT MCU_APA_REQUEST_30toSoc_T_Local.apaStatusReq "" UWORD NO_COMPU_METHOD 0 0 0 65535 ECU_ADDRESS 0xA552A4AE FORMAT "%.15" /end MEASUREMENT
/begin MEASUREMENT ParkOutFlag "" UBYTE NO_COMPU_METHOD 0 0 0 255 ECU_ADDRESS 0xA552A189 FORMAT "%.15" /end MEASUREMENT
/begin MEASUREMENT ParkingFunctionSelectMode "" UBYTE NO_COMPU_METHOD 0 0 0 255 ECU_ADDRESS 0xA5529766 FORMAT "%.15" /end MEASUREMENT
/begin MEASUREMENT Pas4APAToDataHandle_T_APA.APAHKStatus "" UBYTE NO_COMPU_METHOD 0 0 0 255 ECU_ADDRESS 0xA552AE48 FORMAT "%.15" /end MEASUREMENT
/begin MEASUREMENT Pas4APAToDataHandle_T_APA.APA_AbortReason "" UBYTE NO_COMPU_METHOD 0 0 0 255 ECU_ADDRESS 0xA552AE4C FORMAT "%.15" /end MEASUREMENT
/begin MEASUREMENT Pas4APAToDataHandle_T_APA.APA_EntryFailReason "" UBYTE NO_COMPU_METHOD 0 0 0 255 ECU_ADDRESS 0xA552AE4A FORMAT "%.15" /end MEASUREMENT
/begin MEASUREMENT Pas4APAToDataHandle_T_APA.APA_RecomResp "" UBYTE NO_COMPU_METHOD 0 0 0 255 ECU_ADDRESS 0xA552AE50 FORMAT "%.15" /end MEASUREMENT
/begin MEASUREMENT Pas4APAToDataHandle_T_APA.CTR_PrkgGearAssiReq "" UBYTE NO_COMPU_METHOD 0 0 0 255 ECU_ADDRESS 0xA552AE5D FORMAT "%.15" /end MEASUREMENT
/begin MEASUREMENT Pas4APAToDataHandle_T_APA.CTR_PrkgStandstillReq "" UBYTE NO_COMPU_METHOD 0 0 0 255 ECU_ADDRESS 0xA552AE63 FORMAT "%.15" /end MEASUREMENT
/begin MEASUREMENT Pas4APAToDataHandle_T_DATA.APAHKStatus "" UBYTE NO_COMPU_METHOD 0 0 0 255 ECU_ADDRESS 0xA552AE84 FORMAT "%.15" /end MEASUREMENT
/begin MEASUREMENT Pas4ControlSignal_31_T_DATA.CTR_PrkgAccAssiReq "" FLOAT32_IEEE NO_COMPU_METHOD 0 0 -3.40282346639E+38 3.40282346639E+38 ECU_ADDRESS 0xA552AFD4 FORMAT "%.15" /end MEASUREMENT
/begin MEASUREMENT Pas4ControlSignal_31_T_DATA.CTR_PrkgAssiPinionAngleReq "" FLOAT32_IEEE NO_COMPU_METHOD 0 0 -3.40282346639E+38 3.40282346639E+38 ECU_ADDRESS 0xA552AFC8 FORMAT "%.15" /end MEASUREMENT
/begin MEASUREMENT Pas4ControlSignal_31_T_DATA.CTR_PrkgBrkFctModReq "" UBYTE NO_COMPU_METHOD 0 0 0 255 ECU_ADDRESS 0xA552AFDC FORMAT "%.15" /end MEASUREMENT
/begin MEASUREMENT Pas4ControlSignal_31_T_DATA.CTR_PrkgCtrlHandShakeReq "" UBYTE NO_COMPU_METHOD 0 0 0 255 ECU_ADDRESS 0xA552AFCC FORMAT "%.15" /end MEASUREMENT
/begin MEASUREMENT Pas4ControlSignal_31_T_DATA.CTR_PrkgDriverOffReq "" UBYTE NO_COMPU_METHOD 0 0 0 255 ECU_ADDRESS 0xA552AFF1 FORMAT "%.15" /end MEASUREMENT
/begin MEASUREMENT Pas4ControlSignal_31_T_DATA.CTR_PrkgGearAssiReq "" UBYTE NO_COMPU_METHOD 0 0 0 255 ECU_ADDRESS 0xA552AFD0 FORMAT "%.15" /end MEASUREMENT
/begin MEASUREMENT Pas4ControlSignal_31_T_DATA.CTR_PrkgStandstillReq "" UBYTE NO_COMPU_METHOD 0 0 0 255 ECU_ADDRESS 0xA552AFF3 FORMAT "%.15" /end MEASUREMENT
/begin MEASUREMENT Pas4ControlSignal_31_T_DATA.CTR_PrkgStopDistance "" UBYTE NO_COMPU_METHOD 0 0 0 255 ECU_ADDRESS 0xA552AFF2 FORMAT "%.15" /end MEASUREMENT
/begin MEASUREMENT Pas4ControlSignal_31_T_DATA.CTR_Prkg_ESCVLCModeReq "" UBYTE NO_COMPU_METHOD 0 0 0 255 ECU_ADDRESS 0xA552AFCE FORMAT "%.15" /end MEASUREMENT
/begin MEASUREMENT Pas4HppToDataHandle_T_DATA.HPPHKStatus "" UBYTE NO_COMPU_METHOD 0 0 0 255 ECU_ADDRESS 0xA552AC26 FORMAT "%.15" /end MEASUREMENT
/begin MEASUREMENT Pas4RPAToDataHandle_T_DATA.RPAHKStatus "" UBYTE NO_COMPU_METHOD 0 0 0 255 ECU_ADDRESS 0xA552ACFC FORMAT "%.15" /end MEASUREMENT
/begin MEASUREMENT Pas4RPAToDataHandle_T_RPA.APA_AbortReason "" UBYTE NO_COMPU_METHOD 0 0 0 255 ECU_ADDRESS 0xA552AD42 FORMAT "%.15" /end MEASUREMENT
/begin MEASUREMENT Pas4RPAToDataHandle_T_RPA.APA_EntryFailReason "" UBYTE NO_COMPU_METHOD 0 0 0 255 ECU_ADDRESS 0xA552AD41 FORMAT "%.15" /end MEASUREMENT
/begin MEASUREMENT Pas4RPAToDataHandle_T_RPA.APA_ParkTips "" UBYTE NO_COMPU_METHOD 0 0 0 255 ECU_ADDRESS 0xA552AD43 FORMAT "%.15" /end MEASUREMENT
/begin MEASUREMENT Pas4RPAToDataHandle_T_RPA.RPA_EnableSts "" UBYTE NO_COMPU_METHOD 0 0 0 255 ECU_ADDRESS 0xA552AD54 FORMAT "%.15" /end MEASUREMENT
/begin MEASUREMENT Pas4RPAToDataHandle_T_RPA.RPA_MobDevTips "" UBYTE NO_COMPU_METHOD 0 0 0 255 ECU_ADDRESS 0xA552AD48 FORMAT "%.15" /end MEASUREMENT
/begin MEASUREMENT RPAModuleCurrentStatus "" UBYTE NO_COMPU_METHOD 0 0 0 255 ECU_ADDRESS 0xA552ABEA FORMAT "%.15" /end MEASUREMENT
/begin MEASUREMENT RPAReversibleInterruptSts "" UBYTE NO_COMPU_METHOD 0 0 0 255 ECU_ADDRESS 0xA552ABE7 FORMAT "%.15" /end MEASUREMENT
/begin MEASUREMENT RPASysIRReversibleInterruptSts "" UBYTE NO_COMPU_METHOD 0 0 0 255 ECU_ADDRESS 0xA552ABE9 FORMAT "%.15" /end MEASUREMENT
/begin MEASUREMENT RPAVehControlType "" UBYTE NO_COMPU_METHOD 0 0 0 255 ECU_ADDRESS 0xA552ABE5 FORMAT "%.15" /end MEASUREMENT
/begin MEASUREMENT RPPFuncActive "" UBYTE NO_COMPU_METHOD 0 0 0 255 ECU_ADDRESS 0xA552ABE0 FORMAT "%.15" /end MEASUREMENT
/begin MEASUREMENT RpaInteractiveSignal_13_T_Local.RPAControlMode "" UBYTE NO_COMPU_METHOD 0 0 0 255 ECU_ADDRESS 0xA552B370 FORMAT "%.15" /end MEASUREMENT
/begin MEASUREMENT RpaInteractiveSignal_13_T_Local.RPAFuncEnableReq "" UBYTE NO_COMPU_METHOD 0 0 0 255 ECU_ADDRESS 0xA552B372 FORMAT "%.15" /end MEASUREMENT
/begin MEASUREMENT RpaInteractiveSignal_13_T_Local.RPPFuncStartReq "" UBYTE NO_COMPU_METHOD 0 0 0 255 ECU_ADDRESS 0xA552B37A FORMAT "%.15" /end MEASUREMENT
/begin MEASUREMENT Rte_CpApHPPSignalMap_PpALG_Factor1_In_PiHppALG_Factor1_In "" FLOAT32_IEEE NO_COMPU_METHOD 0 0 -3.40282346639E+38 3.40282346639E+38 ECU_ADDRESS 0xA532513C FORMAT "%.15" /end MEASUREMENT
/begin MEASUREMENT Rte_CpApHPPSignalMap_PpALG_Factor2_In_PiHppALG_Factor2_In "" FLOAT32_IEEE NO_COMPU_METHOD 0 0 -3.40282346639E+38 3.40282346639E+38 ECU_ADDRESS 0xA5325140 FORMAT "%.15" /end MEASUREMENT
/begin MEASUREMENT Rte_CpApHPPSignalMap_PpALG_Factor3_In_PiHppALG_Factor3_In "" FLOAT32_IEEE NO_COMPU_METHOD 0 0 -3.40282346639E+38 3.40282346639E+38 ECU_ADDRESS 0xA5325144 FORMAT "%.15" /end MEASUREMENT
/begin MEASUREMENT Rte_CpApHPPSignalMap_PpAPA_ParkBehaviorType_PiHppAPA_ParkBehaviorType "" UBYTE NO_COMPU_METHOD 0 0 0 255 ECU_ADDRESS 0xA53254D5 FORMAT "%.15" /end MEASUREMENT
/begin MEASUREMENT Rte_CpApHPPSignalMap_PpAPA_ParkDirectionInfoType_PiHppAPA_ParkDirectionInfoType "" UBYTE NO_COMPU_METHOD 0 0 0 255 ECU_ADDRESS 0xA53254D6 FORMAT "%.15" /end MEASUREMENT
/begin MEASUREMENT Rte_CpApHPPSignalMap_PpAPA_ParkFunctionType_PiHppAPA_ParkFunctionType "" UBYTE NO_COMPU_METHOD 0 0 0 255 ECU_ADDRESS 0xA53254D7 FORMAT "%.15" /end MEASUREMENT
/begin MEASUREMENT Rte_CpApHPPSignalMap_PpAPA_ParkPlaceInfoType_PiHppAPA_ParkPlaceInfoType "" UBYTE NO_COMPU_METHOD 0 0 0 255 ECU_ADDRESS 0xA53254D8 FORMAT "%.15" /end MEASUREMENT
/begin MEASUREMENT Rte_CpApHPPSignalMap_PpAPA_ParkPlaceX1_PiHppAPA_ParkPlaceX1 "" SLONG NO_COMPU_METHOD 0 0 -2147483648 2147483647 ECU_ADDRESS 0xA5325148 FORMAT "%.15" /end MEASUREMENT
/begin MEASUREMENT Rte_CpApHPPSignalMap_PpAPA_ParkPlaceX2_PiHppAPA_ParkPlaceX2 "" SLONG NO_COMPU_METHOD 0 0 -2147483648 2147483647 ECU_ADDRESS 0xA532514C FORMAT "%.15" /end MEASUREMENT
/begin MEASUREMENT Rte_CpApHPPSignalMap_PpAPA_ParkPlaceX3_PiHppAPA_ParkPlaceX3 "" SLONG NO_COMPU_METHOD 0 0 -2147483648 2147483647 ECU_ADDRESS 0xA5325150 FORMAT "%.15" /end MEASUREMENT
/begin MEASUREMENT Rte_CpApHPPSignalMap_PpAPA_ParkPlaceX4_PiHppAPA_ParkPlaceX4 "" SLONG NO_COMPU_METHOD 0 0 -2147483648 2147483647 ECU_ADDRESS 0xA5325154 FORMAT "%.15" /end MEASUREMENT
/begin MEASUREMENT Rte_CpApHPPSignalMap_PpAPA_ParkPlaceY1_PiHppAPA_ParkPlaceY1 "" SLONG NO_COMPU_METHOD 0 0 -2147483648 2147483647 ECU_ADDRESS 0xA5325158 FORMAT "%.15" /end MEASUREMENT
/begin MEASUREMENT Rte_CpApHPPSignalMap_PpAPA_ParkPlaceY2_PiHppAPA_ParkPlaceY2 "" SLONG NO_COMPU_METHOD 0 0 -2147483648 2147483647 ECU_ADDRESS 0xA532515C FORMAT "%.15" /end MEASUREMENT
/begin MEASUREMENT Rte_CpApHPPSignalMap_PpAPA_ParkPlaceY3_PiHppAPA_ParkPlaceY3 "" SLONG NO_COMPU_METHOD 0 0 -2147483648 2147483647 ECU_ADDRESS 0xA5325160 FORMAT "%.15" /end MEASUREMENT
/begin MEASUREMENT Rte_CpApHPPSignalMap_PpAPA_ParkPlaceY4_PiHppAPA_ParkPlaceY4 "" SLONG NO_COMPU_METHOD 0 0 -2147483648 2147483647 ECU_ADDRESS 0xA5325164 FORMAT "%.15" /end MEASUREMENT
/begin MEASUREMENT Rte_CpApHPPSignalMap_PpAPA_ParkSlotType_PiHppAPA_ParkSlotType "" UBYTE NO_COMPU_METHOD 0 0 0 255 ECU_ADDRESS 0xA53254D9 FORMAT "%.15" /end MEASUREMENT
/begin MEASUREMENT Rte_CpApHPPSignalMap_PpAPA_ParkSlot_Side_PiHppAPA_ParkSlot_Side "" UBYTE NO_COMPU_METHOD 0 0 0 255 ECU_ADDRESS 0xA53254DA FORMAT "%.15" /end MEASUREMENT
/begin MEASUREMENT Rte_CpApHPPSignalMap_PpAPA_ParkType_PiHppAPA_ParkType "" UBYTE NO_COMPU_METHOD 0 0 0 255 ECU_ADDRESS 0xA53254DB FORMAT "%.15" /end MEASUREMENT
/begin MEASUREMENT Rte_CpApHPPSignalMap_PpAPA_Relocation_Theta_PiHppAPA_Relocation_Theta "" FLOAT32_IEEE NO_COMPU_METHOD 0 0 -3.40282346639E+38 3.40282346639E+38 ECU_ADDRESS 0xA5325168 FORMAT "%.15" /end MEASUREMENT
/begin MEASUREMENT Rte_CpApHPPSignalMap_PpAPA_Relocation_X_PiHppAPA_Relocation_X "" FLOAT32_IEEE NO_COMPU_METHOD 0 0 -3.40282346639E+38 3.40282346639E+38 ECU_ADDRESS 0xA532516C FORMAT "%.15" /end MEASUREMENT
/begin MEASUREMENT Rte_CpApHPPSignalMap_PpAPA_Relocation_Y_PiHppAPA_Relocation_Y "" FLOAT32_IEEE NO_COMPU_METHOD 0 0 -3.40282346639E+38 3.40282346639E+38 ECU_ADDRESS 0xA5325170 FORMAT "%.15" /end MEASUREMENT
/begin MEASUREMENT Rte_CpApHPPSignalMap_PpAVM_APA_Slot_Depth_PiHppAVM_APA_Slot_Depth "" SLONG NO_COMPU_METHOD 0 0 -2147483648 2147483647 ECU_ADDRESS 0xA5325174 FORMAT "%.15" /end MEASUREMENT
/begin MEASUREMENT Rte_CpApHPPSignalMap_PpAVM_EMapFSInfo_SlotUpdatePtB_Flag_PiHppAVM_EMapFSInfo_SlotUpdatePtB_Flag "" UBYTE NO_COMPU_METHOD 0 0 0 255 ECU_ADDRESS 0xA53254DC FORMAT "%.15" /end MEASUREMENT
/begin MEASUREMENT Rte_CpApHPPSignalMap_PpAVM_EMapFSInfo_SlotUpdatePtC_Flag_PiHppAVM_EMapFSInfo_SlotUpdatePtC_Flag "" UBYTE NO_COMPU_METHOD 0 0 0 255 ECU_ADDRESS 0xA53254DD FORMAT "%.15" /end MEASUREMENT
/begin MEASUREMENT Rte_CpApHPPSignalMap_PpAVM_EMapFSInfo_SlotUpdate_Bx_PiHppAVM_EMapFSInfo_SlotUpdate_Bx "" SWORD NO_COMPU_METHOD 0 0 -2147483648 2147483647 ECU_ADDRESS 0xA5324F12 FORMAT "%.15" /end MEASUREMENT
/begin MEASUREMENT Rte_CpApHPPSignalMap_PpAVM_EMapFSInfo_SlotUpdate_By_PiHppAVM_EMapFSInfo_SlotUpdate_By "" SWORD NO_COMPU_METHOD 0 0 -2147483648 2147483647 ECU_ADDRESS 0xA5324FA2 FORMAT "%.15" /end MEASUREMENT
/begin MEASUREMENT Rte_CpApHPPSignalMap_PpAVM_EMapFSInfo_SlotUpdate_Cx_PiHppAVM_EMapFSInfo_SlotUpdate_Cx "" SWORD NO_COMPU_METHOD 0 0 -2147483648 2147483647 ECU_ADDRESS 0xA5325468 FORMAT "%.15" /end MEASUREMENT
/begin MEASUREMENT Rte_CpApHPPSignalMap_PpAVM_EMapFSInfo_SlotUpdate_Cy_PiHppAVM_EMapFSInfo_SlotUpdate_Cy "" SWORD NO_COMPU_METHOD 0 0 -2147483648 2147483647 ECU_ADDRESS 0xA532546A FORMAT "%.15" /end MEASUREMENT
/begin MEASUREMENT Rte_CpApHPPSignalMap_PpAVM_Relocation_D_Valid_PiHppAVM_Relocation_D_Valid "" FLOAT32_IEEE NO_COMPU_METHOD 0 0 -3.40282346639E+38 3.40282346639E+38 ECU_ADDRESS 0xA5325178 FORMAT "%.15" /end MEASUREMENT
/begin MEASUREMENT Rte_CpApHPPSignalMap_PpAVM_Relocation_Dis_D_PiHppAVM_Relocation_Dis_D "" FLOAT32_IEEE NO_COMPU_METHOD 0 0 -3.40282346639E+38 3.40282346639E+38 ECU_ADDRESS 0xA532517C FORMAT "%.15" /end MEASUREMENT
/begin MEASUREMENT Rte_CpApHPPSignalMap_PpAVM_Relocation_Dis_L_PiHppAVM_Relocation_Dis_L "" FLOAT32_IEEE NO_COMPU_METHOD 0 0 -3.40282346639E+38 3.40282346639E+38 ECU_ADDRESS 0xA5325180 FORMAT "%.15" /end MEASUREMENT
/begin MEASUREMENT Rte_CpApHPPSignalMap_PpAVM_Relocation_Dis_R_PiHppAVM_Relocation_Dis_R "" FLOAT32_IEEE NO_COMPU_METHOD 0 0 -3.40282346639E+38 3.40282346639E+38 ECU_ADDRESS 0xA5325184 FORMAT "%.15" /end MEASUREMENT
/begin MEASUREMENT Rte_CpApHPPSignalMap_PpAVM_Relocation_Dis_T_PiHppAVM_Relocation_Dis_T "" FLOAT32_IEEE NO_COMPU_METHOD 0 0 -3.40282346639E+38 3.40282346639E+38 ECU_ADDRESS 0xA5325188 FORMAT "%.15" /end MEASUREMENT
/begin MEASUREMENT Rte_CpApHPPSignalMap_PpAVM_Relocation_L_Valid_PiHppAVM_Relocation_L_Valid "" FLOAT32_IEEE NO_COMPU_METHOD 0 0 -3.40282346639E+38 3.40282346639E+38 ECU_ADDRESS 0xA532518C FORMAT "%.15" /end MEASUREMENT
/begin MEASUREMENT Rte_CpApHPPSignalMap_PpAVM_Relocation_R_Valid_PiHppAVM_Relocation_R_Valid "" FLOAT32_IEEE NO_COMPU_METHOD 0 0 -3.40282346639E+38 3.40282346639E+38 ECU_ADDRESS 0xA5325190 FORMAT "%.15" /end MEASUREMENT
/begin MEASUREMENT Rte_CpApHPPSignalMap_PpAVM_Relocation_T_Valid_PiHppAVM_Relocation_T_Valid "" FLOAT32_IEEE NO_COMPU_METHOD 0 0 -3.40282346639E+38 3.40282346639E+38 ECU_ADDRESS 0xA5325194 FORMAT "%.15" /end MEASUREMENT
/begin MEASUREMENT Rte_CpApHPPSignalMap_PpAVM_Relocation_Theta_D_PiHppAVM_Relocation_Theta_D "" FLOAT32_IEEE NO_COMPU_METHOD 0 0 -3.40282346639E+38 3.40282346639E+38 ECU_ADDRESS 0xA5325198 FORMAT "%.15" /end MEASUREMENT
/begin MEASUREMENT Rte_CpApHPPSignalMap_PpAVM_Relocation_Theta_L_PiHppAVM_Relocation_Theta_L "" FLOAT32_IEEE NO_COMPU_METHOD 0 0 -3.40282346639E+38 3.40282346639E+38 ECU_ADDRESS 0xA532519C FORMAT "%.15" /end MEASUREMENT
/begin MEASUREMENT Rte_CpApHPPSignalMap_PpAVM_Relocation_Theta_R_PiHppAVM_Relocation_Theta_R "" FLOAT32_IEEE NO_COMPU_METHOD 0 0 -3.40282346639E+38 3.40282346639E+38 ECU_ADDRESS 0xA53251A0 FORMAT "%.15" /end MEASUREMENT
/begin MEASUREMENT Rte_CpApHPPSignalMap_PpAVM_Relocation_Theta_T_PiHppAVM_Relocation_Theta_T "" FLOAT32_IEEE NO_COMPU_METHOD 0 0 -3.40282346639E+38 3.40282346639E+38 ECU_ADDRESS 0xA53251A4 FORMAT "%.15" /end MEASUREMENT
/begin MEASUREMENT Rte_CpApHPPSignalMap_PpESC_BrakePedalSwitchStatus_PiHppESC_BrakePedalSwitchStatus "" UBYTE NO_COMPU_METHOD 0 0 0 255 ECU_ADDRESS 0xA53254DE FORMAT "%.15" /end MEASUREMENT
/begin MEASUREMENT Rte_CpApHPPSignalMap_PpESC_FLWheelSpeedKPH_PiHppESC_FLWheelSpeedKPH "" FLOAT32_IEEE NO_COMPU_METHOD 0 0 -3.40282346639E+38 3.40282346639E+38 ECU_ADDRESS 0xA53251A8 FORMAT "%.15" /end MEASUREMENT
/begin MEASUREMENT Rte_CpApHPPSignalMap_PpESC_FLWheelSpeedRC_PiHppESC_FLWheelSpeedRC "" UWORD NO_COMPU_METHOD 0 0 -32768 32767 ECU_ADDRESS 0xA532546C FORMAT "%.15" /end MEASUREMENT
/begin MEASUREMENT Rte_CpApHPPSignalMap_PpESC_FRWheelSpeedKPH_PiHppESC_FRWheelSpeedKPH "" FLOAT32_IEEE NO_COMPU_METHOD 0 0 -3.40282346639E+38 3.40282346639E+38 ECU_ADDRESS 0xA53251AC FORMAT "%.15" /end MEASUREMENT
/begin MEASUREMENT Rte_CpApHPPSignalMap_PpESC_FRWheelSpeedRC_PiHppESC_FRWheelSpeedRC "" UWORD NO_COMPU_METHOD 0 0 -32768 32767 ECU_ADDRESS 0xA532546E FORMAT "%.15" /end MEASUREMENT
/begin MEASUREMENT Rte_CpApHPPSignalMap_PpESC_RLWheelDirection_PiHppESC_RLWheelDirection "" UBYTE NO_COMPU_METHOD 0 0 0 255 ECU_ADDRESS 0xA53254DF FORMAT "%.15" /end MEASUREMENT
/begin MEASUREMENT Rte_CpApHPPSignalMap_PpESC_RLWheelSpeedKPH_PiHppESC_RLWheelSpeedKPH "" FLOAT32_IEEE NO_COMPU_METHOD 0 0 -3.40282346639E+38 3.40282346639E+38 ECU_ADDRESS 0xA53251B0 FORMAT "%.15" /end MEASUREMENT
/begin MEASUREMENT Rte_CpApHPPSignalMap_PpESC_RLWheelSpeedRC_PiHppESC_RLWheelSpeedRC "" UWORD NO_COMPU_METHOD 0 0 -32768 32767 ECU_ADDRESS 0xA5325470 FORMAT "%.15" /end MEASUREMENT
/begin MEASUREMENT Rte_CpApHPPSignalMap_PpESC_RRWheelDirection_PiHppESC_RRWheelDirection "" UBYTE NO_COMPU_METHOD 0 0 0 255 ECU_ADDRESS 0xA53254E0 FORMAT "%.15" /end MEASUREMENT
/begin MEASUREMENT Rte_CpApHPPSignalMap_PpESC_RRWheelSpeedKPH_PiHppESC_RRWheelSpeedKPH "" FLOAT32_IEEE NO_COMPU_METHOD 0 0 -3.40282346639E+38 3.40282346639E+38 ECU_ADDRESS 0xA53251B4 FORMAT "%.15" /end MEASUREMENT
/begin MEASUREMENT Rte_CpApHPPSignalMap_PpESC_RRWheelSpeedRC_PiHppESC_RRWheelSpeedRC "" UWORD NO_COMPU_METHOD 0 0 -32768 32767 ECU_ADDRESS 0xA5325472 FORMAT "%.15" /end MEASUREMENT
/begin MEASUREMENT Rte_CpApHPPSignalMap_PpESC_VLC_Active_PiHppESC_VLC_Active "" UBYTE NO_COMPU_METHOD 0 0 0 255 ECU_ADDRESS 0xA53254E1 FORMAT "%.15" /end MEASUREMENT
/begin MEASUREMENT Rte_CpApHPPSignalMap_PpESC_VLC_EngTrqReq_PiHppESC_VLC_EngTrqReq "" SWORD NO_COMPU_METHOD 0 0 -32768 32767 ECU_ADDRESS 0xA5325474 FORMAT "%.15" /end MEASUREMENT
/begin MEASUREMENT Rte_CpApHPPSignalMap_PpESC_VehicleSpeed_PiHppESC_VehicleSpeed "" FLOAT32_IEEE NO_COMPU_METHOD 0 0 -3.40282346639E+38 3.40282346639E+38 ECU_ADDRESS 0xA53251B8 FORMAT "%.15" /end MEASUREMENT
/begin MEASUREMENT Rte_CpApHPPSignalMap_PpESP_VehicleStop_PiHppESP_VehicleStop "" UBYTE NO_COMPU_METHOD 0 0 0 255 ECU_ADDRESS 0xA53254E2 FORMAT "%.15" /end MEASUREMENT
/begin MEASUREMENT Rte_CpApHPPSignalMap_PpHPP_System_Status_PiHppHPP_System_Status "" UBYTE NO_COMPU_METHOD 0 0 0 255 ECU_ADDRESS 0xA53254E3 FORMAT "%.15" /end MEASUREMENT
/begin MEASUREMENT Rte_CpApHPPSignalMap_PpHppAPA_Slot_iLabel_PiHppAPA_Slot_iLabel "" ULONG NO_COMPU_METHOD 0 0 0 4294967295 ECU_ADDRESS 0xA53251BC FORMAT "%.15" /end MEASUREMENT
/begin MEASUREMENT Rte_CpApHPPSignalMap_PpHppAPA_StatusInitReq_PiHppAPA_StatusInitReq "" UBYTE NO_COMPU_METHOD 0 0 0 255 ECU_ADDRESS 0xA53254E6 FORMAT "%.15" /end MEASUREMENT
/begin MEASUREMENT Rte_CpApHPPSignalMap_PpHppAPA_System_Status_PiHppAPA_System_Status "" UBYTE NO_COMPU_METHOD 0 0 0 255 ECU_ADDRESS 0xA53254E7 FORMAT "%.15" /end MEASUREMENT
/begin MEASUREMENT Rte_CpApHPPSignalMap_PpHppAVM_RppCruiseLD_Line0Param_a_PiHppAVM_RppCruiseLD_Line0Param_a "" FLOAT32_IEEE NO_COMPU_METHOD 0 0 -3.40282346639E+38 3.40282346639E+38 ECU_ADDRESS 0xA53251CC FORMAT "%.15" /end MEASUREMENT
/begin MEASUREMENT Rte_CpApHPPSignalMap_PpHppAVM_RppCruiseLD_Line0Param_b_PiHppAVM_RppCruiseLD_Line0Param_b "" FLOAT32_IEEE NO_COMPU_METHOD 0 0 -3.40282346639E+38 3.40282346639E+38 ECU_ADDRESS 0xA53251D0 FORMAT "%.15" /end MEASUREMENT
/begin MEASUREMENT Rte_CpApHPPSignalMap_PpHppAVM_RppCruiseLD_Line0Param_c_PiHppAVM_RppCruiseLD_Line0Param_c "" FLOAT32_IEEE NO_COMPU_METHOD 0 0 -3.40282346639E+38 3.40282346639E+38 ECU_ADDRESS 0xA53251D4 FORMAT "%.15" /end MEASUREMENT
/begin MEASUREMENT Rte_CpApHPPSignalMap_PpHppAVM_RppCruiseLD_Line0Type_c_PiHppAVM_RppCruiseLD_Line0Type_c "" SBYTE NO_COMPU_METHOD 0 0 -128 127 ECU_ADDRESS 0xA53254E8 FORMAT "%.15" /end MEASUREMENT
/begin MEASUREMENT Rte_CpApHPPSignalMap_PpHppAVM_RppCruiseLD_Line0_Condfidents_PiHppAVM_RppCruiseLD_Line0_Condfidents "" UBYTE NO_COMPU_METHOD 0 0 0 255 ECU_ADDRESS 0xA53254E9 FORMAT "%.15" /end MEASUREMENT
/begin MEASUREMENT Rte_CpApHPPSignalMap_PpHppAVM_RppCruiseLD_Line1Param_a_PiHppAVM_RppCruiseLD_Line1Param_a "" FLOAT32_IEEE NO_COMPU_METHOD 0 0 -3.40282346639E+38 3.40282346639E+38 ECU_ADDRESS 0xA53251D8 FORMAT "%.15" /end MEASUREMENT
/begin MEASUREMENT Rte_CpApHPPSignalMap_PpHppAVM_RppCruiseLD_Line1Param_b_PiHppAVM_RppCruiseLD_Line1Param_b "" FLOAT32_IEEE NO_COMPU_METHOD 0 0 -3.40282346639E+38 3.40282346639E+38 ECU_ADDRESS 0xA53251DC FORMAT "%.15" /end MEASUREMENT
/begin MEASUREMENT Rte_CpApHPPSignalMap_PpHppAVM_RppCruiseLD_Line1Param_c_PiHppAVM_RppCruiseLD_Line1Param_c "" FLOAT32_IEEE NO_COMPU_METHOD 0 0 -3.40282346639E+38 3.40282346639E+38 ECU_ADDRESS 0xA53251E0 FORMAT "%.15" /end MEASUREMENT
/begin MEASUREMENT Rte_CpApHPPSignalMap_PpHppAVM_RppCruiseLD_Line1Type_c_PiHppAVM_RppCruiseLD_Line1Type_c "" SBYTE NO_COMPU_METHOD 0 0 -128 127 ECU_ADDRESS 0xA53254EA FORMAT "%.15" /end MEASUREMENT
/begin MEASUREMENT Rte_CpApHPPSignalMap_PpHppAVM_RppCruiseLD_Line1_Condfidents_PiHppAVM_RppCruiseLD_Line1_Condfidents "" UBYTE NO_COMPU_METHOD 0 0 0 255 ECU_ADDRESS 0xA53254EB FORMAT "%.15" /end MEASUREMENT
/begin MEASUREMENT Rte_CpApHPPSignalMap_PpHppAVM_RppCruiseLD_Line2Param_a_PiHppAVM_RppCruiseLD_Line2Param_a "" FLOAT32_IEEE NO_COMPU_METHOD 0 0 -3.40282346639E+38 3.40282346639E+38 ECU_ADDRESS 0xA53251E4 FORMAT "%.15" /end MEASUREMENT
/begin MEASUREMENT Rte_CpApHPPSignalMap_PpHppAVM_RppCruiseLD_Line2Param_b_PiHppAVM_RppCruiseLD_Line2Param_b "" FLOAT32_IEEE NO_COMPU_METHOD 0 0 -3.40282346639E+38 3.40282346639E+38 ECU_ADDRESS 0xA53251E8 FORMAT "%.15" /end MEASUREMENT
/begin MEASUREMENT Rte_CpApHPPSignalMap_PpHppAVM_RppCruiseLD_Line2Param_c_PiHppAVM_RppCruiseLD_Line2Param_c "" FLOAT32_IEEE NO_COMPU_METHOD 0 0 -3.40282346639E+38 3.40282346639E+38 ECU_ADDRESS 0xA53251EC FORMAT "%.15" /end MEASUREMENT
/begin MEASUREMENT Rte_CpApHPPSignalMap_PpHppAVM_RppCruiseLD_Line2Type_c_PiHppAVM_RppCruiseLD_Line2Type_c "" SBYTE NO_COMPU_METHOD 0 0 -128 127 ECU_ADDRESS 0xA53254EC FORMAT "%.15" /end MEASUREMENT
/begin MEASUREMENT Rte_CpApHPPSignalMap_PpHppAVM_RppCruiseLD_Line2_Condfidents_PiHppAVM_RppCruiseLD_Line2_Condfidents "" UBYTE NO_COMPU_METHOD 0 0 0 255 ECU_ADDRESS 0xA53254ED FORMAT "%.15" /end MEASUREMENT
/begin MEASUREMENT Rte_CpApHPPSignalMap_PpHppAVM_RppCruiseLD_Line3Param_a_PiHppAVM_RppCruiseLD_Line3Param_a "" FLOAT32_IEEE NO_COMPU_METHOD 0 0 -3.40282346639E+38 3.40282346639E+38 ECU_ADDRESS 0xA53251F0 FORMAT "%.15" /end MEASUREMENT
/begin MEASUREMENT Rte_CpApHPPSignalMap_PpHppAVM_RppCruiseLD_Line3Param_b_PiHppAVM_RppCruiseLD_Line3Param_b "" FLOAT32_IEEE NO_COMPU_METHOD 0 0 -3.40282346639E+38 3.40282346639E+38 ECU_ADDRESS 0xA53251F4 FORMAT "%.15" /end MEASUREMENT
/begin MEASUREMENT Rte_CpApHPPSignalMap_PpHppAVM_RppCruiseLD_Line3Param_c_PiHppAVM_RppCruiseLD_Line3Param_c "" FLOAT32_IEEE NO_COMPU_METHOD 0 0 -3.40282346639E+38 3.40282346639E+38 ECU_ADDRESS 0xA53251F8 FORMAT "%.15" /end MEASUREMENT
/begin MEASUREMENT Rte_CpApHPPSignalMap_PpHppAVM_RppCruiseLD_Line3Type_c_PiHppAVM_RppCruiseLD_Line3Type_c "" SBYTE NO_COMPU_METHOD 0 0 -128 127 ECU_ADDRESS 0xA53254EE FORMAT "%.15" /end MEASUREMENT
/begin MEASUREMENT Rte_CpApHPPSignalMap_PpHppAVM_RppCruiseLD_Line3_Condfidents_PiHppAVM_RppCruiseLD_Line3_Condfidents "" UBYTE NO_COMPU_METHOD 0 0 0 255 ECU_ADDRESS 0xA53254EF FORMAT "%.15" /end MEASUREMENT
/begin MEASUREMENT Rte_CpApHPPSignalMap_PpHppGlobalMapPose_ParkingLotPt_P0_x_PiHppGlobalMapPose_ParkingLotPt_P0_x "" SLONG NO_COMPU_METHOD 0 0 -2147483648 2147483647 ECU_ADDRESS 0xA53251FC FORMAT "%.15" /end MEASUREMENT
/begin MEASUREMENT Rte_CpApHPPSignalMap_PpHppGlobalMapPose_ParkingLotPt_P0_y_PiHppGlobalMapPose_ParkingLotPt_P0_y "" SLONG NO_COMPU_METHOD 0 0 -2147483648 2147483647 ECU_ADDRESS 0xA5325200 FORMAT "%.15" /end MEASUREMENT
/begin MEASUREMENT Rte_CpApHPPSignalMap_PpHppGlobalMapPose_ParkingLotPt_P1_x_PiHppGlobalMapPose_ParkingLotPt_P1_x "" SLONG NO_COMPU_METHOD 0 0 -2147483648 2147483647 ECU_ADDRESS 0xA5325204 FORMAT "%.15" /end MEASUREMENT
/begin MEASUREMENT Rte_CpApHPPSignalMap_PpHppGlobalMapPose_ParkingLotPt_P1_y_PiHppGlobalMapPose_ParkingLotPt_P1_y "" SLONG NO_COMPU_METHOD 0 0 -2147483648 2147483647 ECU_ADDRESS 0xA5325208 FORMAT "%.15" /end MEASUREMENT
/begin MEASUREMENT Rte_CpApHPPSignalMap_PpHppGlobalMapPose_ParkingLotPt_P2_x_PiHppGlobalMapPose_ParkingLotPt_P2_x "" SLONG NO_COMPU_METHOD 0 0 -2147483648 2147483647 ECU_ADDRESS 0xA532520C FORMAT "%.15" /end MEASUREMENT
/begin MEASUREMENT Rte_CpApHPPSignalMap_PpHppGlobalMapPose_ParkingLotPt_P2_y_PiHppGlobalMapPose_ParkingLotPt_P2_y "" SLONG NO_COMPU_METHOD 0 0 -2147483648 2147483647 ECU_ADDRESS 0xA5325210 FORMAT "%.15" /end MEASUREMENT
/begin MEASUREMENT Rte_CpApHPPSignalMap_PpHppGlobalMapPose_ParkingLotPt_P3_x_PiHppGlobalMapPose_ParkingLotPt_P3_x "" SLONG NO_COMPU_METHOD 0 0 -2147483648 2147483647 ECU_ADDRESS 0xA5325214 FORMAT "%.15" /end MEASUREMENT
/begin MEASUREMENT Rte_CpApHPPSignalMap_PpHppGlobalMapPose_ParkingLotPt_P3_y_PiHppGlobalMapPose_ParkingLotPt_P3_y "" SLONG NO_COMPU_METHOD 0 0 -2147483648 2147483647 ECU_ADDRESS 0xA5325218 FORMAT "%.15" /end MEASUREMENT
/begin MEASUREMENT Rte_CpApHPPSignalMap_PpHppHPP_Localizaion_Status_PiHppHPP_Localizaion_Status "" UBYTE NO_COMPU_METHOD 0 0 0 255 ECU_ADDRESS 0xA53254F0 FORMAT "%.15" /end MEASUREMENT
/begin MEASUREMENT Rte_CpApHPPSignalMap_PpHppHppGlobalMapPose_ParkingSlotInfo_PiHppHppGlobalMapPose_ParkingSlotInfo "" UBYTE NO_COMPU_METHOD 0 0 0 255 ECU_ADDRESS 0xA53254F1 FORMAT "%.15" /end MEASUREMENT
/begin MEASUREMENT Rte_CpApHPPSignalMap_PpHppHppGlobalMapPose_ParkingSlotSide_PiHppHppGlobalMapPose_ParkingSlotSide "" UBYTE NO_COMPU_METHOD 0 0 0 255 ECU_ADDRESS 0xA53254F2 FORMAT "%.15" /end MEASUREMENT
/begin MEASUREMENT Rte_CpApHPPSignalMap_PpHppHppGlobalMapPose_ParkingSlotType_PiHppHppGlobalMapPose_ParkingSlotType "" UBYTE NO_COMPU_METHOD 0 0 0 255 ECU_ADDRESS 0xA53254F3 FORMAT "%.15" /end MEASUREMENT
/begin MEASUREMENT Rte_CpApHPPSignalMap_PpHppHppGlobalMapPose_parkingIn_point_x_PiHppHppGlobalMapPose_parkingIn_point_x "" SLONG NO_COMPU_METHOD 0 0 -2147483648 2147483647 ECU_ADDRESS 0xA532521C FORMAT "%.15" /end MEASUREMENT
/begin MEASUREMENT Rte_CpApHPPSignalMap_PpHppHppGlobalMapPose_parkingIn_point_y_PiHppHppGlobalMapPose_parkingIn_point_y "" SLONG NO_COMPU_METHOD 0 0 -2147483648 2147483647 ECU_ADDRESS 0xA5325220 FORMAT "%.15" /end MEASUREMENT
/begin MEASUREMENT Rte_CpApHPPSignalMap_PpHppHppGlobalMapPose_parkingIn_point_yaw_PiHppHppGlobalMapPose_parkingIn_point_yaw "" FLOAT32_IEEE NO_COMPU_METHOD 0 0 -3.40282346639E+38 3.40282346639E+38 ECU_ADDRESS 0xA5325224 FORMAT "%.15" /end MEASUREMENT
/begin MEASUREMENT Rte_CpApHPPSignalMap_PpHppHppGlobalMapPose_parkingOut_point_x_PiHppHppGlobalMapPose_parkingOut_point_x "" SLONG NO_COMPU_METHOD 0 0 -2147483648 2147483647 ECU_ADDRESS 0xA5325228 FORMAT "%.15" /end MEASUREMENT
/begin MEASUREMENT Rte_CpApHPPSignalMap_PpHppHppGlobalMapPose_parkingOut_point_y_PiHppHppGlobalMapPose_parkingOut_point_y "" SLONG NO_COMPU_METHOD 0 0 -2147483648 2147483647 ECU_ADDRESS 0xA532522C FORMAT "%.15" /end MEASUREMENT
/begin MEASUREMENT Rte_CpApHPPSignalMap_PpHppHppGlobalMapPose_parkingOut_point_yaw_PiHppHppGlobalMapPose_parkingOut_point_yaw "" FLOAT32_IEEE NO_COMPU_METHOD 0 0 -3.40282346639E+38 3.40282346639E+38 ECU_ADDRESS 0xA5325230 FORMAT "%.15" /end MEASUREMENT
/begin MEASUREMENT Rte_CpApHPPSignalMap_PpHppHppGlobalMapPose_pickup_point_x_PiHppHppGlobalMapPose_pickup_point_x "" SLONG NO_COMPU_METHOD 0 0 -2147483648 2147483647 ECU_ADDRESS 0xA5325234 FORMAT "%.15" /end MEASUREMENT
/begin MEASUREMENT Rte_CpApHPPSignalMap_PpHppHppGlobalMapPose_pickup_point_y_PiHppHppGlobalMapPose_pickup_point_y "" SLONG NO_COMPU_METHOD 0 0 -2147483648 2147483647 ECU_ADDRESS 0xA5325238 FORMAT "%.15" /end MEASUREMENT
/begin MEASUREMENT Rte_CpApHPPSignalMap_PpHppHppGlobalMapPose_pickup_point_yaw_PiHppHppGlobalMapPose_pickup_point_yaw "" FLOAT32_IEEE NO_COMPU_METHOD 0 0 -3.40282346639E+38 3.40282346639E+38 ECU_ADDRESS 0xA532523C FORMAT "%.15" /end MEASUREMENT
/begin MEASUREMENT Rte_CpApHPPSignalMap_PpHppHppGlobalMapPose_start_point_x_PiHppHppGlobalMapPose_start_point_x "" SLONG NO_COMPU_METHOD 0 0 -2147483648 2147483647 ECU_ADDRESS 0xA5325240 FORMAT "%.15" /end MEASUREMENT
/begin MEASUREMENT Rte_CpApHPPSignalMap_PpHppHppGlobalMapPose_start_point_y_PiHppHppGlobalMapPose_start_point_y "" SLONG NO_COMPU_METHOD 0 0 -2147483648 2147483647 ECU_ADDRESS 0xA5325244 FORMAT "%.15" /end MEASUREMENT
/begin MEASUREMENT Rte_CpApHPPSignalMap_PpHppHppGlobalMapPose_start_point_yaw_PiHppHppGlobalMapPose_start_point_yaw "" FLOAT32_IEEE NO_COMPU_METHOD 0 0 -3.40282346639E+38 3.40282346639E+38 ECU_ADDRESS 0xA5325248 FORMAT "%.15" /end MEASUREMENT
/begin MEASUREMENT Rte_CpApHPPSignalMap_PpHppParkingOutGlobalStartPt_x_PiHppParkingOutGlobalStartPt_x "" SLONG NO_COMPU_METHOD 0 0 -2147483648 2147483647 ECU_ADDRESS 0xA532524C FORMAT "%.15" /end MEASUREMENT
/begin MEASUREMENT Rte_CpApHPPSignalMap_PpHppParkingOutGlobalStartPt_y_PiHppParkingOutGlobalStartPt_y "" SLONG NO_COMPU_METHOD 0 0 -2147483648 2147483647 ECU_ADDRESS 0xA5325250 FORMAT "%.15" /end MEASUREMENT
/begin MEASUREMENT Rte_CpApHPPSignalMap_PpHppParkingOutGlobalStartPt_yaw_PiHppParkingOutGlobalStartPt_yaw "" FLOAT32_IEEE NO_COMPU_METHOD 0 0 -3.40282346639E+38 3.40282346639E+38 ECU_ADDRESS 0xA5325254 FORMAT "%.15" /end MEASUREMENT
/begin MEASUREMENT Rte_CpApHPPSignalMap_PpHppPerception_ProduceTimeStamp_PiHppPerception_ProduceTimeStamp "" ULONG NO_COMPU_METHOD 0 0 0 4294967295 ECU_ADDRESS 0xA5325258 FORMAT "%.15" /end MEASUREMENT
/begin MEASUREMENT Rte_CpApHPPSignalMap_PpHppPerception_RecieveTimeStamp_PiHppPerception_RecieveTimeStamp "" ULONG NO_COMPU_METHOD 0 0 0 4294967295 ECU_ADDRESS 0xA532525C FORMAT "%.15" /end MEASUREMENT
/begin MEASUREMENT Rte_CpApHPPSignalMap_PpHppRPA_System_Status_PiHppRPA_System_Status "" UBYTE NO_COMPU_METHOD 0 0 0 255 ECU_ADDRESS 0xA53254F4 FORMAT "%.15" /end MEASUREMENT
/begin MEASUREMENT Rte_CpApHPPSignalMap_PpHppRPP_ParkingIn_Req_PiHppRPP_ParkingIn_Req "" UBYTE NO_COMPU_METHOD 0 0 0 255 ECU_ADDRESS 0xA53254F5 FORMAT "%.15" /end MEASUREMENT
/begin MEASUREMENT Rte_CpApHPPSignalMap_PpHppRPP_System_Status_PiHppRPP_System_Status "" UBYTE NO_COMPU_METHOD 0 0 0 255 ECU_ADDRESS 0xA53254F6 FORMAT "%.15" /end MEASUREMENT
/begin MEASUREMENT Rte_CpApHPPSignalMap_PpHppVehicleLocalizationPt_x_PiHppVehicleLocalizationPt_x "" SLONG NO_COMPU_METHOD 0 0 -2147483648 2147483647 ECU_ADDRESS 0xA5325264 FORMAT "%.15" /end MEASUREMENT
/begin MEASUREMENT Rte_CpApHPPSignalMap_PpHppVehicleLocalizationPt_y_PiHppVehicleLocalizationPt_y "" SLONG NO_COMPU_METHOD 0 0 -2147483648 2147483647 ECU_ADDRESS 0xA5325268 FORMAT "%.15" /end MEASUREMENT
/begin MEASUREMENT Rte_CpApHPPSignalMap_PpHppVehicleLocalizationPt_yaw_PiHppVehicleLocalizationPt_yaw "" FLOAT32_IEEE NO_COMPU_METHOD 0 0 -3.40282346639E+38 3.40282346639E+38 ECU_ADDRESS 0xA532526C FORMAT "%.15" /end MEASUREMENT
/begin MEASUREMENT Rte_CpApHPPSignalMap_PpHppVehicleLocalizationPt_z_PiHppVehicleLocalizationPt_z "" SLONG NO_COMPU_METHOD 0 0 -2147483648 2147483647 ECU_ADDRESS 0xA5325270 FORMAT "%.15" /end MEASUREMENT
/begin MEASUREMENT Rte_CpApHPPSignalMap_PpHppVehicleLocalization_ProduceTimeStamp_PiHppVehicleLocalization_ProduceTimeStamp "" ULONG NO_COMPU_METHOD 0 0 0 4294967295 ECU_ADDRESS 0xA5325274 FORMAT "%.15" /end MEASUREMENT
/begin MEASUREMENT Rte_CpApHPPSignalMap_PpHppVehicleLocalization_RecieveTimeStamp_PiHppVehicleLocalization_RecieveTimeStamp "" ULONG NO_COMPU_METHOD 0 0 0 4294967295 ECU_ADDRESS 0xA5325278 FORMAT "%.15" /end MEASUREMENT
/begin MEASUREMENT Rte_CpApHPPSignalMap_PpHppVehicleLocalization_Sequence_PiHppVehicleLocalization_Sequence "" ULONG NO_COMPU_METHOD 0 0 0 4294967295 ECU_ADDRESS 0xA532527C FORMAT "%.15" /end MEASUREMENT
/begin MEASUREMENT Rte_CpApHPPSignalMap_PpHppVehicleType_PiHppVehicleType "" UBYTE NO_COMPU_METHOD 0 0 0 255 ECU_ADDRESS 0xA53254F7 FORMAT "%.15" /end MEASUREMENT
/begin MEASUREMENT Rte_CpApHPPSignalMap_PpModeGearDisplaySts_PiHppModeGearDisplaySts "" UBYTE NO_COMPU_METHOD 0 0 0 255 ECU_ADDRESS 0xA53254FB FORMAT "%.15" /end MEASUREMENT
/begin MEASUREMENT Rte_CpApHPPSignalMap_PpParkingFunctionSelectMode_PiHppParkingFunctionSelectMode "" UBYTE NO_COMPU_METHOD 0 0 0 255 ECU_ADDRESS 0xA53254FC FORMAT "%.15" /end MEASUREMENT
/begin MEASUREMENT Rte_CpApHPPSignalMap_PpSAS_SteerWheelAngle_PiHppSAS_SteerWheelAngle "" FLOAT32_IEEE NO_COMPU_METHOD 0 0 -3.40282346639E+38 3.40282346639E+38 ECU_ADDRESS 0xA53252F0 FORMAT "%.15" /end MEASUREMENT
/begin MEASUREMENT Rte_CpApHPPSignalMap_PpSlotSODFlg_PiHppSlotSODFlg "" UBYTE NO_COMPU_METHOD 0 0 0 255 ECU_ADDRESS 0xA53254FD FORMAT "%.15" /end MEASUREMENT
/begin MEASUREMENT Rte_CpApHPPSignalMap_PpUSS_APA_ParkPlaceX1_PiHppUSS_APA_ParkPlaceX1 "" SLONG NO_COMPU_METHOD 0 0 -2147483648 2147483647 ECU_ADDRESS 0xA53252F4 FORMAT "%.15" /end MEASUREMENT
/begin MEASUREMENT Rte_CpApHPPSignalMap_PpUSS_APA_ParkPlaceX2_PiHppUSS_APA_ParkPlaceX2 "" SLONG NO_COMPU_METHOD 0 0 -2147483648 2147483647 ECU_ADDRESS 0xA53252F8 FORMAT "%.15" /end MEASUREMENT
/begin MEASUREMENT Rte_CpApHPPSignalMap_PpUSS_APA_ParkPlaceX3_PiHppUSS_APA_ParkPlaceX3 "" SLONG NO_COMPU_METHOD 0 0 -2147483648 2147483647 ECU_ADDRESS 0xA53252FC FORMAT "%.15" /end MEASUREMENT
/begin MEASUREMENT Rte_CpApHPPSignalMap_PpUSS_APA_ParkPlaceX4_PiHppUSS_APA_ParkPlaceX4 "" SLONG NO_COMPU_METHOD 0 0 -2147483648 2147483647 ECU_ADDRESS 0xA5325300 FORMAT "%.15" /end MEASUREMENT
/begin MEASUREMENT Rte_CpApHPPSignalMap_PpUSS_APA_ParkPlaceY1_PiHppUSS_APA_ParkPlaceY1 "" SLONG NO_COMPU_METHOD 0 0 -2147483648 2147483647 ECU_ADDRESS 0xA5325304 FORMAT "%.15" /end MEASUREMENT
/begin MEASUREMENT Rte_CpApHPPSignalMap_PpUSS_APA_ParkPlaceY2_PiHppUSS_APA_ParkPlaceY2 "" SLONG NO_COMPU_METHOD 0 0 -2147483648 2147483647 ECU_ADDRESS 0xA5325308 FORMAT "%.15" /end MEASUREMENT
/begin MEASUREMENT Rte_CpApHPPSignalMap_PpUSS_APA_ParkPlaceY3_PiHppUSS_APA_ParkPlaceY3 "" SLONG NO_COMPU_METHOD 0 0 -2147483648 2147483647 ECU_ADDRESS 0xA532530C FORMAT "%.15" /end MEASUREMENT
/begin MEASUREMENT Rte_CpApHPPSignalMap_PpUSS_APA_ParkPlaceY4_PiHppUSS_APA_ParkPlaceY4 "" SLONG NO_COMPU_METHOD 0 0 -2147483648 2147483647 ECU_ADDRESS 0xA5325310 FORMAT "%.15" /end MEASUREMENT
/begin MEASUREMENT Rte_CpApHPPSignalMap_PpUSS_APA_Slot_Depth_PiHppUSS_APA_Slot_Depth "" SLONG NO_COMPU_METHOD 0 0 -2147483648 2147483647 ECU_ADDRESS 0xA5325314 FORMAT "%.15" /end MEASUREMENT
/begin MEASUREMENT Rte_CpApHPPSignalMap_PpUSS_DISTANCE_FLS_PiHppUSS_DISTANCE_FLS "" SWORD NO_COMPU_METHOD 0 0 -32768 32767 ECU_ADDRESS 0xA5325488 FORMAT "%.15" /end MEASUREMENT
/begin MEASUREMENT Rte_CpApHPPSignalMap_PpUSS_DISTANCE_FL_PiHppUSS_DISTANCE_FL "" SWORD NO_COMPU_METHOD 0 0 -32768 32767 ECU_ADDRESS 0xA532548A FORMAT "%.15" /end MEASUREMENT
/begin MEASUREMENT Rte_CpApHPPSignalMap_PpUSS_DISTANCE_FML_PiHppUSS_DISTANCE_FML "" SWORD NO_COMPU_METHOD 0 0 -32768 32767 ECU_ADDRESS 0xA532548C FORMAT "%.15" /end MEASUREMENT
/begin MEASUREMENT Rte_CpApHPPSignalMap_PpUSS_DISTANCE_FMR_PiHppUSS_DISTANCE_FMR "" SWORD NO_COMPU_METHOD 0 0 -32768 32767 ECU_ADDRESS 0xA532548E FORMAT "%.15" /end MEASUREMENT
/begin MEASUREMENT Rte_CpApHPPSignalMap_PpUSS_DISTANCE_FRS_PiHppUSS_DISTANCE_FRS "" SWORD NO_COMPU_METHOD 0 0 -32768 32767 ECU_ADDRESS 0xA5325490 FORMAT "%.15" /end MEASUREMENT
/begin MEASUREMENT Rte_CpApHPPSignalMap_PpUSS_DISTANCE_FR_PiHppUSS_DISTANCE_FR "" SWORD NO_COMPU_METHOD 0 0 -32768 32767 ECU_ADDRESS 0xA5325492 FORMAT "%.15" /end MEASUREMENT
/begin MEASUREMENT Rte_CpApHPPSignalMap_PpUSS_DISTANCE_RLS_PiHppUSS_DISTANCE_RLS "" SWORD NO_COMPU_METHOD 0 0 -32768 32767 ECU_ADDRESS 0xA5325494 FORMAT "%.15" /end MEASUREMENT
/begin MEASUREMENT Rte_CpApHPPSignalMap_PpUSS_DISTANCE_RL_PiHppUSS_DISTANCE_RL "" SWORD NO_COMPU_METHOD 0 0 -32768 32767 ECU_ADDRESS 0xA5325496 FORMAT "%.15" /end MEASUREMENT
/begin MEASUREMENT Rte_CpApHPPSignalMap_PpUSS_DISTANCE_RML_PiHppUSS_DISTANCE_RML "" SWORD NO_COMPU_METHOD 0 0 -32768 32767 ECU_ADDRESS 0xA5325498 FORMAT "%.15" /end MEASUREMENT
/begin MEASUREMENT Rte_CpApHPPSignalMap_PpUSS_DISTANCE_RMR_PiHppUSS_DISTANCE_RMR "" SWORD NO_COMPU_METHOD 0 0 -32768 32767 ECU_ADDRESS 0xA532549A FORMAT "%.15" /end MEASUREMENT
/begin MEASUREMENT Rte_CpApHPPSignalMap_PpUSS_DISTANCE_RRS_PiHppUSS_DISTANCE_RRS "" SWORD NO_COMPU_METHOD 0 0 -32768 32767 ECU_ADDRESS 0xA532549C FORMAT "%.15" /end MEASUREMENT
/begin MEASUREMENT Rte_CpApHPPSignalMap_PpUSS_DISTANCE_RR_PiHppUSS_DISTANCE_RR "" SWORD NO_COMPU_METHOD 0 0 -32768 32767 ECU_ADDRESS 0xA532549E FORMAT "%.15" /end MEASUREMENT
/begin MEASUREMENT Rte_CpApHPPSignalMap_PpUSS_EMapInfo_SlotUpdatePtB_Flag_PiHppUSS_EMapInfo_SlotUpdatePtB_Flag "" UBYTE NO_COMPU_METHOD 0 0 0 255 ECU_ADDRESS 0xA53254FE FORMAT "%.15" /end MEASUREMENT
/begin MEASUREMENT Rte_CpApHPPSignalMap_PpUSS_EMapInfo_SlotUpdatePtC_Flag_PiHppUSS_EMapInfo_SlotUpdatePtC_Flag "" UBYTE NO_COMPU_METHOD 0 0 0 255 ECU_ADDRESS 0xA53254FF FORMAT "%.15" /end MEASUREMENT
/begin MEASUREMENT Rte_CpApHPPSignalMap_PpUSS_EMapInfo_SlotUpdate_Bx_PiHppUSS_EMapInfo_SlotUpdate_Bx "" SLONG NO_COMPU_METHOD 0 0 -2147483648 2147483647 ECU_ADDRESS 0xA5325318 FORMAT "%.15" /end MEASUREMENT
/begin MEASUREMENT Rte_CpApHPPSignalMap_PpUSS_EMapInfo_SlotUpdate_By_PiHppUSS_EMapInfo_SlotUpdate_By "" SLONG NO_COMPU_METHOD 0 0 -2147483648 2147483647 ECU_ADDRESS 0xA532531C FORMAT "%.15" /end MEASUREMENT
/begin MEASUREMENT Rte_CpApHPPSignalMap_PpUSS_EMapInfo_SlotUpdate_Cx_PiHppUSS_EMapInfo_SlotUpdate_Cx "" SLONG NO_COMPU_METHOD 0 0 -2147483648 2147483647 ECU_ADDRESS 0xA5325320 FORMAT "%.15" /end MEASUREMENT
/begin MEASUREMENT Rte_CpApHPPSignalMap_PpUSS_EMapInfo_SlotUpdate_Cy_PiHppUSS_EMapInfo_SlotUpdate_Cy "" SLONG NO_COMPU_METHOD 0 0 -2147483648 2147483647 ECU_ADDRESS 0xA5325324 FORMAT "%.15" /end MEASUREMENT
/begin MEASUREMENT Rte_CpApHPPSignalMap_PpUSS_TimeStamp_PiHppUSS_TimeStamp "" SLONG NO_COMPU_METHOD 0 0 -2147483648 2147483647 ECU_ADDRESS 0xA5325328 FORMAT "%.15" /end MEASUREMENT
/begin MEASUREMENT Rte_CpApHPPSignalMap_PpYRS_LongitAcce_PiHppYRS_LongitAcce "" FLOAT32_IEEE NO_COMPU_METHOD 0 0 -3.40282346639E+38 3.40282346639E+38 ECU_ADDRESS 0xA532532C FORMAT "%.15" /end MEASUREMENT
/begin MEASUREMENT Rte_CpApHPPSignalMap_PpYRS_YawRate_PiHppYRS_YawRate "" FLOAT32_IEEE NO_COMPU_METHOD 0 0 -3.40282346639E+38 3.40282346639E+38 ECU_ADDRESS 0xA5325330 FORMAT "%.15" /end MEASUREMENT
/begin MEASUREMENT Rte_CpApHPPVLCAxAlg_PpHppALG_Factor1_Out_PiHppALG_Factor1_Out "" FLOAT32_IEEE NO_COMPU_METHOD 0 0 -3.40282346639E+38 3.40282346639E+38 ECU_ADDRESS 0xA5325334 FORMAT "%.15" /end MEASUREMENT
/begin MEASUREMENT Rte_CpApHPPVLCAxAlg_PpHppALG_Factor2_Out_PiHppALG_Factor2_Out "" FLOAT32_IEEE NO_COMPU_METHOD 0 0 -3.40282346639E+38 3.40282346639E+38 ECU_ADDRESS 0xA5325338 FORMAT "%.15" /end MEASUREMENT
/begin MEASUREMENT Rte_CpApHPPVLCAxAlg_PpHppALG_Factor3_Out_PiHppALG_Factor3_Out "" FLOAT32_IEEE NO_COMPU_METHOD 0 0 -3.40282346639E+38 3.40282346639E+38 ECU_ADDRESS 0xA532533C FORMAT "%.15" /end MEASUREMENT
/begin MEASUREMENT Rte_CpApHPPVLCAxAlg_PpHppAVM_HPP_APA_BrakePreferred_PiHppAVM_HPP_APA_BrakePreferred "" UBYTE NO_COMPU_METHOD 0 0 0 255 ECU_ADDRESS 0xA5325502 FORMAT "%.15" /end MEASUREMENT
/begin MEASUREMENT Rte_CpApHPPVLCAxAlg_PpHppAVM_HPP_APA_DriverOffReq_PiHppAVM_HPP_APA_DriverOffReq "" UBYTE NO_COMPU_METHOD 0 0 0 255 ECU_ADDRESS 0xA5325503 FORMAT "%.15" /end MEASUREMENT
/begin MEASUREMENT Rte_CpApHPPVLCAxAlg_PpHppAVM_HPP_APA_EmergencyBrakeReq_PiHppAVM_HPP_APA_EmergencyBrakeReq "" UBYTE NO_COMPU_METHOD 0 0 0 255 ECU_ADDRESS 0xA5325504 FORMAT "%.15" /end MEASUREMENT
/begin MEASUREMENT Rte_CpApHPPVLCAxAlg_PpHppAVM_HPP_APA_GearRequest_PiHppAVM_HPP_APA_GearRequest "" UBYTE NO_COMPU_METHOD 0 0 0 255 ECU_ADDRESS 0xA5325505 FORMAT "%.15" /end MEASUREMENT
/begin MEASUREMENT Rte_CpApHPPVLCAxAlg_PpHppAVM_HPP_APA_StandstillReq_PiHppAVM_HPP_APA_StandstillReq "" UBYTE NO_COMPU_METHOD 0 0 0 255 ECU_ADDRESS 0xA5325506 FORMAT "%.15" /end MEASUREMENT
/begin MEASUREMENT Rte_CpApHPPVLCAxAlg_PpHppAVM_HPP_APA_StopDistance_PiHppAVM_HPP_APA_StopDistance "" FLOAT32_IEEE NO_COMPU_METHOD 0 0 -3.40282346639E+38 3.40282346639E+38 ECU_ADDRESS 0xA5325340 FORMAT "%.15" /end MEASUREMENT
/begin MEASUREMENT Rte_CpApHPPVLCAxAlg_PpHppAVM_HPP_APA_VLCAxTarAim_PiHppAVM_HPP_APA_VLCAxTarAim "" FLOAT32_IEEE NO_COMPU_METHOD 0 0 -3.40282346639E+38 3.40282346639E+38 ECU_ADDRESS 0xA5325344 FORMAT "%.15" /end MEASUREMENT
/begin MEASUREMENT Rte_CpApHPPVLCAxAlg_PpHppAVM_HPP_APA_VLCAxTarLowerComfBand_PiHppAVM_HPP_APA_VLCAxTarLowerComfBand "" FLOAT32_IEEE NO_COMPU_METHOD 0 0 -3.40282346639E+38 3.40282346639E+38 ECU_ADDRESS 0xA5325348 FORMAT "%.15" /end MEASUREMENT
/begin MEASUREMENT Rte_CpApHPPVLCAxAlg_PpHppAVM_HPP_APA_VLCAxTarUpperComfBand_PiHppAVM_HPP_APA_VLCAxTarUpperComfBand "" FLOAT32_IEEE NO_COMPU_METHOD 0 0 -3.40282346639E+38 3.40282346639E+38 ECU_ADDRESS 0xA532534C FORMAT "%.15" /end MEASUREMENT
/begin MEASUREMENT Rte_CpApHPPVLCAxAlg_PpHppAVM_HPP_APA_VLCModeReq_PiHppAVM_HPP_APA_VLCModeReq "" UBYTE NO_COMPU_METHOD 0 0 0 255 ECU_ADDRESS 0xA5325507 FORMAT "%.15" /end MEASUREMENT
/begin MEASUREMENT Rte_CpApHPPVLCAxAlg_PpHppAVM_HPP_APA_VLCdAxTarLowerLimit_PiHppAVM_HPP_APA_VLCdAxTarLowerLimit "" FLOAT32_IEEE NO_COMPU_METHOD 0 0 -3.40282346639E+38 3.40282346639E+38 ECU_ADDRESS 0xA5325350 FORMAT "%.15" /end MEASUREMENT
/begin MEASUREMENT Rte_CpApHPPVLCAxAlg_PpHppAVM_HPP_APA_VLCdAxTarUpperLimit_PiHppAVM_HPP_APA_VLCdAxTarUpperLimit "" FLOAT32_IEEE NO_COMPU_METHOD 0 0 -3.40282346639E+38 3.40282346639E+38 ECU_ADDRESS 0xA5325354 FORMAT "%.15" /end MEASUREMENT
/begin MEASUREMENT Rte_CpApHPPVLCAxAlg_PpHppAlgDebug10_PiHppAlgDebug10 "" FLOAT32_IEEE NO_COMPU_METHOD 0 0 -3.40282346639E+38 3.40282346639E+38 ECU_ADDRESS 0xA5325358 FORMAT "%.15" /end MEASUREMENT
/begin MEASUREMENT Rte_CpApHPPVLCAxAlg_PpHppAlgDebug1_PiHppAlgDebug1 "" FLOAT32_IEEE NO_COMPU_METHOD 0 0 -3.40282346639E+38 3.40282346639E+38 ECU_ADDRESS 0xA532535C FORMAT "%.15" /end MEASUREMENT
/begin MEASUREMENT Rte_CpApHPPVLCAxAlg_PpHppAlgDebug2_PiHppAlgDebug2 "" FLOAT32_IEEE NO_COMPU_METHOD 0 0 -3.40282346639E+38 3.40282346639E+38 ECU_ADDRESS 0xA5325360 FORMAT "%.15" /end MEASUREMENT
/begin MEASUREMENT Rte_CpApHPPVLCAxAlg_PpHppAlgDebug3_PiHppAlgDebug3 "" FLOAT32_IEEE NO_COMPU_METHOD 0 0 -3.40282346639E+38 3.40282346639E+38 ECU_ADDRESS 0xA5325364 FORMAT "%.15" /end MEASUREMENT
/begin MEASUREMENT Rte_CpApHPPVLCAxAlg_PpHppAlgDebug4_PiHppAlgDebug4 "" FLOAT32_IEEE NO_COMPU_METHOD 0 0 -3.40282346639E+38 3.40282346639E+38 ECU_ADDRESS 0xA5325368 FORMAT "%.15" /end MEASUREMENT
/begin MEASUREMENT Rte_CpApHPPVLCAxAlg_PpHppAlgDebug5_PiHppAlgDebug5 "" FLOAT32_IEEE NO_COMPU_METHOD 0 0 -3.40282346639E+38 3.40282346639E+38 ECU_ADDRESS 0xA532536C FORMAT "%.15" /end MEASUREMENT
/begin MEASUREMENT Rte_CpApHPPVLCAxAlg_PpHppAlgDebug6_PiHppAlgDebug6 "" FLOAT32_IEEE NO_COMPU_METHOD 0 0 -3.40282346639E+38 3.40282346639E+38 ECU_ADDRESS 0xA5325370 FORMAT "%.15" /end MEASUREMENT
/begin MEASUREMENT Rte_CpApHPPVLCAxAlg_PpHppAlgDebug7_PiHppAlgDebug7 "" FLOAT32_IEEE NO_COMPU_METHOD 0 0 -3.40282346639E+38 3.40282346639E+38 ECU_ADDRESS 0xA5325374 FORMAT "%.15" /end MEASUREMENT
/begin MEASUREMENT Rte_CpApHPPVLCAxAlg_PpHppAlgDebug8_PiHppAlgDebug8 "" FLOAT32_IEEE NO_COMPU_METHOD 0 0 -3.40282346639E+38 3.40282346639E+38 ECU_ADDRESS 0xA5325378 FORMAT "%.15" /end MEASUREMENT
/begin MEASUREMENT Rte_CpApHPPVLCAxAlg_PpHppAlgDebug9_PiHppAlgDebug9 "" FLOAT32_IEEE NO_COMPU_METHOD 0 0 -3.40282346639E+38 3.40282346639E+38 ECU_ADDRESS 0xA532537C FORMAT "%.15" /end MEASUREMENT
/begin MEASUREMENT Rte_CpApHPPVLCAxAlg_PpHppHPP_APA_AlgorithmSts_PiHppHPP_APA_AlgorithmSts "" UBYTE NO_COMPU_METHOD 0 0 0 255 ECU_ADDRESS 0xA5325508 FORMAT "%.15" /end MEASUREMENT
/begin MEASUREMENT Rte_CpApHPPVLCAxAlg_PpHppHPP_APA_CurrentPathNum_PiHppHPP_APA_CurrentPathNum "" UBYTE NO_COMPU_METHOD 0 0 0 255 ECU_ADDRESS 0xA5325509 FORMAT "%.15" /end MEASUREMENT
/begin MEASUREMENT Rte_CpApHPPVLCAxAlg_PpHppHPP_APA_Process_bar_PiHppHPP_APA_Process_bar "" UBYTE NO_COMPU_METHOD 0 0 -3.40282346639E+38 3.40282346639E+38 ECU_ADDRESS 0xA532550A FORMAT "%.15" /end MEASUREMENT
/begin MEASUREMENT Rte_CpApHPPVLCAxAlg_PpHppHPP_APA_SetSteeringWheelAng_PiHppHPP_APA_SetSteeringWheelAng "" FLOAT32_IEEE NO_COMPU_METHOD 0 0 -3.40282346639E+38 3.40282346639E+38 ECU_ADDRESS 0xA5325380 FORMAT "%.15" /end MEASUREMENT
/begin MEASUREMENT Rte_CpApHPPVLCAxAlg_PpHppHPP_APA_Slot_Rloction_Req_PiHppHPP_APA_Slot_Rloction_Req "" UBYTE NO_COMPU_METHOD 0 0 0 255 ECU_ADDRESS 0xA532550B FORMAT "%.15" /end MEASUREMENT
/begin MEASUREMENT Rte_CpApHPPVLCAxAlg_PpHppHPP_APA_Terminate_type_PiHppHPP_APA_Terminate_type "" UBYTE NO_COMPU_METHOD 0 0 0 255 ECU_ADDRESS 0xA532550C FORMAT "%.15" /end MEASUREMENT
/begin MEASUREMENT Rte_CpApHPPVLCAxAlg_PpHppHPP_APA_TotalPathNum_PiHppHPP_APA_TotalPathNum "" UBYTE NO_COMPU_METHOD 0 0 0 255 ECU_ADDRESS 0xA532550D FORMAT "%.15" /end MEASUREMENT
/begin MEASUREMENT Rte_CpApHPPVLCAxAlg_PpHppHPP_APA_tracking_end_x_PiHppHPP_APA_tracking_end_x "" FLOAT32_IEEE NO_COMPU_METHOD 0 0 -3.40282346639E+38 3.40282346639E+38 ECU_ADDRESS 0xA5325384 FORMAT "%.15" /end MEASUREMENT
/begin MEASUREMENT Rte_CpApHPPVLCAxAlg_PpHppHPP_APA_tracking_end_y_PiHppHPP_APA_tracking_end_y "" FLOAT32_IEEE NO_COMPU_METHOD 0 0 -3.40282346639E+38 3.40282346639E+38 ECU_ADDRESS 0xA5325388 FORMAT "%.15" /end MEASUREMENT
/begin MEASUREMENT Rte_CpApHPPVLCAxAlg_PpHppHPP_APA_tracking_end_yaw_PiHppHPP_APA_tracking_end_yaw "" FLOAT32_IEEE NO_COMPU_METHOD 0 0 -3.40282346639E+38 3.40282346639E+38 ECU_ADDRESS 0xA532538C FORMAT "%.15" /end MEASUREMENT
/begin MEASUREMENT Rte_CpApHPPVLCAxAlg_PpHppHPP_HPP_APA_AlgorithmSts_PiHppHPP_HPP_APA_AlgorithmSts "" UBYTE NO_COMPU_METHOD 0 0 0 255 ECU_ADDRESS 0xA532550E FORMAT "%.15" /end MEASUREMENT
/begin MEASUREMENT Rte_CpApHPPVLCAxAlg_PpHppHPP_HPP_APA_Terminate_type_PiHppHPP_HPP_APA_Terminate_type "" UBYTE NO_COMPU_METHOD 0 0 0 255 ECU_ADDRESS 0xA532550F FORMAT "%.15" /end MEASUREMENT
/begin MEASUREMENT Rte_CpApHPPVLCAxAlg_PpHppHPP_ParkingOutToRoad_Status_PiHppHPP_ParkingOutToRoad_Status "" UBYTE NO_COMPU_METHOD 0 0 0 255 ECU_ADDRESS 0xA5325510 FORMAT "%.15" /end MEASUREMENT
/begin MEASUREMENT Rte_CpApHPPVLCAxAlg_PpHppHPP_RPA_AlgorithmSts_PiHppHPP_RPA_AlgorithmSts "" UBYTE NO_COMPU_METHOD 0 0 0 255 ECU_ADDRESS 0xA5325511 FORMAT "%.15" /end MEASUREMENT
/begin MEASUREMENT Rte_CpApHPPVLCAxAlg_PpHppHPP_RPA_Terminate_type_PiHppHPP_RPA_Terminate_type "" UBYTE NO_COMPU_METHOD 0 0 0 255 ECU_ADDRESS 0xA5325512 FORMAT "%.15" /end MEASUREMENT
/begin MEASUREMENT Rte_CpApHPPVLCAxAlg_PpHppHPP_RPP_AlgorithmSts_PiHppHPP_RPP_AlgorithmSts "" UBYTE NO_COMPU_METHOD 0 0 0 255 ECU_ADDRESS 0xA5325513 FORMAT "%.15" /end MEASUREMENT
/begin MEASUREMENT Rte_CpApHPPVLCAxAlg_PpHppHPP_RPP_Terminate_type_PiHppHPP_RPP_Terminate_type "" UBYTE NO_COMPU_METHOD 0 0 0 255 ECU_ADDRESS 0xA5325514 FORMAT "%.15" /end MEASUREMENT
/begin MEASUREMENT Rte_CpApHPPVLCAxAlg_PpHppHPP_UNDO_Status_PiHppHPP_UNDO_Status "" UBYTE NO_COMPU_METHOD 0 0 0 255 ECU_ADDRESS 0xA5325515 FORMAT "%.15" /end MEASUREMENT
/begin MEASUREMENT Rte_CpApHPPVLCAxAlg_PpHppPosAng_PiHppPosAng "" FLOAT32_IEEE NO_COMPU_METHOD 0 0 -3.40282346639E+38 3.40282346639E+38 ECU_ADDRESS 0xA532539C FORMAT "%.15" /end MEASUREMENT
/begin MEASUREMENT Rte_CpApHPPVLCAxAlg_PpHppPosX_PiHppPosX "" FLOAT32_IEEE NO_COMPU_METHOD 0 0 -3.40282346639E+38 3.40282346639E+38 ECU_ADDRESS 0xA53253A0 FORMAT "%.15" /end MEASUREMENT
/begin MEASUREMENT Rte_CpApHPPVLCAxAlg_PpHppPosY_PiHppPosY "" FLOAT32_IEEE NO_COMPU_METHOD 0 0 -3.40282346639E+38 3.40282346639E+38 ECU_ADDRESS 0xA53253A4 FORMAT "%.15" /end MEASUREMENT
/begin MEASUREMENT Rte_CpApHPPVLCAxAlg_PpHppRPP_Slot_ID_ConfirmBack_PiHppRPP_Slot_ID_ConfirmBack "" ULONG NO_COMPU_METHOD 0 0 0 255 ECU_ADDRESS 0xA53253A8 FORMAT "%.15" /end MEASUREMENT
/begin MEASUREMENT Rte_CpApHPPVLCAxAlg_PpHppTimeCounter_PiHppTimeCounter "" SLONG NO_COMPU_METHOD 0 0 -2147483648 2147483647 ECU_ADDRESS 0xA53253AC FORMAT "%.15" /end MEASUREMENT
/begin MEASUREMENT VehControlType "" UBYTE NO_COMPU_METHOD 0 0 0 255 ECU_ADDRESS 0xA552A16A FORMAT "%.15" /end MEASUREMENT
/begin MEASUREMENT XCP_Struct_Len_APA "" UBYTE NO_COMPU_METHOD 0 0 0 255 ECU_ADDRESS 0xA552A160 FORMAT "%.15" /end MEASUREMENT
/begin MEASUREMENT XCP_Struct_Len_AVM "" UBYTE NO_COMPU_METHOD 0 0 0 255 ECU_ADDRESS 0xA552B568 FORMAT "%.15" /end MEASUREMENT
/begin MEASUREMENT XCP_Struct_Len_Collision "" UBYTE NO_COMPU_METHOD 0 0 0 255 ECU_ADDRESS 0xA552B299 FORMAT "%.15" /end MEASUREMENT
/begin MEASUREMENT XCP_Struct_Len_DATA "" UBYTE NO_COMPU_METHOD 0 0 0 255 ECU_ADDRESS 0xA552B583 FORMAT "%.15" /end MEASUREMENT
/begin MEASUREMENT XCP_Struct_Len_HPP "" UBYTE NO_COMPU_METHOD 0 0 0 255 ECU_ADDRESS 0xA552B1B2 FORMAT "%.15" /end MEASUREMENT
/begin MEASUREMENT XCP_Struct_Len_Map "" UBYTE NO_COMPU_METHOD 0 0 0 255 ECU_ADDRESS 0xA5529750 FORMAT "%.15" /end MEASUREMENT
/begin MEASUREMENT XCP_Struct_Len_RPA "" UBYTE NO_COMPU_METHOD 0 0 0 255 ECU_ADDRESS 0xA552ABD8 FORMAT "%.15" /end MEASUREMENT
/begin MEASUREMENT m_ussLibAdaptCtrl.ussRawInfoData.SnsDiagnosticStatus._0_.allStatus "" ULONG NO_COMPU_METHOD 0 0 0 4294967295 ECU_ADDRESS 0xA531D328 FORMAT "%.15" /end MEASUREMENT
/begin MEASUREMENT m_ussLibAdaptCtrl.ussRawInfoData.SnsDiagnosticStatus._10_.allStatus "" ULONG NO_COMPU_METHOD 0 0 0 4294967295 ECU_ADDRESS 0xA531D350 FORMAT "%.15" /end MEASUREMENT
/begin MEASUREMENT m_ussLibAdaptCtrl.ussRawInfoData.SnsDiagnosticStatus._11_.allStatus "" ULONG NO_COMPU_METHOD 0 0 0 4294967295 ECU_ADDRESS 0xA531D354 FORMAT "%.15" /end MEASUREMENT
/begin MEASUREMENT m_ussLibAdaptCtrl.ussRawInfoData.SnsDiagnosticStatus._1_.allStatus "" ULONG NO_COMPU_METHOD 0 0 0 4294967295 ECU_ADDRESS 0xA531D32C FORMAT "%.15" /end MEASUREMENT
/begin MEASUREMENT m_ussLibAdaptCtrl.ussRawInfoData.SnsDiagnosticStatus._2_.allStatus "" ULONG NO_COMPU_METHOD 0 0 0 4294967295 ECU_ADDRESS 0xA531D330 FORMAT "%.15" /end MEASUREMENT
/begin MEASUREMENT m_ussLibAdaptCtrl.ussRawInfoData.SnsDiagnosticStatus._3_.allStatus "" ULONG NO_COMPU_METHOD 0 0 0 4294967295 ECU_ADDRESS 0xA531D334 FORMAT "%.15" /end MEASUREMENT
/begin MEASUREMENT m_ussLibAdaptCtrl.ussRawInfoData.SnsDiagnosticStatus._4_.allStatus "" ULONG NO_COMPU_METHOD 0 0 0 4294967295 ECU_ADDRESS 0xA531D338 FORMAT "%.15" /end MEASUREMENT
/begin MEASUREMENT m_ussLibAdaptCtrl.ussRawInfoData.SnsDiagnosticStatus._5_.allStatus "" ULONG NO_COMPU_METHOD 0 0 0 4294967295 ECU_ADDRESS 0xA531D33C FORMAT "%.15" /end MEASUREMENT
/begin MEASUREMENT m_ussLibAdaptCtrl.ussRawInfoData.SnsDiagnosticStatus._6_.allStatus "" ULONG NO_COMPU_METHOD 0 0 0 4294967295 ECU_ADDRESS 0xA531D340 FORMAT "%.15" /end MEASUREMENT
/begin MEASUREMENT m_ussLibAdaptCtrl.ussRawInfoData.SnsDiagnosticStatus._7_.allStatus "" ULONG NO_COMPU_METHOD 0 0 0 4294967295 ECU_ADDRESS 0xA531D344 FORMAT "%.15" /end MEASUREMENT
/begin MEASUREMENT m_ussLibAdaptCtrl.ussRawInfoData.SnsDiagnosticStatus._8_.allStatus "" ULONG NO_COMPU_METHOD 0 0 0 4294967295 ECU_ADDRESS 0xA531D348 FORMAT "%.15" /end MEASUREMENT
/begin MEASUREMENT m_ussLibAdaptCtrl.ussRawInfoData.SnsDiagnosticStatus._9_.allStatus "" ULONG NO_COMPU_METHOD 0 0 0 4294967295 ECU_ADDRESS 0xA531D34C FORMAT "%.15" /end MEASUREMENT
/begin MEASUREMENT m_ussLibAdaptCtrl.ussRawInfoData.USS_DR.Coordinate "" UBYTE NO_COMPU_METHOD 0 0 0 255 ECU_ADDRESS 0xA531D308 FORMAT "%.15" /end MEASUREMENT
/begin MEASUREMENT m_ussLibAdaptCtrl.ussRawInfoData.USS_DR.Coordinate.x "" FLOAT32_IEEE NO_COMPU_METHOD 0 0 -3.40282346639E+38 3.40282346639E+38 ECU_ADDRESS 0xA531D308 FORMAT "%.15" /end MEASUREMENT
/begin MEASUREMENT m_ussLibAdaptCtrl.ussRawInfoData.USS_DR.Coordinate.y "" FLOAT32_IEEE NO_COMPU_METHOD 0 0 -3.40282346639E+38 3.40282346639E+38 ECU_ADDRESS 0xA531D30C FORMAT "%.15" /end MEASUREMENT
/begin MEASUREMENT m_ussLibAdaptCtrl.ussRawInfoData.USS_Distance_Info.Uss_Dist_Info._0_.DistForPdcLeft "" UWORD NO_COMPU_METHOD 0 0 0 65535 ECU_ADDRESS 0xA531D0E2 FORMAT "%.15" /end MEASUREMENT
/begin MEASUREMENT m_ussLibAdaptCtrl.ussRawInfoData.USS_Distance_Info.Uss_Dist_Info._0_.SelfTxRx "" UWORD NO_COMPU_METHOD 0 0 0 65535 ECU_ADDRESS 0xA531D0E0 FORMAT "%.15" /end MEASUREMENT
/begin MEASUREMENT m_ussLibAdaptCtrl.ussRawInfoData.USS_Distance_Info.Uss_Dist_Info._10_.DistForPdcLeft "" UWORD NO_COMPU_METHOD 0 0 0 65535 ECU_ADDRESS 0xA531D146 FORMAT "%.15" /end MEASUREMENT
/begin MEASUREMENT m_ussLibAdaptCtrl.ussRawInfoData.USS_Distance_Info.Uss_Dist_Info._10_.SelfTxRx "" UWORD NO_COMPU_METHOD 0 0 0 65535 ECU_ADDRESS 0xA531D144 FORMAT "%.15" /end MEASUREMENT
/begin MEASUREMENT m_ussLibAdaptCtrl.ussRawInfoData.USS_Distance_Info.Uss_Dist_Info._11_.DistForPdcLeft "" UWORD NO_COMPU_METHOD 0 0 0 65535 ECU_ADDRESS 0xA531D150 FORMAT "%.15" /end MEASUREMENT
/begin MEASUREMENT m_ussLibAdaptCtrl.ussRawInfoData.USS_Distance_Info.Uss_Dist_Info._11_.SelfTxRx "" UWORD NO_COMPU_METHOD 0 0 0 65535 ECU_ADDRESS 0xA531D14E FORMAT "%.15" /end MEASUREMENT
/begin MEASUREMENT m_ussLibAdaptCtrl.ussRawInfoData.USS_Distance_Info.Uss_Dist_Info._1_.DistForPdcLeft "" UWORD NO_COMPU_METHOD 0 0 0 65535 ECU_ADDRESS 0xA531D0EC FORMAT "%.15" /end MEASUREMENT
/begin MEASUREMENT m_ussLibAdaptCtrl.ussRawInfoData.USS_Distance_Info.Uss_Dist_Info._1_.SelfTxRx "" UWORD NO_COMPU_METHOD 0 0 0 65535 ECU_ADDRESS 0xA531D0EA FORMAT "%.15" /end MEASUREMENT
/begin MEASUREMENT m_ussLibAdaptCtrl.ussRawInfoData.USS_Distance_Info.Uss_Dist_Info._2_.DistForPdcLeft "" UWORD NO_COMPU_METHOD 0 0 0 65535 ECU_ADDRESS 0xA531D0F6 FORMAT "%.15" /end MEASUREMENT
/begin MEASUREMENT m_ussLibAdaptCtrl.ussRawInfoData.USS_Distance_Info.Uss_Dist_Info._2_.SelfTxRx "" UWORD NO_COMPU_METHOD 0 0 0 65535 ECU_ADDRESS 0xA531D0F4 FORMAT "%.15" /end MEASUREMENT
/begin MEASUREMENT m_ussLibAdaptCtrl.ussRawInfoData.USS_Distance_Info.Uss_Dist_Info._3_.DistForPdcLeft "" UWORD NO_COMPU_METHOD 0 0 0 65535 ECU_ADDRESS 0xA531D100 FORMAT "%.15" /end MEASUREMENT
/begin MEASUREMENT m_ussLibAdaptCtrl.ussRawInfoData.USS_Distance_Info.Uss_Dist_Info._3_.SelfTxRx "" UWORD NO_COMPU_METHOD 0 0 0 65535 ECU_ADDRESS 0xA531D0FE FORMAT "%.15" /end MEASUREMENT
/begin MEASUREMENT m_ussLibAdaptCtrl.ussRawInfoData.USS_Distance_Info.Uss_Dist_Info._4_.DistForPdcLeft "" UWORD NO_COMPU_METHOD 0 0 0 65535 ECU_ADDRESS 0xA531D10A FORMAT "%.15" /end MEASUREMENT
/begin MEASUREMENT m_ussLibAdaptCtrl.ussRawInfoData.USS_Distance_Info.Uss_Dist_Info._4_.SelfTxRx "" UWORD NO_COMPU_METHOD 0 0 0 65535 ECU_ADDRESS 0xA531D108 FORMAT "%.15" /end MEASUREMENT
/begin MEASUREMENT m_ussLibAdaptCtrl.ussRawInfoData.USS_Distance_Info.Uss_Dist_Info._5_.DistForPdcLeft "" UWORD NO_COMPU_METHOD 0 0 0 65535 ECU_ADDRESS 0xA531D114 FORMAT "%.15" /end MEASUREMENT
/begin MEASUREMENT m_ussLibAdaptCtrl.ussRawInfoData.USS_Distance_Info.Uss_Dist_Info._5_.SelfTxRx "" UWORD NO_COMPU_METHOD 0 0 0 65535 ECU_ADDRESS 0xA531D112 FORMAT "%.15" /end MEASUREMENT
/begin MEASUREMENT m_ussLibAdaptCtrl.ussRawInfoData.USS_Distance_Info.Uss_Dist_Info._6_.DistForPdcLeft "" UWORD NO_COMPU_METHOD 0 0 0 65535 ECU_ADDRESS 0xA531D11E FORMAT "%.15" /end MEASUREMENT
/begin MEASUREMENT m_ussLibAdaptCtrl.ussRawInfoData.USS_Distance_Info.Uss_Dist_Info._6_.SelfTxRx "" UWORD NO_COMPU_METHOD 0 0 0 65535 ECU_ADDRESS 0xA531D11C FORMAT "%.15" /end MEASUREMENT
/begin MEASUREMENT m_ussLibAdaptCtrl.ussRawInfoData.USS_Distance_Info.Uss_Dist_Info._7_.DistForPdcLeft "" UWORD NO_COMPU_METHOD 0 0 0 65535 ECU_ADDRESS 0xA531D128 FORMAT "%.15" /end MEASUREMENT
/begin MEASUREMENT m_ussLibAdaptCtrl.ussRawInfoData.USS_Distance_Info.Uss_Dist_Info._7_.SelfTxRx "" UWORD NO_COMPU_METHOD 0 0 0 65535 ECU_ADDRESS 0xA531D126 FORMAT "%.15" /end MEASUREMENT
/begin MEASUREMENT m_ussLibAdaptCtrl.ussRawInfoData.USS_Distance_Info.Uss_Dist_Info._8_.DistForPdcLeft "" UWORD NO_COMPU_METHOD 0 0 0 65535 ECU_ADDRESS 0xA531D132 FORMAT "%.15" /end MEASUREMENT
/begin MEASUREMENT m_ussLibAdaptCtrl.ussRawInfoData.USS_Distance_Info.Uss_Dist_Info._8_.SelfTxRx "" UWORD NO_COMPU_METHOD 0 0 0 65535 ECU_ADDRESS 0xA531D130 FORMAT "%.15" /end MEASUREMENT
/begin MEASUREMENT m_ussLibAdaptCtrl.ussRawInfoData.USS_Distance_Info.Uss_Dist_Info._9_.DistForPdcLeft "" UWORD NO_COMPU_METHOD 0 0 0 65535 ECU_ADDRESS 0xA531D13C FORMAT "%.15" /end MEASUREMENT
/begin MEASUREMENT m_ussLibAdaptCtrl.ussRawInfoData.USS_Distance_Info.Uss_Dist_Info._9_.SelfTxRx "" UWORD NO_COMPU_METHOD 0 0 0 65535 ECU_ADDRESS 0xA531D13A FORMAT "%.15" /end MEASUREMENT
/begin MEASUREMENT map_trace_pos_y._39_ "" SLONG NO_COMPU_METHOD 0 0 -2147483648 2147483647 ECU_ADDRESS 0xA5333694 FORMAT "%.15" /end MEASUREMENT
/begin MEASUREMENT map_trace_pos_y._49_ "" SLONG NO_COMPU_METHOD 0 0 -2147483648 2147483647 ECU_ADDRESS 0xA53336BC FORMAT "%.15" /end MEASUREMENT
/begin MEASUREMENT map_trace_pos_y._59_ "" SLONG NO_COMPU_METHOD 0 0 -2147483648 2147483647 ECU_ADDRESS 0xA53336E4 FORMAT "%.15" /end MEASUREMENT
/begin MEASUREMENT map_trace_pos_y._69_ "" SLONG NO_COMPU_METHOD 0 0 -2147483648 2147483647 ECU_ADDRESS 0xA533370C FORMAT "%.15" /end MEASUREMENT
/begin MEASUREMENT map_trace_pos_y._79_ "" SLONG NO_COMPU_METHOD 0 0 -2147483648 2147483647 ECU_ADDRESS 0xA5333734 FORMAT "%.15" /end MEASUREMENT
/begin MEASUREMENT trajectory_point_num_XCP "" SLONG NO_COMPU_METHOD 0 0 -2147483648 2147483647 ECU_ADDRESS 0xA5529784 FORMAT "%.15" /end MEASUREMENT
/begin COMPU_METHOD APSModuleCurrentStatus.CONVERSION "" TAB_VERB "%.0" "" COMPU_TAB_REF APSModuleCurrentStatus.CONVERSION /end COMPU_METHOD
/begin COMPU_METHOD APSModuleCurrentStatus_Match_ALG.CONVERSION "" TAB_VERB "%.0" "" COMPU_TAB_REF APSModuleCurrentStatus_Match_ALG.CONVERSION /end COMPU_METHOD
/begin COMPU_METHOD HPAModuleCurrentStatus_Match_ALG.CONVERSION "" TAB_VERB "%.0" "" COMPU_TAB_REF HPAModuleCurrentStatus_Match_ALG.CONVERSION /end COMPU_METHOD
/begin COMPU_METHOD HPA_Parking_Info.HPAHandShakeStatus.CONVERSION "" TAB_VERB "%.0" "" COMPU_TAB_REF HPA_Parking_Info.HPAHandShakeStatus.CONVERSION /end COMPU_METHOD
/begin COMPU_METHOD HandShakeStatus.CONVERSION "" TAB_VERB "%.0" "" COMPU_TAB_REF HandShakeStatus.CONVERSION /end COMPU_METHOD
/begin COMPU_VTAB_RANGE APSModuleCurrentStatus.CONVERSION "" 8 0 0 "APS_PARKING_OFF" 1 1 "APS_PARKING_INIT" 2 2 "APS_PARKING_SEARCH" 3 3 "APS_PARKING_ACTIVE" 4 4 "APS_PARKING_COMPLETE" 5 5 "APS_PARKING_FAILURE" 6 6 "APS_PARKING_SUSPEND" 7 7 "APS_STATUS_MAX" DEFAULT_VALUE "" /end COMPU_VTAB_RANGE
/begin COMPU_VTAB_RANGE APSModuleCurrentStatus_Match_ALG.CONVERSION "" 8 0 0 "APS_PARKING_OFF" 1 1 "APS_PARKING_INIT" 2 2 "APS_PARKING_SEARCH" 3 3 "APS_PARKING_ACTIVE" 4 4 "APS_PARKING_COMPLETE" 5 5 "APS_PARKING_FAILURE" 6 6 "APS_PARKING_SUSPEND" 7 7 "APS_STATUS_MAX" DEFAULT_VALUE "" /end COMPU_VTAB_RANGE
/begin COMPU_VTAB_RANGE HPAModuleCurrentStatus_Match_ALG.CONVERSION "" 12 0 0 "ALG_HomePrkgSysSts_Off" 1 1 "ALG_HomePrkgSysSts_Standby" 2 2 "ALG_HomePrkgSysSts_Suspend" 3 3 "ALG_HomePrkgSysSts_Abort" 4 4 "ALG_HomePrkgSysSts_MapBuilding" 5 5 "ALG_HomePrkgSysSts_Localization" 6 6 "ALG_HomePrkgSysSts_Cruse" 7 7 "ALG_HomePrkgSysSts_ParkingInPreactive" 8 8 "ALG_HomePrkgSysSts_ParkingInProcess" 9 9 "ALG_HomePrkgSysSts_ParkingOutPreactive" 10 10 "ALG_HomePrkgSysSts_ParkingOutProcess" 11 11 "ALG_HomePrkgSysSts_FunctionCompleted" DEFAULT_VALUE "" /end COMPU_VTAB_RANGE
/begin COMPU_VTAB_RANGE HPA_Parking_Info.HPAHandShakeStatus.CONVERSION "" 4 0 0 "HK_Init" 1 1 "HK_Start" 2 2 "HK_Control" 3 3 "HK_End" DEFAULT_VALUE "" /end COMPU_VTAB_RANGE
/begin COMPU_VTAB_RANGE HandShakeStatus.CONVERSION "" 4 0 0 "APS_PARKING_HK_INVALID" 1 1 "APS_PARKING_HK_START" 2 2 "APS_PARKING_HK_CONTROL" 3 3 "APS_PARKING_HK_END" DEFAULT_VALUE "" /end COMPU_VTAB_RANGE
/begin RECORD_LAYOUT SSV__A_INT64_S AXIS_PTS_X 1 A_INT64 INDEX_INCR DIRECT /end RECORD_LAYOUT
/begin RECORD_LAYOUT SSV__A_UINT64_S AXIS_PTS_X 1 A_UINT64 INDEX_INCR DIRECT /end RECORD_LAYOUT
/begin RECORD_LAYOUT SSV__FLOAT32_IEEE_S AXIS_PTS_X 1 FLOAT32_IEEE INDEX_INCR DIRECT /end RECORD_LAYOUT
/begin RECORD_LAYOUT SSV__FLOAT64_IEEE_S AXIS_PTS_X 1 FLOAT64_IEEE INDEX_INCR DIRECT /end RECORD_LAYOUT
/begin RECORD_LAYOUT SSV__SBYTE_S AXIS_PTS_X 1 SBYTE INDEX_INCR DIRECT /end RECORD_LAYOUT
/begin RECORD_LAYOUT SSV__SLONG_S AXIS_PTS_X 1 SLONG INDEX_INCR DIRECT /end RECORD_LAYOUT
/begin RECORD_LAYOUT SSV__SWORD_S AXIS_PTS_X 1 SWORD INDEX_INCR DIRECT /end RECORD_LAYOUT
/begin RECORD_LAYOUT SSV__UBYTE_S AXIS_PTS_X 1 UBYTE INDEX_INCR DIRECT /end RECORD_LAYOUT
/begin RECORD_LAYOUT SSV__ULONG_S AXIS_PTS_X 1 ULONG INDEX_INCR DIRECT /end RECORD_LAYOUT
/begin RECORD_LAYOUT SSV__UWORD_S AXIS_PTS_X 1 UWORD INDEX_INCR DIRECT /end RECORD_LAYOUT
/begin RECORD_LAYOUT __A_INT64_S FNC_VALUES 1 A_INT64 COLUMN_DIR DIRECT /end RECORD_LAYOUT
/begin RECORD_LAYOUT __A_INT64_Z FNC_VALUES 1 A_INT64 ROW_DIR DIRECT /end RECORD_LAYOUT
/begin RECORD_LAYOUT __A_UINT64_S FNC_VALUES 1 A_UINT64 COLUMN_DIR DIRECT /end RECORD_LAYOUT
/begin RECORD_LAYOUT __A_UINT64_Z FNC_VALUES 1 A_UINT64 ROW_DIR DIRECT /end RECORD_LAYOUT
/begin RECORD_LAYOUT __FLOAT32_IEEE_S FNC_VALUES 1 FLOAT32_IEEE COLUMN_DIR DIRECT /end RECORD_LAYOUT
/begin RECORD_LAYOUT __FLOAT32_IEEE_Z FNC_VALUES 1 FLOAT32_IEEE ROW_DIR DIRECT /end RECORD_LAYOUT
/begin RECORD_LAYOUT __FLOAT64_IEEE_S FNC_VALUES 1 FLOAT64_IEEE COLUMN_DIR DIRECT /end RECORD_LAYOUT
/begin RECORD_LAYOUT __FLOAT64_IEEE_Z FNC_VALUES 1 FLOAT64_IEEE ROW_DIR DIRECT /end RECORD_LAYOUT
/begin RECORD_LAYOUT __SBYTE_S FNC_VALUES 1 SBYTE COLUMN_DIR DIRECT /end RECORD_LAYOUT
/begin RECORD_LAYOUT __SBYTE_Z FNC_VALUES 1 SBYTE ROW_DIR DIRECT /end RECORD_LAYOUT
/begin RECORD_LAYOUT __SLONG_S FNC_VALUES 1 SLONG COLUMN_DIR DIRECT /end RECORD_LAYOUT
/begin RECORD_LAYOUT __SLONG_Z FNC_VALUES 1 SLONG ROW_DIR DIRECT /end RECORD_LAYOUT
/begin RECORD_LAYOUT __SWORD_S FNC_VALUES 1 SWORD COLUMN_DIR DIRECT /end RECORD_LAYOUT
/begin RECORD_LAYOUT __SWORD_Z FNC_VALUES 1 SWORD ROW_DIR DIRECT /end RECORD_LAYOUT
/begin RECORD_LAYOUT __UBYTE_S FNC_VALUES 1 UBYTE COLUMN_DIR DIRECT /end RECORD_LAYOUT
/begin RECORD_LAYOUT __UBYTE_Z FNC_VALUES 1 UBYTE ROW_DIR DIRECT /end RECORD_LAYOUT
/begin RECORD_LAYOUT __ULONG_S FNC_VALUES 1 ULONG COLUMN_DIR DIRECT /end RECORD_LAYOUT
/begin RECORD_LAYOUT __ULONG_Z FNC_VALUES 1 ULONG ROW_DIR DIRECT /end RECORD_LAYOUT
/begin RECORD_LAYOUT __UWORD_S FNC_VALUES 1 UWORD COLUMN_DIR DIRECT /end RECORD_LAYOUT
/begin RECORD_LAYOUT __UWORD_Z FNC_VALUES 1 UWORD ROW_DIR DIRECT /end RECORD_LAYOUT
/end MODULE
/end PROJECT
