/*@!Encoding:936*/
includes
{
  
}

variables
{
  int Handshake_flag=0;
  int Completed_flag=0;
  msTimer timer_JudgeCurrentGear;
  char CurrentGear[37]="Parking Completed,Not return to P !!";
}
on start
{
  $EPS_APA_SystemStatus=2;
  setControlVisibility("ParkingTerminal","CurrentGear",0);
}

on signal AVM_APA_TerminatedType
{
  //不可恢复中断20180605
  if(($AVM_APA_AbortReason || $AVM_APA_OverrideReason)!=0 )
  {
    $ESC_VehicleSpeed=0;
    $ESC_Vehiclestandstill=1;
    write("EPS:avm terminal,abort or override !!");
  }
  //可恢复中断
  else if($AVM_APA_AbortReason==0 && $AVM_APA_SuspendedReason!=0 && $AVM_APA_OverrideReason==0)
  {
    $ESC_VehicleSpeed=0;
    $ESC_Vehiclestandstill=1;
    write("EPS:terminal,suspended,pause");
  }
}
 
on signal DrvrAsscSysSts
{
  if($DrvrAsscSysSts==5)   //parking complete
  {
    $ESC_APA_Available=1;
    $ESC_APA_CDD_available=1;
    Completed_flag=1;
    write("EPS:parking complete");
    setTimer(timer_JudgeCurrentGear,200);
  }
  else if($DrvrAsscSysSts==1 && Completed_flag==1)
  {
    Completed_flag=0;
  }
}
 on timer timer_JudgeCurrentGear
{
  deleteControlContent("ParkingTerminal","CurrentGear");
  if($AVM_APA_GearRequest==1)//P
  {
    setControlVisibility("ParkingTerminal","CurrentGear",0);
  }
  else
  {
    setControlVisibility("ParkingTerminal","CurrentGear",1);
    putValueToControl("ParkingTerminal","CurrentGear",CurrentGear);
  }
}

//******************************Exit handshake*********************//
on signal AVM_APA_EPS_Control_Request
{
  if($AVM_APA_EPS_Control_Request==2)
  {
    Handshake_flag=1;
  }
  else if(this == 0 && Handshake_flag==1 )//EXIT HANDSHAKE
  {
    $EPS_APA_SystemStatus = 2;//OPEN
    $ESC_APA_Active=0;
    $ESC_APA_CDD_active=0;
    write("EPS:EXIT HANDSHAKE");
  }
}
//************************End************************************//

//***************************Handshaking************************//
on signal_update AVM_APA_VLCModeReq
{
  if($AVM_APA_VLCModeReq==3 && $AVM_APA_EPS_Control_Request==2 && $ESC_APA_Active==0 && $ESC_APA_CDD_active==0)
  {
    $ESC_APA_Available=1;
    $ESC_APA_Active = 1;
    $ESC_APA_CDD_active=1;
    $ESC_APA_CDD_available=1;
    $SAS_SteerWheelAngle=0;
    $EPS_APA_SystemStatus = 3;
    write("EPS:eps and esc active");
  }
}
//AVM_APA_VLCModeReq==3 --on;AVM_APA_VLCModeReq==4 --brake only,减速;AVM_APA_VLCModeReq==6 --standstill
//目前软件在中断后倒计时结束，会从6跳变到3再回到0
//****************************End*********************************//