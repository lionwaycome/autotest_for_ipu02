/*@!Encoding:936*/
variables
{
  const long L = 50;
  const long W = 18;
  //以下为目前项目所支持的指�?
  byte Nor_Data[L][W]           =   {{0xFF,0x01,0xFF,0xFF},
                                     {0xFF,0x02,0xFF,0xFF},
                                     {0xFF,0x03,0xFF,0xFF},
                                     {0xFF,0x05,0xFF,0xFF},
                                     {0xFF,0x30,0xFF,0xFF},
                                     {0xFF,0x32,0xFF,0xFF},
                                     {0xFF,0x33,0xFF,0xFF},
                                     {0xFF,0x34,0xFF,0xFF,0x30,0x31,0x32,0x33,0x34,0x35,0x36,0x37,0x38,0x39,0x3A,0x3B,0x3C,0x3D},
                                     {0xFF,0x35,0xFF,0xFF},
                                     {0xFF,0x36,0xFF,0xFF},
                                     {0xFF,0x37,0xFF,0xFF},
                                     {0xFF,0x38,0xFF,0xFF,0x1A,0x2B},
                                     {0xFF,0x39,0xFF,0xFF},
                                     {0xFF,0x3A,0xFF,0xFF},
                                     {0xFF,0x3B,0xFF,0xFF},
                                     {0xFF,0x3C,0xFF,0xFF},
                                     {0xFF,0x3D,0xFF,0xFF},
                                     {0xFF,0x51,0xFF,0xFF,0x01},
                                     {0xFF,0x52,0xFF,0xFF,0x01},
                                     {0xFF,0x55,0xFF,0xFF,0x01},
                                     {0xFF,0x56,0xFF,0xFF,0x01,0x01},
                                     {0xFF,0x57,0xFF,0xFF},
                                     {0xFF,0x60,0xFF,0xFF},
                                     {0xFF,0x61,0xFF,0xFF},
                                     {0xFF,0x65,0xFF,0xFF},
                                     {0xFF,0x66,0xFF,0xFF,0x20,0x18,0x12,0x06},
                                     {0xFF,0x67,0xFF,0xFF},
                                     {0xFF,0x71,0xFF,0xFF,0x20,0x18,0x12,0x06},
                                     {0xFF,0x72,0xFF,0xFF},
                                     {0xFF,0x85,0xFF,0xFF},
                                     {0xFF,0x86,0xFF,0xFF,0x01},
                                     {0xFF,0x87,0xFF,0xFF,0x01},
                                     {0xFF,0x88,0xFF,0xFF,0x01},
                                     {0xFF,0x89,0xFF,0xFF,0x01},
                                     {0xFF,0x90,0xFF,0xFF},
                                     {0xFF,0x91,0xFF,0xFF}
                                     };
}

