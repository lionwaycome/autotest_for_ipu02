/*@!Encoding:936*/
variables
{
  const int A = 100;
  const int B = 23;
  const int ProjSize = 5;
  //以下变量为项目提示变量，再启用节点时会在Write窗口打印出对应的项目名称，需要手动修�?
  char ProjName[ProjSize] = "SX11";
  byte AT_ENTER[ 6 ]     =  {0x05,0xFF,0x01,0xFF,0xFF,0xFB};
  //以下为自动运行指令，根据项目进行对应修改，无需手动添加指令长度和CheckSum，指令可在Nor_Data.cin文件中Nor_Data[L][W]复制过来，再对有Data的指令添加Data值即�?
  byte AT_SEND[ A ][ B ] = { {0xFF,0x30,0xFF,0xFF}
                            ,{0xFF,0x32,0xFF,0xFF}
                            ,{0xFF,0x33,0xFF,0xFF}
                            ,{0xFF,0x34,0xFF,0xFF,0x30,0x31,0x32,0x33,0x34,0x35,0x36,0x37,0x38,0x39,0x3A,0x3B,0x3C,0x3D}
                            ,{0xFF,0x35,0xFF,0xFF}
                            ,{0xFF,0x36,0xFF,0xFF}
                            ,{0xFF,0x37,0xFF,0xFF}
                            ,{0xFF,0x36,0xFF,0xFF}
                            ,{0xFF,0x38,0xFF,0xFF,0x1A,0x2B}
                            ,{0xFF,0x39,0xFF,0xFF}
                            ,{0xFF,0x51,0xFF,0xFF,0x01}
                            ,{0xFF,0x52,0xFF,0xFF,0x01}
                            ,{0xFF,0x52,0xFF,0xFF,0x00}
                            ,{0xFF,0x55,0xFF,0xFF,0x01}
                            ,{0xFF,0x55,0xFF,0xFF,0x03}
                            ,{0xFF,0x55,0xFF,0xFF,0x04}
                            ,{0xFF,0x55,0xFF,0xFF,0x02}
                            ,{0xFF,0x55,0xFF,0xFF,0x00}
                            ,{0xFF,0x51,0xFF,0xFF,0x00}
                            ,{0xFF,0x60,0xFF,0xFF}
                            ,{0xFF,0x61,0xFF,0xFF}
                            ,{0xFF,0x57,0xFF,0xFF}
                            ,{0xFF,0x65,0xFF,0xFF}
                            ,{0xFF,0x66,0xFF,0xFF,0x20,0x18,0x06,0x23}
                            ,{0xFF,0x67,0xFF,0xFF}
    						            ,{0xFF,0x56,0xFF,0xFF,0x01,0x01}
                            ,{0xFF,0x05,0xFF,0xFF}
                            };
}