/*@!Encoding:936*/
variables
{
  char DBC[8]                 = "DBC.txt";
}

