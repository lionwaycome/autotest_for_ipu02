VERSION "SafetyCANFD4"

NS_ :

BS_:

BU_: ASDM ETC PAS Vector_XXX

BO_ 101 ASDMSafetyCANFD4Fr01: 64 ASDM
 SG_ AbsCtrlActv_UB : 10|1@0+ (1,0) [0|1] ""  PAS
 SG_ AbsCtrlActvChks : 7|8@0+ (1,0) [0|255] "Unitless"  PAS
 SG_ AbsCtrlActvCntr : 15|4@0+ (1,0) [0|15] "Unitless"  PAS
 SG_ AbsCtrlActvCtrlSts1 : 11|1@0+ (1,0) [0|1] ""  PAS
 SG_ AccrPedlPsd_UB : 25|1@0+ (1,0) [0|1] ""  PAS
 SG_ AccrPedlPsdAccrPedlPsd : 27|1@0+ (1,0) [0|1] ""  PAS
 SG_ AccrPedlPsdChks : 23|8@0+ (1,0) [0|255] "Unitless"  PAS
 SG_ AccrPedlPsdCntr : 31|4@0+ (1,0) [0|15] "Unitless"  PAS
 SG_ AccrPedlPsdSts : 26|1@0+ (1,0) [0|1] ""  PAS
 SG_ AccrPedlRat_UB : 39|1@0+ (1,0) [0|1] ""  PAS
 SG_ AccrPedlRatAccrPedlRat : 38|15@0+ (0.00390625,0) [0|100] "%"  PAS
 SG_ AccrPedlRatChks : 55|8@0+ (1,0) [0|255] "Unitless"  PAS
 SG_ AccrPedlRatCntr : 63|4@0+ (1,0) [0|15] "Unitless"  PAS
 SG_ AccrpedlSts : 9|1@0+ (1,0) [0|1] ""  PAS
 SG_ AccrpedlSts_UB : 8|1@0+ (1,0) [0|1] ""  PAS
 SG_ BltLockStSafeAtDrvr_UB : 70|1@0+ (1,0) [0|1] ""  PAS
 SG_ BltLockStSafeAtDrvrBltLockSt1 : 69|1@0+ (1,0) [0|1] ""  PAS
 SG_ BltLockStSafeAtDrvrBltLockStErrS : 68|1@0+ (1,0) [0|1] ""  PAS
 SG_ BltLockStSafeAtDrvrChks : 79|8@0+ (1,0) [0|255] "Unitless"  PAS
 SG_ BltLockStSafeAtDrvrCntr : 67|4@0+ (1,0) [0|15] "Unitless"  PAS
 SG_ EngSt1WdSts_UB : 71|1@0+ (1,0) [0|1] ""  PAS
 SG_ EngSt1WdStsChks : 87|8@0+ (1,0) [0|255] "Unitless"  PAS
 SG_ EngSt1WdStsCntr : 95|4@0+ (1,0) [0|15] "Unitless"  PAS
 SG_ EngSt1WdStsEngSt1WdSts : 91|4@0+ (1,0) [0|15] ""  PAS
 SG_ EscSt_UB : 167|1@0+ (1,0) [0|1] ""  PAS
 SG_ EscStChks : 175|8@0+ (1,0) [0|255] "Unitless"  PAS
 SG_ EscStCntr : 163|4@0+ (1,0) [0|15] "Unitless"  PAS
 SG_ EscStEscSt : 166|3@0+ (1,0) [0|7] ""  PAS
 SG_ GuestrSts_UB : 354|1@0+ (1,0) [0|1] ""  PAS
 SG_ GuestrStsChks : 351|8@0+ (1,0) [0|255] "Unitless"  PAS
 SG_ GuestrStsCntr : 359|4@0+ (1,0) [0|15] "Unitless"  PAS
 SG_ GuestrStsValidity : 355|1@0+ (1,0) [0|1] ""  PAS
 SG_ PinionSteerAgGroup_UB : 153|1@0+ (1,0) [0|1] ""  Vector_XXX
 SG_ PinionSteerAgGroupChks : 103|8@0+ (1,0) [0|255] "Unitless"  Vector_XXX
 SG_ PinionSteerAgGroupCntr : 159|4@0+ (1,0) [0|15] "Unitless"  Vector_XXX
 SG_ PinionSteerAgGroupPinionSteerAg1 : 142|15@0- (0.0009765625,0) [-14.5|14.5] "rad"  Vector_XXX
 SG_ PinionSteerAgGroupPinionSte_0000 : 111|2@0+ (1,0) [0|3] ""  Vector_XXX
 SG_ PinionSteerAgGroupPinionSteerAgS : 109|14@0- (0.0078125,0) [-50|50] "rad/s"  Vector_XXX
 SG_ PinionSteerAgGroupPinionSte_0001 : 127|2@0+ (1,0) [0|3] ""  Vector_XXX
 SG_ PinionSteerAgGroupSteerWhlTq : 125|14@0- (0.00390625,0) [-30|30] "NewtonMeter"  Vector_XXX
 SG_ PinionSteerAgGroupSteerWhlTqQf : 155|2@0+ (1,0) [0|3] ""  Vector_XXX
 SG_ PosnFromSatlt1_UB : 416|1@0+ (1,0) [0|1] ""  PAS
 SG_ PosnFromSatlt1Cntr : 431|3@0+ (1,0) [0|7] "Unitless"  PAS
 SG_ PosnFromSatlt1PosnLat : 367|30@0- (2.77778E-007,0) [-90.000072|90.000072] "Deg"  PAS
 SG_ PosnFromSatlt1PosnLgt : 399|31@0- (2.77778E-007,0) [-180.000144|180.000144] "Deg"  PAS
 SG_ PosnFromSatlt2_UB : 440|1@0+ (1,0) [0|1] ""  PAS
 SG_ PosnFromSatlt2Cntr : 443|3@0+ (1,0) [0|7] "Unitless"  PAS
 SG_ PosnFromSatlt2PosnSpdosn : 428|17@0+ (0.001,0) [0|100] "m/s"  PAS
 SG_ PosnFromSatlt3_UB : 510|1@0+ (1,0) [0|1] ""  PAS
 SG_ PosnFromSatlt3Cntr : 497|3@0+ (1,0) [0|7] "Unitless"  PAS
 SG_ PosnFromSatlt3PosnAlti : 455|16@0+ (0.1,-100) [-100|6000] "m"  PAS
 SG_ PosnFromSatlt3PosnDir : 471|16@0+ (0.01,0) [0|359.99] "Deg"  PAS
 SG_ PosnFromSatlt3TiForMins : 487|6@0+ (1,0) [0|59] "Mins"  PAS
 SG_ PosnFromSatlt3TiForMsec : 481|10@0+ (1,0) [0|1023] "Unitless"  PAS
 SG_ PosnFromSatlt3TiForSec : 503|6@0+ (1,0) [0|59] "s"  PAS
 SG_ PrkLatLgtFailr_UB : 223|1@0+ (1,0) [0|1] ""  PAS
 SG_ PrkLatLgtFailrChks : 231|8@0+ (1,0) [0|255] "Unitless"  PAS
 SG_ PrkLatLgtFailrCntr : 219|4@0+ (1,0) [0|15] "Unitless"  PAS
 SG_ PrkLatLgtFailrPrkLatLgtFailr : 222|3@0+ (1,0) [0|7] ""  PAS
 SG_ SwtIndcr_UB : 238|1@0+ (1,0) [0|1] ""  PAS
 SG_ SwtIndcrIndcrTypExtReq : 237|2@0+ (1,0) [0|3] ""  PAS
 SG_ SwtIndcrIndcrTypExtReqChks : 247|8@0+ (1,0) [0|255] "Unitless"  PAS
 SG_ SwtIndcrIndcrTypExtReqCntr : 235|2@0+ (1,0) [0|3] "Unitless"  PAS
 SG_ SwtIndcrIndcrTypExtReqToUpdQf : 233|2@0+ (1,0) [0|3] ""  PAS
 SG_ TrsmParkLockd_UB : 198|1@0+ (1,0) [0|1] ""  PAS
 SG_ TrsmParkLockdChks : 207|8@0+ (1,0) [0|255] "Unitless"  PAS
 SG_ TrsmParkLockdCntr : 195|4@0+ (1,0) [0|15] "Unitless"  PAS
 SG_ TrsmParkLockdTrsmParkLockd : 197|2@0+ (1,0) [0|3] ""  PAS
 SG_ VehMtnSt_UB : 255|1@0+ (1,0) [0|1] ""  PAS
 SG_ VehMtnStChks : 263|8@0+ (1,0) [0|255] "Unitless"  PAS
 SG_ VehMtnStCntr : 254|4@0+ (1,0) [0|15] "Unitless"  PAS
 SG_ VehMtnStVehMtnSt : 250|3@0+ (1,0) [0|7] ""  PAS
 SG_ VehSpdLgt_UB : 271|1@0+ (1,0) [0|1] ""  PAS
 SG_ VehSpdLgtA : 270|15@0+ (0.00391,0) [0|125.0027] "m/s"  PAS
 SG_ VehSpdLgtChks : 287|8@0+ (1,0) [0|255] "Unitless"  PAS
 SG_ VehSpdLgtCntr : 295|4@0+ (1,0) [0|15] "Unitless"  PAS
 SG_ VehSpdLgtQf : 291|2@0+ (1,0) [0|3] ""  PAS
 SG_ VehTiAndData_UB : 303|1@0+ (1,0) [0|1] ""  PAS
 SG_ VehTiAndDataDataValid : 302|1@0+ (1,0) [0|1] ""  PAS
 SG_ VehTiAndDataDay : 324|5@0+ (1,0) [1|31] "Days"  PAS
 SG_ VehTiAndDataHr1 : 316|5@0+ (1,0) [0|23] "hours"  PAS
 SG_ VehTiAndDataMins1 : 309|6@0+ (1,0) [0|59] "Mins"  PAS
 SG_ VehTiAndDataMth1 : 331|4@0+ (1,0) [1|12] "Month"  PAS
 SG_ VehTiAndDataSec1 : 301|6@0+ (1,0) [0|59] "s"  PAS
 SG_ VehTiAndDataYr1 : 342|7@0+ (1,0) [0|99] "Year"  PAS

BO_ 105 ASDMSafetyCANFD4Fr02: 64 ASDM
 SG_ AsyADL3FuncCtrlSts_UB : 16|1@0+ (1,0) [0|1] ""  PAS
 SG_ AsyADL3FuncCtrlStsADMod : 23|2@0+ (1,0) [0|3] ""  PAS
 SG_ AsyADL3FuncCtrlStsChks : 7|8@0+ (1,0) [0|255] "Unitless"  PAS
 SG_ AsyADL3FuncCtrlStsCntr : 15|4@0+ (1,0) [0|15] "Unitless"  PAS
 SG_ AsyADL3FuncCtrlStsCtrlSts : 21|1@0+ (1,0) [0|1] ""  PAS
 SG_ AsyADL3FuncCtrlStsDegraded : 11|4@0+ (1,0) [0|15] "Unitless"  PAS
 SG_ AsyADL3FuncCtrlStsQf : 20|2@0+ (1,0) [0|3] ""  PAS
 SG_ AsyADL3FuncCtrlStsSts : 18|2@0+ (1,0) [0|3] ""  PAS
 SG_ AsyALgtCtrlMod_UB : 47|1@0+ (1,0) [0|1] ""  PAS
 SG_ AsyALgtCtrlMod1 : 35|4@0+ (1,0) [0|15] ""  PAS
 SG_ AsyALgtCtrlModCfmd_UB : 40|1@0+ (1,0) [0|1] ""  PAS
 SG_ AsyALgtCtrlModCfmdAsyALgtCtrlMod : 59|4@0+ (1,0) [0|15] ""  PAS
 SG_ AsyALgtCtrlModCfmdChks : 55|8@0+ (1,0) [0|255] "Unitless"  PAS
 SG_ AsyALgtCtrlModCfmdCntr : 63|4@0+ (1,0) [0|15] "Unitless"  PAS
 SG_ AsyALgtCtrlModChks : 31|8@0+ (1,0) [0|255] "Unitless"  PAS
 SG_ AsyALgtCtrlModCntr : 39|4@0+ (1,0) [0|15] "Unitless"  PAS
 SG_ AsyALgtSts_UB : 41|1@0+ (1,0) [0|1] ""  PAS
 SG_ AsyALgtStsAsyALgtSts : 75|4@0+ (1,0) [0|15] ""  PAS
 SG_ AsyALgtStsChks : 71|8@0+ (1,0) [0|255] "Unitless"  PAS
 SG_ AsyALgtStsCntr : 79|4@0+ (1,0) [0|15] "Unitless"  PAS
 SG_ AsyLatCtrlModReqGroup_UB : 42|1@0+ (1,0) [0|1] ""  PAS
 SG_ AsyLatCtrlModReqGroupAsyLatCtrlM : 91|4@0+ (1,0) [0|15] ""  PAS
 SG_ AsyLatCtrlModReqGroupCfmd_UB : 43|1@0+ (1,0) [0|1] ""  PAS
 SG_ AsyLatCtrlModReqGroupCfmdChks : 103|8@0+ (1,0) [0|255] "Unitless"  PAS
 SG_ AsyLatCtrlModReqGroupCfmdCntr : 111|4@0+ (1,0) [0|15] "Unitless"  PAS
 SG_ AsyLatCtrlModReqGroupCfmdLatCtrl : 107|4@0+ (1,0) [0|15] ""  PAS
 SG_ AsyLatCtrlModReqGroupChks : 87|8@0+ (1,0) [0|255] "Unitless"  PAS
 SG_ AsyLatCtrlModReqGroupCntr : 95|4@0+ (1,0) [0|15] "Unitless"  PAS
 SG_ BiasedPosnFromSatlt1_UB : 352|1@0+ (1,0) [0|1] ""  PAS
 SG_ BiasedPosnFromSatlt1Cntr : 399|3@0+ (1,0) [0|7] "Unitless"  PAS
 SG_ BiasedPosnFromSatlt1PosnLat : 335|30@0- (2.77778E-007,0) [-90.000072|90.000072] "Deg"  PAS
 SG_ BiasedPosnFromSatlt1PosnLgt : 367|31@0- (2.77778E-007,0) [-180.000144|180.000144] "Deg"  PAS
 SG_ BrkHptcWarnReqForAutDrv_UB : 121|1@0+ (1,0) [0|1] ""  PAS
 SG_ BrkHptcWarnReqForAutDrvBrkHptcWa : 123|2@0+ (1,0) [0|3] ""  PAS
 SG_ BrkHptcWarnReqForAutDrvChks : 119|8@0+ (1,0) [0|255] "Unitless"  PAS
 SG_ BrkHptcWarnReqForAutDrvCntr : 127|4@0+ (1,0) [0|15] "Unitless"  PAS
 SG_ BrkPedlPsd_UB : 120|1@0+ (1,0) [0|1] ""  PAS
 SG_ BrkPedlPsdBrkPedlNotPsdSafe : 135|1@0+ (1,0) [0|1] ""  PAS
 SG_ BrkPedlPsdBrkPedlPsd : 134|1@0+ (1,0) [0|1] ""  PAS
 SG_ BrkPedlPsdChks : 143|8@0+ (1,0) [0|255] "Unitless"  PAS
 SG_ BrkPedlPsdCntr : 131|4@0+ (1,0) [0|15] "Unitless"  PAS
 SG_ BrkPedlPsdQf : 133|2@0+ (1,0) [0|3] ""  PAS
 SG_ DrvrAsscSysBtnPush : 396|4@0+ (1,0) [0|15] ""  PAS
 SG_ DrvrAsscSysBtnPush_UB : 392|1@0+ (1,0) [0|1] ""  PAS
 SG_ EpbSts_UB : 304|1@0+ (1,0) [0|1] ""  PAS
 SG_ EpbStsChks : 319|8@0+ (1,0) [0|255] "Unitless"  PAS
 SG_ EpbStsCntr : 323|4@0+ (1,0) [0|15] "Unitless"  PAS
 SG_ EpbStsEpbSts : 327|4@0+ (1,0) [0|15] ""  PAS
 SG_ EscCtrlIndcn : 295|2@0+ (1,0) [0|3] ""  PAS
 SG_ EscCtrlIndcn_UB : 293|1@0+ (1,0) [0|1] ""  PAS
 SG_ FctaIndcnLe : 165|2@0+ (1,0) [0|3] ""  PAS
 SG_ FctaIndcnLe_UB : 161|1@0+ (1,0) [0|1] ""  PAS
 SG_ FctaIndcnRi : 163|2@0+ (1,0) [0|3] ""  PAS
 SG_ FctaIndcnRi_UB : 160|1@0+ (1,0) [0|1] ""  PAS
 SG_ GearLvrIndcn : 292|3@0+ (1,0) [0|7] ""  PAS
 SG_ GearLvrIndcn_UB : 289|1@0+ (1,0) [0|1] ""  PAS
 SG_ MobDevRPAAuthResp_UB : 421|1@0+ (1,0) [0|1] ""  PAS
 SG_ MobDevRPAAuthRespAnswer : 416|9@0+ (1,0) [0|511] "Unitless"  PAS
 SG_ MobDevRPAAuthRespChks : 455|8@0+ (1,0) [0|255] "Unitless"  PAS
 SG_ MobDevRPAAuthRespCntr : 420|4@0+ (1,0) [0|15] "Unitless"  PAS
 SG_ MobDevRPAAuthRespX : 439|8@0+ (1,0) [0|255] "Unitless"  PAS
 SG_ MobDevRPAAuthRespY : 447|8@0+ (1,0) [0|255] "Unitless"  PAS
 SG_ MsgReqByHillDwnCtrl : 311|3@0+ (1,0) [0|7] ""  PAS
 SG_ MsgReqByHillDwnCtrl_UB : 308|1@0+ (1,0) [0|1] ""  PAS
 SG_ PdcMuteBtnReq : 307|2@0+ (1,0) [0|3] ""  PAS
 SG_ PdcMuteBtnReq_UB : 305|1@0+ (1,0) [0|1] ""  PAS
 SG_ RctaBrkReq_UB : 154|1@0+ (1,0) [0|1] ""  PAS
 SG_ RctaBrkReqChks : 151|8@0+ (1,0) [0|255] "Unitless"  PAS
 SG_ RctaBrkReqCntr : 159|4@0+ (1,0) [0|15] "Unitless"  PAS
 SG_ RctaBrkReqRctaBrkReq : 155|1@0+ (1,0) [0|1] ""  PAS
 SG_ RctaIndcnLe : 167|2@0+ (1,0) [0|3] ""  PAS
 SG_ RctaIndcnLe_UB : 175|1@0+ (1,0) [0|1] ""  PAS
 SG_ RctaIndcnRi : 174|2@0+ (1,0) [0|3] ""  PAS
 SG_ RctaIndcnRi_UB : 172|1@0+ (1,0) [0|1] ""  PAS
 SG_ RcwmBrkReq_UB : 186|1@0+ (1,0) [0|1] ""  PAS
 SG_ RcwmBrkReqChks : 183|8@0+ (1,0) [0|255] "Unitless"  PAS
 SG_ RcwmBrkReqCntr : 191|4@0+ (1,0) [0|15] "Unitless"  PAS
 SG_ RcwmBrkReqRcwmBrkReq : 187|1@0+ (1,0) [0|1] ""  PAS
 SG_ RoadIncln_UB : 213|1@0+ (1,0) [0|1] ""  PAS
 SG_ RoadInclnQly : 215|2@0+ (1,0) [0|3] ""  PAS
 SG_ RoadInclnRoadIncln : 199|16@0- (3.0518E-005,0) [-0.999983306|0.999983306] "rad"  PAS
 SG_ SftyDecelGroupSafe_UB : 234|1@0+ (1,0) [0|1] ""  PAS
 SG_ SftyDecelGroupSafeAsySftyDecelRe : 231|8@0+ (0.1,0) [0|15] "m/s^2"  PAS
 SG_ SftyDecelGroupSafeAsySftyEnaDece : 235|1@0+ (1,0) [0|1] ""  PAS
 SG_ SftyDecelGroupSafeChks : 223|8@0+ (1,0) [0|255] "Unitless"  PAS
 SG_ SftyDecelGroupSafeCntr : 239|4@0+ (1,0) [0|15] "Unitless"  PAS
 SG_ VehModMngtGlbSafe1_UB : 280|1@0+ (1,0) [0|1] ""  PAS
 SG_ VehModMngtGlbSafe1CarModSts1 : 287|3@0+ (1,0) [0|7] ""  PAS
 SG_ VehModMngtGlbSafe1CarModSubtypWd : 284|3@0+ (1,0) [0|7] "Unitless"  PAS
 SG_ VehModMngtGlbSafe1Chks : 255|8@0+ (1,0) [0|255] "Unitless"  PAS
 SG_ VehModMngtGlbSafe1Cntr : 263|4@0+ (1,0) [0|15] "Unitless"  PAS
 SG_ VehModMngtGlbSafe1EgyLvlElecMai : 259|4@0+ (1,0) [0|15] "Unitless"  PAS
 SG_ VehModMngtGlbSafe1EgyLvlElecSubt : 271|4@0+ (1,0) [0|15] "Unitless"  PAS
 SG_ VehModMngtGlbSafe1FltEgyCnsWdSts : 281|1@0+ (1,0) [0|1] ""  PAS
 SG_ VehModMngtGlbSafe1PwrLvlElecMai : 267|4@0+ (1,0) [0|15] "Unitless"  PAS
 SG_ VehModMngtGlbSafe1PwrLvlElecSubt : 279|4@0+ (1,0) [0|15] "Unitless"  PAS
 SG_ VehModMngtGlbSafe1UsgModSts : 275|4@0+ (1,0) [0|15] ""  PAS

BO_ 128 ASDMSafetyCANFD4Fr03: 64 ASDM
 SG_ ADataRawSafe_UB : 56|1@0+ (1,0) [0|1] ""  PAS
 SG_ ADataRawSafeALat : 23|15@0- (0.0085,0) [-138.992|139.0005] "m/s^2"  PAS
 SG_ ADataRawSafeALat1Qf : 11|2@0+ (1,0) [0|3] ""  PAS
 SG_ ADataRawSafeALgt : 38|15@0- (0.0085,0) [-138.992|139.0005] "m/s^2"  PAS
 SG_ ADataRawSafeALgt1Qf : 9|2@0+ (1,0) [0|3] ""  PAS
 SG_ ADataRawSafeAVert : 55|15@0- (0.0085,0) [-138.992|139.0005] "m/s^2"  PAS
 SG_ ADataRawSafeAVertQf : 24|2@0+ (1,0) [0|3] ""  PAS
 SG_ ADataRawSafeChks : 7|8@0+ (1,0) [0|255] "Unitless"  PAS
 SG_ ADataRawSafeCntr : 15|4@0+ (1,0) [0|15] "Unitless"  PAS
 SG_ AgDataRawSafe_UB : 183|1@0+ (1,0) [0|1] ""  PAS
 SG_ AgDataRawSafeChks : 103|8@0+ (1,0) [0|255] "Unitless"  PAS
 SG_ AgDataRawSafeCntr : 111|4@0+ (1,0) [0|15] "Unitless"  PAS
 SG_ AgDataRawSafeRollRate : 71|16@0- (0.000244140625,0) [-6|6] "rad/s"  PAS
 SG_ AgDataRawSafeRollRateQf : 107|2@0+ (1,0) [0|3] ""  PAS
 SG_ AgDataRawSafeYawRate : 87|16@0- (0.000244140625,0) [-6|6] "rad/s"  PAS
 SG_ AgDataRawSafeYawRateQf : 105|2@0+ (1,0) [0|3] ""  PAS
 SG_ AsyDataWithCmpSafe_UB : 168|1@0+ (1,0) [0|1] ""  PAS
 SG_ AsyDataWithCmpSafeALat1Qf : 153|2@0+ (1,0) [0|3] ""  PAS
 SG_ AsyDataWithCmpSafeALatWithCmp : 167|15@0- (0.0085,0) [-138.992|139.0005] "m/s^2"  PAS
 SG_ AsyDataWithCmpSafeALgt1Qf : 155|2@0+ (1,0) [0|3] ""  PAS
 SG_ AsyDataWithCmpSafeChks : 135|8@0+ (1,0) [0|255] "Unitless"  PAS
 SG_ AsyDataWithCmpSafeCntr : 159|4@0+ (1,0) [0|15] "Unitless"  PAS
 SG_ AsyDataWithCmpSafeGrdtOfALgt : 143|14@0- (0.00390625,0) [-30|30] "m/s^3"  PAS
 SG_ AsyDataWithCmpSafeYawRateQf : 145|2@0+ (1,0) [0|3] ""  PAS
 SG_ AsyDataWithCmpSafeYawRateWithCmp : 119|16@0- (0.000244140625,0) [-6|6] "rad/s"  PAS
 SG_ AsyHandsOffIndcr_UB : 432|1@0+ (1,0) [0|1] ""  PAS
 SG_ AsyHandsOffIndcrAsyIndcrDispSts : 435|3@0+ (1,0) [0|7] ""  PAS
 SG_ AsyHandsOffIndcrChks : 431|8@0+ (1,0) [0|255] "Unitless"  PAS
 SG_ AsyHandsOffIndcrCntr : 439|4@0+ (1,0) [0|15] "Unitless"  PAS
 SG_ GearMov : 196|2@0+ (1,0) [0|3] ""  PAS
 SG_ GearMov_UB : 197|1@0+ (1,0) [0|1] ""  PAS
 SG_ MobDevRPAReq_UB : 360|1@0+ (1,0) [0|1] ""  PAS
 SG_ MobDevRPAReqChks : 351|8@0+ (1,0) [0|255] "Unitless"  PAS
 SG_ MobDevRPAReqCntr : 339|4@0+ (1,0) [0|15] "Unitless"  PAS
 SG_ MobDevRPAReqMobDevSts : 359|8@0+ (1,0) [0|255] "Unitless"  PAS
 SG_ MobDevRPAReqRPAOutModeSubT : 343|4@0+ (1,0) [0|15] ""  PAS
 SG_ MobDevRPAReqRPAReq : 367|4@0+ (1,0) [0|15] ""  PAS
 SG_ MobDevRPAReqRSPACtrl : 363|3@0+ (1,0) [0|7] ""  PAS
 SG_ NetTCAMActvt_UB : 193|1@0+ (1,0) [0|1] ""  PAS
 SG_ NetTCAMActvtPrio : 192|1@0+ (1,0) [0|1] ""  PAS
 SG_ NetTCAMActvtResourceGroup : 207|8@0+ (1,0) [0|255] "Unitless"  PAS
 SG_ SeatBackAngleRowFirstDrvr : 215|8@0+ (1,0) [0|180] "Deg"  PAS
 SG_ SeatBackAngleRowFirstDrvr_UB : 194|1@0+ (1,0) [0|1] ""  PAS
 SG_ StandStillMgrStsForHld_UB : 223|1@0+ (1,0) [0|1] ""  PAS
 SG_ StandStillMgrStsForHld1 : 222|3@0+ (1,0) [0|7] ""  PAS
 SG_ StandStillMgrStsForHldChks : 231|8@0+ (1,0) [0|255] "Unitless"  PAS
 SG_ StandStillMgrStsForHldCntr : 219|4@0+ (1,0) [0|15] "Unitless"  PAS
 SG_ VisnImgDispModReq : 420|5@0+ (1,0) [0|31] ""  PAS
 SG_ VisnImgDispModReq_UB : 421|1@0+ (1,0) [0|1] ""  PAS
 SG_ WhlDirRotlFrnt_UB : 328|1@0+ (1,0) [0|1] ""  PAS
 SG_ WhlDirRotlFrntChks : 263|8@0+ (1,0) [0|255] "Unitless"  PAS
 SG_ WhlDirRotlFrntCntr : 271|4@0+ (1,0) [0|15] "Unitless"  PAS
 SG_ WhlDirRotlFrntLe : 267|2@0+ (1,0) [0|3] ""  PAS
 SG_ WhlDirRotlFrntRi : 265|2@0+ (1,0) [0|3] ""  PAS
 SG_ WhlDirRotlRe_UB : 423|1@0+ (1,0) [0|1] ""  PAS
 SG_ WhlDirRotlReChks : 279|8@0+ (1,0) [0|255] "Unitless"  PAS
 SG_ WhlDirRotlReCntr : 283|4@0+ (1,0) [0|15] "Unitless"  PAS
 SG_ WhlDirRotlReLe : 287|2@0+ (1,0) [0|3] ""  PAS
 SG_ WhlDirRotlReRi : 285|2@0+ (1,0) [0|3] ""  PAS
 SG_ WhlRotToothCntr_UB : 444|1@0+ (1,0) [0|1] ""  PAS
 SG_ WhlRotToothCntrChks : 455|8@0+ (1,0) [0|255] "Unitless"  PAS
 SG_ WhlRotToothCntrCntr : 443|4@0+ (1,0) [0|15] "Unitless"  PAS
 SG_ WhlRotToothCntrFrntLe : 463|8@0+ (1,0) [0|255] "Unitless"  PAS
 SG_ WhlRotToothCntrFrntRi : 471|8@0+ (1,0) [0|255] "Unitless"  PAS
 SG_ WhlRotToothCntrReLe : 479|8@0+ (1,0) [0|255] "Unitless"  PAS
 SG_ WhlRotToothCntrReRi : 487|8@0+ (1,0) [0|255] "Unitless"  PAS
 SG_ WhlSpdCircumlFrnt_UB : 375|1@0+ (1,0) [0|1] ""  PAS
 SG_ WhlSpdCircumlFrntChks : 391|8@0+ (1,0) [0|255] "Unitless"  PAS
 SG_ WhlSpdCircumlFrntCntr : 399|4@0+ (1,0) [0|15] "Unitless"  PAS
 SG_ WhlSpdCircumlFrntLe : 374|15@0+ (0.00391,0) [0|125.0027] "m/s"  PAS
 SG_ WhlSpdCircumlFrntLeQf : 395|2@0+ (1,0) [0|3] ""  PAS
 SG_ WhlSpdCircumlFrntRiQf : 393|2@0+ (1,0) [0|3] ""  PAS
 SG_ WhlSpdCircumlFrntWhlSpdCircumlFr : 407|15@0+ (0.00391,0) [0|125.0027] "m/s"  PAS
 SG_ WhlSpdCircumlRe_UB : 295|1@0+ (1,0) [0|1] ""  PAS
 SG_ WhlSpdCircumlReChks : 311|8@0+ (1,0) [0|255] "Unitless"  PAS
 SG_ WhlSpdCircumlReCntr : 319|4@0+ (1,0) [0|15] "Unitless"  PAS
 SG_ WhlSpdCircumlReLe : 294|15@0+ (0.00391,0) [0|125.0027] "m/s"  PAS
 SG_ WhlSpdCircumlReLeQf : 315|2@0+ (1,0) [0|3] ""  PAS
 SG_ WhlSpdCircumlReRi : 327|15@0+ (0.00391,0) [0|125.0027] "m/s"  PAS
 SG_ WhlSpdCircumlReRiQf : 313|2@0+ (1,0) [0|3] ""  PAS

BO_ 389 ASDMSafetyCANFD4Fr04: 64 ASDM
 SG_ AmbTRaw_UB : 5|1@0+ (1,0) [0|1] ""  PAS
 SG_ AmbTRawAmbTVal : 2|11@0+ (0.1,-70) [-70|134.7] "degC"  PAS
 SG_ AmbTRawQly : 4|2@0+ (1,0) [0|3] ""  PAS
 SG_ AutValtPrkgSwt : 92|2@0+ (1,0) [0|3] ""  PAS
 SG_ AutValtPrkgSwt_UB : 90|1@0+ (1,0) [0|1] ""  PAS
 SG_ BleConSts : 99|1@0+ (1,0) [0|1] ""  PAS
 SG_ BleConSts_UB : 98|1@0+ (1,0) [0|1] ""  PAS
 SG_ GNSSSolution_UB : 365|1@0+ (1,0) [0|1] ""  PAS
 SG_ GNSSSolutionCntr : 391|3@0+ (1,0) [0|7] "Unitless"  PAS
 SG_ GNSSSolutionNoOfSatltForSysNo1 : 364|5@0+ (1,0) [0|31] "Unitless"  PAS
 SG_ GNSSSolutionNoOfSatltForSysNo2 : 388|5@0+ (1,0) [0|31] "Unitless"  PAS
 SG_ GNSSSolutionNoOfSatltForSysNo3 : 396|5@0+ (1,0) [0|31] "Unitless"  PAS
 SG_ GNSSSolutionNoOfSatltForSysNo4 : 404|5@0+ (1,0) [0|31] "Unitless"  PAS
 SG_ GNSSSolutionNoOfSatltForSysNo5 : 412|5@0+ (1,0) [0|31] "Unitless"  PAS
 SG_ GNSSSolutionNoOfSatltForSysNo6 : 420|5@0+ (1,0) [0|31] "Unitless"  PAS
 SG_ GNSSSolutionNoOfSatltForSysNo7 : 428|5@0+ (1,0) [0|31] "Unitless"  PAS
 SG_ GNSSSolutionPreHozlDil : 447|8@0+ (0.1,0) [0|25.5] "Unitless"  PAS
 SG_ GNSSSolutionPrePosnDil : 455|8@0+ (0.1,0) [0|25.5] "Unitless"  PAS
 SG_ GNSSSolutionPreVertDil : 463|8@0+ (0.1,0) [0|25.5] "Unitless"  PAS
 SG_ GNSSSolutionSatltPosnStsPrm1 : 398|2@0+ (1,0) [0|3] ""  PAS
 SG_ GNSSSolutionSatltPosnStsPrm2 : 399|1@0+ (1,0) [0|1] ""  PAS
 SG_ GNSSSolutionSatltSysNo1InUse : 405|1@0+ (1,0) [0|1] ""  PAS
 SG_ GNSSSolutionSatltSysNo2InUse : 406|1@0+ (1,0) [0|1] ""  PAS
 SG_ GNSSSolutionSatltSysNo3InUse : 407|1@0+ (1,0) [0|1] ""  PAS
 SG_ GNSSSolutionSatltSysNo4InUse : 413|1@0+ (1,0) [0|1] ""  PAS
 SG_ GNSSSolutionSatltSysNo5InUse : 414|1@0+ (1,0) [0|1] ""  PAS
 SG_ GNSSSolutionSatltSysNo6InUse : 415|1@0+ (1,0) [0|1] ""  PAS
 SG_ GNSSSolutionSatltSysNo7InUse : 421|1@0+ (1,0) [0|1] ""  PAS
 SG_ GNSSSolutionTiForMins : 437|6@0+ (1,0) [0|59] "Mins"  PAS
 SG_ GNSSSolutionTiForMsec : 375|10@0+ (1,0) [0|1023] "Unitless"  PAS
 SG_ GNSSSolutionTiForSec : 381|6@0+ (1,0) [0|59] "s"  PAS
 SG_ KeyDistncSts_UB : 20|1@0+ (1,0) [0|1] ""  PAS
 SG_ KeyDistncStsKey0 : 19|10@0+ (1,0) [0|1023] "cm"  PAS
 SG_ KeyDistncStsKey1 : 25|10@0+ (1,0) [0|1023] "cm"  PAS
 SG_ KeyDistncStsKey2 : 47|10@0+ (1,0) [0|1023] "cm"  PAS
 SG_ KeyDistncStsKey3 : 53|10@0+ (1,0) [0|1023] "cm"  PAS
 SG_ KeyDistncStsKey4 : 59|10@0+ (1,0) [0|1023] "cm"  PAS
 SG_ KeyDistncStsKey5 : 65|10@0+ (1,0) [0|1023] "cm"  PAS
 SG_ MobDevKeyDistStsVld : 87|10@0+ (1,0) [0|1023] "cm"  PAS
 SG_ MobDevKeyDistStsVld_UB : 93|1@0+ (1,0) [0|1] ""  PAS
 SG_ PosnFromSatlt_UB : 136|1@0+ (1,0) [0|1] ""  PAS
 SG_ PosnFromSatltCntr : 351|3@0+ (1,0) [0|7] "Unitless"  PAS
 SG_ PosnFromSatltPosnAlti : 151|16@0+ (0.1,-100) [-100|6000] "m"  PAS
 SG_ PosnFromSatltPosnDir : 167|16@0+ (0.01,0) [0|359.99] "Deg"  PAS
 SG_ PosnFromSatltPosnLat : 181|30@0- (2.77778E-007,0) [-90.000072|90.000072] "Deg"  PAS
 SG_ PosnFromSatltPosnLgt : 214|31@0- (2.77778E-007,0) [-180.000144|180.000144] "Deg"  PAS
 SG_ PosnFromSatltPosnSpd : 247|17@0+ (0.001,0) [0|100] "m/s"  PAS
 SG_ PosnFromSatltPosnVHozl : 256|17@0+ (0.001,0) [0|100] "m/s"  PAS
 SG_ PosnFromSatltPosnVVert : 287|18@0- (0.001,0) [-100|100] "m/s"  PAS
 SG_ PosnFromSatltTiForMins : 262|6@0+ (1,0) [0|59] "Mins"  PAS
 SG_ PosnFromSatltTiForMsec : 305|10@0+ (1,0) [0|1023] "Unitless"  PAS
 SG_ PosnFromSatltTiForSec : 301|6@0+ (1,0) [0|59] "s"  PAS
 SG_ PosnFromSatltUTCForDay : 348|5@0+ (1,0) [1|31] "Days"  PAS
 SG_ PosnFromSatltUTCForHr : 356|5@0+ (1,0) [0|23] "hours"  PAS
 SG_ PosnFromSatltUTCForMins : 341|6@0+ (1,0) [0|59] "Mins"  PAS
 SG_ PosnFromSatltUTCForMth : 311|4@0+ (1,0) [1|12] "Month"  PAS
 SG_ PosnFromSatltUTCForSec : 325|6@0+ (1,0) [0|59] "s"  PAS
 SG_ PosnFromSatltUTCForYr : 334|7@0+ (1,0) [0|99] "Year"  PAS
 SG_ RainfallAmnt : 143|4@0+ (1,0) [0|15] ""  PAS
 SG_ RainfallAmnt_UB : 139|1@0+ (1,0) [0|1] ""  PAS
 SG_ RemPrkgSelfSearchReq : 89|1@0+ (1,0) [0|1] ""  PAS
 SG_ RemPrkgSelfSearchReq_UB : 88|1@0+ (1,0) [0|1] ""  PAS
 SG_ WinPosnStsAtDrvr : 111|5@0+ (1,0) [0|31] ""  PAS
 SG_ WinPosnStsAtDrvr_UB : 106|1@0+ (1,0) [0|1] ""  PAS
 SG_ WinPosnStsAtPass : 119|5@0+ (1,0) [0|31] ""  PAS
 SG_ WinPosnStsAtPass_UB : 114|1@0+ (1,0) [0|1] ""  PAS
 SG_ WinPosnStsAtReLe : 127|5@0+ (1,0) [0|31] ""  PAS
 SG_ WinPosnStsAtReLe_UB : 122|1@0+ (1,0) [0|1] ""  PAS
 SG_ WinPosnStsAtReRi : 135|5@0+ (1,0) [0|31] ""  PAS
 SG_ WinPosnStsAtReRi_UB : 130|1@0+ (1,0) [0|1] ""  PAS

BO_ 144 ASDMSafetyCANFD4Fr05: 64 ASDM
 SG_ AlrmSts_UB : 105|1@0+ (1,0) [0|1] ""  PAS
 SG_ AlrmStsAlrmFailr : 116|1@0+ (1,0) [0|1] ""  PAS
 SG_ AlrmStsAlrmSt : 118|2@0+ (1,0) [0|3] ""  PAS
 SG_ AlrmStsAlrmTrgSrc : 115|4@0+ (1,0) [0|15] ""  PAS
 SG_ AlrmStsSnsrInclnFailr : 119|1@0+ (1,0) [0|1] ""  PAS
 SG_ AlrmStsSnsrIntrScanrFailr : 104|1@0+ (1,0) [0|1] ""  PAS
 SG_ BiasedPosnFromSatlt_UB : 199|1@0+ (1,0) [0|1] ""  PAS
 SG_ BiasedPosnFromSatltCntr : 198|3@0+ (1,0) [0|7] "Unitless"  PAS
 SG_ BiasedPosnFromSatltPosnLat : 195|30@0- (2.77778E-007,0) [-90.000072|90.000072] "Deg"  PAS
 SG_ BiasedPosnFromSatltPosnLgt : 229|31@0- (2.77778E-007,0) [-180.000144|180.000144] "Deg"  PAS
 SG_ BiasedPosnFromSatltTiForMins : 262|6@0+ (1,0) [0|59] "Mins"  PAS
 SG_ BiasedPosnFromSatltTiForMsec : 271|10@0+ (1,0) [0|1023] "Unitless"  PAS
 SG_ BiasedPosnFromSatltTiForSec : 277|6@0+ (1,0) [0|59] "s"  PAS
 SG_ DoorDrvrSts : 7|2@0+ (1,0) [0|3] ""  PAS
 SG_ DoorDrvrSts_UB : 5|1@0+ (1,0) [0|1] ""  PAS
 SG_ DoorLeReSts : 4|2@0+ (1,0) [0|3] ""  PAS
 SG_ DoorLeReSts_UB : 2|1@0+ (1,0) [0|1] ""  PAS
 SG_ DoorPassSts : 23|2@0+ (1,0) [0|3] ""  PAS
 SG_ DoorPassSts_UB : 21|1@0+ (1,0) [0|1] ""  PAS
 SG_ DoorRiReSts : 20|2@0+ (1,0) [0|3] ""  PAS
 SG_ DoorRiReSts_UB : 18|1@0+ (1,0) [0|1] ""  PAS
 SG_ GpsStatus : 287|1@0+ (1,0) [0|1] ""  PAS
 SG_ GpsStatus_UB : 286|1@0+ (1,0) [0|1] ""  PAS
 SG_ HoodSts : 55|2@0+ (1,0) [0|3] ""  PAS
 SG_ HoodSts_UB : 53|1@0+ (1,0) [0|1] ""  PAS
 SG_ IHUfail : 52|1@0+ (1,0) [0|1] ""  PAS
 SG_ IHUfail_UB : 51|1@0+ (1,0) [0|1] ""  PAS
 SG_ LeFrntTireMsg_UB : 280|1@0+ (1,0) [0|1] ""  PAS
 SG_ LeFrntTireMsgBattLoSt : 295|1@0+ (1,0) [0|1] ""  PAS
 SG_ LeFrntTireMsgFastLoseWarnFlg : 294|1@0+ (1,0) [0|1] ""  PAS
 SG_ LeFrntTireMsgMsgOldFlg : 293|1@0+ (1,0) [0|1] ""  PAS
 SG_ LeFrntTireMsgP : 303|8@0+ (1.373,0) [0|350.115] "KiloPa"  PAS
 SG_ LeFrntTireMsgPWarnFlg : 292|2@0+ (1,0) [0|3] ""  PAS
 SG_ LeFrntTireMsgSysWarnFlg : 290|1@0+ (1,0) [0|1] ""  PAS
 SG_ LeFrntTireMsgT : 311|8@0+ (1,-50) [-50|205] "degC"  PAS
 SG_ LeFrntTireMsgTireFillgAssiPSts : 289|1@0+ (1,0) [0|1] ""  PAS
 SG_ LeFrntTireMsgTWarnFlg : 288|1@0+ (1,0) [0|1] ""  PAS
 SG_ LeReTireMsg_UB : 343|1@0+ (1,0) [0|1] ""  PAS
 SG_ LeReTireMsgBattLoSt : 319|1@0+ (1,0) [0|1] ""  PAS
 SG_ LeReTireMsgFastLoseWarnFlg : 318|1@0+ (1,0) [0|1] ""  PAS
 SG_ LeReTireMsgMsgOldFlg : 317|1@0+ (1,0) [0|1] ""  PAS
 SG_ LeReTireMsgP : 327|8@0+ (1.373,0) [0|350.115] "KiloPa"  PAS
 SG_ LeReTireMsgPWarnFlg : 316|2@0+ (1,0) [0|3] ""  PAS
 SG_ LeReTireMsgSysWarnFlg : 314|1@0+ (1,0) [0|1] ""  PAS
 SG_ LeReTireMsgT : 335|8@0+ (1,-50) [-50|205] "degC"  PAS
 SG_ LeReTireMsgTireFillgAssiPSts : 313|1@0+ (1,0) [0|1] ""  PAS
 SG_ LeReTireMsgTWarnFlg : 312|1@0+ (1,0) [0|1] ""  PAS
 SG_ LockgCenSts_UB : 342|1@0+ (1,0) [0|1] ""  PAS
 SG_ LockgCenStsLockSt : 341|2@0+ (1,0) [0|3] ""  PAS
 SG_ LockgCenStsTrigSrc : 339|4@0+ (1,0) [0|15] ""  PAS
 SG_ LockgCenStsUpdEve : 351|1@0+ (1,0) [0|1] ""  PAS
 SG_ MirrFoldStsAtDrvr : 71|3@0+ (1,0) [0|7] ""  PAS
 SG_ MirrFoldStsAtDrvr_UB : 68|1@0+ (1,0) [0|1] ""  PAS
 SG_ MirrFoldStsAtPass : 103|3@0+ (1,0) [0|7] ""  PAS
 SG_ MirrFoldStsAtPass_UB : 100|1@0+ (1,0) [0|1] ""  PAS
 SG_ NetASDMActvt_UB : 1|1@0+ (1,0) [0|1] ""  PAS
 SG_ NetASDMActvtPrio : 0|1@0+ (1,0) [0|1] ""  PAS
 SG_ NetASDMActvtResourceGroup : 15|8@0+ (1,0) [0|255] "Unitless"  PAS
 SG_ NetDIMActvt_UB : 17|1@0+ (1,0) [0|1] ""  PAS
 SG_ NetDIMActvtPrio : 16|1@0+ (1,0) [0|1] ""  PAS
 SG_ NetDIMActvtResourceGroup : 31|8@0+ (1,0) [0|255] "Unitless"  PAS
 SG_ NetDMMActvt_UB : 33|1@0+ (1,0) [0|1] ""  PAS
 SG_ NetDMMActvtPrio : 32|1@0+ (1,0) [0|1] ""  PAS
 SG_ NetDMMActvtResourceGroup : 47|8@0+ (1,0) [0|255] "Unitless"  PAS
 SG_ NetDVRActvt_UB : 49|1@0+ (1,0) [0|1] ""  PAS
 SG_ NetDVRActvtPrio : 48|1@0+ (1,0) [0|1] ""  PAS
 SG_ NetDVRActvtResourceGroup : 63|8@0+ (1,0) [0|255] "Unitless"  PAS
 SG_ NetIHUActvt_UB : 65|1@0+ (1,0) [0|1] ""  PAS
 SG_ NetIHUActvtPrio : 64|1@0+ (1,0) [0|1] ""  PAS
 SG_ NetIHUActvtResourceGroup : 79|8@0+ (1,0) [0|255] "Unitless"  PAS
 SG_ NetVGMActvt_UB : 81|1@0+ (1,0) [0|1] ""  PAS
 SG_ NetVGMActvtPrio : 80|1@0+ (1,0) [0|1] ""  PAS
 SG_ NetVGMActvtResourceGroup : 95|8@0+ (1,0) [0|255] "Unitless"  PAS
 SG_ RiFrntTireMsg_UB : 350|1@0+ (1,0) [0|1] ""  PAS
 SG_ RiFrntTireMsgBattLoSt : 349|1@0+ (1,0) [0|1] ""  PAS
 SG_ RiFrntTireMsgFastLoseWarnFlg : 348|1@0+ (1,0) [0|1] ""  PAS
 SG_ RiFrntTireMsgMsgOldFlg : 347|1@0+ (1,0) [0|1] ""  PAS
 SG_ RiFrntTireMsgP : 359|8@0+ (1.373,0) [0|350.115] "KiloPa"  PAS
 SG_ RiFrntTireMsgPWarnFlg : 346|2@0+ (1,0) [0|3] ""  PAS
 SG_ RiFrntTireMsgSysWarnFlg : 344|1@0+ (1,0) [0|1] ""  PAS
 SG_ RiFrntTireMsgT : 367|8@0+ (1,-50) [-50|205] "degC"  PAS
 SG_ RiFrntTireMsgTireFillgAssiPSts : 375|1@0+ (1,0) [0|1] ""  PAS
 SG_ RiFrntTireMsgTWarnFlg : 374|1@0+ (1,0) [0|1] ""  PAS
 SG_ RiReTireMsg_UB : 373|1@0+ (1,0) [0|1] ""  PAS
 SG_ RiReTireMsgBattLoSt : 372|1@0+ (1,0) [0|1] ""  PAS
 SG_ RiReTireMsgFastLoseWarnFlg : 371|1@0+ (1,0) [0|1] ""  PAS
 SG_ RiReTireMsgMsgOldFlg : 370|1@0+ (1,0) [0|1] ""  PAS
 SG_ RiReTireMsgP : 383|8@0+ (1.373,0) [0|350.115] "KiloPa"  PAS
 SG_ RiReTireMsgPWarnFlg : 369|2@0+ (1,0) [0|3] ""  PAS
 SG_ RiReTireMsgSysWarnFlg : 399|1@0+ (1,0) [0|1] ""  PAS
 SG_ RiReTireMsgT : 391|8@0+ (1,-50) [-50|205] "degC"  PAS
 SG_ RiReTireMsgTireFillgAssiPSts : 398|1@0+ (1,0) [0|1] ""  PAS
 SG_ RiReTireMsgTWarnFlg : 397|1@0+ (1,0) [0|1] ""  PAS
 SG_ SunRoofPosnSts : 190|5@0+ (1,0) [0|31] ""  PAS
 SG_ SunRoofPosnSts_UB : 191|1@0+ (1,0) [0|1] ""  PAS
 SG_ TrSts : 83|2@0+ (1,0) [0|3] ""  PAS
 SG_ TrSts_UB : 84|1@0+ (1,0) [0|1] ""  PAS

CM_ BU_ ETC "External Tester Connector";
CM_ SG_ 101 AbsCtrlActvChks "checksum";
CM_ SG_ 101 AbsCtrlActvCntr "counter";
CM_ SG_ 101 AbsCtrlActvCtrlSts1 "Anti Blocking Systems (ABS) control is active (at least one wheel)
0 = No wheel is in Anti Blocking Systems (ABS) control
1 = At least one wheel is in Anti Blocking Systems (ABS) control";
CM_ SG_ 101 AccrPedlPsdAccrPedlPsd "Describes if the accelerator pedal is pressed. Will indicate pressed for a small pedal press. Accompanying status signal will indicate the integrity of the information.";
CM_ SG_ 101 AccrPedlPsdChks "Describes if the accelerator pedal is pressed. Will indicate pressed for a small pedal press.checksum";
CM_ SG_ 101 AccrPedlPsdCntr "Describes if the accelerator pedal is pressed. Will indicate pressed for a small pedal press.couner";
CM_ SG_ 101 AccrPedlPsdSts "Describes if the accelerator pedal is pressed. Will indicate pressed for a small pedal press. Accompanying status signal will indicate the integrity of the information. AccrPedlPsd fulfills ASIL C integrity";
CM_ SG_ 101 AccrPedlRatAccrPedlRat "Accelerator Pedal Position with adapted 0 point. Value as percentage of fully pressed pedal";
CM_ SG_ 101 AccrPedlRatChks "Accelerator Pedal Position with adapted 0 point. Value as percentage of fully pressed pedal. Checksum";
CM_ SG_ 101 AccrPedlRatCntr "Accelerator Pedal Position with adapted 0 point. Value as percentage of fully pressed pedal. Counter";
CM_ SG_ 101 AccrpedlSts " It should provide acceleration pedal Status signal ( AccrpedlSts ) to predict whether the accelerator pedal  has fault or not.1-Fault; 0-NoFault";
CM_ SG_ 101 BltLockStSafeAtDrvrBltLockSt1 "State of belt lock at driver seating position Belt lock state, locked/unlocked";
CM_ SG_ 101 BltLockStSafeAtDrvrBltLockStErrS "State of belt lock at driver seating position Belt lock status, OK/NOK";
CM_ SG_ 101 BltLockStSafeAtDrvrChks "Counter for E2E";
CM_ SG_ 101 BltLockStSafeAtDrvrCntr "Checksum for E2E";
CM_ SG_ 101 EngSt1WdStsChks "checksum";
CM_ SG_ 101 EngSt1WdStsCntr "counter";
CM_ SG_ 101 EngSt1WdStsEngSt1WdSts "Signaling the state of the powerpack";
CM_ SG_ 101 EscStChks "Information on activation/ deactivation of Electronic Stability Control (ESC) Checksum for Esc state";
CM_ SG_ 101 EscStCntr "Information on activation/ deactivation of Electronic Stability Control (ESC) Counter for Esc state";
CM_ SG_ 101 EscStEscSt "Information on activation/ deactivation of Electronic Stability Control (ESC) Esc state information for Esc ON, Esc OFF or Esc Sport";
CM_ SG_ 101 GuestrStsChks "Checksum calculation";
CM_ SG_ 101 GuestrStsCntr "Counter";
CM_ SG_ 101 GuestrStsValidity "Validity of RPA";
CM_ SG_ 101 PinionSteerAgGroupChks "Checksum for PinionSteerAgGroup";
CM_ SG_ 101 PinionSteerAgGroupCntr "Counter for PinionSteerAgGroup";
CM_ SG_ 101 PinionSteerAgGroupPinionSteerAg1 "Calculated pinion steer angle at the front steering device";
CM_ SG_ 101 PinionSteerAgGroupPinionSte_0000 "Quality factor for PinionSteerAg1";
CM_ SG_ 101 PinionSteerAgGroupPinionSteerAgS "Calculated pinion steer angle speed at the front steering device ";
CM_ SG_ 101 PinionSteerAgGroupPinionSte_0001 "Quality factor for PinionSteerAgSpd1";
CM_ SG_ 101 PinionSteerAgGroupSteerWhlTq "Torque on steering wheel";
CM_ SG_ 101 PinionSteerAgGroupSteerWhlTqQf "Quality factor for SteerWhlTq";
CM_ SG_ 101 PosnFromSatlt1Cntr "Counter ";
CM_ SG_ 101 PosnFromSatlt1PosnLat "Latitude";
CM_ SG_ 101 PosnFromSatlt1PosnLgt "Longitude";
CM_ SG_ 101 PosnFromSatlt2Cntr "counter";
CM_ SG_ 101 PosnFromSatlt2PosnSpdosn "Speed";
CM_ SG_ 101 PosnFromSatlt3Cntr "counter";
CM_ SG_ 101 PosnFromSatlt3PosnAlti "Altitide from mean sea level";
CM_ SG_ 101 PosnFromSatlt3PosnDir "Heading from true north";
CM_ SG_ 101 PosnFromSatlt3TiForMins "minute";
CM_ SG_ 101 PosnFromSatlt3TiForMsec "milliseconds";
CM_ SG_ 101 PosnFromSatlt3TiForSec "second";
CM_ SG_ 101 PrkLatLgtFailrChks "Checksum";
CM_ SG_ 101 PrkLatLgtFailrCntr "Counter";
CM_ SG_ 101 PrkLatLgtFailrPrkLatLgtFailr "Failure mode";
CM_ SG_ 101 SwtIndcrIndcrTypExtReq "Signal represent status of the turn stalk swich";
CM_ SG_ 101 SwtIndcrIndcrTypExtReqChks "Checksum";
CM_ SG_ 101 SwtIndcrIndcrTypExtReqCntr "Counter";
CM_ SG_ 101 SwtIndcrIndcrTypExtReqToUpdQf "Qf";
CM_ SG_ 101 TrsmParkLockdChks "Checksum for TrsmParkLockd";
CM_ SG_ 101 TrsmParkLockdCntr "Counter for TrsmParkLockd";
CM_ SG_ 101 TrsmParkLockdTrsmParkLockd "Transmission park lock status";
CM_ SG_ 101 VehMtnStChks "Vehicle motion state information based on wheel speed sensors. Provides information about vehicle stand still and vehicle rolling direction. Checksum for vehicle motion state";
CM_ SG_ 101 VehMtnStCntr "Vehicle motion state information based on wheel speed sensors. Provides information about vehicle stand still and vehicle rolling direction. Counter for vehicle motion state";
CM_ SG_ 101 VehMtnStVehMtnSt "Vehicle motion state information based on wheel speed sensors. Provides information about vehicle stand still and vehicle rolling direction. Vehicle motion state";
CM_ SG_ 101 VehSpdLgtA "Vehicle speed longitudinal based on wheel speed sensors and longitudinal acceleration.";
CM_ SG_ 101 VehSpdLgtChks "Checksum";
CM_ SG_ 101 VehSpdLgtCntr "Counter";
CM_ SG_ 101 VehSpdLgtQf "Quality factor for vehicle speed as measured by wheel speed sensors and longitudinal acceleration.";
CM_ SG_ 101 VehTiAndDataDataValid "Vehicle time (Hr, Min and Sec) and date (Year, Months and days) data for indication. See requirement for more information about the signals. Signal qualifier, No means values should be ignored.";
CM_ SG_ 101 VehTiAndDataDay "Vehicle time (Hr, Min and Sec) and date (Year, Months and days) data for indication. See requirement for more information about the signals. Day";
CM_ SG_ 101 VehTiAndDataHr1 "Vehicle time (Hr, Min and Sec) and date (Year, Months and days) data for indication. See requirement for more information about the signals. Hour";
CM_ SG_ 101 VehTiAndDataMins1 "Vehicle time (Hr, Min and Sec) and date (Year, Months and days) data for indication. See requirement for more information about the signals. Minutes";
CM_ SG_ 101 VehTiAndDataMth1 "Vehicle time (Hr, Min and Sec) and date (Year, Months and days) data for indication. See requirement for more information about the signals. Month, 1-12";
CM_ SG_ 101 VehTiAndDataSec1 "Vehicle time (Hr, Min and Sec) and date (Year, Months and days) data for indication. See requirement for more information about the signals. Seconds";
CM_ SG_ 101 VehTiAndDataYr1 "Vehicle time (Hr, Min and Sec) and date (Year, Months and days) data for indication. See requirement for more information about the signals. Year, 0-99";
CM_ SG_ 105 AsyADL3FuncCtrlStsADMod "ADMod";
CM_ SG_ 105 AsyADL3FuncCtrlStsChks "Checksum";
CM_ SG_ 105 AsyADL3FuncCtrlStsCntr "Counter";
CM_ SG_ 105 AsyADL3FuncCtrlStsCtrlSts "CtrlSts";
CM_ SG_ 105 AsyADL3FuncCtrlStsDegraded "Degraded";
CM_ SG_ 105 AsyADL3FuncCtrlStsQf "Qf";
CM_ SG_ 105 AsyADL3FuncCtrlStsSts "Status";
CM_ SG_ 105 AsyALgtCtrlMod1 "longitudinal control mode signal";
CM_ SG_ 105 AsyALgtCtrlModCfmdAsyALgtCtrlMod "to feedback the confirmation of AsyALgtCtrlMod";
CM_ SG_ 105 AsyALgtCtrlModCfmdChks "checksum";
CM_ SG_ 105 AsyALgtCtrlModCfmdCntr "rollingcounter";
CM_ SG_ 105 AsyALgtCtrlModChks "counter";
CM_ SG_ 105 AsyALgtCtrlModCntr "checksum";
CM_ SG_ 105 AsyALgtStsAsyALgtSts "The signal indicates the status of the longitudinal control; off, passive, standby, active etc.";
CM_ SG_ 105 AsyALgtStsChks "check sum for E2E
";
CM_ SG_ 105 AsyALgtStsCntr "counter for E2E";
CM_ SG_ 105 AsyLatCtrlModReqGroupAsyLatCtrlM "lateral control mode signal";
CM_ SG_ 105 AsyLatCtrlModReqGroupCfmdChks "checlksum";
CM_ SG_ 105 AsyLatCtrlModReqGroupCfmdCntr "Counter";
CM_ SG_ 105 AsyLatCtrlModReqGroupCfmdLatCtrl "Lateral control mode confirmation";
CM_ SG_ 105 AsyLatCtrlModReqGroupChks "checksum";
CM_ SG_ 105 AsyLatCtrlModReqGroupCntr "counter";
CM_ SG_ 105 BiasedPosnFromSatlt1Cntr "counter";
CM_ SG_ 105 BiasedPosnFromSatlt1PosnLat "Latitude";
CM_ SG_ 105 BiasedPosnFromSatlt1PosnLgt "Longitude";
CM_ SG_ 105 BrkHptcWarnReqForAutDrvBrkHptcWa "To indicate the relative subsystem to excute a haptic warning (short brake) for driver.";
CM_ SG_ 105 BrkHptcWarnReqForAutDrvChks "crc";
CM_ SG_ 105 BrkHptcWarnReqForAutDrvCntr "counter";
CM_ SG_ 105 BrkPedlPsdBrkPedlNotPsdSafe "Set to 1 if brake pedal is not pressed, otherwise 0";
CM_ SG_ 105 BrkPedlPsdBrkPedlPsd "Set to 1 if brake pedal is pressed, otherwise 0";
CM_ SG_ 105 BrkPedlPsdChks "Checksum";
CM_ SG_ 105 BrkPedlPsdCntr "Counter";
CM_ SG_ 105 BrkPedlPsdQf "Quality factor";
CM_ SG_ 105 DrvrAsscSysBtnPush "APA button requirement";
CM_ SG_ 105 EpbStsChks "Electrical Park Brake system status information Status for the rear wheel park actuator";
CM_ SG_ 105 EpbStsCntr "Electrical Park Brake system status information Counter for EPB status";
CM_ SG_ 105 EpbStsEpbSts "Electrical Park Brake system status information Status for the rear wheel park actuator";
CM_ SG_ 105 EscCtrlIndcn "Indicates that an Electronic stability control (ESC) controller is active";
CM_ SG_ 105 FctaIndcnLe "Indicates if a left FCTA warning shall be shown to the driver or not.";
CM_ SG_ 105 FctaIndcnRi "Indicates if a right FCTA warning shall be shown to the driver or not.";
CM_ SG_ 105 GearLvrIndcn "Gear lever indication (drivetrain position) to the driver. If drivetrain position is not possible to decide signal is set to undefined. Valid for automatic vehicles.
";
CM_ SG_ 105 MobDevRPAAuthRespAnswer "Answer";
CM_ SG_ 105 MobDevRPAAuthRespChks "Checksum calculation";
CM_ SG_ 105 MobDevRPAAuthRespCntr "Counter";
CM_ SG_ 105 MobDevRPAAuthRespX "response X";
CM_ SG_ 105 MobDevRPAAuthRespY "response Y";
CM_ SG_ 105 MsgReqByHillDwnCtrl "Text message request from HDC function for driver information about current HDC state.";
CM_ SG_ 105 PdcMuteBtnReq "PDC mute button";
CM_ SG_ 105 RctaBrkReqChks "RCTA brake request signal.couner";
CM_ SG_ 105 RctaBrkReqCntr "RCTA brake request signal.checksum";
CM_ SG_ 105 RctaBrkReqRctaBrkReq "RCTA brake request signal.";
CM_ SG_ 105 RctaIndcnLe "RCTA left warning signal";
CM_ SG_ 105 RctaIndcnRi "RCTA right warning signal";
CM_ SG_ 105 RcwmBrkReqChks "Brake request from RCW to brake controller.couner";
CM_ SG_ 105 RcwmBrkReqCntr "Brake request from RCW to brake controller.checksum";
CM_ SG_ 105 RcwmBrkReqRcwmBrkReq "Brake request from RCW to brake controller.";
CM_ SG_ 105 RoadInclnQly "Road inclination information. The road inclination is negative when the vehicle is facing uphill and positive when the vehicle is facing downhill. Quality information for road inclination";
CM_ SG_ 105 RoadInclnRoadIncln "Road inclination information. The road inclination is negative when the vehicle is facing uphill and positive when the vehicle is facing downhill.";
CM_ SG_ 105 SftyDecelGroupSafeAsySftyDecelRe "target deceleration";
CM_ SG_ 105 SftyDecelGroupSafeAsySftyEnaDece "brake order
";
CM_ SG_ 105 SftyDecelGroupSafeChks "crc";
CM_ SG_ 105 SftyDecelGroupSafeCntr "counter";
CM_ SG_ 105 VehModMngtGlbSafe1CarModSts1 "CarMode Status";
CM_ SG_ 105 VehModMngtGlbSafe1CarModSubtypWd "CarMode substate status";
CM_ SG_ 105 VehModMngtGlbSafe1Chks "Checksum";
CM_ SG_ 105 VehModMngtGlbSafe1Cntr "Counter";
CM_ SG_ 105 VehModMngtGlbSafe1EgyLvlElecMai "Main energy level in the vehicle.";
CM_ SG_ 105 VehModMngtGlbSafe1EgyLvlElecSubt "Substate of the energy level in the vehicle.";
CM_ SG_ 105 VehModMngtGlbSafe1FltEgyCnsWdSts "High quiescent current detected by CEM via BMS.";
CM_ SG_ 105 VehModMngtGlbSafe1PwrLvlElecMai "Main Power level in the vehicle.";
CM_ SG_ 105 VehModMngtGlbSafe1PwrLvlElecSubt "Substate of the power level in the vehicle.";
CM_ SG_ 105 VehModMngtGlbSafe1UsgModSts "UsageMode Status";
CM_ SG_ 128 ADataRawSafeALat "IMU acceleration data Lateral acceleration";
CM_ SG_ 128 ADataRawSafeALat1Qf "IMU acceleration data Quality factor for Lateral acceleration signal";
CM_ SG_ 128 ADataRawSafeALgt "IMU acceleration data Longitudinal acceleration";
CM_ SG_ 128 ADataRawSafeALgt1Qf "IMU acceleration data Quality factor for Longitudinal acceleration";
CM_ SG_ 128 ADataRawSafeAVert "IMU acceleration data Vertical acceleration";
CM_ SG_ 128 ADataRawSafeAVertQf "IMU acceleration data Quality factor for Vertical acceleration";
CM_ SG_ 128 ADataRawSafeChks "IMU acceleration data Check sum";
CM_ SG_ 128 ADataRawSafeCntr "IMU acceleration data Counter";
CM_ SG_ 128 AgDataRawSafeChks "IMU angular rate data. Check summa";
CM_ SG_ 128 AgDataRawSafeCntr "IMU angular rate data. Counter";
CM_ SG_ 128 AgDataRawSafeRollRate "IMU angular rate data. Roll Rate";
CM_ SG_ 128 AgDataRawSafeRollRateQf "IMU angular rate data. Quality factor for Roll Rate";
CM_ SG_ 128 AgDataRawSafeYawRate "IMU angular rate data. Yaw Rate";
CM_ SG_ 128 AgDataRawSafeYawRateQf "IMU angular rate data. Quality Factor for Yaw Rate";
CM_ SG_ 128 AsyDataWithCmpSafeALat1Qf "IMU processed special data. Quality factor for Lateral acceleration signal";
CM_ SG_ 128 AsyDataWithCmpSafeALatWithCmp "IMU processed special data.  Compensated Lateral acceleration";
CM_ SG_ 128 AsyDataWithCmpSafeALgt1Qf "IMU processed special data. Quality factor for Longitudinal acceleration";
CM_ SG_ 128 AsyDataWithCmpSafeChks "IMU processed special data. Check sum";
CM_ SG_ 128 AsyDataWithCmpSafeCntr "IMU processed special data. Counter";
CM_ SG_ 128 AsyDataWithCmpSafeGrdtOfALgt "IMU processed special data. Derivative of Longitudinal acceleration";
CM_ SG_ 128 AsyDataWithCmpSafeYawRateQf "IMU processed special data. Quality Factor for Yaw Rate";
CM_ SG_ 128 AsyDataWithCmpSafeYawRateWithCmp "IMU processed special data. Compensated Yaw rate";
CM_ SG_ 128 AsyHandsOffIndcrAsyIndcrDispSts "Indicator of Hands off function";
CM_ SG_ 128 AsyHandsOffIndcrChks "E2E";
CM_ SG_ 128 AsyHandsOffIndcrCntr "E2E";
CM_ SG_ 128 GearMov "To indicate the case that if any one of gear lever, shifting fork, gear lock button, P-button is intervened when vehicle enter APA/RPA mode";
CM_ SG_ 128 MobDevRPAReqChks "Checksum calculation for E2E";
CM_ SG_ 128 MobDevRPAReqCntr "E2E counter";
CM_ SG_ 128 MobDevRPAReqMobDevSts "Mobile Device Status";
CM_ SG_ 128 MobDevRPAReqRPAOutModeSubT "Remote Park Assist Out Subtype definition";
CM_ SG_ 128 MobDevRPAReqRPAReq "Remote Park Assist Request";
CM_ SG_ 128 MobDevRPAReqRSPACtrl "Remote Straight Parking Assist Request";
CM_ SG_ 128 NetTCAMActvtPrio "Default values are Prio = PRIO-NORM and no resource group ( ResourceGroup = 0x00) is requested, which means that the vehicle internal IP network is not requested";
CM_ SG_ 128 NetTCAMActvtResourceGroup "It describes which state managers that are member of each resource group";
CM_ SG_ 128 SeatBackAngleRowFirstDrvr "Backrest angle of the First Row Driver Seat";
CM_ SG_ 128 StandStillMgrStsForHld1 "Brake systen hold status";
CM_ SG_ 128 StandStillMgrStsForHldChks "chks";
CM_ SG_ 128 StandStillMgrStsForHldCntr "cntr";
CM_ SG_ 128 VisnImgDispModReq "AVM video mode requirement";
CM_ SG_ 128 WhlDirRotlFrntChks "check sum";
CM_ SG_ 128 WhlDirRotlFrntCntr "counter";
CM_ SG_ 128 WhlDirRotlFrntLe "Rotational direction for the front individual wheels. Wheel rotation direction of front left wheel.";
CM_ SG_ 128 WhlDirRotlFrntRi "Rotational direction for the front individual wheels. Wheel rotation direction of front right wheel.";
CM_ SG_ 128 WhlDirRotlReChks "checksum";
CM_ SG_ 128 WhlDirRotlReCntr "counter";
CM_ SG_ 128 WhlDirRotlReLe "Rotational direction for the rear individual wheels. Wheel rotation direction of rear left wheel.";
CM_ SG_ 128 WhlDirRotlReRi "Rotational direction for the rear individual wheels. Wheel rotation direction of rear right wheel.";
CM_ SG_ 128 WhlRotToothCntrChks "check sum";
CM_ SG_ 128 WhlRotToothCntrCntr "counter";
CM_ SG_ 128 WhlRotToothCntrFrntLe "Wheel rotation ticks for each individual wheel. Wheel rotation impuls counter front left. For one complete wheel revolution the counter will increase by 96 (with 48 magnetic pole-pairs).";
CM_ SG_ 128 WhlRotToothCntrFrntRi "Wheel rotation ticks for each individual wheel. Wheel rotation impuls counter front right. For one complete wheel revolution the counter will increase by 96 (with 48 magnetic pole-pairs).";
CM_ SG_ 128 WhlRotToothCntrReLe "Wheel rotation ticks for each individual wheel. Wheel rotation impuls counter rear left. For one complete wheel revolution the counter will increase by 96 (with 48 magnetic pole-pairs).";
CM_ SG_ 128 WhlRotToothCntrReRi "Wheel rotation ticks for each individual wheel. Wheel rotation impuls counter rear right. For one complete wheel revolution the counter will increase by 96 (with 48 magnetic pole-pairs).";
CM_ SG_ 128 WhlSpdCircumlFrntChks "Individual wheel speed from front wheel speed sensors. Checksum";
CM_ SG_ 128 WhlSpdCircumlFrntCntr "Individual wheel speed from front wheel speed sensors. Counter";
CM_ SG_ 128 WhlSpdCircumlFrntLe "Individual wheel speed from front wheel speed sensors. Wheel speed from front left wheel speed sensor using nominal value of wheel radius.";
CM_ SG_ 128 WhlSpdCircumlFrntLeQf "Individual wheel speed from front wheel speed sensors. Qf for wheel speed sensor";
CM_ SG_ 128 WhlSpdCircumlFrntRiQf "Individual wheel speed from front wheel speed sensors. Qf for wheel speed sensor";
CM_ SG_ 128 WhlSpdCircumlFrntWhlSpdCircumlFr "Individual wheel speed from front wheel speed sensors. Wheel speed from front right wheel speed sensor using nominal value of wheel radius";
CM_ SG_ 128 WhlSpdCircumlReChks "Individual wheel speed from rear wheel speed sensors. Checksum";
CM_ SG_ 128 WhlSpdCircumlReCntr "Individual wheel speed from rear wheel speed sensors. Counter";
CM_ SG_ 128 WhlSpdCircumlReLe "Individual wheel speed from rear wheel speed sensors. Wheel speed from rear left wheel speed sensor using nominal value of wheel radius.";
CM_ SG_ 128 WhlSpdCircumlReLeQf "Individual wheel speed from rear wheel speed sensors. Qf for wheel speed sensor";
CM_ SG_ 128 WhlSpdCircumlReRi "Individual wheel speed from rear wheel speed sensors. Wheel speed from rear right wheel speed sensor using nominal value of wheel radius.";
CM_ SG_ 128 WhlSpdCircumlReRiQf "Individual wheel speed from rear wheel speed sensors. Qf for wheel speed sensor";
CM_ SG_ 389 AmbTRawAmbTVal "Unfiltered ambient temp raw data in deg C. Ambient temp value";
CM_ SG_ 389 AmbTRawQly "Unfiltered ambient temp raw data in deg C. Quality Factor of the ambient temp";
CM_ SG_ 389 AutValtPrkgSwt "AVP open or exit request";
CM_ SG_ 389 BleConSts "After the BLE module and mobile phone verification is completed, the BLE module provides Bluetooth connection status.";
CM_ SG_ 389 GNSSSolutionCntr "Counter ";
CM_ SG_ 389 GNSSSolutionNoOfSatltForSysNo1 "Number of GPS satellites used for positioning";
CM_ SG_ 389 GNSSSolutionNoOfSatltForSysNo2 "Number of GLONASS satellites used for positioning";
CM_ SG_ 389 GNSSSolutionNoOfSatltForSysNo3 "Number of Galileo satellites used for positioning";
CM_ SG_ 389 GNSSSolutionNoOfSatltForSysNo4 "Number of SBAS satellites used for positioning";
CM_ SG_ 389 GNSSSolutionNoOfSatltForSysNo5 "Number of QZSS L1 satellites used for positioning";
CM_ SG_ 389 GNSSSolutionNoOfSatltForSysNo6 "Number of QZSS L1-SAIF satellites used for positioning";
CM_ SG_ 389 GNSSSolutionNoOfSatltForSysNo7 "Number of BeiDou satellites used for positioning";
CM_ SG_ 389 GNSSSolutionPreHozlDil "Horizontal Dilution Of Precision";
CM_ SG_ 389 GNSSSolutionPrePosnDil "Position Dilution Of Precision";
CM_ SG_ 389 GNSSSolutionPreVertDil "Vertical Dilution Of Precision";
CM_ SG_ 389 GNSSSolutionSatltPosnStsPrm1 "Navigation solution status";
CM_ SG_ 389 GNSSSolutionSatltPosnStsPrm2 "DGPS usage in solution";
CM_ SG_ 389 GNSSSolutionSatltSysNo1InUse "GPS used for positioning";
CM_ SG_ 389 GNSSSolutionSatltSysNo2InUse "GLONASS used for positioning";
CM_ SG_ 389 GNSSSolutionSatltSysNo3InUse "Galileo used for positioning";
CM_ SG_ 389 GNSSSolutionSatltSysNo4InUse "SBAS used for positioning";
CM_ SG_ 389 GNSSSolutionSatltSysNo5InUse "QZSS L1 used for positioning";
CM_ SG_ 389 GNSSSolutionSatltSysNo6InUse "QZSS L1-SAIF used for positioning";
CM_ SG_ 389 GNSSSolutionSatltSysNo7InUse "BeiDou used for positioning";
CM_ SG_ 389 GNSSSolutionTiForMins "minutes";
CM_ SG_ 389 GNSSSolutionTiForMsec "milliseconds";
CM_ SG_ 389 GNSSSolutionTiForSec "seconds";
CM_ SG_ 389 KeyDistncStsKey0 "KeyDistncSts - Key Distance status
The actual key distance measured in cm from car perimeter, for Key0";
CM_ SG_ 389 KeyDistncStsKey1 "KeyDistncSts - Key Distance status
The actual key distance measured in cm from car perimeter, for Key1";
CM_ SG_ 389 KeyDistncStsKey2 "KeyDistncSts - Key Distance status
The actual key distance measured in cm from car perimeter, for Key2";
CM_ SG_ 389 KeyDistncStsKey3 "KeyDistncSts - Key Distance status
The actual key distance measured in cm from car perimeter, for Key3";
CM_ SG_ 389 KeyDistncStsKey4 "KeyDistncSts - Key Distance status
The actual key distance measured in cm from car perimeter, for Key4";
CM_ SG_ 389 KeyDistncStsKey5 "KeyDistncSts - Key Distance status
The actual key distance measured in cm from car perimeter, for Key5";
CM_ SG_ 389 MobDevKeyDistStsVld "Mobile Device Key Distance status Valid";
CM_ SG_ 389 PosnFromSatltCntr "Counter ";
CM_ SG_ 389 PosnFromSatltPosnAlti "Altitide from mean sea level";
CM_ SG_ 389 PosnFromSatltPosnDir "Heading from true north";
CM_ SG_ 389 PosnFromSatltPosnLat "Latitude";
CM_ SG_ 389 PosnFromSatltPosnLgt "Longitude";
CM_ SG_ 389 PosnFromSatltPosnSpd "Speed";
CM_ SG_ 389 PosnFromSatltPosnVHozl "Horizontal velocity";
CM_ SG_ 389 PosnFromSatltPosnVVert "Vertical velocity";
CM_ SG_ 389 PosnFromSatltTiForMins "in vehicle global time minutes";
CM_ SG_ 389 PosnFromSatltTiForMsec "milliseconds";
CM_ SG_ 389 PosnFromSatltTiForSec "in vehicle global time seconds";
CM_ SG_ 389 PosnFromSatltUTCForDay "UTC day";
CM_ SG_ 389 PosnFromSatltUTCForHr "UTC hour";
CM_ SG_ 389 PosnFromSatltUTCForMins "UTC minute";
CM_ SG_ 389 PosnFromSatltUTCForMth "UTC month";
CM_ SG_ 389 PosnFromSatltUTCForSec "UTC second";
CM_ SG_ 389 PosnFromSatltUTCForYr "UTC year";
CM_ SG_ 389 RainfallAmnt "The signal describe the amount of rain falling";
CM_ SG_ 389 RemPrkgSelfSearchReq "RPA self-searching request";
CM_ SG_ 389 WinPosnStsAtDrvr "Signal sent to inform the rest of the car of the window position status for the front driver side door. The value of the signal is either an approximated percentage of openness, of the window is moving or if the position is unkown.
";
CM_ SG_ 389 WinPosnStsAtPass "Signal sent to inform the rest of the car of the window position status for the front passenger side door. The value of the signal is either an approximated percentage of openness, of the window is moving or if the position is unkown.
";
CM_ SG_ 389 WinPosnStsAtReLe "Signal sent to inform the rest of the car of the window position status for the rear driver side door. The value of the signal is either an approximated percentage of openness, of the window is moving or if the position is unkown.

";
CM_ SG_ 389 WinPosnStsAtReRi "Signal sent to inform the rest of the car of the window position status for the rear passenger side door. The value of the signal is either an approximated percentage of openness, of the window is moving or if the position is unkown.
";
CM_ SG_ 144 AlrmStsAlrmFailr "Indicates alarm status, last trigger source and alarm component errors.";
CM_ SG_ 144 AlrmStsAlrmSt "Indicates alarm status, last trigger source and alarm component errors.";
CM_ SG_ 144 AlrmStsAlrmTrgSrc "Indicates alarm status, last trigger source and alarm component errors.";
CM_ SG_ 144 AlrmStsSnsrInclnFailr "Indicates alarm status, last trigger source and alarm component errors.";
CM_ SG_ 144 AlrmStsSnsrIntrScanrFailr "Indicates alarm status, last trigger source and alarm component errors.";
CM_ SG_ 144 BiasedPosnFromSatltCntr "Counter ";
CM_ SG_ 144 BiasedPosnFromSatltPosnLat "Latitude";
CM_ SG_ 144 BiasedPosnFromSatltPosnLgt "Longitude";
CM_ SG_ 144 BiasedPosnFromSatltTiForMins "minutes";
CM_ SG_ 144 BiasedPosnFromSatltTiForMsec "milliseconds ";
CM_ SG_ 144 BiasedPosnFromSatltTiForSec "seconds";
CM_ SG_ 144 DoorDrvrSts "DoorDrvrSts - Driver Door Status
Ukwn - Unknown status
Opend - Opened
Clsd - Closed";
CM_ SG_ 144 DoorLeReSts "DoorLeReSts - Left Rear Side Door Status.
Ukwn - Unknown status
Opend - Opened
Clsd - Closed";
CM_ SG_ 144 DoorPassSts "DoorPassSts - Passenger Door Status
Ukwn - Unknown status
Opend - Opened
Clsd - Closed";
CM_ SG_ 144 DoorRiReSts "DoorRiReSts - Right Rear Side Door Status
Ukwn - Unknown status
Opend - Opened
Clsd - Closed";
CM_ SG_ 144 GpsStatus "GPS signal confidence, successful=1 or failure=0. ";
CM_ SG_ 144 HoodSts "HoodSts - Hood Status
Ukwn - Unknown status
Opend - Opened
Clsd - Closed";
CM_ SG_ 144 IHUfail "IHU fail signal indicates IHU is in failure mode.";
CM_ SG_ 144 LeFrntTireMsgBattLoSt "battery low status";
CM_ SG_ 144 LeFrntTireMsgFastLoseWarnFlg "fast lost warn flag";
CM_ SG_ 144 LeFrntTireMsgMsgOldFlg "message old flag";
CM_ SG_ 144 LeFrntTireMsgP "tire temperature";
CM_ SG_ 144 LeFrntTireMsgPWarnFlg "pressure warn flag";
CM_ SG_ 144 LeFrntTireMsgSysWarnFlg "system warn flag";
CM_ SG_ 144 LeFrntTireMsgT "tire pressure";
CM_ SG_ 144 LeFrntTireMsgTireFillgAssiPSts "tire fill status";
CM_ SG_ 144 LeFrntTireMsgTWarnFlg "temperature warn flag";
CM_ SG_ 144 LeReTireMsgBattLoSt "battery low status";
CM_ SG_ 144 LeReTireMsgFastLoseWarnFlg "fast lost warn flag";
CM_ SG_ 144 LeReTireMsgMsgOldFlg "message old flag";
CM_ SG_ 144 LeReTireMsgP "tire temperature";
CM_ SG_ 144 LeReTireMsgPWarnFlg "pressure warn flag";
CM_ SG_ 144 LeReTireMsgSysWarnFlg "system warn flag";
CM_ SG_ 144 LeReTireMsgT "tire pressure";
CM_ SG_ 144 LeReTireMsgTireFillgAssiPSts "tire fill status";
CM_ SG_ 144 LeReTireMsgTWarnFlg "temperature warn flag";
CM_ SG_ 144 LockgCenStsLockSt "Signal LockgCenSts provides central locking status to other subsystems.
Signal is a record with three items
- LockSt (Lock State)
- TrigSrc (Trig Source)
- UpdEve (Will be set to TRUE during one second at each new central locking or unlocking event)";
CM_ SG_ 144 LockgCenStsTrigSrc "Signal LockgCenSts provides central locking status to other subsystems.
Signal is a record with three items
- LockSt (Lock State)
- TrigSrc (Trig Source)
- UpdEve (Will be set to TRUE during one second at each new central locking or unlocking event)";
CM_ SG_ 144 LockgCenStsUpdEve "Signal LockgCenSts provides central locking status to other subsystems.
Signal is a record with three items
- LockSt (Lock State)
- TrigSrc (Trig Source)
- UpdEve (Will be set to TRUE during one second at each new central locking or unlocking event)";
CM_ SG_ 144 MirrFoldStsAtDrvr "Reports the fold status of the outer rear view mirrors. Driver side.";
CM_ SG_ 144 MirrFoldStsAtPass "Reports the fold status of the outer rear view mirrors. Passanger side.";
CM_ SG_ 144 NetASDMActvtPrio "Default values are Prio = PRIO-NORM and no resource group ( ResourceGroup = 0x00) is requested, which means that the vehicle internal IP network is not requested";
CM_ SG_ 144 NetASDMActvtResourceGroup "It describes which state managers that are member of each resource group";
CM_ SG_ 144 NetDIMActvtPrio "Default values are Prio = PRIO-NORM and no resource group ( ResourceGroup = 0x00) is requested, which means that the vehicle internal IP network is not requested";
CM_ SG_ 144 NetDIMActvtResourceGroup "It describes which state managers that are member of each resource group";
CM_ SG_ 144 NetDMMActvtPrio "Default values are Prio = PRIO-NORM and no resource group ( ResourceGroup = 0x00) is requested, which means that the vehicle internal IP network is not requested.";
CM_ SG_ 144 NetDMMActvtResourceGroup "It describes which state managers that are member of each resource group";
CM_ SG_ 144 NetDVRActvtPrio "Default values are Prio = PRIO-NORM and no resource group ( ResourceGroup = 0x00) is requested, which means that the vehicle internal IP network is not requested.";
CM_ SG_ 144 NetDVRActvtResourceGroup "It describes which state managers that are member of each resource group";
CM_ SG_ 144 NetIHUActvtPrio "Default values are Prio = PRIO-NORM and no resource group ( ResourceGroup = 0x00) is requested, which means that the vehicle internal IP network is not requested.";
CM_ SG_ 144 NetIHUActvtResourceGroup "It describes which state managers that are member of each resource group";
CM_ SG_ 144 NetVGMActvtPrio "Default values are Prio = PRIO-NORM and no resource group ( ResourceGroup = 0x00) is requested, which means that the vehicle internal IP network is not requested";
CM_ SG_ 144 NetVGMActvtResourceGroup "It describes which state managers that are member of each resource group";
CM_ SG_ 144 RiFrntTireMsgBattLoSt "battery low status";
CM_ SG_ 144 RiFrntTireMsgFastLoseWarnFlg "fast lost warn flag";
CM_ SG_ 144 RiFrntTireMsgMsgOldFlg "message old flag";
CM_ SG_ 144 RiFrntTireMsgP "tire temperature";
CM_ SG_ 144 RiFrntTireMsgPWarnFlg "pressure warn flag";
CM_ SG_ 144 RiFrntTireMsgSysWarnFlg "system warn flag";
CM_ SG_ 144 RiFrntTireMsgT "tire pressure";
CM_ SG_ 144 RiFrntTireMsgTireFillgAssiPSts "tire fill status";
CM_ SG_ 144 RiFrntTireMsgTWarnFlg "temperature warn flag";
CM_ SG_ 144 RiReTireMsgBattLoSt "battery low status";
CM_ SG_ 144 RiReTireMsgFastLoseWarnFlg "fast lost warn flag";
CM_ SG_ 144 RiReTireMsgMsgOldFlg "message old flag";
CM_ SG_ 144 RiReTireMsgP "tire temperature";
CM_ SG_ 144 RiReTireMsgPWarnFlg "pressure warn flag";
CM_ SG_ 144 RiReTireMsgSysWarnFlg "system warn flag";
CM_ SG_ 144 RiReTireMsgT "tire pressure";
CM_ SG_ 144 RiReTireMsgTireFillgAssiPSts "tire fill status";
CM_ SG_ 144 RiReTireMsgTWarnFlg "temperature warn flag";
CM_ SG_ 144 SunRoofPosnSts "Sun roof position status";
CM_ SG_ 144 TrSts "TrSts - Tailgate or Bootlid Status
Ukwn - Unknown status
Opend - Opened
Clsd - Closed";
BA_DEF_  "Baudrate" INT 1000 1000000;
BA_DEF_  "BaudRateCANFD" FLOAT 1000 10000000;
BA_DEF_ BO_  "VFrameFormat" ENUM  "StandardCAN","ExtendedCAN","reserved","J1939PG","reserved","reserved","reserved","reserved","reserved","reserved","reserved","reserved","reserved","reserved","StandardCAN_FD","ExtendedCAN_FD";
BA_DEF_ BO_  "CANFD_BRS" ENUM  "0","1";
BA_DEF_ BO_  "GenMsgSendType" ENUM  "cyclic","spontaneous","not-used","not-used","not-used","cyclicAndSpontaneous","not-used","cyclicIfActive","NoMsgSendType";
BA_DEF_ BO_  "GenMsgCycleTime" INT 0 65536;
BA_DEF_ BO_  "GenMsgStartDelayTime" INT 0 65536;
BA_DEF_ BO_  "GenMsgDelayTime" INT 0 65536;
BA_DEF_ SG_  "GenSigSendType" ENUM  "Cyclic","OnWrite","OnWriteWithRepetition","OnChange","OnChangeWithRepetition","IfActive","IfActiveWithRepetition","NoSigSendType";
BA_DEF_ SG_  "GenSigStartValue" HEX 0 80000000;
BA_DEF_ BU_  "NmAsrNodeIdentifier" INT 0 255;
BA_DEF_  "DBName" STRING ;
BA_DEF_  "BusType" STRING ;
BA_DEF_  "ProtocolType" STRING ;
BA_DEF_ BO_  "GenMsgILSupport" ENUM  "No","Yes";
BA_DEF_ BO_  "NmAsrMessage" ENUM  "No","Yes";
BA_DEF_  "NmAsrBaseAddress" HEX 0 536870911;
BA_DEF_  "NmAsrMessageCount" INT 0 255;
BA_DEF_ BU_  "NodeLayerModules" STRING ;
BA_DEF_ BU_  "NmAsrNode" ENUM  "No","Yes";
BA_DEF_ BU_  "ILused" ENUM  "No","Yes";
BA_DEF_ SG_  "GenSigFuncType" ENUM  "NoFunction","n/a","n/a","n/a","n/a","n/a","n/a","n/a","n/a","n/a","n/a","n/a","n/a","n/a","n/a","CHK","CNTR","n/a","n/a","n/a","CNTR_AR_01","CRC_AR_01_BOTH","CRC_AR_01_ALT","CRC_AR_01_LOW","CRC_AR_01_NIBBLE","CNTR_AR_04","CRC_AR_04A","CNTR_AR_05","CRC_AR_05";
BA_DEF_ SG_  "GenSigDataID" STRING ;
BA_DEF_ SG_  "SigGroup" STRING ;
BA_DEF_ SG_  "SystemSignalLongSymbol" STRING ;
BA_DEF_ BO_  "SystemMessageLongSymbol" STRING ;
BA_DEF_DEF_  "Baudrate" 1000;
BA_DEF_DEF_  "BaudRateCANFD" 1000;
BA_DEF_DEF_  "VFrameFormat" "J1939PG";
BA_DEF_DEF_  "CANFD_BRS" "1";
BA_DEF_DEF_  "GenMsgSendType" "NoMsgSendType";
BA_DEF_DEF_  "GenMsgCycleTime" 0;
BA_DEF_DEF_  "GenMsgStartDelayTime" 0;
BA_DEF_DEF_  "GenMsgDelayTime" 0;
BA_DEF_DEF_  "GenSigSendType" "NoSigSendType";
BA_DEF_DEF_  "GenSigStartValue" 0;
BA_DEF_DEF_  "NmAsrNodeIdentifier" 0;
BA_DEF_DEF_  "DBName" "";
BA_DEF_DEF_  "BusType" "";
BA_DEF_DEF_  "ProtocolType" "";
BA_DEF_DEF_  "GenMsgILSupport" "Yes";
BA_DEF_DEF_  "NmAsrMessage" "No";
BA_DEF_DEF_  "NmAsrBaseAddress" 1280;
BA_DEF_DEF_  "NmAsrMessageCount" 64;
BA_DEF_DEF_  "NodeLayerModules" "CANoeILNLSPA.dll";
BA_DEF_DEF_  "NmAsrNode" "No";
BA_DEF_DEF_  "ILused" "Yes";
BA_DEF_DEF_  "GenSigFuncType" "NoFunction";
BA_DEF_DEF_  "GenSigDataID" "";
BA_DEF_DEF_  "SigGroup" "";
BA_DEF_DEF_  "SystemSignalLongSymbol" "";
BA_DEF_DEF_  "SystemMessageLongSymbol" "";
BA_ "BaudRateCANFD" 2000000;
BA_ "Baudrate" 500000;
BA_ "ProtocolType" "CAN";
BA_ "BusType" "CAN FD";
BA_ "DBName" "SafetyCANFD4";
BA_ "NodeLayerModules" BU_ ASDM "CANoeILNLSPA.dll,AsrNM33.dll";
BA_ "NmAsrNode" BU_ ASDM 1;
BA_ "NmAsrNodeIdentifier" BU_ ASDM 1;
BA_ "ILused" BU_ ETC 0;
BA_ "NodeLayerModules" BU_ PAS "CANoeILNLSPA.dll,AsrNM33.dll";
BA_ "NmAsrNode" BU_ PAS 1;
BA_ "NmAsrNodeIdentifier" BU_ PAS 2;
BA_ "GenMsgCycleTime" BO_ 101 10;
BA_ "GenMsgSendType" BO_ 101 0;
BA_ "VFrameFormat" BO_ 101 14;
BA_ "GenMsgCycleTime" BO_ 105 20;
BA_ "GenMsgSendType" BO_ 105 0;
BA_ "VFrameFormat" BO_ 105 14;
BA_ "GenMsgCycleTime" BO_ 128 30;
BA_ "GenMsgSendType" BO_ 128 0;
BA_ "VFrameFormat" BO_ 128 14;
BA_ "GenMsgCycleTime" BO_ 389 60;
BA_ "GenMsgSendType" BO_ 389 0;
BA_ "VFrameFormat" BO_ 389 14;
BA_ "GenMsgCycleTime" BO_ 144 100;
BA_ "GenMsgSendType" BO_ 144 0;
BA_ "VFrameFormat" BO_ 144 14;
BA_ "GenSigDataID" SG_ 101 AbsCtrlActvChks "0xD06";
BA_ "GenSigFuncType" SG_ 101 AbsCtrlActvChks 15;
BA_ "GenSigSendType" SG_ 101 AbsCtrlActvChks 0;
BA_ "GenSigFuncType" SG_ 101 AbsCtrlActvCntr 16;
BA_ "GenSigSendType" SG_ 101 AbsCtrlActvCntr 0;
BA_ "GenSigSendType" SG_ 101 AbsCtrlActvCtrlSts1 0;
BA_ "GenSigStartValue" SG_ 101 AccrPedlPsd_UB 1;
BA_ "GenSigSendType" SG_ 101 AccrPedlPsdAccrPedlPsd 0;
BA_ "GenSigDataID" SG_ 101 AccrPedlPsdChks "0x48";
BA_ "GenSigFuncType" SG_ 101 AccrPedlPsdChks 15;
BA_ "GenSigSendType" SG_ 101 AccrPedlPsdChks 0;
BA_ "GenSigStartValue" SG_ 101 AccrPedlPsdChks 255;
BA_ "GenSigFuncType" SG_ 101 AccrPedlPsdCntr 16;
BA_ "GenSigSendType" SG_ 101 AccrPedlPsdCntr 0;
BA_ "GenSigSendType" SG_ 101 AccrPedlPsdSts 0;
BA_ "GenSigSendType" SG_ 101 AccrPedlRatAccrPedlRat 0;
BA_ "GenSigDataID" SG_ 101 AccrPedlRatChks "0x364";
BA_ "GenSigFuncType" SG_ 101 AccrPedlRatChks 15;
BA_ "GenSigSendType" SG_ 101 AccrPedlRatChks 0;
BA_ "GenSigFuncType" SG_ 101 AccrPedlRatCntr 16;
BA_ "GenSigSendType" SG_ 101 AccrPedlRatCntr 0;
BA_ "GenSigSendType" SG_ 101 AccrpedlSts 0;
BA_ "GenSigStartValue" SG_ 101 BltLockStSafeAtDrvr_UB 1;
BA_ "GenSigSendType" SG_ 101 BltLockStSafeAtDrvrBltLockSt1 0;
BA_ "GenSigStartValue" SG_ 101 BltLockStSafeAtDrvrBltLockSt1 1;
BA_ "GenSigSendType" SG_ 101 BltLockStSafeAtDrvrBltLockStErrS 0;
BA_ "SystemSignalLongSymbol" SG_ 101 BltLockStSafeAtDrvrBltLockStErrS "BltLockStSafeAtDrvrBltLockStErrSts";
BA_ "GenSigDataID" SG_ 101 BltLockStSafeAtDrvrChks "0x40C";
BA_ "GenSigFuncType" SG_ 101 BltLockStSafeAtDrvrChks 15;
BA_ "GenSigSendType" SG_ 101 BltLockStSafeAtDrvrChks 0;
BA_ "GenSigStartValue" SG_ 101 BltLockStSafeAtDrvrChks 255;
BA_ "GenSigFuncType" SG_ 101 BltLockStSafeAtDrvrCntr 16;
BA_ "GenSigSendType" SG_ 101 BltLockStSafeAtDrvrCntr 0;
BA_ "GenSigDataID" SG_ 101 EngSt1WdStsChks "0x89";
BA_ "GenSigFuncType" SG_ 101 EngSt1WdStsChks 15;
BA_ "GenSigSendType" SG_ 101 EngSt1WdStsChks 0;
BA_ "GenSigFuncType" SG_ 101 EngSt1WdStsCntr 16;
BA_ "GenSigSendType" SG_ 101 EngSt1WdStsCntr 0;
BA_ "GenSigSendType" SG_ 101 EngSt1WdStsEngSt1WdSts 0;
BA_ "GenSigDataID" SG_ 101 EscStChks "0x7F";
BA_ "GenSigFuncType" SG_ 101 EscStChks 15;
BA_ "GenSigSendType" SG_ 101 EscStChks 0;
BA_ "GenSigFuncType" SG_ 101 EscStCntr 16;
BA_ "GenSigSendType" SG_ 101 EscStCntr 0;
BA_ "GenSigSendType" SG_ 101 EscStEscSt 0;
BA_ "GenSigStartValue" SG_ 101 EscStEscSt 1;
BA_ "GenSigDataID" SG_ 101 GuestrStsChks "0x1F4A";
BA_ "GenSigFuncType" SG_ 101 GuestrStsChks 15;
BA_ "GenSigSendType" SG_ 101 GuestrStsChks 0;
BA_ "GenSigFuncType" SG_ 101 GuestrStsCntr 16;
BA_ "GenSigSendType" SG_ 101 GuestrStsCntr 0;
BA_ "GenSigSendType" SG_ 101 GuestrStsValidity 0;
BA_ "GenSigStartValue" SG_ 101 PinionSteerAgGroup_UB 1;
BA_ "GenSigDataID" SG_ 101 PinionSteerAgGroupChks "0x40D";
BA_ "GenSigFuncType" SG_ 101 PinionSteerAgGroupChks 15;
BA_ "GenSigSendType" SG_ 101 PinionSteerAgGroupChks 0;
BA_ "GenSigFuncType" SG_ 101 PinionSteerAgGroupCntr 16;
BA_ "GenSigSendType" SG_ 101 PinionSteerAgGroupCntr 0;
BA_ "GenSigSendType" SG_ 101 PinionSteerAgGroupPinionSteerAg1 0;
BA_ "GenSigSendType" SG_ 101 PinionSteerAgGroupPinionSte_0000 0;
BA_ "GenSigStartValue" SG_ 101 PinionSteerAgGroupPinionSte_0000 1;
BA_ "SystemSignalLongSymbol" SG_ 101 PinionSteerAgGroupPinionSte_0000 "PinionSteerAgGroupPinionSteerAg1Qf";
BA_ "GenSigSendType" SG_ 101 PinionSteerAgGroupPinionSteerAgS 0;
BA_ "SystemSignalLongSymbol" SG_ 101 PinionSteerAgGroupPinionSteerAgS "PinionSteerAgGroupPinionSteerAgSpd1";
BA_ "GenSigSendType" SG_ 101 PinionSteerAgGroupPinionSte_0001 0;
BA_ "GenSigStartValue" SG_ 101 PinionSteerAgGroupPinionSte_0001 1;
BA_ "SystemSignalLongSymbol" SG_ 101 PinionSteerAgGroupPinionSte_0001 "PinionSteerAgGroupPinionSteerAgSpd1Qf";
BA_ "GenSigSendType" SG_ 101 PinionSteerAgGroupSteerWhlTq 0;
BA_ "GenSigSendType" SG_ 101 PinionSteerAgGroupSteerWhlTqQf 0;
BA_ "GenSigStartValue" SG_ 101 PinionSteerAgGroupSteerWhlTqQf 1;
BA_ "GenSigSendType" SG_ 101 PosnFromSatlt1Cntr 0;
BA_ "GenSigSendType" SG_ 101 PosnFromSatlt1PosnLat 0;
BA_ "GenSigSendType" SG_ 101 PosnFromSatlt1PosnLgt 0;
BA_ "GenSigSendType" SG_ 101 PosnFromSatlt2Cntr 0;
BA_ "GenSigSendType" SG_ 101 PosnFromSatlt2PosnSpdosn 0;
BA_ "GenSigSendType" SG_ 101 PosnFromSatlt3Cntr 0;
BA_ "GenSigSendType" SG_ 101 PosnFromSatlt3PosnAlti 0;
BA_ "GenSigStartValue" SG_ 101 PosnFromSatlt3PosnAlti 1000;
BA_ "GenSigSendType" SG_ 101 PosnFromSatlt3PosnDir 0;
BA_ "GenSigStartValue" SG_ 101 PosnFromSatlt3PosnDir 100;
BA_ "GenSigSendType" SG_ 101 PosnFromSatlt3TiForMins 0;
BA_ "GenSigSendType" SG_ 101 PosnFromSatlt3TiForMsec 0;
BA_ "GenSigSendType" SG_ 101 PosnFromSatlt3TiForSec 0;
BA_ "GenSigDataID" SG_ 101 PrkLatLgtFailrChks "0x421";
BA_ "GenSigFuncType" SG_ 101 PrkLatLgtFailrChks 15;
BA_ "GenSigSendType" SG_ 101 PrkLatLgtFailrChks 0;
BA_ "GenSigFuncType" SG_ 101 PrkLatLgtFailrCntr 16;
BA_ "GenSigSendType" SG_ 101 PrkLatLgtFailrCntr 0;
BA_ "GenSigSendType" SG_ 101 PrkLatLgtFailrPrkLatLgtFailr 0;
BA_ "GenSigSendType" SG_ 101 SwtIndcrIndcrTypExtReq 0;
BA_ "GenSigSendType" SG_ 101 SwtIndcrIndcrTypExtReqChks 0;
BA_ "GenSigSendType" SG_ 101 SwtIndcrIndcrTypExtReqCntr 0;
BA_ "GenSigSendType" SG_ 101 SwtIndcrIndcrTypExtReqToUpdQf 0;
BA_ "GenSigStartValue" SG_ 101 SwtIndcrIndcrTypExtReqToUpdQf 1;
BA_ "GenSigDataID" SG_ 101 TrsmParkLockdChks "0x32";
BA_ "GenSigFuncType" SG_ 101 TrsmParkLockdChks 15;
BA_ "GenSigSendType" SG_ 101 TrsmParkLockdChks 0;
BA_ "GenSigFuncType" SG_ 101 TrsmParkLockdCntr 16;
BA_ "GenSigSendType" SG_ 101 TrsmParkLockdCntr 0;
BA_ "GenSigSendType" SG_ 101 TrsmParkLockdTrsmParkLockd 0;
BA_ "GenSigStartValue" SG_ 101 TrsmParkLockdTrsmParkLockd 3;
BA_ "GenSigStartValue" SG_ 101 VehMtnSt_UB 1;
BA_ "GenSigDataID" SG_ 101 VehMtnStChks "0x36";
BA_ "GenSigFuncType" SG_ 101 VehMtnStChks 15;
BA_ "GenSigSendType" SG_ 101 VehMtnStChks 0;
BA_ "GenSigFuncType" SG_ 101 VehMtnStCntr 16;
BA_ "GenSigSendType" SG_ 101 VehMtnStCntr 0;
BA_ "GenSigSendType" SG_ 101 VehMtnStVehMtnSt 0;
BA_ "GenSigStartValue" SG_ 101 VehSpdLgt_UB 1;
BA_ "GenSigSendType" SG_ 101 VehSpdLgtA 0;
BA_ "GenSigDataID" SG_ 101 VehSpdLgtChks "0x37";
BA_ "GenSigFuncType" SG_ 101 VehSpdLgtChks 15;
BA_ "GenSigSendType" SG_ 101 VehSpdLgtChks 0;
BA_ "GenSigFuncType" SG_ 101 VehSpdLgtCntr 16;
BA_ "GenSigSendType" SG_ 101 VehSpdLgtCntr 0;
BA_ "GenSigSendType" SG_ 101 VehSpdLgtQf 0;
BA_ "GenSigStartValue" SG_ 101 VehSpdLgtQf 1;
BA_ "GenSigSendType" SG_ 101 VehTiAndDataDataValid 0;
BA_ "GenSigSendType" SG_ 101 VehTiAndDataDay 0;
BA_ "GenSigStartValue" SG_ 101 VehTiAndDataDay 1;
BA_ "GenSigSendType" SG_ 101 VehTiAndDataHr1 0;
BA_ "GenSigSendType" SG_ 101 VehTiAndDataMins1 0;
BA_ "GenSigSendType" SG_ 101 VehTiAndDataMth1 0;
BA_ "GenSigStartValue" SG_ 101 VehTiAndDataMth1 1;
BA_ "GenSigSendType" SG_ 101 VehTiAndDataSec1 0;
BA_ "GenSigSendType" SG_ 101 VehTiAndDataYr1 0;
BA_ "GenSigSendType" SG_ 105 AsyADL3FuncCtrlStsADMod 0;
BA_ "GenSigDataID" SG_ 105 AsyADL3FuncCtrlStsChks "0xD17";
BA_ "GenSigFuncType" SG_ 105 AsyADL3FuncCtrlStsChks 15;
BA_ "GenSigSendType" SG_ 105 AsyADL3FuncCtrlStsChks 0;
BA_ "GenSigFuncType" SG_ 105 AsyADL3FuncCtrlStsCntr 16;
BA_ "GenSigSendType" SG_ 105 AsyADL3FuncCtrlStsCntr 0;
BA_ "GenSigSendType" SG_ 105 AsyADL3FuncCtrlStsCtrlSts 0;
BA_ "GenSigSendType" SG_ 105 AsyADL3FuncCtrlStsDegraded 0;
BA_ "GenSigSendType" SG_ 105 AsyADL3FuncCtrlStsQf 0;
BA_ "GenSigSendType" SG_ 105 AsyADL3FuncCtrlStsSts 0;
BA_ "GenSigSendType" SG_ 105 AsyALgtCtrlMod1 0;
BA_ "GenSigSendType" SG_ 105 AsyALgtCtrlModCfmdAsyALgtCtrlMod 0;
BA_ "SystemSignalLongSymbol" SG_ 105 AsyALgtCtrlModCfmdAsyALgtCtrlMod "AsyALgtCtrlModCfmdAsyALgtCtrlMod1";
BA_ "GenSigDataID" SG_ 105 AsyALgtCtrlModCfmdChks "0x416";
BA_ "GenSigFuncType" SG_ 105 AsyALgtCtrlModCfmdChks 15;
BA_ "GenSigSendType" SG_ 105 AsyALgtCtrlModCfmdChks 0;
BA_ "GenSigFuncType" SG_ 105 AsyALgtCtrlModCfmdCntr 16;
BA_ "GenSigSendType" SG_ 105 AsyALgtCtrlModCfmdCntr 0;
BA_ "GenSigDataID" SG_ 105 AsyALgtCtrlModChks "0xD16";
BA_ "GenSigFuncType" SG_ 105 AsyALgtCtrlModChks 15;
BA_ "GenSigSendType" SG_ 105 AsyALgtCtrlModChks 0;
BA_ "GenSigFuncType" SG_ 105 AsyALgtCtrlModCntr 16;
BA_ "GenSigSendType" SG_ 105 AsyALgtCtrlModCntr 0;
BA_ "GenSigSendType" SG_ 105 AsyALgtStsAsyALgtSts 0;
BA_ "GenSigDataID" SG_ 105 AsyALgtStsChks "0xAF0";
BA_ "GenSigFuncType" SG_ 105 AsyALgtStsChks 15;
BA_ "GenSigSendType" SG_ 105 AsyALgtStsChks 0;
BA_ "GenSigFuncType" SG_ 105 AsyALgtStsCntr 16;
BA_ "GenSigSendType" SG_ 105 AsyALgtStsCntr 0;
BA_ "GenSigSendType" SG_ 105 AsyLatCtrlModReqGroupAsyLatCtrlM 0;
BA_ "SystemSignalLongSymbol" SG_ 105 AsyLatCtrlModReqGroupAsyLatCtrlM "AsyLatCtrlModReqGroupAsyLatCtrlModReq";
BA_ "GenSigDataID" SG_ 105 AsyLatCtrlModReqGroupCfmdChks "0x424";
BA_ "GenSigFuncType" SG_ 105 AsyLatCtrlModReqGroupCfmdChks 15;
BA_ "GenSigSendType" SG_ 105 AsyLatCtrlModReqGroupCfmdChks 0;
BA_ "GenSigFuncType" SG_ 105 AsyLatCtrlModReqGroupCfmdCntr 16;
BA_ "GenSigSendType" SG_ 105 AsyLatCtrlModReqGroupCfmdCntr 0;
BA_ "GenSigSendType" SG_ 105 AsyLatCtrlModReqGroupCfmdLatCtrl 0;
BA_ "SystemSignalLongSymbol" SG_ 105 AsyLatCtrlModReqGroupCfmdLatCtrl "AsyLatCtrlModReqGroupCfmdLatCtrlMod";
BA_ "GenSigDataID" SG_ 105 AsyLatCtrlModReqGroupChks "0x1ED2";
BA_ "GenSigFuncType" SG_ 105 AsyLatCtrlModReqGroupChks 15;
BA_ "GenSigSendType" SG_ 105 AsyLatCtrlModReqGroupChks 0;
BA_ "GenSigFuncType" SG_ 105 AsyLatCtrlModReqGroupCntr 16;
BA_ "GenSigSendType" SG_ 105 AsyLatCtrlModReqGroupCntr 0;
BA_ "GenSigSendType" SG_ 105 BiasedPosnFromSatlt1Cntr 0;
BA_ "GenSigSendType" SG_ 105 BiasedPosnFromSatlt1PosnLat 0;
BA_ "GenSigSendType" SG_ 105 BiasedPosnFromSatlt1PosnLgt 0;
BA_ "GenSigSendType" SG_ 105 BrkHptcWarnReqForAutDrvBrkHptcWa 0;
BA_ "SystemSignalLongSymbol" SG_ 105 BrkHptcWarnReqForAutDrvBrkHptcWa "BrkHptcWarnReqForAutDrvBrkHptcWarnReqForAutDrv";
BA_ "GenSigDataID" SG_ 105 BrkHptcWarnReqForAutDrvChks "0xD27";
BA_ "GenSigFuncType" SG_ 105 BrkHptcWarnReqForAutDrvChks 15;
BA_ "GenSigSendType" SG_ 105 BrkHptcWarnReqForAutDrvChks 0;
BA_ "GenSigFuncType" SG_ 105 BrkHptcWarnReqForAutDrvCntr 16;
BA_ "GenSigSendType" SG_ 105 BrkHptcWarnReqForAutDrvCntr 0;
BA_ "GenSigStartValue" SG_ 105 BrkPedlPsd_UB 1;
BA_ "GenSigSendType" SG_ 105 BrkPedlPsdBrkPedlNotPsdSafe 0;
BA_ "GenSigSendType" SG_ 105 BrkPedlPsdBrkPedlPsd 0;
BA_ "GenSigDataID" SG_ 105 BrkPedlPsdChks "0x38";
BA_ "GenSigFuncType" SG_ 105 BrkPedlPsdChks 15;
BA_ "GenSigSendType" SG_ 105 BrkPedlPsdChks 0;
BA_ "GenSigFuncType" SG_ 105 BrkPedlPsdCntr 16;
BA_ "GenSigSendType" SG_ 105 BrkPedlPsdCntr 0;
BA_ "GenSigSendType" SG_ 105 BrkPedlPsdQf 0;
BA_ "GenSigSendType" SG_ 105 DrvrAsscSysBtnPush 0;
BA_ "GenSigStartValue" SG_ 105 DrvrAsscSysBtnPush_UB 1;
BA_ "GenSigStartValue" SG_ 105 EpbSts_UB 1;
BA_ "GenSigDataID" SG_ 105 EpbStsChks "0x84";
BA_ "GenSigFuncType" SG_ 105 EpbStsChks 15;
BA_ "GenSigSendType" SG_ 105 EpbStsChks 0;
BA_ "GenSigFuncType" SG_ 105 EpbStsCntr 16;
BA_ "GenSigSendType" SG_ 105 EpbStsCntr 0;
BA_ "GenSigSendType" SG_ 105 EpbStsEpbSts 0;
BA_ "GenSigSendType" SG_ 105 EscCtrlIndcn 0;
BA_ "GenSigStartValue" SG_ 105 EscCtrlIndcn 1;
BA_ "GenSigSendType" SG_ 105 FctaIndcnLe 0;
BA_ "GenSigSendType" SG_ 105 FctaIndcnRi 0;
BA_ "GenSigSendType" SG_ 105 GearLvrIndcn 0;
BA_ "GenSigStartValue" SG_ 105 GearLvrIndcn 7;
BA_ "GenSigStartValue" SG_ 105 GearLvrIndcn_UB 1;
BA_ "GenSigSendType" SG_ 105 MobDevRPAAuthRespAnswer 0;
BA_ "GenSigDataID" SG_ 105 MobDevRPAAuthRespChks "0x1F4B";
BA_ "GenSigFuncType" SG_ 105 MobDevRPAAuthRespChks 15;
BA_ "GenSigSendType" SG_ 105 MobDevRPAAuthRespChks 0;
BA_ "GenSigFuncType" SG_ 105 MobDevRPAAuthRespCntr 16;
BA_ "GenSigSendType" SG_ 105 MobDevRPAAuthRespCntr 0;
BA_ "GenSigSendType" SG_ 105 MobDevRPAAuthRespX 0;
BA_ "GenSigSendType" SG_ 105 MobDevRPAAuthRespY 0;
BA_ "GenSigSendType" SG_ 105 MsgReqByHillDwnCtrl 0;
BA_ "GenSigSendType" SG_ 105 PdcMuteBtnReq 1;
BA_ "GenSigDataID" SG_ 105 RctaBrkReqChks "0x0A";
BA_ "GenSigFuncType" SG_ 105 RctaBrkReqChks 15;
BA_ "GenSigSendType" SG_ 105 RctaBrkReqChks 0;
BA_ "GenSigFuncType" SG_ 105 RctaBrkReqCntr 16;
BA_ "GenSigSendType" SG_ 105 RctaBrkReqCntr 0;
BA_ "GenSigSendType" SG_ 105 RctaBrkReqRctaBrkReq 0;
BA_ "GenSigStartValue" SG_ 105 RctaBrkReqRctaBrkReq 1;
BA_ "GenSigSendType" SG_ 105 RctaIndcnLe 0;
BA_ "GenSigSendType" SG_ 105 RctaIndcnRi 0;
BA_ "GenSigDataID" SG_ 105 RcwmBrkReqChks "0x06";
BA_ "GenSigFuncType" SG_ 105 RcwmBrkReqChks 15;
BA_ "GenSigSendType" SG_ 105 RcwmBrkReqChks 0;
BA_ "GenSigFuncType" SG_ 105 RcwmBrkReqCntr 16;
BA_ "GenSigSendType" SG_ 105 RcwmBrkReqCntr 0;
BA_ "GenSigSendType" SG_ 105 RcwmBrkReqRcwmBrkReq 0;
BA_ "GenSigSendType" SG_ 105 RoadInclnQly 0;
BA_ "GenSigStartValue" SG_ 105 RoadInclnQly 1;
BA_ "GenSigSendType" SG_ 105 RoadInclnRoadIncln 0;
BA_ "GenSigSendType" SG_ 105 SftyDecelGroupSafeAsySftyDecelRe 0;
BA_ "SystemSignalLongSymbol" SG_ 105 SftyDecelGroupSafeAsySftyDecelRe "SftyDecelGroupSafeAsySftyDecelReq";
BA_ "GenSigSendType" SG_ 105 SftyDecelGroupSafeAsySftyEnaDece 0;
BA_ "SystemSignalLongSymbol" SG_ 105 SftyDecelGroupSafeAsySftyEnaDece "SftyDecelGroupSafeAsySftyEnaDecel";
BA_ "GenSigDataID" SG_ 105 SftyDecelGroupSafeChks "0x4C";
BA_ "GenSigFuncType" SG_ 105 SftyDecelGroupSafeChks 15;
BA_ "GenSigSendType" SG_ 105 SftyDecelGroupSafeChks 0;
BA_ "GenSigFuncType" SG_ 105 SftyDecelGroupSafeCntr 16;
BA_ "GenSigSendType" SG_ 105 SftyDecelGroupSafeCntr 0;
BA_ "GenSigStartValue" SG_ 105 VehModMngtGlbSafe1_UB 1;
BA_ "GenSigSendType" SG_ 105 VehModMngtGlbSafe1CarModSts1 0;
BA_ "GenSigSendType" SG_ 105 VehModMngtGlbSafe1CarModSubtypWd 0;
BA_ "SystemSignalLongSymbol" SG_ 105 VehModMngtGlbSafe1CarModSubtypWd "VehModMngtGlbSafe1CarModSubtypWdCarModSubtyp";
BA_ "GenSigDataID" SG_ 105 VehModMngtGlbSafe1Chks "0x74";
BA_ "GenSigFuncType" SG_ 105 VehModMngtGlbSafe1Chks 15;
BA_ "GenSigSendType" SG_ 105 VehModMngtGlbSafe1Chks 0;
BA_ "GenSigFuncType" SG_ 105 VehModMngtGlbSafe1Cntr 16;
BA_ "GenSigSendType" SG_ 105 VehModMngtGlbSafe1Cntr 0;
BA_ "GenSigSendType" SG_ 105 VehModMngtGlbSafe1EgyLvlElecMai 0;
BA_ "GenSigSendType" SG_ 105 VehModMngtGlbSafe1EgyLvlElecSubt 0;
BA_ "SystemSignalLongSymbol" SG_ 105 VehModMngtGlbSafe1EgyLvlElecSubt "VehModMngtGlbSafe1EgyLvlElecSubtyp";
BA_ "GenSigSendType" SG_ 105 VehModMngtGlbSafe1FltEgyCnsWdSts 0;
BA_ "GenSigSendType" SG_ 105 VehModMngtGlbSafe1PwrLvlElecMai 0;
BA_ "GenSigSendType" SG_ 105 VehModMngtGlbSafe1PwrLvlElecSubt 0;
BA_ "SystemSignalLongSymbol" SG_ 105 VehModMngtGlbSafe1PwrLvlElecSubt "VehModMngtGlbSafe1PwrLvlElecSubtyp";
BA_ "GenSigSendType" SG_ 105 VehModMngtGlbSafe1UsgModSts 0;
BA_ "GenSigStartValue" SG_ 105 VehModMngtGlbSafe1UsgModSts 1;
BA_ "GenSigSendType" SG_ 128 ADataRawSafeALat 0;
BA_ "GenSigSendType" SG_ 128 ADataRawSafeALat1Qf 0;
BA_ "GenSigStartValue" SG_ 128 ADataRawSafeALat1Qf 1;
BA_ "GenSigSendType" SG_ 128 ADataRawSafeALgt 0;
BA_ "GenSigSendType" SG_ 128 ADataRawSafeALgt1Qf 0;
BA_ "GenSigStartValue" SG_ 128 ADataRawSafeALgt1Qf 1;
BA_ "GenSigSendType" SG_ 128 ADataRawSafeAVert 0;
BA_ "GenSigStartValue" SG_ 128 ADataRawSafeAVert 1155.059;
BA_ "GenSigSendType" SG_ 128 ADataRawSafeAVertQf 0;
BA_ "GenSigStartValue" SG_ 128 ADataRawSafeAVertQf 1;
BA_ "GenSigDataID" SG_ 128 ADataRawSafeChks "0x22";
BA_ "GenSigFuncType" SG_ 128 ADataRawSafeChks 15;
BA_ "GenSigSendType" SG_ 128 ADataRawSafeChks 0;
BA_ "GenSigStartValue" SG_ 128 ADataRawSafeChks 255;
BA_ "GenSigFuncType" SG_ 128 ADataRawSafeCntr 16;
BA_ "GenSigSendType" SG_ 128 ADataRawSafeCntr 0;
BA_ "GenSigDataID" SG_ 128 AgDataRawSafeChks "0x23";
BA_ "GenSigFuncType" SG_ 128 AgDataRawSafeChks 15;
BA_ "GenSigSendType" SG_ 128 AgDataRawSafeChks 0;
BA_ "GenSigStartValue" SG_ 128 AgDataRawSafeChks 255;
BA_ "GenSigFuncType" SG_ 128 AgDataRawSafeCntr 16;
BA_ "GenSigSendType" SG_ 128 AgDataRawSafeCntr 0;
BA_ "GenSigSendType" SG_ 128 AgDataRawSafeRollRate 0;
BA_ "GenSigSendType" SG_ 128 AgDataRawSafeRollRateQf 0;
BA_ "GenSigStartValue" SG_ 128 AgDataRawSafeRollRateQf 1;
BA_ "GenSigSendType" SG_ 128 AgDataRawSafeYawRate 0;
BA_ "GenSigSendType" SG_ 128 AgDataRawSafeYawRateQf 0;
BA_ "GenSigStartValue" SG_ 128 AgDataRawSafeYawRateQf 1;
BA_ "GenSigSendType" SG_ 128 AsyDataWithCmpSafeALat1Qf 0;
BA_ "GenSigStartValue" SG_ 128 AsyDataWithCmpSafeALat1Qf 1;
BA_ "GenSigSendType" SG_ 128 AsyDataWithCmpSafeALatWithCmp 0;
BA_ "GenSigSendType" SG_ 128 AsyDataWithCmpSafeALgt1Qf 0;
BA_ "GenSigStartValue" SG_ 128 AsyDataWithCmpSafeALgt1Qf 1;
BA_ "GenSigDataID" SG_ 128 AsyDataWithCmpSafeChks "0x24";
BA_ "GenSigFuncType" SG_ 128 AsyDataWithCmpSafeChks 15;
BA_ "GenSigSendType" SG_ 128 AsyDataWithCmpSafeChks 0;
BA_ "GenSigStartValue" SG_ 128 AsyDataWithCmpSafeChks 255;
BA_ "GenSigFuncType" SG_ 128 AsyDataWithCmpSafeCntr 16;
BA_ "GenSigSendType" SG_ 128 AsyDataWithCmpSafeCntr 0;
BA_ "GenSigSendType" SG_ 128 AsyDataWithCmpSafeGrdtOfALgt 0;
BA_ "GenSigSendType" SG_ 128 AsyDataWithCmpSafeYawRateQf 0;
BA_ "GenSigStartValue" SG_ 128 AsyDataWithCmpSafeYawRateQf 1;
BA_ "GenSigSendType" SG_ 128 AsyDataWithCmpSafeYawRateWithCmp 0;
BA_ "GenSigSendType" SG_ 128 AsyHandsOffIndcrAsyIndcrDispSts 0;
BA_ "GenSigDataID" SG_ 128 AsyHandsOffIndcrChks "0x4B";
BA_ "GenSigFuncType" SG_ 128 AsyHandsOffIndcrChks 15;
BA_ "GenSigSendType" SG_ 128 AsyHandsOffIndcrChks 0;
BA_ "GenSigFuncType" SG_ 128 AsyHandsOffIndcrCntr 16;
BA_ "GenSigSendType" SG_ 128 AsyHandsOffIndcrCntr 0;
BA_ "GenSigSendType" SG_ 128 GearMov 0;
BA_ "GenSigStartValue" SG_ 128 GearMov 2;
BA_ "GenSigDataID" SG_ 128 MobDevRPAReqChks "0x1F41";
BA_ "GenSigFuncType" SG_ 128 MobDevRPAReqChks 15;
BA_ "GenSigSendType" SG_ 128 MobDevRPAReqChks 0;
BA_ "GenSigFuncType" SG_ 128 MobDevRPAReqCntr 16;
BA_ "GenSigSendType" SG_ 128 MobDevRPAReqCntr 0;
BA_ "GenSigSendType" SG_ 128 MobDevRPAReqMobDevSts 0;
BA_ "GenSigSendType" SG_ 128 MobDevRPAReqRPAOutModeSubT 0;
BA_ "GenSigStartValue" SG_ 128 MobDevRPAReqRPAOutModeSubT 1;
BA_ "GenSigSendType" SG_ 128 MobDevRPAReqRPAReq 0;
BA_ "GenSigStartValue" SG_ 128 MobDevRPAReqRPAReq 2;
BA_ "GenSigSendType" SG_ 128 MobDevRPAReqRSPACtrl 0;
BA_ "GenSigSendType" SG_ 128 NetTCAMActvtPrio 0;
BA_ "GenSigSendType" SG_ 128 NetTCAMActvtResourceGroup 0;
BA_ "GenSigSendType" SG_ 128 SeatBackAngleRowFirstDrvr 0;
BA_ "GenSigSendType" SG_ 128 StandStillMgrStsForHld1 0;
BA_ "GenSigDataID" SG_ 128 StandStillMgrStsForHldChks "0x448";
BA_ "GenSigFuncType" SG_ 128 StandStillMgrStsForHldChks 15;
BA_ "GenSigSendType" SG_ 128 StandStillMgrStsForHldChks 0;
BA_ "GenSigFuncType" SG_ 128 StandStillMgrStsForHldCntr 16;
BA_ "GenSigSendType" SG_ 128 StandStillMgrStsForHldCntr 0;
BA_ "GenSigSendType" SG_ 128 VisnImgDispModReq 1;
BA_ "GenSigStartValue" SG_ 128 VisnImgDispModReq_UB 1;
BA_ "GenSigStartValue" SG_ 128 WhlDirRotlFrnt_UB 1;
BA_ "GenSigDataID" SG_ 128 WhlDirRotlFrntChks "0x228";
BA_ "GenSigFuncType" SG_ 128 WhlDirRotlFrntChks 15;
BA_ "GenSigSendType" SG_ 128 WhlDirRotlFrntChks 0;
BA_ "GenSigFuncType" SG_ 128 WhlDirRotlFrntCntr 16;
BA_ "GenSigSendType" SG_ 128 WhlDirRotlFrntCntr 0;
BA_ "GenSigSendType" SG_ 128 WhlDirRotlFrntLe 0;
BA_ "GenSigSendType" SG_ 128 WhlDirRotlFrntRi 0;
BA_ "GenSigStartValue" SG_ 128 WhlDirRotlRe_UB 1;
BA_ "GenSigDataID" SG_ 128 WhlDirRotlReChks "0x227";
BA_ "GenSigFuncType" SG_ 128 WhlDirRotlReChks 15;
BA_ "GenSigSendType" SG_ 128 WhlDirRotlReChks 0;
BA_ "GenSigFuncType" SG_ 128 WhlDirRotlReCntr 16;
BA_ "GenSigSendType" SG_ 128 WhlDirRotlReCntr 0;
BA_ "GenSigSendType" SG_ 128 WhlDirRotlReLe 0;
BA_ "GenSigSendType" SG_ 128 WhlDirRotlReRi 0;
BA_ "GenSigStartValue" SG_ 128 WhlRotToothCntr_UB 1;
BA_ "GenSigDataID" SG_ 128 WhlRotToothCntrChks "0x19C8";
BA_ "GenSigFuncType" SG_ 128 WhlRotToothCntrChks 15;
BA_ "GenSigSendType" SG_ 128 WhlRotToothCntrChks 0;
BA_ "GenSigFuncType" SG_ 128 WhlRotToothCntrCntr 16;
BA_ "GenSigSendType" SG_ 128 WhlRotToothCntrCntr 0;
BA_ "GenSigSendType" SG_ 128 WhlRotToothCntrFrntLe 0;
BA_ "GenSigSendType" SG_ 128 WhlRotToothCntrFrntRi 0;
BA_ "GenSigSendType" SG_ 128 WhlRotToothCntrReLe 0;
BA_ "GenSigSendType" SG_ 128 WhlRotToothCntrReRi 0;
BA_ "GenSigStartValue" SG_ 128 WhlSpdCircumlFrnt_UB 1;
BA_ "GenSigDataID" SG_ 128 WhlSpdCircumlFrntChks "0x6F";
BA_ "GenSigFuncType" SG_ 128 WhlSpdCircumlFrntChks 15;
BA_ "GenSigSendType" SG_ 128 WhlSpdCircumlFrntChks 0;
BA_ "GenSigFuncType" SG_ 128 WhlSpdCircumlFrntCntr 16;
BA_ "GenSigSendType" SG_ 128 WhlSpdCircumlFrntCntr 0;
BA_ "GenSigSendType" SG_ 128 WhlSpdCircumlFrntLe 0;
BA_ "GenSigSendType" SG_ 128 WhlSpdCircumlFrntLeQf 0;
BA_ "GenSigStartValue" SG_ 128 WhlSpdCircumlFrntLeQf 1;
BA_ "GenSigSendType" SG_ 128 WhlSpdCircumlFrntRiQf 0;
BA_ "GenSigStartValue" SG_ 128 WhlSpdCircumlFrntRiQf 1;
BA_ "GenSigSendType" SG_ 128 WhlSpdCircumlFrntWhlSpdCircumlFr 0;
BA_ "SystemSignalLongSymbol" SG_ 128 WhlSpdCircumlFrntWhlSpdCircumlFr "WhlSpdCircumlFrntWhlSpdCircumlFrntRi";
BA_ "GenSigStartValue" SG_ 128 WhlSpdCircumlRe_UB 1;
BA_ "GenSigDataID" SG_ 128 WhlSpdCircumlReChks "0x7C";
BA_ "GenSigFuncType" SG_ 128 WhlSpdCircumlReChks 15;
BA_ "GenSigSendType" SG_ 128 WhlSpdCircumlReChks 0;
BA_ "GenSigFuncType" SG_ 128 WhlSpdCircumlReCntr 16;
BA_ "GenSigSendType" SG_ 128 WhlSpdCircumlReCntr 0;
BA_ "GenSigSendType" SG_ 128 WhlSpdCircumlReLe 0;
BA_ "GenSigSendType" SG_ 128 WhlSpdCircumlReLeQf 0;
BA_ "GenSigStartValue" SG_ 128 WhlSpdCircumlReLeQf 1;
BA_ "GenSigSendType" SG_ 128 WhlSpdCircumlReRi 0;
BA_ "GenSigSendType" SG_ 128 WhlSpdCircumlReRiQf 0;
BA_ "GenSigStartValue" SG_ 128 WhlSpdCircumlReRiQf 1;
BA_ "GenSigSendType" SG_ 389 AmbTRawAmbTVal 0;
BA_ "GenSigStartValue" SG_ 389 AmbTRawAmbTVal 700;
BA_ "GenSigSendType" SG_ 389 AmbTRawQly 0;
BA_ "GenSigSendType" SG_ 389 AutValtPrkgSwt 0;
BA_ "GenSigStartValue" SG_ 389 AutValtPrkgSwt_UB 1;
BA_ "GenSigSendType" SG_ 389 BleConSts 0;
BA_ "GenSigStartValue" SG_ 389 BleConSts_UB 1;
BA_ "GenSigSendType" SG_ 389 GNSSSolutionCntr 0;
BA_ "GenSigSendType" SG_ 389 GNSSSolutionNoOfSatltForSysNo1 0;
BA_ "GenSigSendType" SG_ 389 GNSSSolutionNoOfSatltForSysNo2 0;
BA_ "GenSigSendType" SG_ 389 GNSSSolutionNoOfSatltForSysNo3 0;
BA_ "GenSigSendType" SG_ 389 GNSSSolutionNoOfSatltForSysNo4 0;
BA_ "GenSigSendType" SG_ 389 GNSSSolutionNoOfSatltForSysNo5 0;
BA_ "GenSigSendType" SG_ 389 GNSSSolutionNoOfSatltForSysNo6 0;
BA_ "GenSigSendType" SG_ 389 GNSSSolutionNoOfSatltForSysNo7 0;
BA_ "GenSigSendType" SG_ 389 GNSSSolutionPreHozlDil 0;
BA_ "GenSigSendType" SG_ 389 GNSSSolutionPrePosnDil 0;
BA_ "GenSigSendType" SG_ 389 GNSSSolutionPreVertDil 0;
BA_ "GenSigSendType" SG_ 389 GNSSSolutionSatltPosnStsPrm1 0;
BA_ "GenSigSendType" SG_ 389 GNSSSolutionSatltPosnStsPrm2 0;
BA_ "GenSigSendType" SG_ 389 GNSSSolutionSatltSysNo1InUse 0;
BA_ "GenSigSendType" SG_ 389 GNSSSolutionSatltSysNo2InUse 0;
BA_ "GenSigSendType" SG_ 389 GNSSSolutionSatltSysNo3InUse 0;
BA_ "GenSigSendType" SG_ 389 GNSSSolutionSatltSysNo4InUse 0;
BA_ "GenSigSendType" SG_ 389 GNSSSolutionSatltSysNo5InUse 0;
BA_ "GenSigSendType" SG_ 389 GNSSSolutionSatltSysNo6InUse 0;
BA_ "GenSigSendType" SG_ 389 GNSSSolutionSatltSysNo7InUse 0;
BA_ "GenSigSendType" SG_ 389 GNSSSolutionTiForMins 0;
BA_ "GenSigSendType" SG_ 389 GNSSSolutionTiForMsec 0;
BA_ "GenSigSendType" SG_ 389 GNSSSolutionTiForSec 0;
BA_ "GenSigSendType" SG_ 389 KeyDistncStsKey0 0;
BA_ "GenSigStartValue" SG_ 389 KeyDistncStsKey0 1023;
BA_ "GenSigSendType" SG_ 389 KeyDistncStsKey1 0;
BA_ "GenSigStartValue" SG_ 389 KeyDistncStsKey1 1023;
BA_ "GenSigSendType" SG_ 389 KeyDistncStsKey2 0;
BA_ "GenSigStartValue" SG_ 389 KeyDistncStsKey2 1023;
BA_ "GenSigSendType" SG_ 389 KeyDistncStsKey3 0;
BA_ "GenSigStartValue" SG_ 389 KeyDistncStsKey3 1023;
BA_ "GenSigSendType" SG_ 389 KeyDistncStsKey4 0;
BA_ "GenSigStartValue" SG_ 389 KeyDistncStsKey4 1023;
BA_ "GenSigSendType" SG_ 389 KeyDistncStsKey5 0;
BA_ "GenSigStartValue" SG_ 389 KeyDistncStsKey5 1023;
BA_ "GenSigSendType" SG_ 389 MobDevKeyDistStsVld 0;
BA_ "GenSigSendType" SG_ 389 PosnFromSatltCntr 0;
BA_ "GenSigSendType" SG_ 389 PosnFromSatltPosnAlti 0;
BA_ "GenSigStartValue" SG_ 389 PosnFromSatltPosnAlti 1000;
BA_ "GenSigSendType" SG_ 389 PosnFromSatltPosnDir 0;
BA_ "GenSigSendType" SG_ 389 PosnFromSatltPosnLat 0;
BA_ "GenSigSendType" SG_ 389 PosnFromSatltPosnLgt 0;
BA_ "GenSigSendType" SG_ 389 PosnFromSatltPosnSpd 0;
BA_ "GenSigSendType" SG_ 389 PosnFromSatltPosnVHozl 0;
BA_ "GenSigSendType" SG_ 389 PosnFromSatltPosnVVert 0;
BA_ "GenSigSendType" SG_ 389 PosnFromSatltTiForMins 0;
BA_ "GenSigSendType" SG_ 389 PosnFromSatltTiForMsec 0;
BA_ "GenSigSendType" SG_ 389 PosnFromSatltTiForSec 0;
BA_ "GenSigSendType" SG_ 389 PosnFromSatltUTCForDay 0;
BA_ "GenSigStartValue" SG_ 389 PosnFromSatltUTCForDay 1;
BA_ "GenSigSendType" SG_ 389 PosnFromSatltUTCForHr 0;
BA_ "GenSigSendType" SG_ 389 PosnFromSatltUTCForMins 0;
BA_ "GenSigSendType" SG_ 389 PosnFromSatltUTCForMth 0;
BA_ "GenSigStartValue" SG_ 389 PosnFromSatltUTCForMth 1;
BA_ "GenSigSendType" SG_ 389 PosnFromSatltUTCForSec 0;
BA_ "GenSigSendType" SG_ 389 PosnFromSatltUTCForYr 0;
BA_ "GenSigSendType" SG_ 389 RainfallAmnt 0;
BA_ "GenSigStartValue" SG_ 389 RainfallAmnt 14;
BA_ "GenSigSendType" SG_ 389 RemPrkgSelfSearchReq 0;
BA_ "GenSigSendType" SG_ 389 WinPosnStsAtDrvr 0;
BA_ "GenSigSendType" SG_ 389 WinPosnStsAtPass 0;
BA_ "GenSigSendType" SG_ 389 WinPosnStsAtReLe 0;
BA_ "GenSigSendType" SG_ 389 WinPosnStsAtReRi 0;
BA_ "GenSigSendType" SG_ 144 AlrmStsAlrmFailr 0;
BA_ "GenSigSendType" SG_ 144 AlrmStsAlrmSt 0;
BA_ "GenSigSendType" SG_ 144 AlrmStsAlrmTrgSrc 0;
BA_ "GenSigSendType" SG_ 144 AlrmStsSnsrInclnFailr 0;
BA_ "GenSigSendType" SG_ 144 AlrmStsSnsrIntrScanrFailr 0;
BA_ "GenSigSendType" SG_ 144 BiasedPosnFromSatltCntr 0;
BA_ "GenSigSendType" SG_ 144 BiasedPosnFromSatltPosnLat 0;
BA_ "GenSigSendType" SG_ 144 BiasedPosnFromSatltPosnLgt 0;
BA_ "GenSigSendType" SG_ 144 BiasedPosnFromSatltTiForMins 0;
BA_ "GenSigSendType" SG_ 144 BiasedPosnFromSatltTiForMsec 0;
BA_ "GenSigSendType" SG_ 144 BiasedPosnFromSatltTiForSec 0;
BA_ "GenSigSendType" SG_ 144 DoorDrvrSts 0;
BA_ "GenSigStartValue" SG_ 144 DoorDrvrSts_UB 1;
BA_ "GenSigSendType" SG_ 144 DoorLeReSts 0;
BA_ "GenSigStartValue" SG_ 144 DoorLeReSts_UB 1;
BA_ "GenSigSendType" SG_ 144 DoorPassSts 0;
BA_ "GenSigStartValue" SG_ 144 DoorPassSts_UB 1;
BA_ "GenSigSendType" SG_ 144 DoorRiReSts 0;
BA_ "GenSigStartValue" SG_ 144 DoorRiReSts_UB 1;
BA_ "GenSigSendType" SG_ 144 GpsStatus 0;
BA_ "GenSigStartValue" SG_ 144 GpsStatus 1;
BA_ "GenSigSendType" SG_ 144 HoodSts 0;
BA_ "GenSigStartValue" SG_ 144 HoodSts_UB 1;
BA_ "GenSigSendType" SG_ 144 IHUfail 0;
BA_ "GenSigSendType" SG_ 144 LeFrntTireMsgBattLoSt 0;
BA_ "GenSigSendType" SG_ 144 LeFrntTireMsgFastLoseWarnFlg 0;
BA_ "GenSigSendType" SG_ 144 LeFrntTireMsgMsgOldFlg 0;
BA_ "GenSigSendType" SG_ 144 LeFrntTireMsgP 0;
BA_ "GenSigStartValue" SG_ 144 LeFrntTireMsgP 255;
BA_ "GenSigSendType" SG_ 144 LeFrntTireMsgPWarnFlg 0;
BA_ "GenSigSendType" SG_ 144 LeFrntTireMsgSysWarnFlg 0;
BA_ "GenSigSendType" SG_ 144 LeFrntTireMsgT 0;
BA_ "GenSigStartValue" SG_ 144 LeFrntTireMsgT 255;
BA_ "GenSigSendType" SG_ 144 LeFrntTireMsgTireFillgAssiPSts 0;
BA_ "GenSigSendType" SG_ 144 LeFrntTireMsgTWarnFlg 0;
BA_ "GenSigSendType" SG_ 144 LeReTireMsgBattLoSt 0;
BA_ "GenSigSendType" SG_ 144 LeReTireMsgFastLoseWarnFlg 0;
BA_ "GenSigSendType" SG_ 144 LeReTireMsgMsgOldFlg 0;
BA_ "GenSigSendType" SG_ 144 LeReTireMsgP 0;
BA_ "GenSigStartValue" SG_ 144 LeReTireMsgP 255;
BA_ "GenSigSendType" SG_ 144 LeReTireMsgPWarnFlg 0;
BA_ "GenSigSendType" SG_ 144 LeReTireMsgSysWarnFlg 0;
BA_ "GenSigSendType" SG_ 144 LeReTireMsgT 0;
BA_ "GenSigStartValue" SG_ 144 LeReTireMsgT 255;
BA_ "GenSigSendType" SG_ 144 LeReTireMsgTireFillgAssiPSts 0;
BA_ "GenSigSendType" SG_ 144 LeReTireMsgTWarnFlg 0;
BA_ "GenSigSendType" SG_ 144 LockgCenStsLockSt 0;
BA_ "GenSigSendType" SG_ 144 LockgCenStsTrigSrc 0;
BA_ "GenSigSendType" SG_ 144 LockgCenStsUpdEve 0;
BA_ "GenSigSendType" SG_ 144 MirrFoldStsAtDrvr 0;
BA_ "GenSigStartValue" SG_ 144 MirrFoldStsAtDrvr_UB 1;
BA_ "GenSigSendType" SG_ 144 MirrFoldStsAtPass 0;
BA_ "GenSigStartValue" SG_ 144 MirrFoldStsAtPass_UB 1;
BA_ "GenSigSendType" SG_ 144 NetASDMActvtPrio 0;
BA_ "GenSigSendType" SG_ 144 NetASDMActvtResourceGroup 0;
BA_ "GenSigSendType" SG_ 144 NetDIMActvtPrio 0;
BA_ "GenSigSendType" SG_ 144 NetDIMActvtResourceGroup 0;
BA_ "GenSigSendType" SG_ 144 NetDMMActvtPrio 0;
BA_ "GenSigSendType" SG_ 144 NetDMMActvtResourceGroup 0;
BA_ "GenSigSendType" SG_ 144 NetDVRActvtPrio 0;
BA_ "GenSigSendType" SG_ 144 NetDVRActvtResourceGroup 0;
BA_ "GenSigSendType" SG_ 144 NetIHUActvtPrio 0;
BA_ "GenSigSendType" SG_ 144 NetIHUActvtResourceGroup 0;
BA_ "GenSigSendType" SG_ 144 NetVGMActvtPrio 0;
BA_ "GenSigSendType" SG_ 144 NetVGMActvtResourceGroup 0;
BA_ "GenSigSendType" SG_ 144 RiFrntTireMsgBattLoSt 0;
BA_ "GenSigSendType" SG_ 144 RiFrntTireMsgFastLoseWarnFlg 0;
BA_ "GenSigSendType" SG_ 144 RiFrntTireMsgMsgOldFlg 0;
BA_ "GenSigSendType" SG_ 144 RiFrntTireMsgP 0;
BA_ "GenSigStartValue" SG_ 144 RiFrntTireMsgP 255;
BA_ "GenSigSendType" SG_ 144 RiFrntTireMsgPWarnFlg 0;
BA_ "GenSigSendType" SG_ 144 RiFrntTireMsgSysWarnFlg 0;
BA_ "GenSigSendType" SG_ 144 RiFrntTireMsgT 0;
BA_ "GenSigStartValue" SG_ 144 RiFrntTireMsgT 255;
BA_ "GenSigSendType" SG_ 144 RiFrntTireMsgTireFillgAssiPSts 0;
BA_ "GenSigSendType" SG_ 144 RiFrntTireMsgTWarnFlg 0;
BA_ "GenSigSendType" SG_ 144 RiReTireMsgBattLoSt 0;
BA_ "GenSigSendType" SG_ 144 RiReTireMsgFastLoseWarnFlg 0;
BA_ "GenSigSendType" SG_ 144 RiReTireMsgMsgOldFlg 0;
BA_ "GenSigSendType" SG_ 144 RiReTireMsgP 0;
BA_ "GenSigStartValue" SG_ 144 RiReTireMsgP 255;
BA_ "GenSigSendType" SG_ 144 RiReTireMsgPWarnFlg 0;
BA_ "GenSigSendType" SG_ 144 RiReTireMsgSysWarnFlg 0;
BA_ "GenSigSendType" SG_ 144 RiReTireMsgT 0;
BA_ "GenSigStartValue" SG_ 144 RiReTireMsgT 255;
BA_ "GenSigSendType" SG_ 144 RiReTireMsgTireFillgAssiPSts 0;
BA_ "GenSigSendType" SG_ 144 RiReTireMsgTWarnFlg 0;
BA_ "GenSigSendType" SG_ 144 SunRoofPosnSts 0;
BA_ "GenSigStartValue" SG_ 144 SunRoofPosnSts_UB 1;
BA_ "GenSigSendType" SG_ 144 TrSts 0;
BA_ "GenSigStartValue" SG_ 144 TrSts_UB 1;
VAL_ 101 AbsCtrlActvCtrlSts1 0 "CtrlSts1_NoCtrl" 1 "CtrlSts1_InCtrl" ;
VAL_ 101 AccrPedlPsdAccrPedlPsd 0 "NoYes1_No" 1 "NoYes1_Yes" ;
VAL_ 101 AccrPedlPsdSts 0 "NoYes1_No" 1 "NoYes1_Yes" ;
VAL_ 101 AccrpedlSts 0 "Flt_NoFault" 1 "Flt_Fault" ;
VAL_ 101 BltLockStSafeAtDrvrBltLockSt1 0 "BltLockSt1_Unlock" 1 "BltLockSt1_Lock" ;
VAL_ 101 BltLockStSafeAtDrvrBltLockStErrS 0 "DevErrSts2_NoFlt" 1 "DevErrSts2_Flt" ;
VAL_ 101 EngSt1WdStsEngSt1WdSts 0 "EngSt1_Ini" 1 "EngSt1_Awake" 2 "EngSt1_Rdy" 3 "EngSt1_PreStrtg" 4 "EngSt1_StrtgInProgs" 5 "EngSt1_RunngRunng" 6 "EngSt1_RunngStb" 7 "EngSt1_RunngStrtgInProgs" 8 "EngSt1_RunngRemStrtd" 9 "EngSt1_AftRun" ;
VAL_ 101 EscStEscSt 0 "EscSt1_Inin" 1 "EscSt1_Ok" 2 "EscSt1_TmpErr" 3 "EscSt1_PrmntErr" 4 "EscSt1_UsrOff" ;
VAL_ 101 GuestrStsValidity 0 "Validity_NotValid" 1 "Validity_Valid" ;
VAL_ 101 PinionSteerAgGroupPinionSte_0000 0 "GenQf1_UndefindDataAccur" 1 "GenQf1_TmpUndefdData" 2 "GenQf1_DataAccurNotWithinSpcn" 3 "GenQf1_AccurData" ;
VAL_ 101 PinionSteerAgGroupPinionSte_0001 0 "GenQf1_UndefindDataAccur" 1 "GenQf1_TmpUndefdData" 2 "GenQf1_DataAccurNotWithinSpcn" 3 "GenQf1_AccurData" ;
VAL_ 101 PinionSteerAgGroupSteerWhlTqQf 0 "GenQf1_UndefindDataAccur" 1 "GenQf1_TmpUndefdData" 2 "GenQf1_DataAccurNotWithinSpcn" 3 "GenQf1_AccurData" ;
VAL_ 101 PrkLatLgtFailrPrkLatLgtFailr 0 "PrkLatLgtFail_NoFailure" 1 "PrkLatLgtFail_SteeringFailure" 2 "PrkLatLgtFail_BrakeFailure" 3 "PrkLatLgtFail_PropulsionFailure" 4 "PrkLatLgtFail_RBUFailure" 5 "PrkLatLgtFail_CommunicationFailure" 6 "PrkLatLgtFail_VDSWInternalFailure" 7 "PrkLatLgtFail_RWSFailure" ;
VAL_ 101 SwtIndcrIndcrTypExtReq 0 "IndcrTypExt1_Off" 1 "IndcrTypExt1_Le" 2 "IndcrTypExt1_Ri" ;
VAL_ 101 SwtIndcrIndcrTypExtReqToUpdQf 0 "Qf1_DevOfDataUndefd" 1 "Qf1_DataTmpUndefdAndEvlnInProgs" 2 "Qf1_DevOfDataNotWithinRngAllwd" 3 "Qf1_DataCalcdWithDevDefd" ;
VAL_ 101 TrsmParkLockdTrsmParkLockd 0 "TrsmParkLock1_ParkNotEngd" 1 "TrsmParkLock1_ParkEngd" 2 "TrsmParkLock1_NotInUse" 3 "TrsmParkLock1_Undefd" ;
VAL_ 101 VehMtnStVehMtnSt 0 "VehMtnSt2_Ukwn" 1 "VehMtnSt2_StandStillVal1" 2 "VehMtnSt2_StandStillVal2" 3 "VehMtnSt2_StandStillVal3" 4 "VehMtnSt2_RollgFwdVal1" 5 "VehMtnSt2_RollgFwdVal2" 6 "VehMtnSt2_RollgBackwVal1" 7 "VehMtnSt2_RollgBackwVal2" ;
VAL_ 101 VehSpdLgtQf 0 "GenQf1_UndefindDataAccur" 1 "GenQf1_TmpUndefdData" 2 "GenQf1_DataAccurNotWithinSpcn" 3 "GenQf1_AccurData" ;
VAL_ 101 VehTiAndDataDataValid 0 "NoYes1_No" 1 "NoYes1_Yes" ;
VAL_ 105 AsyADL3FuncCtrlStsADMod 0 "ADMod_NAD_Mod" 1 "ADMod_TJP" 2 "ADMod_SHWA" 3 "ADMod_Reserved" ;
VAL_ 105 AsyADL3FuncCtrlStsCtrlSts 0 "Primary" 1 "Secondary" ;
VAL_ 105 AsyADL3FuncCtrlStsQf 0 "GenQf1_UndefindDataAccur" 1 "GenQf1_TmpUndefdData" 2 "GenQf1_DataAccurNotWithinSpcn" 3 "GenQf1_AccurData" ;
VAL_ 105 AsyADL3FuncCtrlStsSts 0 "ColorSts_Red" 1 "ColorSts_Yellow" 2 "ColorSts_Green" 3 "ColorSts_Reserved" ;
VAL_ 105 AsyALgtCtrlMod1 0 "AsyALgtCtrlMod_NoReq" 10 "AsyALgtCtrlMod_PEB" 11 "AsyALgtCtrlMod_APA" 12 "AsyALgtCtrlMod_RPA" 13 "AsyALgtCtrlMod_HPA" ;
VAL_ 105 AsyALgtCtrlModCfmdAsyALgtCtrlMod 0 "AsyALgtCtrlMod_NoReq" 10 "AsyALgtCtrlMod_PEB" 11 "AsyALgtCtrlMod_APA" 12 "AsyALgtCtrlMod_RPA" 13 "AsyALgtCtrlMod_HPA" ;
VAL_ 105 AsyALgtStsAsyALgtSts 0 "AsyALgtSts_Reserved1" 1 "AsyALgtSts_AccSts1_StandBy" 2 "AsyALgtSts_AccSts1_Active" 3 "AsyALgtSts_Reserved2" 4 "AsyALgtSts_AccSts1_Override" 5 "AsyALgtSts_AccSts1_StandActive" 6 "AsyALgtSts_AccSts1_StandWait" 7 "AsyALgtSts_AccSts1_TemporaryFailure" 8 "AsyALgtSts_AccSts1_PermanentFailure" 9 "AsyALgtSts_Reserved3" ;
VAL_ 105 AsyLatCtrlModReqGroupAsyLatCtrlM 0 "AsyLatCtrlModReq_NoReq" 1 "AsyLatCtrlModReq_HighWayAssist" 2 "AsyLatCtrlModReq_EmgyLaneKeepAidForObjRe" 3 "AsyLatCtrlModReq_EmgyLaneKeepAidForStat" 4 "AsyLatCtrlModReq_SftyLaneKeepAid" 5 "AsyLatCtrlModReq_SteerAssc" 6 "AsyLatCtrlModReq_Reserved1" 7 "AsyLatCtrlModReq_Reserved2" 8 "AsyLatCtrlModReq_Reserved3" 9 "AsyLatCtrlModReq_EmgyManvAssi" 10 "AsyLatCtrlModReq_Reserved4" 11 "AsyLatCtrlModReq_Reserved5" 12 "AsyLatCtrlModReq_SHWA" 13 "AsyLatCtrlModReq_APA" 14 "AsyLatCtrlModReq_RPA" 15 "AsyLatCtrlModReq_HPA" ;
VAL_ 105 AsyLatCtrlModReqGroupCfmdLatCtrl 0 "LatCtrlMod1_NoReq" 1 "LatCtrlMod1_HighWayAssist" 2 "LatCtrlMod1_EmgyLaneKeepAidForObjRe" 3 "LatCtrlMod1_EmgyLaneKeepAidForStat" 4 "LatCtrlMod1_SftyLaneKeepAid" 5 "LatCtrlMod1_SteerAssc" 6 "LatCtrlMod1_DsrOversteer" 7 "LatCtrlMod1_DsrMueSplit" 8 "LatCtrlMod1_DsrTrlrStaby" 9 "LatCtrlMod1_EmgyManvAssi" 10 "LatCtrlMod1_Reserved1" 11 "LatCtrlMod1_Reserved2" 12 "LatCtrlMod1_SHWA" 13 "LatCtrlMod1_APA" 14 "LatCtrlMod1_RPA" 15 "LatCtrlMod1_HPA" ;
VAL_ 105 BrkHptcWarnReqForAutDrvBrkHptcWa 0 "CllsnThreat1_Ukwn" 1 "CllsnThreat1_ThreatLo" 2 "CllsnThreat1_ThreatMed" 3 "CllsnThreat1_ThreatHi" ;
VAL_ 105 BrkPedlPsdBrkPedlNotPsdSafe 0 "NoYes1_No" 1 "NoYes1_Yes" ;
VAL_ 105 BrkPedlPsdBrkPedlPsd 0 "NoYes1_No" 1 "NoYes1_Yes" ;
VAL_ 105 BrkPedlPsdQf 0 "GenQf1_UndefindDataAccur" 1 "GenQf1_TmpUndefdData" 2 "GenQf1_DataAccurNotWithinSpcn" 3 "GenQf1_AccurData" ;
VAL_ 105 DrvrAsscSysBtnPush 0 "DrvrAsscSysBtnPush_APAFunctionOnButtonNoPress" 1 "DrvrAsscSysBtnPush_APAFunctionOnButtionPressed" 2 "DrvrAsscSysBtnPush_Undobuttonnopress" 3 "DrvrAsscSysBtnPush_Undobuttonpressed" 4 "DrvrAsscSysBtnPush_Cancelparkingbuttonnopress" 5 "DrvrAsscSysBtnPush_Cancelparkingbuttonpressed" 6 "DrvrAsscSysBtnPush_Confirmparkingbuttonnopressed" 7 "DrvrAsscSysBtnPush_ManualButtonPressed" 8 "DrvrAsscSysBtnPush_ComfirmEnterAutoParkingButtonPressed" 9 "DrvrAsscSysBtnPush_PASbuttonPressed" 10 "DrvrAsscSysBtnPush_RPAbuttonpresse" 11 "DrvrAsscSysBtnPush_RPAbuttonPressed" 12 "DrvrAsscSysBtnPush_Reserved" ;
VAL_ 105 EpbStsEpbSts 0 "EpbSts_Resd0" 1 "EpbSts_Resd1" 2 "EpbSts_Resd2" 3 "EpbSts_AllAppld" 4 "EpbSts_Resd4" 5 "EpbSts_AllInTran" 6 "EpbSts_BrkgDynByActr" 7 "EpbSts_Resd7" 8 "EpbSts_Resd8" 9 "EpbSts_ActrAllReld" 10 "EpbSts_BrkgDynDegraded" 11 "EpbSts_Resd11" 12 "EpbSts_BrkgDyn" 13 "EpbSts_Resd13" 14 "EpbSts_Resd14" 15 "EpbSts_Err" ;
VAL_ 105 EscCtrlIndcn 0 "DevSts1_On" 1 "DevSts1_Off" 2 "DevSts1_Flt" ;
VAL_ 105 FctaIndcnLe 0 "LcmaIndcn_NoLcmaWarn" 1 "LcmaIndcn_LcmaWarnLvl1" 2 "LcmaIndcn_NotUsed" 3 "LcmaIndcn_LcmaWarnLvl2" ;
VAL_ 105 FctaIndcnRi 0 "LcmaIndcn_NoLcmaWarn" 1 "LcmaIndcn_LcmaWarnLvl1" 2 "LcmaIndcn_NotUsed" 3 "LcmaIndcn_LcmaWarnLvl2" ;
VAL_ 105 GearLvrIndcn 0 "GearLvrIndcn2_ParkIndcn" 1 "GearLvrIndcn2_RvsIndcn" 2 "GearLvrIndcn2_NeutIndcn" 3 "GearLvrIndcn2_DrvIndcn" 4 "GearLvrIndcn2_ManModeIndcn" 5 "GearLvrIndcn2_Resd1" 6 "GearLvrIndcn2_Resd2" 7 "GearLvrIndcn2_Undefd" ;
VAL_ 105 MsgReqByHillDwnCtrl 0 "MsgReqByHillDwnCtrl1_MsgForHillDwnCtrlNotReqd" 1 "MsgReqByHillDwnCtrl1_MsgForHillDwnCtrlOnReqd" 2 "MsgReqByHillDwnCtrl1_MsgForHillDwnCtrlReqdForBrkg" 3 "MsgReqByHillDwnCtrl1_MsgForHillDwnCtrlTmpOffReqd" 4 "MsgReqByHillDwnCtrl1_Resd4" 5 "MsgReqByHillDwnCtrl1_Resd5" 6 "MsgReqByHillDwnCtrl1_Resd6" 7 "MsgReqByHillDwnCtrl1_Resd7" ;
VAL_ 105 PdcMuteBtnReq 0 "OnOffNoReq_NoReq" 1 "OnOffNoReq_On" 2 "OnOffNoReq_Off" ;
VAL_ 105 RctaBrkReqRctaBrkReq 0 "YesNo1_Yes" 1 "YesNo1_No" ;
VAL_ 105 RctaIndcnLe 0 "LcmaIndcn_NoLcmaWarn" 1 "LcmaIndcn_LcmaWarnLvl1" 2 "LcmaIndcn_NotUsed" 3 "LcmaIndcn_LcmaWarnLvl2" ;
VAL_ 105 RctaIndcnRi 0 "LcmaIndcn_NoLcmaWarn" 1 "LcmaIndcn_LcmaWarnLvl1" 2 "LcmaIndcn_NotUsed" 3 "LcmaIndcn_LcmaWarnLvl2" ;
VAL_ 105 RcwmBrkReqRcwmBrkReq 0 "OnOff1_Off" 1 "OnOff1_On" ;
VAL_ 105 RoadInclnQly 0 "Qly2_Flt" 1 "Qly2_NoInfo" 2 "Qly2_Vld" ;
VAL_ 105 SftyDecelGroupSafeAsySftyEnaDece 0 "OnOff1_Off" 1 "OnOff1_On" ;
VAL_ 105 VehModMngtGlbSafe1CarModSts1 0 "CarModSts1_CarModNorm" 1 "CarModSts1_CarModTrnsp" 2 "CarModSts1_CarModFcy" 3 "CarModSts1_CarModCrash" 5 "CarModSts1_CarModDyno" ;
VAL_ 105 VehModMngtGlbSafe1FltEgyCnsWdSts 0 "FltEgyCns1_NoFlt" 1 "FltEgyCns1_Flt" ;
VAL_ 105 VehModMngtGlbSafe1UsgModSts 0 "UsgModSts1_UsgModAbdnd" 1 "UsgModSts1_UsgModInActv" 2 "UsgModSts1_UsgModCnvinc" 11 "UsgModSts1_UsgModActv" 13 "UsgModSts1_UsgModDrvg" ;
VAL_ 128 ADataRawSafeALat1Qf 0 "Qf1_DevOfDataUndefd" 1 "Qf1_DataTmpUndefdAndEvlnInProgs" 2 "Qf1_DevOfDataNotWithinRngAllwd" 3 "Qf1_DataCalcdWithDevDefd" ;
VAL_ 128 ADataRawSafeALgt1Qf 0 "Qf1_DevOfDataUndefd" 1 "Qf1_DataTmpUndefdAndEvlnInProgs" 2 "Qf1_DevOfDataNotWithinRngAllwd" 3 "Qf1_DataCalcdWithDevDefd" ;
VAL_ 128 ADataRawSafeAVertQf 0 "Qf1_DevOfDataUndefd" 1 "Qf1_DataTmpUndefdAndEvlnInProgs" 2 "Qf1_DevOfDataNotWithinRngAllwd" 3 "Qf1_DataCalcdWithDevDefd" ;
VAL_ 128 AgDataRawSafeRollRateQf 0 "Qf1_DevOfDataUndefd" 1 "Qf1_DataTmpUndefdAndEvlnInProgs" 2 "Qf1_DevOfDataNotWithinRngAllwd" 3 "Qf1_DataCalcdWithDevDefd" ;
VAL_ 128 AgDataRawSafeYawRateQf 0 "Qf1_DevOfDataUndefd" 1 "Qf1_DataTmpUndefdAndEvlnInProgs" 2 "Qf1_DevOfDataNotWithinRngAllwd" 3 "Qf1_DataCalcdWithDevDefd" ;
VAL_ 128 AsyDataWithCmpSafeALat1Qf 0 "Qf1_DevOfDataUndefd" 1 "Qf1_DataTmpUndefdAndEvlnInProgs" 2 "Qf1_DevOfDataNotWithinRngAllwd" 3 "Qf1_DataCalcdWithDevDefd" ;
VAL_ 128 AsyDataWithCmpSafeALgt1Qf 0 "Qf1_DevOfDataUndefd" 1 "Qf1_DataTmpUndefdAndEvlnInProgs" 2 "Qf1_DevOfDataNotWithinRngAllwd" 3 "Qf1_DataCalcdWithDevDefd" ;
VAL_ 128 AsyDataWithCmpSafeYawRateQf 0 "Qf1_DevOfDataUndefd" 1 "Qf1_DataTmpUndefdAndEvlnInProgs" 2 "Qf1_DevOfDataNotWithinRngAllwd" 3 "Qf1_DataCalcdWithDevDefd" ;
VAL_ 128 AsyHandsOffIndcrAsyIndcrDispSts 0 "AsyIndcrDispSts_NoDisp" 1 "AsyIndcrDispSts_OffDisp" 2 "AsyIndcrDispSts_StandByDisp" 3 "AsyIndcrDispSts_ActiveDisp" 4 "AsyIndcrDispSts_OverrideDisp" 5 "AsyIndcrDispSts_FailureDisp" ;
VAL_ 128 GearMov 0 "NoYesUnknown_No" 1 "NoYesUnknown_Yes" 2 "NoYesUnknown_Unknown" ;
VAL_ 128 MobDevRPAReqRPAOutModeSubT 1 "RPAOutModeSubT_PrlRiOut" 2 "RPAOutModeSubT_RrlLeOut" 3 "RPAOutModeSubT_HeadPrpndRiOut" 4 "RPAOutModeSubT_HeadPrpndLeOut" 5 "RPAOutModeSubT_TailPrpndRiOut" 6 "RPAOutModeSubT_TailPrpndLeOut" 7 "RPAOutModeSubT_Resd1" 8 "RPAOutModeSubT_Resd2" ;
VAL_ 128 MobDevRPAReqRPAReq 1 "RPAReq_Start" 2 "RPAReq_Stop" 3 "RPAReq_OutMode" 4 "RPAReq_Undo" 5 "RPAReq_Start_Searching" 6 "RPAReq_Start_Parking_In" 7 "RPAReq_Start_Parking_Out" 8 "RPAReq_Pause" 9 "RPAReq_Continue" ;
VAL_ 128 MobDevRPAReqRSPACtrl 1 "RSPACtrl_Function_On" 2 "RSPACtrl_Backward" 3 "RSPACtrl_Forward" 4 "RSPACtrl_Release_Button" 5 "RSPACtrl_Exit_Function" ;
VAL_ 128 NetTCAMActvtPrio 0 "PrioHighNormal_PrioNormal" 1 "PrioHighNormal_PrioHigh" ;
VAL_ 128 StandStillMgrStsForHld1 0 "StandStillMgrStsForHld1_StandStillMgrStsForHldVal0" 1 "StandStillMgrStsForHld1_StandStillMgrStsForHldVal1" 2 "StandStillMgrStsForHld1_StandStillMgrStsForHldVal2" 3 "StandStillMgrStsForHld1_StandStillMgrStsForHldVal3" 4 "StandStillMgrStsForHld1_StandStillMgrStsForHldVal4" 5 "StandStillMgrStsForHld1_StandStillMgrStsForHldVal5" 6 "StandStillMgrStsForHld1_StandStillMgrStsForHldVal6" 7 "StandStillMgrStsForHld1_StandStillMgrStsForHldVal7" ;
VAL_ 128 VisnImgDispModReq 0 "VisnImgDispModReq_2D_NotActive" 1 "VisnImgDispModReq_2D_FrontView" 2 "VisnImgDispModReq_2D_RearView" 3 "VisnImgDispModReq_2D_LeftView" 4 "VisnImgDispModReq_2D_RightView" 5 "VisnImgDispModReq_2D_LeftFrontAndRightFrontView" 6 "VisnImgDispModReq_2D_LeftRearAndRightRearView" 7 "VisnImgDispModReq_2D_FrontWideView" 8 "VisnImgDispModReq_2D_RearWideView" 13 "VisnImgDispModReq_3D_FrontView" 14 "VisnImgDispModReq_3D_RearView" 15 "VisnImgDispModReq_3D_LeftView" 16 "VisnImgDispModReq_3D_RightView" 17 "VisnImgDispModReq_3D_LeftFrontView" 18 "VisnImgDispModReq_3D_RightFrontView" 19 "VisnImgDispModReq_3D_LeftRearView" 20 "VisnImgDispModReq_3D_RightRearView" ;
VAL_ 128 WhlDirRotlFrntLe 0 "WhlRotlDirStd1_Undefd" 1 "WhlRotlDirStd1_StandStill" 2 "WhlRotlDirStd1_Fwd" 3 "WhlRotlDirStd1_Backw" ;
VAL_ 128 WhlDirRotlFrntRi 0 "WhlRotlDirStd1_Undefd" 1 "WhlRotlDirStd1_StandStill" 2 "WhlRotlDirStd1_Fwd" 3 "WhlRotlDirStd1_Backw" ;
VAL_ 128 WhlDirRotlReLe 0 "WhlRotlDirStd1_Undefd" 1 "WhlRotlDirStd1_StandStill" 2 "WhlRotlDirStd1_Fwd" 3 "WhlRotlDirStd1_Backw" ;
VAL_ 128 WhlDirRotlReRi 0 "WhlRotlDirStd1_Undefd" 1 "WhlRotlDirStd1_StandStill" 2 "WhlRotlDirStd1_Fwd" 3 "WhlRotlDirStd1_Backw" ;
VAL_ 128 WhlSpdCircumlFrntLeQf 0 "GenQf1_UndefindDataAccur" 1 "GenQf1_TmpUndefdData" 2 "GenQf1_DataAccurNotWithinSpcn" 3 "GenQf1_AccurData" ;
VAL_ 128 WhlSpdCircumlFrntRiQf 0 "GenQf1_UndefindDataAccur" 1 "GenQf1_TmpUndefdData" 2 "GenQf1_DataAccurNotWithinSpcn" 3 "GenQf1_AccurData" ;
VAL_ 128 WhlSpdCircumlReLeQf 0 "GenQf1_UndefindDataAccur" 1 "GenQf1_TmpUndefdData" 2 "GenQf1_DataAccurNotWithinSpcn" 3 "GenQf1_AccurData" ;
VAL_ 128 WhlSpdCircumlReRiQf 0 "GenQf1_UndefindDataAccur" 1 "GenQf1_TmpUndefdData" 2 "GenQf1_DataAccurNotWithinSpcn" 3 "GenQf1_AccurData" ;
VAL_ 389 AmbTRawQly 0 "GenQf1_UndefindDataAccur" 1 "GenQf1_TmpUndefdData" 2 "GenQf1_DataAccurNotWithinSpcn" 3 "GenQf1_AccurData" ;
VAL_ 389 AutValtPrkgSwt 0 "OnOffNoReq_NoReq" 1 "OnOffNoReq_On" 2 "OnOffNoReq_Off" ;
VAL_ 389 BleConSts 0 "Boolean_FALSE" 1 "Boolean_TRUE" ;
VAL_ 389 GNSSSolutionSatltPosnStsPrm1 0 "SatltPosnSts_PosnStsOfLvl1" 1 "SatltPosnSts_PosnStsOfLvl2" 2 "SatltPosnSts_PosnStsOfLvl3" 3 "SatltPosnSts_PosnStsOfLvl4" ;
VAL_ 389 GNSSSolutionSatltPosnStsPrm2 0 "Boolean_FALSE" 1 "Boolean_TRUE" ;
VAL_ 389 GNSSSolutionSatltSysNo1InUse 0 "NoYes1_No" 1 "NoYes1_Yes" ;
VAL_ 389 GNSSSolutionSatltSysNo2InUse 0 "NoYes1_No" 1 "NoYes1_Yes" ;
VAL_ 389 GNSSSolutionSatltSysNo3InUse 0 "NoYes1_No" 1 "NoYes1_Yes" ;
VAL_ 389 GNSSSolutionSatltSysNo4InUse 0 "NoYes1_No" 1 "NoYes1_Yes" ;
VAL_ 389 GNSSSolutionSatltSysNo5InUse 0 "NoYes1_No" 1 "NoYes1_Yes" ;
VAL_ 389 GNSSSolutionSatltSysNo6InUse 0 "NoYes1_No" 1 "NoYes1_Yes" ;
VAL_ 389 GNSSSolutionSatltSysNo7InUse 0 "NoYes1_No" 1 "NoYes1_Yes" ;
VAL_ 389 RainfallAmnt 0 "AmntSnsr_Amnt" 14 "AmntSnsr_InitValue" 15 "AmntSnsr_Error" ;
VAL_ 389 RemPrkgSelfSearchReq 0 "PsdNotPsd1_NotPsd" 1 "PsdNotPsd1_Psd" ;
VAL_ 389 WinPosnStsAtDrvr 0 "WinAndRoofAndCurtPosnTyp_PosnUkwn" 1 "WinAndRoofAndCurtPosnTyp_ClsFull" 2 "WinAndRoofAndCurtPosnTyp_PercOpen4" 3 "WinAndRoofAndCurtPosnTyp_PercOpen8" 4 "WinAndRoofAndCurtPosnTyp_PercOpen12" 5 "WinAndRoofAndCurtPosnTyp_PercOpen16" 6 "WinAndRoofAndCurtPosnTyp_PercOpen20" 7 "WinAndRoofAndCurtPosnTyp_PercOpen24" 8 "WinAndRoofAndCurtPosnTyp_PercOpen28" 9 "WinAndRoofAndCurtPosnTyp_PercOpen32" 10 "WinAndRoofAndCurtPosnTyp_PercOpen36" 11 "WinAndRoofAndCurtPosnTyp_PercOpen40" 12 "WinAndRoofAndCurtPosnTyp_PercOpen44" 13 "WinAndRoofAndCurtPosnTyp_PercOpen48" 14 "WinAndRoofAndCurtPosnTyp_PercOpen52" 15 "WinAndRoofAndCurtPosnTyp_PercOpen56" 16 "WinAndRoofAndCurtPosnTyp_PercOpen60" 17 "WinAndRoofAndCurtPosnTyp_PercOpen64" 18 "WinAndRoofAndCurtPosnTyp_PercOpen68" 19 "WinAndRoofAndCurtPosnTyp_PercOpen72" 20 "WinAndRoofAndCurtPosnTyp_PercOpen76" 21 "WinAndRoofAndCurtPosnTyp_PercOpen80" 22 "WinAndRoofAndCurtPosnTyp_PercOpen84" 23 "WinAndRoofAndCurtPosnTyp_PercOpen88" 24 "WinAndRoofAndCurtPosnTyp_PercOpen92" 25 "WinAndRoofAndCurtPosnTyp_PercOpen96" 26 "WinAndRoofAndCurtPosnTyp_OpenFull" 27 "WinAndRoofAndCurtPosnTyp_Resd1" 28 "WinAndRoofAndCurtPosnTyp_Resd2" 29 "WinAndRoofAndCurtPosnTyp_Resd3" 30 "WinAndRoofAndCurtPosnTyp_Resd4" 31 "WinAndRoofAndCurtPosnTyp_Movg" ;
VAL_ 389 WinPosnStsAtPass 0 "WinAndRoofAndCurtPosnTyp_PosnUkwn" 1 "WinAndRoofAndCurtPosnTyp_ClsFull" 2 "WinAndRoofAndCurtPosnTyp_PercOpen4" 3 "WinAndRoofAndCurtPosnTyp_PercOpen8" 4 "WinAndRoofAndCurtPosnTyp_PercOpen12" 5 "WinAndRoofAndCurtPosnTyp_PercOpen16" 6 "WinAndRoofAndCurtPosnTyp_PercOpen20" 7 "WinAndRoofAndCurtPosnTyp_PercOpen24" 8 "WinAndRoofAndCurtPosnTyp_PercOpen28" 9 "WinAndRoofAndCurtPosnTyp_PercOpen32" 10 "WinAndRoofAndCurtPosnTyp_PercOpen36" 11 "WinAndRoofAndCurtPosnTyp_PercOpen40" 12 "WinAndRoofAndCurtPosnTyp_PercOpen44" 13 "WinAndRoofAndCurtPosnTyp_PercOpen48" 14 "WinAndRoofAndCurtPosnTyp_PercOpen52" 15 "WinAndRoofAndCurtPosnTyp_PercOpen56" 16 "WinAndRoofAndCurtPosnTyp_PercOpen60" 17 "WinAndRoofAndCurtPosnTyp_PercOpen64" 18 "WinAndRoofAndCurtPosnTyp_PercOpen68" 19 "WinAndRoofAndCurtPosnTyp_PercOpen72" 20 "WinAndRoofAndCurtPosnTyp_PercOpen76" 21 "WinAndRoofAndCurtPosnTyp_PercOpen80" 22 "WinAndRoofAndCurtPosnTyp_PercOpen84" 23 "WinAndRoofAndCurtPosnTyp_PercOpen88" 24 "WinAndRoofAndCurtPosnTyp_PercOpen92" 25 "WinAndRoofAndCurtPosnTyp_PercOpen96" 26 "WinAndRoofAndCurtPosnTyp_OpenFull" 27 "WinAndRoofAndCurtPosnTyp_Resd1" 28 "WinAndRoofAndCurtPosnTyp_Resd2" 29 "WinAndRoofAndCurtPosnTyp_Resd3" 30 "WinAndRoofAndCurtPosnTyp_Resd4" 31 "WinAndRoofAndCurtPosnTyp_Movg" ;
VAL_ 389 WinPosnStsAtReLe 0 "WinAndRoofAndCurtPosnTyp_PosnUkwn" 1 "WinAndRoofAndCurtPosnTyp_ClsFull" 2 "WinAndRoofAndCurtPosnTyp_PercOpen4" 3 "WinAndRoofAndCurtPosnTyp_PercOpen8" 4 "WinAndRoofAndCurtPosnTyp_PercOpen12" 5 "WinAndRoofAndCurtPosnTyp_PercOpen16" 6 "WinAndRoofAndCurtPosnTyp_PercOpen20" 7 "WinAndRoofAndCurtPosnTyp_PercOpen24" 8 "WinAndRoofAndCurtPosnTyp_PercOpen28" 9 "WinAndRoofAndCurtPosnTyp_PercOpen32" 10 "WinAndRoofAndCurtPosnTyp_PercOpen36" 11 "WinAndRoofAndCurtPosnTyp_PercOpen40" 12 "WinAndRoofAndCurtPosnTyp_PercOpen44" 13 "WinAndRoofAndCurtPosnTyp_PercOpen48" 14 "WinAndRoofAndCurtPosnTyp_PercOpen52" 15 "WinAndRoofAndCurtPosnTyp_PercOpen56" 16 "WinAndRoofAndCurtPosnTyp_PercOpen60" 17 "WinAndRoofAndCurtPosnTyp_PercOpen64" 18 "WinAndRoofAndCurtPosnTyp_PercOpen68" 19 "WinAndRoofAndCurtPosnTyp_PercOpen72" 20 "WinAndRoofAndCurtPosnTyp_PercOpen76" 21 "WinAndRoofAndCurtPosnTyp_PercOpen80" 22 "WinAndRoofAndCurtPosnTyp_PercOpen84" 23 "WinAndRoofAndCurtPosnTyp_PercOpen88" 24 "WinAndRoofAndCurtPosnTyp_PercOpen92" 25 "WinAndRoofAndCurtPosnTyp_PercOpen96" 26 "WinAndRoofAndCurtPosnTyp_OpenFull" 27 "WinAndRoofAndCurtPosnTyp_Resd1" 28 "WinAndRoofAndCurtPosnTyp_Resd2" 29 "WinAndRoofAndCurtPosnTyp_Resd3" 30 "WinAndRoofAndCurtPosnTyp_Resd4" 31 "WinAndRoofAndCurtPosnTyp_Movg" ;
VAL_ 389 WinPosnStsAtReRi 0 "WinAndRoofAndCurtPosnTyp_PosnUkwn" 1 "WinAndRoofAndCurtPosnTyp_ClsFull" 2 "WinAndRoofAndCurtPosnTyp_PercOpen4" 3 "WinAndRoofAndCurtPosnTyp_PercOpen8" 4 "WinAndRoofAndCurtPosnTyp_PercOpen12" 5 "WinAndRoofAndCurtPosnTyp_PercOpen16" 6 "WinAndRoofAndCurtPosnTyp_PercOpen20" 7 "WinAndRoofAndCurtPosnTyp_PercOpen24" 8 "WinAndRoofAndCurtPosnTyp_PercOpen28" 9 "WinAndRoofAndCurtPosnTyp_PercOpen32" 10 "WinAndRoofAndCurtPosnTyp_PercOpen36" 11 "WinAndRoofAndCurtPosnTyp_PercOpen40" 12 "WinAndRoofAndCurtPosnTyp_PercOpen44" 13 "WinAndRoofAndCurtPosnTyp_PercOpen48" 14 "WinAndRoofAndCurtPosnTyp_PercOpen52" 15 "WinAndRoofAndCurtPosnTyp_PercOpen56" 16 "WinAndRoofAndCurtPosnTyp_PercOpen60" 17 "WinAndRoofAndCurtPosnTyp_PercOpen64" 18 "WinAndRoofAndCurtPosnTyp_PercOpen68" 19 "WinAndRoofAndCurtPosnTyp_PercOpen72" 20 "WinAndRoofAndCurtPosnTyp_PercOpen76" 21 "WinAndRoofAndCurtPosnTyp_PercOpen80" 22 "WinAndRoofAndCurtPosnTyp_PercOpen84" 23 "WinAndRoofAndCurtPosnTyp_PercOpen88" 24 "WinAndRoofAndCurtPosnTyp_PercOpen92" 25 "WinAndRoofAndCurtPosnTyp_PercOpen96" 26 "WinAndRoofAndCurtPosnTyp_OpenFull" 27 "WinAndRoofAndCurtPosnTyp_Resd1" 28 "WinAndRoofAndCurtPosnTyp_Resd2" 29 "WinAndRoofAndCurtPosnTyp_Resd3" 30 "WinAndRoofAndCurtPosnTyp_Resd4" 31 "WinAndRoofAndCurtPosnTyp_Movg" ;
VAL_ 144 AlrmStsAlrmFailr 0 "SnsrSoundrBattBackedFailr_NoFailr" 1 "SnsrSoundrBattBackedFailr_Failr" ;
VAL_ 144 AlrmStsAlrmSt 0 "AlrmSt_Disarmd" 1 "AlrmSt_Armd" 2 "AlrmSt_Actv" ;
VAL_ 144 AlrmStsAlrmTrgSrc 0 "AlrmTrgSrc_NoTrigSrc" 1 "AlrmTrgSrc_SnsrSoundrBattBacked" 2 "AlrmTrgSrc_SnsrIncln" 3 "AlrmTrgSrc_SnsrIntrScanr" 4 "AlrmTrgSrc_Hood" 5 "AlrmTrgSrc_Tr" 6 "AlrmTrgSrc_DoorDrvr" 7 "AlrmTrgSrc_DoorPass" 8 "AlrmTrgSrc_DoorReLe" 9 "AlrmTrgSrc_DoorReRi" 10 "AlrmTrgSrc_VehImobnInvld" ;
VAL_ 144 AlrmStsSnsrInclnFailr 0 "SnsrInclnFailr_NoFailr" 1 "SnsrInclnFailr_Failr" ;
VAL_ 144 AlrmStsSnsrIntrScanrFailr 0 "SnsrIntrScanrFailr_NoFailr" 1 "SnsrIntrScanrFailr_Failr" ;
VAL_ 144 DoorDrvrSts 0 "DoorSts2_Ukwn" 1 "DoorSts2_Opend" 2 "DoorSts2_Clsd" ;
VAL_ 144 DoorLeReSts 0 "DoorSts2_Ukwn" 1 "DoorSts2_Opend" 2 "DoorSts2_Clsd" ;
VAL_ 144 DoorPassSts 0 "DoorSts2_Ukwn" 1 "DoorSts2_Opend" 2 "DoorSts2_Clsd" ;
VAL_ 144 DoorRiReSts 0 "DoorSts2_Ukwn" 1 "DoorSts2_Opend" 2 "DoorSts2_Clsd" ;
VAL_ 144 GpsStatus 0 "NoYes1_No" 1 "NoYes1_Yes" ;
VAL_ 144 HoodSts 0 "DoorSts2_Ukwn" 1 "DoorSts2_Opend" 2 "DoorSts2_Clsd" ;
VAL_ 144 IHUfail 0 "IhuErrSts_NoError" 1 "IhuErrSts_Error" ;
VAL_ 144 LeFrntTireMsgBattLoSt 0 "Normalwarning_Normal" 1 "Normalwarning_Warning" ;
VAL_ 144 LeFrntTireMsgFastLoseWarnFlg 0 "Normalwarning_Normal" 1 "Normalwarning_Warning" ;
VAL_ 144 LeFrntTireMsgMsgOldFlg 0 "Normalwarning_Normal" 1 "Normalwarning_Warning" ;
VAL_ 144 LeFrntTireMsgPWarnFlg 0 "PWarnFlg_Normal" 1 "PWarnFlg_LowPressureWarning" 2 "PWarnFlg_HighPressureWarning" 3 "PWarnFlg_Reserve" ;
VAL_ 144 LeFrntTireMsgSysWarnFlg 0 "Normalwarning_Normal" 1 "Normalwarning_Warning" ;
VAL_ 144 LeFrntTireMsgTireFillgAssiPSts 0 "Normalwarning_Normal" 1 "Normalwarning_Warning" ;
VAL_ 144 LeFrntTireMsgTWarnFlg 0 "Normalwarning_Normal" 1 "Normalwarning_Warning" ;
VAL_ 144 LeReTireMsgBattLoSt 0 "Normalwarning_Normal" 1 "Normalwarning_Warning" ;
VAL_ 144 LeReTireMsgFastLoseWarnFlg 0 "Normalwarning_Normal" 1 "Normalwarning_Warning" ;
VAL_ 144 LeReTireMsgMsgOldFlg 0 "Normalwarning_Normal" 1 "Normalwarning_Warning" ;
VAL_ 144 LeReTireMsgPWarnFlg 0 "PWarnFlg_Normal" 1 "PWarnFlg_LowPressureWarning" 2 "PWarnFlg_HighPressureWarning" 3 "PWarnFlg_Reserve" ;
VAL_ 144 LeReTireMsgSysWarnFlg 0 "Normalwarning_Normal" 1 "Normalwarning_Warning" ;
VAL_ 144 LeReTireMsgTireFillgAssiPSts 0 "Normalwarning_Normal" 1 "Normalwarning_Warning" ;
VAL_ 144 LeReTireMsgTWarnFlg 0 "Normalwarning_Normal" 1 "Normalwarning_Warning" ;
VAL_ 144 LockgCenStsLockSt 0 "LockSt3_LockUndefd" 1 "LockSt3_LockUnlckd" 2 "LockSt3_LockTrUnlckd" 3 "LockSt3_LockLockd" ;
VAL_ 144 LockgCenStsTrigSrc 0 "LockTrigSrc2_NoTrigSrc" 1 "LockTrigSrc2_KeyRem" 2 "LockTrigSrc2_Keyls" 3 "LockTrigSrc2_IntrSwt" 4 "LockTrigSrc2_SpdAut" 5 "LockTrigSrc2_TmrAut" 6 "LockTrigSrc2_Slam" 7 "LockTrigSrc2_Telm" 8 "LockTrigSrc2_Crash" ;
VAL_ 144 LockgCenStsUpdEve 0 "Boolean_FALSE" 1 "Boolean_TRUE" ;
VAL_ 144 MirrFoldStsAtDrvr 0 "MirrFoldStsTyp_MirrFoldPosnUndefd" 1 "MirrFoldStsTyp_MirrNotFoldPosn" 2 "MirrFoldStsTyp_MirrFoldPosn" 3 "MirrFoldStsTyp_MirrMovgToNotFold" 4 "MirrFoldStsTyp_MirrMovgToFold" ;
VAL_ 144 MirrFoldStsAtPass 0 "MirrFoldStsTyp_MirrFoldPosnUndefd" 1 "MirrFoldStsTyp_MirrNotFoldPosn" 2 "MirrFoldStsTyp_MirrFoldPosn" 3 "MirrFoldStsTyp_MirrMovgToNotFold" 4 "MirrFoldStsTyp_MirrMovgToFold" ;
VAL_ 144 NetASDMActvtPrio 0 "PrioHighNormal_PrioNormal" 1 "PrioHighNormal_PrioHigh" ;
VAL_ 144 NetDIMActvtPrio 0 "PrioHighNormal_PrioNormal" 1 "PrioHighNormal_PrioHigh" ;
VAL_ 144 NetDMMActvtPrio 0 "PrioHighNormal_PrioNormal" 1 "PrioHighNormal_PrioHigh" ;
VAL_ 144 NetDVRActvtPrio 0 "PrioHighNormal_PrioNormal" 1 "PrioHighNormal_PrioHigh" ;
VAL_ 144 NetIHUActvtPrio 0 "PrioHighNormal_PrioNormal" 1 "PrioHighNormal_PrioHigh" ;
VAL_ 144 NetVGMActvtPrio 0 "PrioHighNormal_PrioNormal" 1 "PrioHighNormal_PrioHigh" ;
VAL_ 144 RiFrntTireMsgBattLoSt 0 "Normalwarning_Normal" 1 "Normalwarning_Warning" ;
VAL_ 144 RiFrntTireMsgFastLoseWarnFlg 0 "Normalwarning_Normal" 1 "Normalwarning_Warning" ;
VAL_ 144 RiFrntTireMsgMsgOldFlg 0 "Normalwarning_Normal" 1 "Normalwarning_Warning" ;
VAL_ 144 RiFrntTireMsgPWarnFlg 0 "PWarnFlg_Normal" 1 "PWarnFlg_LowPressureWarning" 2 "PWarnFlg_HighPressureWarning" 3 "PWarnFlg_Reserve" ;
VAL_ 144 RiFrntTireMsgSysWarnFlg 0 "Normalwarning_Normal" 1 "Normalwarning_Warning" ;
VAL_ 144 RiFrntTireMsgTireFillgAssiPSts 0 "Normalwarning_Normal" 1 "Normalwarning_Warning" ;
VAL_ 144 RiFrntTireMsgTWarnFlg 0 "Normalwarning_Normal" 1 "Normalwarning_Warning" ;
VAL_ 144 RiReTireMsgBattLoSt 0 "Normalwarning_Normal" 1 "Normalwarning_Warning" ;
VAL_ 144 RiReTireMsgFastLoseWarnFlg 0 "Normalwarning_Normal" 1 "Normalwarning_Warning" ;
VAL_ 144 RiReTireMsgMsgOldFlg 0 "Normalwarning_Normal" 1 "Normalwarning_Warning" ;
VAL_ 144 RiReTireMsgPWarnFlg 0 "PWarnFlg_Normal" 1 "PWarnFlg_LowPressureWarning" 2 "PWarnFlg_HighPressureWarning" 3 "PWarnFlg_Reserve" ;
VAL_ 144 RiReTireMsgSysWarnFlg 0 "Normalwarning_Normal" 1 "Normalwarning_Warning" ;
VAL_ 144 RiReTireMsgTireFillgAssiPSts 0 "Normalwarning_Normal" 1 "Normalwarning_Warning" ;
VAL_ 144 RiReTireMsgTWarnFlg 0 "Normalwarning_Normal" 1 "Normalwarning_Warning" ;
VAL_ 144 SunRoofPosnSts 0 "WinAndRoofAndCurtPosnTyp_PosnUkwn" 1 "WinAndRoofAndCurtPosnTyp_ClsFull" 2 "WinAndRoofAndCurtPosnTyp_PercOpen4" 3 "WinAndRoofAndCurtPosnTyp_PercOpen8" 4 "WinAndRoofAndCurtPosnTyp_PercOpen12" 5 "WinAndRoofAndCurtPosnTyp_PercOpen16" 6 "WinAndRoofAndCurtPosnTyp_PercOpen20" 7 "WinAndRoofAndCurtPosnTyp_PercOpen24" 8 "WinAndRoofAndCurtPosnTyp_PercOpen28" 9 "WinAndRoofAndCurtPosnTyp_PercOpen32" 10 "WinAndRoofAndCurtPosnTyp_PercOpen36" 11 "WinAndRoofAndCurtPosnTyp_PercOpen40" 12 "WinAndRoofAndCurtPosnTyp_PercOpen44" 13 "WinAndRoofAndCurtPosnTyp_PercOpen48" 14 "WinAndRoofAndCurtPosnTyp_PercOpen52" 15 "WinAndRoofAndCurtPosnTyp_PercOpen56" 16 "WinAndRoofAndCurtPosnTyp_PercOpen60" 17 "WinAndRoofAndCurtPosnTyp_PercOpen64" 18 "WinAndRoofAndCurtPosnTyp_PercOpen68" 19 "WinAndRoofAndCurtPosnTyp_PercOpen72" 20 "WinAndRoofAndCurtPosnTyp_PercOpen76" 21 "WinAndRoofAndCurtPosnTyp_PercOpen80" 22 "WinAndRoofAndCurtPosnTyp_PercOpen84" 23 "WinAndRoofAndCurtPosnTyp_PercOpen88" 24 "WinAndRoofAndCurtPosnTyp_PercOpen92" 25 "WinAndRoofAndCurtPosnTyp_PercOpen96" 26 "WinAndRoofAndCurtPosnTyp_OpenFull" 27 "WinAndRoofAndCurtPosnTyp_Resd1" 28 "WinAndRoofAndCurtPosnTyp_Resd2" 29 "WinAndRoofAndCurtPosnTyp_Resd3" 30 "WinAndRoofAndCurtPosnTyp_Resd4" 31 "WinAndRoofAndCurtPosnTyp_Movg" ;
VAL_ 144 TrSts 0 "DoorSts2_Ukwn" 1 "DoorSts2_Opend" 2 "DoorSts2_Clsd" ;
SIG_GROUP_ 101 AbsCtrlActv 1 : AbsCtrlActvChks AbsCtrlActvCntr AbsCtrlActvCtrlSts1;
SIG_GROUP_ 101 AccrPedlPsd 1 : AccrPedlPsdAccrPedlPsd AccrPedlPsdChks AccrPedlPsdCntr AccrPedlPsdSts;
SIG_GROUP_ 101 AccrPedlRat 1 : AccrPedlRatAccrPedlRat AccrPedlRatChks AccrPedlRatCntr;
SIG_GROUP_ 101 BltLockStSafeAtDrvr 1 : BltLockStSafeAtDrvrBltLockSt1 BltLockStSafeAtDrvrBltLockStErrS BltLockStSafeAtDrvrChks BltLockStSafeAtDrvrCntr;
SIG_GROUP_ 101 EngSt1WdSts 1 : EngSt1WdStsChks EngSt1WdStsCntr EngSt1WdStsEngSt1WdSts;
SIG_GROUP_ 101 EscSt 1 : EscStChks EscStCntr EscStEscSt;
SIG_GROUP_ 101 GuestrSts 1 : GuestrStsChks GuestrStsCntr GuestrStsValidity;
SIG_GROUP_ 101 PinionSteerAgGroup 1 : PinionSteerAgGroupChks PinionSteerAgGroupCntr PinionSteerAgGroupPinionSteerAg1 PinionSteerAgGroupPinionSte_0000 PinionSteerAgGroupPinionSteerAgS PinionSteerAgGroupPinionSte_0001 PinionSteerAgGroupSteerWhlTq PinionSteerAgGroupSteerWhlTqQf;
SIG_GROUP_ 101 PosnFromSatlt1 1 : PosnFromSatlt1Cntr PosnFromSatlt1PosnLat PosnFromSatlt1PosnLgt;
SIG_GROUP_ 101 PosnFromSatlt2 1 : PosnFromSatlt2Cntr PosnFromSatlt2PosnSpdosn;
SIG_GROUP_ 101 PosnFromSatlt3 1 : PosnFromSatlt3Cntr PosnFromSatlt3PosnAlti PosnFromSatlt3PosnDir PosnFromSatlt3TiForMins PosnFromSatlt3TiForMsec PosnFromSatlt3TiForSec;
SIG_GROUP_ 101 PrkLatLgtFailr 1 : PrkLatLgtFailrChks PrkLatLgtFailrCntr PrkLatLgtFailrPrkLatLgtFailr;
SIG_GROUP_ 101 SwtIndcr 1 : SwtIndcrIndcrTypExtReq SwtIndcrIndcrTypExtReqChks SwtIndcrIndcrTypExtReqCntr SwtIndcrIndcrTypExtReqToUpdQf;
SIG_GROUP_ 101 TrsmParkLockd 1 : TrsmParkLockdChks TrsmParkLockdCntr TrsmParkLockdTrsmParkLockd;
SIG_GROUP_ 101 VehMtnSt 1 : VehMtnStChks VehMtnStCntr VehMtnStVehMtnSt;
SIG_GROUP_ 101 VehSpdLgt 1 : VehSpdLgtA VehSpdLgtChks VehSpdLgtCntr VehSpdLgtQf;
SIG_GROUP_ 101 VehTiAndData 1 : VehTiAndDataDataValid VehTiAndDataDay VehTiAndDataHr1 VehTiAndDataMins1 VehTiAndDataMth1 VehTiAndDataSec1 VehTiAndDataYr1;
SIG_GROUP_ 105 AsyADL3FuncCtrlSts 1 : AsyADL3FuncCtrlStsADMod AsyADL3FuncCtrlStsChks AsyADL3FuncCtrlStsCntr AsyADL3FuncCtrlStsCtrlSts AsyADL3FuncCtrlStsDegraded AsyADL3FuncCtrlStsQf AsyADL3FuncCtrlStsSts;
SIG_GROUP_ 105 AsyALgtCtrlMod 1 : AsyALgtCtrlMod1 AsyALgtCtrlModChks AsyALgtCtrlModCntr;
SIG_GROUP_ 105 AsyALgtCtrlModCfmd 1 : AsyALgtCtrlModCfmdAsyALgtCtrlMod AsyALgtCtrlModCfmdChks AsyALgtCtrlModCfmdCntr;
SIG_GROUP_ 105 AsyALgtSts 1 : AsyALgtStsAsyALgtSts AsyALgtStsChks AsyALgtStsCntr;
SIG_GROUP_ 105 AsyLatCtrlModReqGroup 1 : AsyLatCtrlModReqGroupAsyLatCtrlM AsyLatCtrlModReqGroupChks AsyLatCtrlModReqGroupCntr;
SIG_GROUP_ 105 AsyLatCtrlModReqGroupCfmd 1 : AsyLatCtrlModReqGroupCfmdChks AsyLatCtrlModReqGroupCfmdCntr AsyLatCtrlModReqGroupCfmdLatCtrl;
SIG_GROUP_ 105 BiasedPosnFromSatlt1 1 : BiasedPosnFromSatlt1Cntr BiasedPosnFromSatlt1PosnLat BiasedPosnFromSatlt1PosnLgt;
SIG_GROUP_ 105 BrkHptcWarnReqForAutDrv 1 : BrkHptcWarnReqForAutDrvBrkHptcWa BrkHptcWarnReqForAutDrvChks BrkHptcWarnReqForAutDrvCntr;
SIG_GROUP_ 105 BrkPedlPsd 1 : BrkPedlPsdBrkPedlNotPsdSafe BrkPedlPsdBrkPedlPsd BrkPedlPsdChks BrkPedlPsdCntr BrkPedlPsdQf;
SIG_GROUP_ 105 EpbSts 1 : EpbStsChks EpbStsCntr EpbStsEpbSts;
SIG_GROUP_ 105 MobDevRPAAuthResp 1 : MobDevRPAAuthRespAnswer MobDevRPAAuthRespChks MobDevRPAAuthRespCntr MobDevRPAAuthRespX MobDevRPAAuthRespY;
SIG_GROUP_ 105 RctaBrkReq 1 : RctaBrkReqChks RctaBrkReqCntr RctaBrkReqRctaBrkReq;
SIG_GROUP_ 105 RcwmBrkReq 1 : RcwmBrkReqChks RcwmBrkReqCntr RcwmBrkReqRcwmBrkReq;
SIG_GROUP_ 105 RoadIncln 1 : RoadInclnQly RoadInclnRoadIncln;
SIG_GROUP_ 105 SftyDecelGroupSafe 1 : SftyDecelGroupSafeAsySftyDecelRe SftyDecelGroupSafeAsySftyEnaDece SftyDecelGroupSafeChks SftyDecelGroupSafeCntr;
SIG_GROUP_ 105 VehModMngtGlbSafe1 1 : VehModMngtGlbSafe1CarModSts1 VehModMngtGlbSafe1CarModSubtypWd VehModMngtGlbSafe1Chks VehModMngtGlbSafe1Cntr VehModMngtGlbSafe1EgyLvlElecMai VehModMngtGlbSafe1EgyLvlElecSubt VehModMngtGlbSafe1FltEgyCnsWdSts VehModMngtGlbSafe1PwrLvlElecMai VehModMngtGlbSafe1PwrLvlElecSubt VehModMngtGlbSafe1UsgModSts;
SIG_GROUP_ 128 ADataRawSafe 1 : ADataRawSafeALat ADataRawSafeALat1Qf ADataRawSafeALgt ADataRawSafeALgt1Qf ADataRawSafeAVert ADataRawSafeAVertQf ADataRawSafeChks ADataRawSafeCntr;
SIG_GROUP_ 128 AgDataRawSafe 1 : AgDataRawSafeChks AgDataRawSafeCntr AgDataRawSafeRollRate AgDataRawSafeRollRateQf AgDataRawSafeYawRate AgDataRawSafeYawRateQf;
SIG_GROUP_ 128 AsyDataWithCmpSafe 1 : AsyDataWithCmpSafeALat1Qf AsyDataWithCmpSafeALatWithCmp AsyDataWithCmpSafeALgt1Qf AsyDataWithCmpSafeChks AsyDataWithCmpSafeCntr AsyDataWithCmpSafeGrdtOfALgt AsyDataWithCmpSafeYawRateQf AsyDataWithCmpSafeYawRateWithCmp;
SIG_GROUP_ 128 AsyHandsOffIndcr 1 : AsyHandsOffIndcrAsyIndcrDispSts AsyHandsOffIndcrChks AsyHandsOffIndcrCntr;
SIG_GROUP_ 128 MobDevRPAReq 1 : MobDevRPAReqChks MobDevRPAReqCntr MobDevRPAReqMobDevSts MobDevRPAReqRPAOutModeSubT MobDevRPAReqRPAReq MobDevRPAReqRSPACtrl;
SIG_GROUP_ 128 NetTCAMActvt 1 : NetTCAMActvtPrio NetTCAMActvtResourceGroup;
SIG_GROUP_ 128 StandStillMgrStsForHld 1 : StandStillMgrStsForHld1 StandStillMgrStsForHldChks StandStillMgrStsForHldCntr;
SIG_GROUP_ 128 WhlDirRotlFrnt 1 : WhlDirRotlFrntChks WhlDirRotlFrntCntr WhlDirRotlFrntLe WhlDirRotlFrntRi;
SIG_GROUP_ 128 WhlDirRotlRe 1 : WhlDirRotlReChks WhlDirRotlReCntr WhlDirRotlReLe WhlDirRotlReRi;
SIG_GROUP_ 128 WhlRotToothCntr 1 : WhlRotToothCntrChks WhlRotToothCntrCntr WhlRotToothCntrFrntLe WhlRotToothCntrFrntRi WhlRotToothCntrReLe WhlRotToothCntrReRi;
SIG_GROUP_ 128 WhlSpdCircumlFrnt 1 : WhlSpdCircumlFrntChks WhlSpdCircumlFrntCntr WhlSpdCircumlFrntLe WhlSpdCircumlFrntLeQf WhlSpdCircumlFrntRiQf WhlSpdCircumlFrntWhlSpdCircumlFr;
SIG_GROUP_ 128 WhlSpdCircumlRe 1 : WhlSpdCircumlReChks WhlSpdCircumlReCntr WhlSpdCircumlReLe WhlSpdCircumlReLeQf WhlSpdCircumlReRi WhlSpdCircumlReRiQf;
SIG_GROUP_ 389 AmbTRaw 1 : AmbTRawAmbTVal AmbTRawQly;
SIG_GROUP_ 389 GNSSSolution 1 : GNSSSolutionCntr GNSSSolutionNoOfSatltForSysNo1 GNSSSolutionNoOfSatltForSysNo2 GNSSSolutionNoOfSatltForSysNo3 GNSSSolutionNoOfSatltForSysNo4 GNSSSolutionNoOfSatltForSysNo5 GNSSSolutionNoOfSatltForSysNo6 GNSSSolutionNoOfSatltForSysNo7 GNSSSolutionPreHozlDil GNSSSolutionPrePosnDil GNSSSolutionPreVertDil GNSSSolutionSatltPosnStsPrm1 GNSSSolutionSatltPosnStsPrm2 GNSSSolutionSatltSysNo1InUse GNSSSolutionSatltSysNo2InUse GNSSSolutionSatltSysNo3InUse GNSSSolutionSatltSysNo4InUse GNSSSolutionSatltSysNo5InUse GNSSSolutionSatltSysNo6InUse GNSSSolutionSatltSysNo7InUse GNSSSolutionTiForMins GNSSSolutionTiForMsec GNSSSolutionTiForSec;
SIG_GROUP_ 389 KeyDistncSts 1 : KeyDistncStsKey0 KeyDistncStsKey1 KeyDistncStsKey2 KeyDistncStsKey3 KeyDistncStsKey4 KeyDistncStsKey5;
SIG_GROUP_ 389 PosnFromSatlt 1 : PosnFromSatltCntr PosnFromSatltPosnAlti PosnFromSatltPosnDir PosnFromSatltPosnLat PosnFromSatltPosnLgt PosnFromSatltPosnSpd PosnFromSatltPosnVHozl PosnFromSatltPosnVVert PosnFromSatltTiForMins PosnFromSatltTiForMsec PosnFromSatltTiForSec PosnFromSatltUTCForDay PosnFromSatltUTCForHr PosnFromSatltUTCForMins PosnFromSatltUTCForMth PosnFromSatltUTCForSec PosnFromSatltUTCForYr;
SIG_GROUP_ 144 AlrmSts 1 : AlrmStsAlrmFailr AlrmStsAlrmSt AlrmStsAlrmTrgSrc AlrmStsSnsrInclnFailr AlrmStsSnsrIntrScanrFailr;
SIG_GROUP_ 144 BiasedPosnFromSatlt 1 : BiasedPosnFromSatltCntr BiasedPosnFromSatltPosnLat BiasedPosnFromSatltPosnLgt BiasedPosnFromSatltTiForMins BiasedPosnFromSatltTiForMsec BiasedPosnFromSatltTiForSec;
SIG_GROUP_ 144 LeFrntTireMsg 1 : LeFrntTireMsgBattLoSt LeFrntTireMsgFastLoseWarnFlg LeFrntTireMsgMsgOldFlg LeFrntTireMsgP LeFrntTireMsgPWarnFlg LeFrntTireMsgSysWarnFlg LeFrntTireMsgT LeFrntTireMsgTireFillgAssiPSts LeFrntTireMsgTWarnFlg;
SIG_GROUP_ 144 LeReTireMsg 1 : LeReTireMsgBattLoSt LeReTireMsgFastLoseWarnFlg LeReTireMsgMsgOldFlg LeReTireMsgP LeReTireMsgPWarnFlg LeReTireMsgSysWarnFlg LeReTireMsgT LeReTireMsgTireFillgAssiPSts LeReTireMsgTWarnFlg;
SIG_GROUP_ 144 LockgCenSts 1 : LockgCenStsLockSt LockgCenStsTrigSrc LockgCenStsUpdEve;
SIG_GROUP_ 144 NetASDMActvt 1 : NetASDMActvtPrio NetASDMActvtResourceGroup;
SIG_GROUP_ 144 NetDIMActvt 1 : NetDIMActvtPrio NetDIMActvtResourceGroup;
SIG_GROUP_ 144 NetDMMActvt 1 : NetDMMActvtPrio NetDMMActvtResourceGroup;
SIG_GROUP_ 144 NetDVRActvt 1 : NetDVRActvtPrio NetDVRActvtResourceGroup;
SIG_GROUP_ 144 NetIHUActvt 1 : NetIHUActvtPrio NetIHUActvtResourceGroup;
SIG_GROUP_ 144 NetVGMActvt 1 : NetVGMActvtPrio NetVGMActvtResourceGroup;
SIG_GROUP_ 144 RiFrntTireMsg 1 : RiFrntTireMsgBattLoSt RiFrntTireMsgFastLoseWarnFlg RiFrntTireMsgMsgOldFlg RiFrntTireMsgP RiFrntTireMsgPWarnFlg RiFrntTireMsgSysWarnFlg RiFrntTireMsgT RiFrntTireMsgTireFillgAssiPSts RiFrntTireMsgTWarnFlg;
SIG_GROUP_ 144 RiReTireMsg 1 : RiReTireMsgBattLoSt RiReTireMsgFastLoseWarnFlg RiReTireMsgMsgOldFlg RiReTireMsgP RiReTireMsgPWarnFlg RiReTireMsgSysWarnFlg RiReTireMsgT RiReTireMsgTireFillgAssiPSts RiReTireMsgTWarnFlg;
