// *************************************************************************** *
// *                                                                           *
// *                      Mentor Graphics Corporation                          *
// *                          All rights reserved                              *
// *                                                                           *
// *************************************************************************** *
// *                                                                           *
// * Description:         CANDB File                                           *
// * Generated at:        2020-04-14 13:14:03                                  *
// * System:              SDB20010                                             *
// * Variant:             EX11_AVP                                             *
// * Network:             SafetyCANFD3                                         *
// *                                                                           *
// *************************************************************************** *
// *                                                                           *
// *             THIS CONFIGURATION MIGHT CONTAIN SOME ERRORS                  *
// *              IF THE INPUT MODEL WAS NOT PROPERLY FORMED!                  *
// *                    Do Not Use this File directly!                         *
// *                                                                           *
// *************************************************************************** *
VERSION "SafetyCANFD3"

NS_ :

BS_:

BU_:  ASDM ETC PAS SODL SODR

BO_ 332 SODLSafetyCANFD3Frame15: 64 SODL
 SG_ ReSideRdrLeDetn85_UB : 74|1@0+ (1,0) [0|1] "" ASDM,PAS
 SG_ ReSideRdrLeDetn85RdrDetnAzi : 31|11@0+ (0.1,-90.0) [-90.0|90.0] "Deg" ASDM,PAS
 SG_ ReSideRdrLeDetn85RdrDetnChks : 7|8@0+ (1.0,0.0) [0.0|255.0] "Unitless" ASDM,PAS
 SG_ ReSideRdrLeDetn85RdrDetnCntr : 15|4@0+ (1.0,0.0) [0.0|15.0] "Unitless" ASDM,PAS
 SG_ ReSideRdrLeDetn85RdrDetnConf : 71|7@0+ (1.0,0.0) [0.0|100.0] "%" ASDM,PAS
 SG_ ReSideRdrLeDetn85RdrDetnElevn : 79|5@0+ (1.0,-15.0) [-15.0|15.0] "Deg" ASDM,PAS
 SG_ ReSideRdrLeDetn85RdrDetnPwr : 8|9@0+ (0.1,0.0) [0.0|51.1] "dB" ASDM,PAS
 SG_ ReSideRdrLeDetn85RdrDetnRng : 55|14@0+ (0.02,-1.0) [-1.0|200.0] "m" ASDM,PAS
 SG_ ReSideRdrLeDetn85RdrDetnRngV : 36|13@0+ (0.02,-80.0) [-80.0|80.0] "m/s" ASDM,PAS
 SG_ ReSideRdrLeDetn85RdrDetnSts : 11|2@0+ (1,0) [0|3] "" ASDM,PAS
 SG_ ReSideRdrLeDetn86_UB : 154|1@0+ (1,0) [0|1] "" ASDM,PAS
 SG_ ReSideRdrLeDetn86RdrDetnAzi : 119|11@0+ (0.1,-90.0) [-90.0|90.0] "Deg" ASDM,PAS
 SG_ ReSideRdrLeDetn86RdrDetnChks : 87|8@0+ (1.0,0.0) [0.0|255.0] "Unitless" ASDM,PAS
 SG_ ReSideRdrLeDetn86RdrDetnCntr : 95|4@0+ (1.0,0.0) [0.0|15.0] "Unitless" ASDM,PAS
 SG_ ReSideRdrLeDetn86RdrDetnConf : 111|7@0+ (1.0,0.0) [0.0|100.0] "%" ASDM,PAS
 SG_ ReSideRdrLeDetn86RdrDetnElevn : 159|5@0+ (1.0,-15.0) [-15.0|15.0] "Deg" ASDM,PAS
 SG_ ReSideRdrLeDetn86RdrDetnPwr : 89|9@0+ (0.1,0.0) [0.0|51.1] "dB" ASDM,PAS
 SG_ ReSideRdrLeDetn86RdrDetnRng : 143|14@0+ (0.02,-1.0) [-1.0|200.0] "m" ASDM,PAS
 SG_ ReSideRdrLeDetn86RdrDetnRngV : 124|13@0+ (0.02,-80.0) [-80.0|80.0] "m/s" ASDM,PAS
 SG_ ReSideRdrLeDetn86RdrDetnSts : 91|2@0+ (1,0) [0|3] "" ASDM,PAS
 SG_ ReSideRdrLeDetn87_UB : 234|1@0+ (1,0) [0|1] "" ASDM,PAS
 SG_ ReSideRdrLeDetn87RdrDetnAzi : 199|11@0+ (0.1,-90.0) [-90.0|90.0] "Deg" ASDM,PAS
 SG_ ReSideRdrLeDetn87RdrDetnChks : 167|8@0+ (1.0,0.0) [0.0|255.0] "Unitless" ASDM,PAS
 SG_ ReSideRdrLeDetn87RdrDetnCntr : 175|4@0+ (1.0,0.0) [0.0|15.0] "Unitless" ASDM,PAS
 SG_ ReSideRdrLeDetn87RdrDetnConf : 191|7@0+ (1.0,0.0) [0.0|100.0] "%" ASDM,PAS
 SG_ ReSideRdrLeDetn87RdrDetnElevn : 239|5@0+ (1.0,-15.0) [-15.0|15.0] "Deg" ASDM,PAS
 SG_ ReSideRdrLeDetn87RdrDetnPwr : 169|9@0+ (0.1,0.0) [0.0|51.1] "dB" ASDM,PAS
 SG_ ReSideRdrLeDetn87RdrDetnRng : 223|14@0+ (0.02,-1.0) [-1.0|200.0] "m" ASDM,PAS
 SG_ ReSideRdrLeDetn87RdrDetnRngV : 204|13@0+ (0.02,-80.0) [-80.0|80.0] "m/s" ASDM,PAS
 SG_ ReSideRdrLeDetn87RdrDetnSts : 171|2@0+ (1,0) [0|3] "" ASDM,PAS
 SG_ ReSideRdrLeDetn88_UB : 314|1@0+ (1,0) [0|1] "" ASDM,PAS
 SG_ ReSideRdrLeDetn88RdrDetnAzi : 287|11@0+ (0.1,-90.0) [-90.0|90.0] "Deg" ASDM,PAS
 SG_ ReSideRdrLeDetn88RdrDetnChks : 247|8@0+ (1.0,0.0) [0.0|255.0] "Unitless" ASDM,PAS
 SG_ ReSideRdrLeDetn88RdrDetnCntr : 255|4@0+ (1.0,0.0) [0.0|15.0] "Unitless" ASDM,PAS
 SG_ ReSideRdrLeDetn88RdrDetnConf : 311|7@0+ (1.0,0.0) [0.0|100.0] "%" ASDM,PAS
 SG_ ReSideRdrLeDetn88RdrDetnElevn : 319|5@0+ (1.0,-15.0) [-15.0|15.0] "Deg" ASDM,PAS
 SG_ ReSideRdrLeDetn88RdrDetnPwr : 249|9@0+ (0.1,0.0) [0.0|51.1] "dB" ASDM,PAS
 SG_ ReSideRdrLeDetn88RdrDetnRng : 271|14@0+ (0.02,-1.0) [-1.0|200.0] "m" ASDM,PAS
 SG_ ReSideRdrLeDetn88RdrDetnRngV : 292|13@0+ (0.02,-80.0) [-80.0|80.0] "m/s" ASDM,PAS
 SG_ ReSideRdrLeDetn88RdrDetnSts : 251|2@0+ (1,0) [0|3] "" ASDM,PAS
 SG_ ReSideRdrLeDetn89_UB : 394|1@0+ (1,0) [0|1] "" ASDM,PAS
 SG_ ReSideRdrLeDetn89RdrDetnAzi : 351|11@0+ (0.1,-90.0) [-90.0|90.0] "Deg" ASDM,PAS
 SG_ ReSideRdrLeDetn89RdrDetnChks : 327|8@0+ (1.0,0.0) [0.0|255.0] "Unitless" ASDM,PAS
 SG_ ReSideRdrLeDetn89RdrDetnCntr : 335|4@0+ (1.0,0.0) [0.0|15.0] "Unitless" ASDM,PAS
 SG_ ReSideRdrLeDetn89RdrDetnConf : 391|7@0+ (1.0,0.0) [0.0|100.0] "%" ASDM,PAS
 SG_ ReSideRdrLeDetn89RdrDetnElevn : 399|5@0+ (1.0,-15.0) [-15.0|15.0] "Deg" ASDM,PAS
 SG_ ReSideRdrLeDetn89RdrDetnPwr : 329|9@0+ (0.1,0.0) [0.0|51.1] "dB" ASDM,PAS
 SG_ ReSideRdrLeDetn89RdrDetnRng : 375|14@0+ (0.02,-1.0) [-1.0|200.0] "m" ASDM,PAS
 SG_ ReSideRdrLeDetn89RdrDetnRngV : 356|13@0+ (0.02,-80.0) [-80.0|80.0] "m/s" ASDM,PAS
 SG_ ReSideRdrLeDetn89RdrDetnSts : 331|2@0+ (1,0) [0|3] "" ASDM,PAS
 SG_ ReSideRdrLeDetn90_UB : 474|1@0+ (1,0) [0|1] "" ASDM,PAS
 SG_ ReSideRdrLeDetn90RdrDetnAzi : 447|11@0+ (0.1,-90.0) [-90.0|90.0] "Deg" ASDM,PAS
 SG_ ReSideRdrLeDetn90RdrDetnChks : 407|8@0+ (1.0,0.0) [0.0|255.0] "Unitless" ASDM,PAS
 SG_ ReSideRdrLeDetn90RdrDetnCntr : 415|4@0+ (1.0,0.0) [0.0|15.0] "Unitless" ASDM,PAS
 SG_ ReSideRdrLeDetn90RdrDetnConf : 471|7@0+ (1.0,0.0) [0.0|100.0] "%" ASDM,PAS
 SG_ ReSideRdrLeDetn90RdrDetnElevn : 479|5@0+ (1.0,-15.0) [-15.0|15.0] "Deg" ASDM,PAS
 SG_ ReSideRdrLeDetn90RdrDetnPwr : 409|9@0+ (0.1,0.0) [0.0|51.1] "dB" ASDM,PAS
 SG_ ReSideRdrLeDetn90RdrDetnRng : 431|14@0+ (0.02,-1.0) [-1.0|200.0] "m" ASDM,PAS
 SG_ ReSideRdrLeDetn90RdrDetnRngV : 452|13@0+ (0.02,-80.0) [-80.0|80.0] "m/s" ASDM,PAS
 SG_ ReSideRdrLeDetn90RdrDetnSts : 411|2@0+ (1,0) [0|3] "" ASDM,PAS

BO_ 334 SODLSafetyCANFD3Frame16: 64 SODL
 SG_ ReSideRdrLeDetn91_UB : 74|1@0+ (1,0) [0|1] "" ASDM,PAS
 SG_ ReSideRdrLeDetn91RdrDetnAzi : 31|11@0+ (0.1,-90.0) [-90.0|90.0] "Deg" ASDM,PAS
 SG_ ReSideRdrLeDetn91RdrDetnChks : 7|8@0+ (1.0,0.0) [0.0|255.0] "Unitless" ASDM,PAS
 SG_ ReSideRdrLeDetn91RdrDetnCntr : 15|4@0+ (1.0,0.0) [0.0|15.0] "Unitless" ASDM,PAS
 SG_ ReSideRdrLeDetn91RdrDetnConf : 71|7@0+ (1.0,0.0) [0.0|100.0] "%" ASDM,PAS
 SG_ ReSideRdrLeDetn91RdrDetnElevn : 79|5@0+ (1.0,-15.0) [-15.0|15.0] "Deg" ASDM,PAS
 SG_ ReSideRdrLeDetn91RdrDetnPwr : 8|9@0+ (0.1,0.0) [0.0|51.1] "dB" ASDM,PAS
 SG_ ReSideRdrLeDetn91RdrDetnRng : 55|14@0+ (0.02,-1.0) [-1.0|200.0] "m" ASDM,PAS
 SG_ ReSideRdrLeDetn91RdrDetnRngV : 36|13@0+ (0.02,-80.0) [-80.0|80.0] "m/s" ASDM,PAS
 SG_ ReSideRdrLeDetn91RdrDetnSts : 11|2@0+ (1,0) [0|3] "" ASDM,PAS
 SG_ ReSideRdrLeDetn92_UB : 154|1@0+ (1,0) [0|1] "" ASDM,PAS
 SG_ ReSideRdrLeDetn92RdrDetnAzi : 119|11@0+ (0.1,-90.0) [-90.0|90.0] "Deg" ASDM,PAS
 SG_ ReSideRdrLeDetn92RdrDetnChks : 87|8@0+ (1.0,0.0) [0.0|255.0] "Unitless" ASDM,PAS
 SG_ ReSideRdrLeDetn92RdrDetnCntr : 95|4@0+ (1.0,0.0) [0.0|15.0] "Unitless" ASDM,PAS
 SG_ ReSideRdrLeDetn92RdrDetnConf : 111|7@0+ (1.0,0.0) [0.0|100.0] "%" ASDM,PAS
 SG_ ReSideRdrLeDetn92RdrDetnElevn : 159|5@0+ (1.0,-15.0) [-15.0|15.0] "Deg" ASDM,PAS
 SG_ ReSideRdrLeDetn92RdrDetnPwr : 89|9@0+ (0.1,0.0) [0.0|51.1] "dB" ASDM,PAS
 SG_ ReSideRdrLeDetn92RdrDetnRng : 143|14@0+ (0.02,-1.0) [-1.0|200.0] "m" ASDM,PAS
 SG_ ReSideRdrLeDetn92RdrDetnRngV : 124|13@0+ (0.02,-80.0) [-80.0|80.0] "m/s" ASDM,PAS
 SG_ ReSideRdrLeDetn92RdrDetnSts : 91|2@0+ (1,0) [0|3] "" ASDM,PAS
 SG_ ReSideRdrLeDetn93_UB : 234|1@0+ (1,0) [0|1] "" ASDM,PAS
 SG_ ReSideRdrLeDetn93RdrDetnAzi : 199|11@0+ (0.1,-90.0) [-90.0|90.0] "Deg" ASDM,PAS
 SG_ ReSideRdrLeDetn93RdrDetnChks : 167|8@0+ (1.0,0.0) [0.0|255.0] "Unitless" ASDM,PAS
 SG_ ReSideRdrLeDetn93RdrDetnCntr : 175|4@0+ (1.0,0.0) [0.0|15.0] "Unitless" ASDM,PAS
 SG_ ReSideRdrLeDetn93RdrDetnConf : 191|7@0+ (1.0,0.0) [0.0|100.0] "%" ASDM,PAS
 SG_ ReSideRdrLeDetn93RdrDetnElevn : 239|5@0+ (1.0,-15.0) [-15.0|15.0] "Deg" ASDM,PAS
 SG_ ReSideRdrLeDetn93RdrDetnPwr : 169|9@0+ (0.1,0.0) [0.0|51.1] "dB" ASDM,PAS
 SG_ ReSideRdrLeDetn93RdrDetnRng : 223|14@0+ (0.02,-1.0) [-1.0|200.0] "m" ASDM,PAS
 SG_ ReSideRdrLeDetn93RdrDetnRngV : 204|13@0+ (0.02,-80.0) [-80.0|80.0] "m/s" ASDM,PAS
 SG_ ReSideRdrLeDetn93RdrDetnSts : 171|2@0+ (1,0) [0|3] "" ASDM,PAS
 SG_ ReSideRdrLeDetn94_UB : 314|1@0+ (1,0) [0|1] "" ASDM,PAS
 SG_ ReSideRdrLeDetn94RdrDetnAzi : 287|11@0+ (0.1,-90.0) [-90.0|90.0] "Deg" ASDM,PAS
 SG_ ReSideRdrLeDetn94RdrDetnChks : 247|8@0+ (1.0,0.0) [0.0|255.0] "Unitless" ASDM,PAS
 SG_ ReSideRdrLeDetn94RdrDetnCntr : 255|4@0+ (1.0,0.0) [0.0|15.0] "Unitless" ASDM,PAS
 SG_ ReSideRdrLeDetn94RdrDetnConf : 311|7@0+ (1.0,0.0) [0.0|100.0] "%" ASDM,PAS
 SG_ ReSideRdrLeDetn94RdrDetnElevn : 319|5@0+ (1.0,-15.0) [-15.0|15.0] "Deg" ASDM,PAS
 SG_ ReSideRdrLeDetn94RdrDetnPwr : 249|9@0+ (0.1,0.0) [0.0|51.1] "dB" ASDM,PAS
 SG_ ReSideRdrLeDetn94RdrDetnRng : 271|14@0+ (0.02,-1.0) [-1.0|200.0] "m" ASDM,PAS
 SG_ ReSideRdrLeDetn94RdrDetnRngV : 292|13@0+ (0.02,-80.0) [-80.0|80.0] "m/s" ASDM,PAS
 SG_ ReSideRdrLeDetn94RdrDetnSts : 251|2@0+ (1,0) [0|3] "" ASDM,PAS
 SG_ ReSideRdrLeDetn95_UB : 394|1@0+ (1,0) [0|1] "" ASDM,PAS
 SG_ ReSideRdrLeDetn95RdrDetnAzi : 351|11@0+ (0.1,-90.0) [-90.0|90.0] "Deg" ASDM,PAS
 SG_ ReSideRdrLeDetn95RdrDetnChks : 327|8@0+ (1.0,0.0) [0.0|255.0] "Unitless" ASDM,PAS
 SG_ ReSideRdrLeDetn95RdrDetnCntr : 335|4@0+ (1.0,0.0) [0.0|15.0] "Unitless" ASDM,PAS
 SG_ ReSideRdrLeDetn95RdrDetnConf : 391|7@0+ (1.0,0.0) [0.0|100.0] "%" ASDM,PAS
 SG_ ReSideRdrLeDetn95RdrDetnElevn : 399|5@0+ (1.0,-15.0) [-15.0|15.0] "Deg" ASDM,PAS
 SG_ ReSideRdrLeDetn95RdrDetnPwr : 329|9@0+ (0.1,0.0) [0.0|51.1] "dB" ASDM,PAS
 SG_ ReSideRdrLeDetn95RdrDetnRng : 375|14@0+ (0.02,-1.0) [-1.0|200.0] "m" ASDM,PAS
 SG_ ReSideRdrLeDetn95RdrDetnRngV : 356|13@0+ (0.02,-80.0) [-80.0|80.0] "m/s" ASDM,PAS
 SG_ ReSideRdrLeDetn95RdrDetnSts : 331|2@0+ (1,0) [0|3] "" ASDM,PAS
 SG_ ReSideRdrLeDetn96_UB : 474|1@0+ (1,0) [0|1] "" ASDM,PAS
 SG_ ReSideRdrLeDetn96RdrDetnAzi : 447|11@0+ (0.1,-90.0) [-90.0|90.0] "Deg" ASDM,PAS
 SG_ ReSideRdrLeDetn96RdrDetnChks : 407|8@0+ (1.0,0.0) [0.0|255.0] "Unitless" ASDM,PAS
 SG_ ReSideRdrLeDetn96RdrDetnCntr : 415|4@0+ (1.0,0.0) [0.0|15.0] "Unitless" ASDM,PAS
 SG_ ReSideRdrLeDetn96RdrDetnConf : 471|7@0+ (1.0,0.0) [0.0|100.0] "%" ASDM,PAS
 SG_ ReSideRdrLeDetn96RdrDetnElevn : 479|5@0+ (1.0,-15.0) [-15.0|15.0] "Deg" ASDM,PAS
 SG_ ReSideRdrLeDetn96RdrDetnPwr : 409|9@0+ (0.1,0.0) [0.0|51.1] "dB" ASDM,PAS
 SG_ ReSideRdrLeDetn96RdrDetnRng : 431|14@0+ (0.02,-1.0) [-1.0|200.0] "m" ASDM,PAS
 SG_ ReSideRdrLeDetn96RdrDetnRngV : 452|13@0+ (0.02,-80.0) [-80.0|80.0] "m/s" ASDM,PAS
 SG_ ReSideRdrLeDetn96RdrDetnSts : 411|2@0+ (1,0) [0|3] "" ASDM,PAS

BO_ 336 SODLSafetyCANFD3Frame17: 64 SODL
 SG_ ReSideRdrLeDetn100_UB : 314|1@0+ (1,0) [0|1] "" ASDM,PAS
 SG_ ReSideRdrLeDetn100RdrDetnAzi : 287|11@0+ (0.1,-90.0) [-90.0|90.0] "Deg" ASDM,PAS
 SG_ ReSideRdrLeDetn100RdrDetnChks : 247|8@0+ (1.0,0.0) [0.0|255.0] "Unitless" ASDM,PAS
 SG_ ReSideRdrLeDetn100RdrDetnCntr : 255|4@0+ (1.0,0.0) [0.0|15.0] "Unitless" ASDM,PAS
 SG_ ReSideRdrLeDetn100RdrDetnConf : 311|7@0+ (1.0,0.0) [0.0|100.0] "%" ASDM,PAS
 SG_ ReSideRdrLeDetn100RdrDetnElevn : 319|5@0+ (1.0,-15.0) [-15.0|15.0] "Deg" ASDM,PAS
 SG_ ReSideRdrLeDetn100RdrDetnPwr : 249|9@0+ (0.1,0.0) [0.0|51.1] "dB" ASDM,PAS
 SG_ ReSideRdrLeDetn100RdrDetnRng : 271|14@0+ (0.02,-1.0) [-1.0|200.0] "m" ASDM,PAS
 SG_ ReSideRdrLeDetn100RdrDetnRngV : 292|13@0+ (0.02,-80.0) [-80.0|80.0] "m/s" ASDM,PAS
 SG_ ReSideRdrLeDetn100RdrDetnSts : 251|2@0+ (1,0) [0|3] "" ASDM,PAS
 SG_ ReSideRdrLeDetn101_UB : 394|1@0+ (1,0) [0|1] "" ASDM,PAS
 SG_ ReSideRdrLeDetn101RdrDetnAzi : 351|11@0+ (0.1,-90.0) [-90.0|90.0] "Deg" ASDM,PAS
 SG_ ReSideRdrLeDetn101RdrDetnChks : 327|8@0+ (1.0,0.0) [0.0|255.0] "Unitless" ASDM,PAS
 SG_ ReSideRdrLeDetn101RdrDetnCntr : 335|4@0+ (1.0,0.0) [0.0|15.0] "Unitless" ASDM,PAS
 SG_ ReSideRdrLeDetn101RdrDetnConf : 391|7@0+ (1.0,0.0) [0.0|100.0] "%" ASDM,PAS
 SG_ ReSideRdrLeDetn101RdrDetnElevn : 399|5@0+ (1.0,-15.0) [-15.0|15.0] "Deg" ASDM,PAS
 SG_ ReSideRdrLeDetn101RdrDetnPwr : 329|9@0+ (0.1,0.0) [0.0|51.1] "dB" ASDM,PAS
 SG_ ReSideRdrLeDetn101RdrDetnRng : 375|14@0+ (0.02,-1.0) [-1.0|200.0] "m" ASDM,PAS
 SG_ ReSideRdrLeDetn101RdrDetnRngV : 356|13@0+ (0.02,-80.0) [-80.0|80.0] "m/s" ASDM,PAS
 SG_ ReSideRdrLeDetn101RdrDetnSts : 331|2@0+ (1,0) [0|3] "" ASDM,PAS
 SG_ ReSideRdrLeDetn102_UB : 474|1@0+ (1,0) [0|1] "" ASDM,PAS
 SG_ ReSideRdrLeDetn102RdrDetnAzi : 447|11@0+ (0.1,-90.0) [-90.0|90.0] "Deg" ASDM,PAS
 SG_ ReSideRdrLeDetn102RdrDetnChks : 407|8@0+ (1.0,0.0) [0.0|255.0] "Unitless" ASDM,PAS
 SG_ ReSideRdrLeDetn102RdrDetnCntr : 415|4@0+ (1.0,0.0) [0.0|15.0] "Unitless" ASDM,PAS
 SG_ ReSideRdrLeDetn102RdrDetnConf : 471|7@0+ (1.0,0.0) [0.0|100.0] "%" ASDM,PAS
 SG_ ReSideRdrLeDetn102RdrDetnElevn : 479|5@0+ (1.0,-15.0) [-15.0|15.0] "Deg" ASDM,PAS
 SG_ ReSideRdrLeDetn102RdrDetnPwr : 409|9@0+ (0.1,0.0) [0.0|51.1] "dB" ASDM,PAS
 SG_ ReSideRdrLeDetn102RdrDetnRng : 431|14@0+ (0.02,-1.0) [-1.0|200.0] "m" ASDM,PAS
 SG_ ReSideRdrLeDetn102RdrDetnRngV : 452|13@0+ (0.02,-80.0) [-80.0|80.0] "m/s" ASDM,PAS
 SG_ ReSideRdrLeDetn102RdrDetnSts : 411|2@0+ (1,0) [0|3] "" ASDM,PAS
 SG_ ReSideRdrLeDetn97_UB : 74|1@0+ (1,0) [0|1] "" ASDM,PAS
 SG_ ReSideRdrLeDetn97RdrDetnAzi : 31|11@0+ (0.1,-90.0) [-90.0|90.0] "Deg" ASDM,PAS
 SG_ ReSideRdrLeDetn97RdrDetnChks : 7|8@0+ (1.0,0.0) [0.0|255.0] "Unitless" ASDM,PAS
 SG_ ReSideRdrLeDetn97RdrDetnCntr : 15|4@0+ (1.0,0.0) [0.0|15.0] "Unitless" ASDM,PAS
 SG_ ReSideRdrLeDetn97RdrDetnConf : 71|7@0+ (1.0,0.0) [0.0|100.0] "%" ASDM,PAS
 SG_ ReSideRdrLeDetn97RdrDetnElevn : 79|5@0+ (1.0,-15.0) [-15.0|15.0] "Deg" ASDM,PAS
 SG_ ReSideRdrLeDetn97RdrDetnPwr : 8|9@0+ (0.1,0.0) [0.0|51.1] "dB" ASDM,PAS
 SG_ ReSideRdrLeDetn97RdrDetnRng : 55|14@0+ (0.02,-1.0) [-1.0|200.0] "m" ASDM,PAS
 SG_ ReSideRdrLeDetn97RdrDetnRngV : 36|13@0+ (0.02,-80.0) [-80.0|80.0] "m/s" ASDM,PAS
 SG_ ReSideRdrLeDetn97RdrDetnSts : 11|2@0+ (1,0) [0|3] "" ASDM,PAS
 SG_ ReSideRdrLeDetn98_UB : 154|1@0+ (1,0) [0|1] "" ASDM,PAS
 SG_ ReSideRdrLeDetn98RdrDetnAzi : 119|11@0+ (0.1,-90.0) [-90.0|90.0] "Deg" ASDM,PAS
 SG_ ReSideRdrLeDetn98RdrDetnChks : 87|8@0+ (1.0,0.0) [0.0|255.0] "Unitless" ASDM,PAS
 SG_ ReSideRdrLeDetn98RdrDetnCntr : 95|4@0+ (1.0,0.0) [0.0|15.0] "Unitless" ASDM,PAS
 SG_ ReSideRdrLeDetn98RdrDetnConf : 111|7@0+ (1.0,0.0) [0.0|100.0] "%" ASDM,PAS
 SG_ ReSideRdrLeDetn98RdrDetnElevn : 159|5@0+ (1.0,-15.0) [-15.0|15.0] "Deg" ASDM,PAS
 SG_ ReSideRdrLeDetn98RdrDetnPwr : 89|9@0+ (0.1,0.0) [0.0|51.1] "dB" ASDM,PAS
 SG_ ReSideRdrLeDetn98RdrDetnRng : 143|14@0+ (0.02,-1.0) [-1.0|200.0] "m" ASDM,PAS
 SG_ ReSideRdrLeDetn98RdrDetnRngV : 124|13@0+ (0.02,-80.0) [-80.0|80.0] "m/s" ASDM,PAS
 SG_ ReSideRdrLeDetn98RdrDetnSts : 91|2@0+ (1,0) [0|3] "" ASDM,PAS
 SG_ ReSideRdrLeDetn99_UB : 234|1@0+ (1,0) [0|1] "" ASDM,PAS
 SG_ ReSideRdrLeDetn99RdrDetnAzi : 199|11@0+ (0.1,-90.0) [-90.0|90.0] "Deg" ASDM,PAS
 SG_ ReSideRdrLeDetn99RdrDetnChks : 167|8@0+ (1.0,0.0) [0.0|255.0] "Unitless" ASDM,PAS
 SG_ ReSideRdrLeDetn99RdrDetnCntr : 175|4@0+ (1.0,0.0) [0.0|15.0] "Unitless" ASDM,PAS
 SG_ ReSideRdrLeDetn99RdrDetnConf : 191|7@0+ (1.0,0.0) [0.0|100.0] "%" ASDM,PAS
 SG_ ReSideRdrLeDetn99RdrDetnElevn : 239|5@0+ (1.0,-15.0) [-15.0|15.0] "Deg" ASDM,PAS
 SG_ ReSideRdrLeDetn99RdrDetnPwr : 169|9@0+ (0.1,0.0) [0.0|51.1] "dB" ASDM,PAS
 SG_ ReSideRdrLeDetn99RdrDetnRng : 223|14@0+ (0.02,-1.0) [-1.0|200.0] "m" ASDM,PAS
 SG_ ReSideRdrLeDetn99RdrDetnRngV : 204|13@0+ (0.02,-80.0) [-80.0|80.0] "m/s" ASDM,PAS
 SG_ ReSideRdrLeDetn99RdrDetnSts : 171|2@0+ (1,0) [0|3] "" ASDM,PAS

BO_ 338 SODLSafetyCANFD3Frame18: 64 SODL
 SG_ ReSideRdrLeDetn103_UB : 74|1@0+ (1,0) [0|1] "" ASDM,PAS
 SG_ ReSideRdrLeDetn103RdrDetnAzi : 31|11@0+ (0.1,-90.0) [-90.0|90.0] "Deg" ASDM,PAS
 SG_ ReSideRdrLeDetn103RdrDetnChks : 7|8@0+ (1.0,0.0) [0.0|255.0] "Unitless" ASDM,PAS
 SG_ ReSideRdrLeDetn103RdrDetnCntr : 15|4@0+ (1.0,0.0) [0.0|15.0] "Unitless" ASDM,PAS
 SG_ ReSideRdrLeDetn103RdrDetnConf : 71|7@0+ (1.0,0.0) [0.0|100.0] "%" ASDM,PAS
 SG_ ReSideRdrLeDetn103RdrDetnElevn : 79|5@0+ (1.0,-15.0) [-15.0|15.0] "Deg" ASDM,PAS
 SG_ ReSideRdrLeDetn103RdrDetnPwr : 8|9@0+ (0.1,0.0) [0.0|51.1] "dB" ASDM,PAS
 SG_ ReSideRdrLeDetn103RdrDetnRng : 55|14@0+ (0.02,-1.0) [-1.0|200.0] "m" ASDM,PAS
 SG_ ReSideRdrLeDetn103RdrDetnRngV : 36|13@0+ (0.02,-80.0) [-80.0|80.0] "m/s" ASDM,PAS
 SG_ ReSideRdrLeDetn103RdrDetnSts : 11|2@0+ (1,0) [0|3] "" ASDM,PAS
 SG_ ReSideRdrLeDetn104_UB : 154|1@0+ (1,0) [0|1] "" ASDM,PAS
 SG_ ReSideRdrLeDetn104RdrDetnAzi : 119|11@0+ (0.1,-90.0) [-90.0|90.0] "Deg" ASDM,PAS
 SG_ ReSideRdrLeDetn104RdrDetnChks : 87|8@0+ (1.0,0.0) [0.0|255.0] "Unitless" ASDM,PAS
 SG_ ReSideRdrLeDetn104RdrDetnCntr : 95|4@0+ (1.0,0.0) [0.0|15.0] "Unitless" ASDM,PAS
 SG_ ReSideRdrLeDetn104RdrDetnConf : 111|7@0+ (1.0,0.0) [0.0|100.0] "%" ASDM,PAS
 SG_ ReSideRdrLeDetn104RdrDetnElevn : 159|5@0+ (1.0,-15.0) [-15.0|15.0] "Deg" ASDM,PAS
 SG_ ReSideRdrLeDetn104RdrDetnPwr : 89|9@0+ (0.1,0.0) [0.0|51.1] "dB" ASDM,PAS
 SG_ ReSideRdrLeDetn104RdrDetnRng : 143|14@0+ (0.02,-1.0) [-1.0|200.0] "m" ASDM,PAS
 SG_ ReSideRdrLeDetn104RdrDetnRngV : 124|13@0+ (0.02,-80.0) [-80.0|80.0] "m/s" ASDM,PAS
 SG_ ReSideRdrLeDetn104RdrDetnSts : 91|2@0+ (1,0) [0|3] "" ASDM,PAS
 SG_ ReSideRdrLeDetn105_UB : 234|1@0+ (1,0) [0|1] "" ASDM,PAS
 SG_ ReSideRdrLeDetn105RdrDetnAzi : 199|11@0+ (0.1,-90.0) [-90.0|90.0] "Deg" ASDM,PAS
 SG_ ReSideRdrLeDetn105RdrDetnChks : 167|8@0+ (1.0,0.0) [0.0|255.0] "Unitless" ASDM,PAS
 SG_ ReSideRdrLeDetn105RdrDetnCntr : 175|4@0+ (1.0,0.0) [0.0|15.0] "Unitless" ASDM,PAS
 SG_ ReSideRdrLeDetn105RdrDetnConf : 191|7@0+ (1.0,0.0) [0.0|100.0] "%" ASDM,PAS
 SG_ ReSideRdrLeDetn105RdrDetnElevn : 239|5@0+ (1.0,-15.0) [-15.0|15.0] "Deg" ASDM,PAS
 SG_ ReSideRdrLeDetn105RdrDetnPwr : 169|9@0+ (0.1,0.0) [0.0|51.1] "dB" ASDM,PAS
 SG_ ReSideRdrLeDetn105RdrDetnRng : 223|14@0+ (0.02,-1.0) [-1.0|200.0] "m" ASDM,PAS
 SG_ ReSideRdrLeDetn105RdrDetnRngV : 204|13@0+ (0.02,-80.0) [-80.0|80.0] "m/s" ASDM,PAS
 SG_ ReSideRdrLeDetn105RdrDetnSts : 171|2@0+ (1,0) [0|3] "" ASDM,PAS
 SG_ ReSideRdrLeDetn106_UB : 314|1@0+ (1,0) [0|1] "" ASDM,PAS
 SG_ ReSideRdrLeDetn106RdrDetnAzi : 287|11@0+ (0.1,-90.0) [-90.0|90.0] "Deg" ASDM,PAS
 SG_ ReSideRdrLeDetn106RdrDetnChks : 247|8@0+ (1.0,0.0) [0.0|255.0] "Unitless" ASDM,PAS
 SG_ ReSideRdrLeDetn106RdrDetnCntr : 255|4@0+ (1.0,0.0) [0.0|15.0] "Unitless" ASDM,PAS
 SG_ ReSideRdrLeDetn106RdrDetnConf : 311|7@0+ (1.0,0.0) [0.0|100.0] "%" ASDM,PAS
 SG_ ReSideRdrLeDetn106RdrDetnElevn : 319|5@0+ (1.0,-15.0) [-15.0|15.0] "Deg" ASDM,PAS
 SG_ ReSideRdrLeDetn106RdrDetnPwr : 249|9@0+ (0.1,0.0) [0.0|51.1] "dB" ASDM,PAS
 SG_ ReSideRdrLeDetn106RdrDetnRng : 271|14@0+ (0.02,-1.0) [-1.0|200.0] "m" ASDM,PAS
 SG_ ReSideRdrLeDetn106RdrDetnRngV : 292|13@0+ (0.02,-80.0) [-80.0|80.0] "m/s" ASDM,PAS
 SG_ ReSideRdrLeDetn106RdrDetnSts : 251|2@0+ (1,0) [0|3] "" ASDM,PAS
 SG_ ReSideRdrLeDetn107_UB : 394|1@0+ (1,0) [0|1] "" ASDM,PAS
 SG_ ReSideRdrLeDetn107RdrDetnAzi : 351|11@0+ (0.1,-90.0) [-90.0|90.0] "Deg" ASDM,PAS
 SG_ ReSideRdrLeDetn107RdrDetnChks : 327|8@0+ (1.0,0.0) [0.0|255.0] "Unitless" ASDM,PAS
 SG_ ReSideRdrLeDetn107RdrDetnCntr : 335|4@0+ (1.0,0.0) [0.0|15.0] "Unitless" ASDM,PAS
 SG_ ReSideRdrLeDetn107RdrDetnConf : 391|7@0+ (1.0,0.0) [0.0|100.0] "%" ASDM,PAS
 SG_ ReSideRdrLeDetn107RdrDetnElevn : 399|5@0+ (1.0,-15.0) [-15.0|15.0] "Deg" ASDM,PAS
 SG_ ReSideRdrLeDetn107RdrDetnPwr : 329|9@0+ (0.1,0.0) [0.0|51.1] "dB" ASDM,PAS
 SG_ ReSideRdrLeDetn107RdrDetnRng : 375|14@0+ (0.02,-1.0) [-1.0|200.0] "m" ASDM,PAS
 SG_ ReSideRdrLeDetn107RdrDetnRngV : 356|13@0+ (0.02,-80.0) [-80.0|80.0] "m/s" ASDM,PAS
 SG_ ReSideRdrLeDetn107RdrDetnSts : 331|2@0+ (1,0) [0|3] "" ASDM,PAS
 SG_ ReSideRdrLeDetn108_UB : 474|1@0+ (1,0) [0|1] "" ASDM,PAS
 SG_ ReSideRdrLeDetn108RdrDetnAzi : 447|11@0+ (0.1,-90.0) [-90.0|90.0] "Deg" ASDM,PAS
 SG_ ReSideRdrLeDetn108RdrDetnChks : 407|8@0+ (1.0,0.0) [0.0|255.0] "Unitless" ASDM,PAS
 SG_ ReSideRdrLeDetn108RdrDetnCntr : 415|4@0+ (1.0,0.0) [0.0|15.0] "Unitless" ASDM,PAS
 SG_ ReSideRdrLeDetn108RdrDetnConf : 471|7@0+ (1.0,0.0) [0.0|100.0] "%" ASDM,PAS
 SG_ ReSideRdrLeDetn108RdrDetnElevn : 479|5@0+ (1.0,-15.0) [-15.0|15.0] "Deg" ASDM,PAS
 SG_ ReSideRdrLeDetn108RdrDetnPwr : 409|9@0+ (0.1,0.0) [0.0|51.1] "dB" ASDM,PAS
 SG_ ReSideRdrLeDetn108RdrDetnRng : 431|14@0+ (0.02,-1.0) [-1.0|200.0] "m" ASDM,PAS
 SG_ ReSideRdrLeDetn108RdrDetnRngV : 452|13@0+ (0.02,-80.0) [-80.0|80.0] "m/s" ASDM,PAS
 SG_ ReSideRdrLeDetn108RdrDetnSts : 411|2@0+ (1,0) [0|3] "" ASDM,PAS

BO_ 340 SODLSafetyCANFD3Frame19: 64 SODL
 SG_ ReSideRdrLeDetn109_UB : 74|1@0+ (1,0) [0|1] "" ASDM,PAS
 SG_ ReSideRdrLeDetn109RdrDetnAzi : 31|11@0+ (0.1,-90.0) [-90.0|90.0] "Deg" ASDM,PAS
 SG_ ReSideRdrLeDetn109RdrDetnChks : 7|8@0+ (1.0,0.0) [0.0|255.0] "Unitless" ASDM,PAS
 SG_ ReSideRdrLeDetn109RdrDetnCntr : 15|4@0+ (1.0,0.0) [0.0|15.0] "Unitless" ASDM,PAS
 SG_ ReSideRdrLeDetn109RdrDetnConf : 71|7@0+ (1.0,0.0) [0.0|100.0] "%" ASDM,PAS
 SG_ ReSideRdrLeDetn109RdrDetnElevn : 79|5@0+ (1.0,-15.0) [-15.0|15.0] "Deg" ASDM,PAS
 SG_ ReSideRdrLeDetn109RdrDetnPwr : 8|9@0+ (0.1,0.0) [0.0|51.1] "dB" ASDM,PAS
 SG_ ReSideRdrLeDetn109RdrDetnRng : 55|14@0+ (0.02,-1.0) [-1.0|200.0] "m" ASDM,PAS
 SG_ ReSideRdrLeDetn109RdrDetnRngV : 36|13@0+ (0.02,-80.0) [-80.0|80.0] "m/s" ASDM,PAS
 SG_ ReSideRdrLeDetn109RdrDetnSts : 11|2@0+ (1,0) [0|3] "" ASDM,PAS
 SG_ ReSideRdrLeDetn110_UB : 154|1@0+ (1,0) [0|1] "" ASDM,PAS
 SG_ ReSideRdrLeDetn110RdrDetnAzi : 119|11@0+ (0.1,-90.0) [-90.0|90.0] "Deg" ASDM,PAS
 SG_ ReSideRdrLeDetn110RdrDetnChks : 87|8@0+ (1.0,0.0) [0.0|255.0] "Unitless" ASDM,PAS
 SG_ ReSideRdrLeDetn110RdrDetnCntr : 95|4@0+ (1.0,0.0) [0.0|15.0] "Unitless" ASDM,PAS
 SG_ ReSideRdrLeDetn110RdrDetnConf : 111|7@0+ (1.0,0.0) [0.0|100.0] "%" ASDM,PAS
 SG_ ReSideRdrLeDetn110RdrDetnElevn : 159|5@0+ (1.0,-15.0) [-15.0|15.0] "Deg" ASDM,PAS
 SG_ ReSideRdrLeDetn110RdrDetnPwr : 89|9@0+ (0.1,0.0) [0.0|51.1] "dB" ASDM,PAS
 SG_ ReSideRdrLeDetn110RdrDetnRng : 143|14@0+ (0.02,-1.0) [-1.0|200.0] "m" ASDM,PAS
 SG_ ReSideRdrLeDetn110RdrDetnRngV : 124|13@0+ (0.02,-80.0) [-80.0|80.0] "m/s" ASDM,PAS
 SG_ ReSideRdrLeDetn110RdrDetnSts : 91|2@0+ (1,0) [0|3] "" ASDM,PAS
 SG_ ReSideRdrLeDetn111_UB : 234|1@0+ (1,0) [0|1] "" ASDM,PAS
 SG_ ReSideRdrLeDetn111RdrDetnAzi : 199|11@0+ (0.1,-90.0) [-90.0|90.0] "Deg" ASDM,PAS
 SG_ ReSideRdrLeDetn111RdrDetnChks : 167|8@0+ (1.0,0.0) [0.0|255.0] "Unitless" ASDM,PAS
 SG_ ReSideRdrLeDetn111RdrDetnCntr : 175|4@0+ (1.0,0.0) [0.0|15.0] "Unitless" ASDM,PAS
 SG_ ReSideRdrLeDetn111RdrDetnConf : 191|7@0+ (1.0,0.0) [0.0|100.0] "%" ASDM,PAS
 SG_ ReSideRdrLeDetn111RdrDetnElevn : 239|5@0+ (1.0,-15.0) [-15.0|15.0] "Deg" ASDM,PAS
 SG_ ReSideRdrLeDetn111RdrDetnPwr : 169|9@0+ (0.1,0.0) [0.0|51.1] "dB" ASDM,PAS
 SG_ ReSideRdrLeDetn111RdrDetnRng : 223|14@0+ (0.02,-1.0) [-1.0|200.0] "m" ASDM,PAS
 SG_ ReSideRdrLeDetn111RdrDetnRngV : 204|13@0+ (0.02,-80.0) [-80.0|80.0] "m/s" ASDM,PAS
 SG_ ReSideRdrLeDetn111RdrDetnSts : 171|2@0+ (1,0) [0|3] "" ASDM,PAS
 SG_ ReSideRdrLeDetn112_UB : 314|1@0+ (1,0) [0|1] "" ASDM,PAS
 SG_ ReSideRdrLeDetn112RdrDetnAzi : 287|11@0+ (0.1,-90.0) [-90.0|90.0] "Deg" ASDM,PAS
 SG_ ReSideRdrLeDetn112RdrDetnChks : 247|8@0+ (1.0,0.0) [0.0|255.0] "Unitless" ASDM,PAS
 SG_ ReSideRdrLeDetn112RdrDetnCntr : 255|4@0+ (1.0,0.0) [0.0|15.0] "Unitless" ASDM,PAS
 SG_ ReSideRdrLeDetn112RdrDetnConf : 311|7@0+ (1.0,0.0) [0.0|100.0] "%" ASDM,PAS
 SG_ ReSideRdrLeDetn112RdrDetnElevn : 319|5@0+ (1.0,-15.0) [-15.0|15.0] "Deg" ASDM,PAS
 SG_ ReSideRdrLeDetn112RdrDetnPwr : 249|9@0+ (0.1,0.0) [0.0|51.1] "dB" ASDM,PAS
 SG_ ReSideRdrLeDetn112RdrDetnRng : 271|14@0+ (0.02,-1.0) [-1.0|200.0] "m" ASDM,PAS
 SG_ ReSideRdrLeDetn112RdrDetnRngV : 292|13@0+ (0.02,-80.0) [-80.0|80.0] "m/s" ASDM,PAS
 SG_ ReSideRdrLeDetn112RdrDetnSts : 251|2@0+ (1,0) [0|3] "" ASDM,PAS
 SG_ ReSideRdrLeDetn113_UB : 394|1@0+ (1,0) [0|1] "" ASDM,PAS
 SG_ ReSideRdrLeDetn113RdrDetnAzi : 351|11@0+ (0.1,-90.0) [-90.0|90.0] "Deg" ASDM,PAS
 SG_ ReSideRdrLeDetn113RdrDetnChks : 327|8@0+ (1.0,0.0) [0.0|255.0] "Unitless" ASDM,PAS
 SG_ ReSideRdrLeDetn113RdrDetnCntr : 335|4@0+ (1.0,0.0) [0.0|15.0] "Unitless" ASDM,PAS
 SG_ ReSideRdrLeDetn113RdrDetnConf : 391|7@0+ (1.0,0.0) [0.0|100.0] "%" ASDM,PAS
 SG_ ReSideRdrLeDetn113RdrDetnElevn : 399|5@0+ (1.0,-15.0) [-15.0|15.0] "Deg" ASDM,PAS
 SG_ ReSideRdrLeDetn113RdrDetnPwr : 329|9@0+ (0.1,0.0) [0.0|51.1] "dB" ASDM,PAS
 SG_ ReSideRdrLeDetn113RdrDetnRng : 375|14@0+ (0.02,-1.0) [-1.0|200.0] "m" ASDM,PAS
 SG_ ReSideRdrLeDetn113RdrDetnRngV : 356|13@0+ (0.02,-80.0) [-80.0|80.0] "m/s" ASDM,PAS
 SG_ ReSideRdrLeDetn113RdrDetnSts : 331|2@0+ (1,0) [0|3] "" ASDM,PAS
 SG_ ReSideRdrLeDetn114_UB : 474|1@0+ (1,0) [0|1] "" ASDM,PAS
 SG_ ReSideRdrLeDetn114RdrDetnAzi : 447|11@0+ (0.1,-90.0) [-90.0|90.0] "Deg" ASDM,PAS
 SG_ ReSideRdrLeDetn114RdrDetnChks : 407|8@0+ (1.0,0.0) [0.0|255.0] "Unitless" ASDM,PAS
 SG_ ReSideRdrLeDetn114RdrDetnCntr : 415|4@0+ (1.0,0.0) [0.0|15.0] "Unitless" ASDM,PAS
 SG_ ReSideRdrLeDetn114RdrDetnConf : 471|7@0+ (1.0,0.0) [0.0|100.0] "%" ASDM,PAS
 SG_ ReSideRdrLeDetn114RdrDetnElevn : 479|5@0+ (1.0,-15.0) [-15.0|15.0] "Deg" ASDM,PAS
 SG_ ReSideRdrLeDetn114RdrDetnPwr : 409|9@0+ (0.1,0.0) [0.0|51.1] "dB" ASDM,PAS
 SG_ ReSideRdrLeDetn114RdrDetnRng : 431|14@0+ (0.02,-1.0) [-1.0|200.0] "m" ASDM,PAS
 SG_ ReSideRdrLeDetn114RdrDetnRngV : 452|13@0+ (0.02,-80.0) [-80.0|80.0] "m/s" ASDM,PAS
 SG_ ReSideRdrLeDetn114RdrDetnSts : 411|2@0+ (1,0) [0|3] "" ASDM,PAS

BO_ 342 SODLSafetyCANFD3Frame20: 64 SODL
 SG_ ReSideRdrLeDetn115_UB : 74|1@0+ (1,0) [0|1] "" ASDM,PAS
 SG_ ReSideRdrLeDetn115RdrDetnAzi : 31|11@0+ (0.1,-90.0) [-90.0|90.0] "Deg" ASDM,PAS
 SG_ ReSideRdrLeDetn115RdrDetnChks : 7|8@0+ (1.0,0.0) [0.0|255.0] "Unitless" ASDM,PAS
 SG_ ReSideRdrLeDetn115RdrDetnCntr : 15|4@0+ (1.0,0.0) [0.0|15.0] "Unitless" ASDM,PAS
 SG_ ReSideRdrLeDetn115RdrDetnConf : 71|7@0+ (1.0,0.0) [0.0|100.0] "%" ASDM,PAS
 SG_ ReSideRdrLeDetn115RdrDetnElevn : 79|5@0+ (1.0,-15.0) [-15.0|15.0] "Deg" ASDM,PAS
 SG_ ReSideRdrLeDetn115RdrDetnPwr : 8|9@0+ (0.1,0.0) [0.0|51.1] "dB" ASDM,PAS
 SG_ ReSideRdrLeDetn115RdrDetnRng : 55|14@0+ (0.02,-1.0) [-1.0|200.0] "m" ASDM,PAS
 SG_ ReSideRdrLeDetn115RdrDetnRngV : 36|13@0+ (0.02,-80.0) [-80.0|80.0] "m/s" ASDM,PAS
 SG_ ReSideRdrLeDetn115RdrDetnSts : 11|2@0+ (1,0) [0|3] "" ASDM,PAS
 SG_ ReSideRdrLeDetn116_UB : 154|1@0+ (1,0) [0|1] "" ASDM,PAS
 SG_ ReSideRdrLeDetn116RdrDetnAzi : 119|11@0+ (0.1,-90.0) [-90.0|90.0] "Deg" ASDM,PAS
 SG_ ReSideRdrLeDetn116RdrDetnChks : 87|8@0+ (1.0,0.0) [0.0|255.0] "Unitless" ASDM,PAS
 SG_ ReSideRdrLeDetn116RdrDetnCntr : 95|4@0+ (1.0,0.0) [0.0|15.0] "Unitless" ASDM,PAS
 SG_ ReSideRdrLeDetn116RdrDetnConf : 111|7@0+ (1.0,0.0) [0.0|100.0] "%" ASDM,PAS
 SG_ ReSideRdrLeDetn116RdrDetnElevn : 159|5@0+ (1.0,-15.0) [-15.0|15.0] "Deg" ASDM,PAS
 SG_ ReSideRdrLeDetn116RdrDetnPwr : 89|9@0+ (0.1,0.0) [0.0|51.1] "dB" ASDM,PAS
 SG_ ReSideRdrLeDetn116RdrDetnRng : 143|14@0+ (0.02,-1.0) [-1.0|200.0] "m" ASDM,PAS
 SG_ ReSideRdrLeDetn116RdrDetnRngV : 124|13@0+ (0.02,-80.0) [-80.0|80.0] "m/s" ASDM,PAS
 SG_ ReSideRdrLeDetn116RdrDetnSts : 91|2@0+ (1,0) [0|3] "" ASDM,PAS
 SG_ ReSideRdrLeDetn117_UB : 234|1@0+ (1,0) [0|1] "" ASDM,PAS
 SG_ ReSideRdrLeDetn117RdrDetnAzi : 199|11@0+ (0.1,-90.0) [-90.0|90.0] "Deg" ASDM,PAS
 SG_ ReSideRdrLeDetn117RdrDetnChks : 167|8@0+ (1.0,0.0) [0.0|255.0] "Unitless" ASDM,PAS
 SG_ ReSideRdrLeDetn117RdrDetnCntr : 175|4@0+ (1.0,0.0) [0.0|15.0] "Unitless" ASDM,PAS
 SG_ ReSideRdrLeDetn117RdrDetnConf : 191|7@0+ (1.0,0.0) [0.0|100.0] "%" ASDM,PAS
 SG_ ReSideRdrLeDetn117RdrDetnElevn : 239|5@0+ (1.0,-15.0) [-15.0|15.0] "Deg" ASDM,PAS
 SG_ ReSideRdrLeDetn117RdrDetnPwr : 169|9@0+ (0.1,0.0) [0.0|51.1] "dB" ASDM,PAS
 SG_ ReSideRdrLeDetn117RdrDetnRng : 223|14@0+ (0.02,-1.0) [-1.0|200.0] "m" ASDM,PAS
 SG_ ReSideRdrLeDetn117RdrDetnRngV : 204|13@0+ (0.02,-80.0) [-80.0|80.0] "m/s" ASDM,PAS
 SG_ ReSideRdrLeDetn117RdrDetnSts : 171|2@0+ (1,0) [0|3] "" ASDM,PAS
 SG_ ReSideRdrLeDetn118_UB : 314|1@0+ (1,0) [0|1] "" ASDM,PAS
 SG_ ReSideRdrLeDetn118RdrDetnAzi : 287|11@0+ (0.1,-90.0) [-90.0|90.0] "Deg" ASDM,PAS
 SG_ ReSideRdrLeDetn118RdrDetnChks : 247|8@0+ (1.0,0.0) [0.0|255.0] "Unitless" ASDM,PAS
 SG_ ReSideRdrLeDetn118RdrDetnCntr : 255|4@0+ (1.0,0.0) [0.0|15.0] "Unitless" ASDM,PAS
 SG_ ReSideRdrLeDetn118RdrDetnConf : 311|7@0+ (1.0,0.0) [0.0|100.0] "%" ASDM,PAS
 SG_ ReSideRdrLeDetn118RdrDetnElevn : 319|5@0+ (1.0,-15.0) [-15.0|15.0] "Deg" ASDM,PAS
 SG_ ReSideRdrLeDetn118RdrDetnPwr : 249|9@0+ (0.1,0.0) [0.0|51.1] "dB" ASDM,PAS
 SG_ ReSideRdrLeDetn118RdrDetnRng : 271|14@0+ (0.02,-1.0) [-1.0|200.0] "m" ASDM,PAS
 SG_ ReSideRdrLeDetn118RdrDetnRngV : 292|13@0+ (0.02,-80.0) [-80.0|80.0] "m/s" ASDM,PAS
 SG_ ReSideRdrLeDetn118RdrDetnSts : 251|2@0+ (1,0) [0|3] "" ASDM,PAS
 SG_ ReSideRdrLeDetn119_UB : 394|1@0+ (1,0) [0|1] "" ASDM,PAS
 SG_ ReSideRdrLeDetn119RdrDetnAzi : 351|11@0+ (0.1,-90.0) [-90.0|90.0] "Deg" ASDM,PAS
 SG_ ReSideRdrLeDetn119RdrDetnChks : 327|8@0+ (1.0,0.0) [0.0|255.0] "Unitless" ASDM,PAS
 SG_ ReSideRdrLeDetn119RdrDetnCntr : 335|4@0+ (1.0,0.0) [0.0|15.0] "Unitless" ASDM,PAS
 SG_ ReSideRdrLeDetn119RdrDetnConf : 391|7@0+ (1.0,0.0) [0.0|100.0] "%" ASDM,PAS
 SG_ ReSideRdrLeDetn119RdrDetnElevn : 399|5@0+ (1.0,-15.0) [-15.0|15.0] "Deg" ASDM,PAS
 SG_ ReSideRdrLeDetn119RdrDetnPwr : 329|9@0+ (0.1,0.0) [0.0|51.1] "dB" ASDM,PAS
 SG_ ReSideRdrLeDetn119RdrDetnRng : 375|14@0+ (0.02,-1.0) [-1.0|200.0] "m" ASDM,PAS
 SG_ ReSideRdrLeDetn119RdrDetnRngV : 356|13@0+ (0.02,-80.0) [-80.0|80.0] "m/s" ASDM,PAS
 SG_ ReSideRdrLeDetn119RdrDetnSts : 331|2@0+ (1,0) [0|3] "" ASDM,PAS
 SG_ ReSideRdrLeDetn120_UB : 474|1@0+ (1,0) [0|1] "" ASDM,PAS
 SG_ ReSideRdrLeDetn120RdrDetnAzi : 447|11@0+ (0.1,-90.0) [-90.0|90.0] "Deg" ASDM,PAS
 SG_ ReSideRdrLeDetn120RdrDetnChks : 407|8@0+ (1.0,0.0) [0.0|255.0] "Unitless" ASDM,PAS
 SG_ ReSideRdrLeDetn120RdrDetnCntr : 415|4@0+ (1.0,0.0) [0.0|15.0] "Unitless" ASDM,PAS
 SG_ ReSideRdrLeDetn120RdrDetnConf : 471|7@0+ (1.0,0.0) [0.0|100.0] "%" ASDM,PAS
 SG_ ReSideRdrLeDetn120RdrDetnElevn : 479|5@0+ (1.0,-15.0) [-15.0|15.0] "Deg" ASDM,PAS
 SG_ ReSideRdrLeDetn120RdrDetnPwr : 409|9@0+ (0.1,0.0) [0.0|51.1] "dB" ASDM,PAS
 SG_ ReSideRdrLeDetn120RdrDetnRng : 431|14@0+ (0.02,-1.0) [-1.0|200.0] "m" ASDM,PAS
 SG_ ReSideRdrLeDetn120RdrDetnRngV : 452|13@0+ (0.02,-80.0) [-80.0|80.0] "m/s" ASDM,PAS
 SG_ ReSideRdrLeDetn120RdrDetnSts : 411|2@0+ (1,0) [0|3] "" ASDM,PAS

BO_ 344 SODLSafetyCANFD3Frame21: 64 SODL
 SG_ ReSideRdrLeDetn121_UB : 74|1@0+ (1,0) [0|1] "" ASDM,PAS
 SG_ ReSideRdrLeDetn121RdrDetnAzi : 31|11@0+ (0.1,-90.0) [-90.0|90.0] "Deg" ASDM,PAS
 SG_ ReSideRdrLeDetn121RdrDetnChks : 7|8@0+ (1.0,0.0) [0.0|255.0] "Unitless" ASDM,PAS
 SG_ ReSideRdrLeDetn121RdrDetnCntr : 15|4@0+ (1.0,0.0) [0.0|15.0] "Unitless" ASDM,PAS
 SG_ ReSideRdrLeDetn121RdrDetnConf : 71|7@0+ (1.0,0.0) [0.0|100.0] "%" ASDM,PAS
 SG_ ReSideRdrLeDetn121RdrDetnElevn : 79|5@0+ (1.0,-15.0) [-15.0|15.0] "Deg" ASDM,PAS
 SG_ ReSideRdrLeDetn121RdrDetnPwr : 8|9@0+ (0.1,0.0) [0.0|51.1] "dB" ASDM,PAS
 SG_ ReSideRdrLeDetn121RdrDetnRng : 55|14@0+ (0.02,-1.0) [-1.0|200.0] "m" ASDM,PAS
 SG_ ReSideRdrLeDetn121RdrDetnRngV : 36|13@0+ (0.02,-80.0) [-80.0|80.0] "m/s" ASDM,PAS
 SG_ ReSideRdrLeDetn121RdrDetnSts : 11|2@0+ (1,0) [0|3] "" ASDM,PAS
 SG_ ReSideRdrLeDetn122_UB : 154|1@0+ (1,0) [0|1] "" ASDM,PAS
 SG_ ReSideRdrLeDetn122RdrDetnAzi : 119|11@0+ (0.1,-90.0) [-90.0|90.0] "Deg" ASDM,PAS
 SG_ ReSideRdrLeDetn122RdrDetnChks : 87|8@0+ (1.0,0.0) [0.0|255.0] "Unitless" ASDM,PAS
 SG_ ReSideRdrLeDetn122RdrDetnCntr : 95|4@0+ (1.0,0.0) [0.0|15.0] "Unitless" ASDM,PAS
 SG_ ReSideRdrLeDetn122RdrDetnConf : 111|7@0+ (1.0,0.0) [0.0|100.0] "%" ASDM,PAS
 SG_ ReSideRdrLeDetn122RdrDetnElevn : 159|5@0+ (1.0,-15.0) [-15.0|15.0] "Deg" ASDM,PAS
 SG_ ReSideRdrLeDetn122RdrDetnPwr : 89|9@0+ (0.1,0.0) [0.0|51.1] "dB" ASDM,PAS
 SG_ ReSideRdrLeDetn122RdrDetnRng : 143|14@0+ (0.02,-1.0) [-1.0|200.0] "m" ASDM,PAS
 SG_ ReSideRdrLeDetn122RdrDetnRngV : 124|13@0+ (0.02,-80.0) [-80.0|80.0] "m/s" ASDM,PAS
 SG_ ReSideRdrLeDetn122RdrDetnSts : 91|2@0+ (1,0) [0|3] "" ASDM,PAS
 SG_ ReSideRdrLeDetn123_UB : 234|1@0+ (1,0) [0|1] "" ASDM,PAS
 SG_ ReSideRdrLeDetn123RdrDetnAzi : 199|11@0+ (0.1,-90.0) [-90.0|90.0] "Deg" ASDM,PAS
 SG_ ReSideRdrLeDetn123RdrDetnChks : 167|8@0+ (1.0,0.0) [0.0|255.0] "Unitless" ASDM,PAS
 SG_ ReSideRdrLeDetn123RdrDetnCntr : 175|4@0+ (1.0,0.0) [0.0|15.0] "Unitless" ASDM,PAS
 SG_ ReSideRdrLeDetn123RdrDetnConf : 191|7@0+ (1.0,0.0) [0.0|100.0] "%" ASDM,PAS
 SG_ ReSideRdrLeDetn123RdrDetnElevn : 239|5@0+ (1.0,-15.0) [-15.0|15.0] "Deg" ASDM,PAS
 SG_ ReSideRdrLeDetn123RdrDetnPwr : 169|9@0+ (0.1,0.0) [0.0|51.1] "dB" ASDM,PAS
 SG_ ReSideRdrLeDetn123RdrDetnRng : 223|14@0+ (0.02,-1.0) [-1.0|200.0] "m" ASDM,PAS
 SG_ ReSideRdrLeDetn123RdrDetnRngV : 204|13@0+ (0.02,-80.0) [-80.0|80.0] "m/s" ASDM,PAS
 SG_ ReSideRdrLeDetn123RdrDetnSts : 171|2@0+ (1,0) [0|3] "" ASDM,PAS
 SG_ ReSideRdrLeDetn124_UB : 314|1@0+ (1,0) [0|1] "" ASDM,PAS
 SG_ ReSideRdrLeDetn124RdrDetnAzi : 287|11@0+ (0.1,-90.0) [-90.0|90.0] "Deg" ASDM,PAS
 SG_ ReSideRdrLeDetn124RdrDetnChks : 247|8@0+ (1.0,0.0) [0.0|255.0] "Unitless" ASDM,PAS
 SG_ ReSideRdrLeDetn124RdrDetnCntr : 255|4@0+ (1.0,0.0) [0.0|15.0] "Unitless" ASDM,PAS
 SG_ ReSideRdrLeDetn124RdrDetnConf : 311|7@0+ (1.0,0.0) [0.0|100.0] "%" ASDM,PAS
 SG_ ReSideRdrLeDetn124RdrDetnElevn : 319|5@0+ (1.0,-15.0) [-15.0|15.0] "Deg" ASDM,PAS
 SG_ ReSideRdrLeDetn124RdrDetnPwr : 249|9@0+ (0.1,0.0) [0.0|51.1] "dB" ASDM,PAS
 SG_ ReSideRdrLeDetn124RdrDetnRng : 271|14@0+ (0.02,-1.0) [-1.0|200.0] "m" ASDM,PAS
 SG_ ReSideRdrLeDetn124RdrDetnRngV : 292|13@0+ (0.02,-80.0) [-80.0|80.0] "m/s" ASDM,PAS
 SG_ ReSideRdrLeDetn124RdrDetnSts : 251|2@0+ (1,0) [0|3] "" ASDM,PAS
 SG_ ReSideRdrLeDetn125_UB : 394|1@0+ (1,0) [0|1] "" ASDM,PAS
 SG_ ReSideRdrLeDetn125RdrDetnAzi : 351|11@0+ (0.1,-90.0) [-90.0|90.0] "Deg" ASDM,PAS
 SG_ ReSideRdrLeDetn125RdrDetnChks : 327|8@0+ (1.0,0.0) [0.0|255.0] "Unitless" ASDM,PAS
 SG_ ReSideRdrLeDetn125RdrDetnCntr : 335|4@0+ (1.0,0.0) [0.0|15.0] "Unitless" ASDM,PAS
 SG_ ReSideRdrLeDetn125RdrDetnConf : 391|7@0+ (1.0,0.0) [0.0|100.0] "%" ASDM,PAS
 SG_ ReSideRdrLeDetn125RdrDetnElevn : 399|5@0+ (1.0,-15.0) [-15.0|15.0] "Deg" ASDM,PAS
 SG_ ReSideRdrLeDetn125RdrDetnPwr : 329|9@0+ (0.1,0.0) [0.0|51.1] "dB" ASDM,PAS
 SG_ ReSideRdrLeDetn125RdrDetnRng : 375|14@0+ (0.02,-1.0) [-1.0|200.0] "m" ASDM,PAS
 SG_ ReSideRdrLeDetn125RdrDetnRngV : 356|13@0+ (0.02,-80.0) [-80.0|80.0] "m/s" ASDM,PAS
 SG_ ReSideRdrLeDetn125RdrDetnSts : 331|2@0+ (1,0) [0|3] "" ASDM,PAS
 SG_ ReSideRdrLeDetn126_UB : 474|1@0+ (1,0) [0|1] "" ASDM,PAS
 SG_ ReSideRdrLeDetn126RdrDetnAzi : 447|11@0+ (0.1,-90.0) [-90.0|90.0] "Deg" ASDM,PAS
 SG_ ReSideRdrLeDetn126RdrDetnChks : 407|8@0+ (1.0,0.0) [0.0|255.0] "Unitless" ASDM,PAS
 SG_ ReSideRdrLeDetn126RdrDetnCntr : 415|4@0+ (1.0,0.0) [0.0|15.0] "Unitless" ASDM,PAS
 SG_ ReSideRdrLeDetn126RdrDetnConf : 471|7@0+ (1.0,0.0) [0.0|100.0] "%" ASDM,PAS
 SG_ ReSideRdrLeDetn126RdrDetnElevn : 479|5@0+ (1.0,-15.0) [-15.0|15.0] "Deg" ASDM,PAS
 SG_ ReSideRdrLeDetn126RdrDetnPwr : 409|9@0+ (0.1,0.0) [0.0|51.1] "dB" ASDM,PAS
 SG_ ReSideRdrLeDetn126RdrDetnRng : 431|14@0+ (0.02,-1.0) [-1.0|200.0] "m" ASDM,PAS
 SG_ ReSideRdrLeDetn126RdrDetnRngV : 452|13@0+ (0.02,-80.0) [-80.0|80.0] "m/s" ASDM,PAS
 SG_ ReSideRdrLeDetn126RdrDetnSts : 411|2@0+ (1,0) [0|3] "" ASDM,PAS

BO_ 346 SODLSafetyCANFD3Frame22: 64 SODL
 SG_ ReSideRdrLeDetn127_UB : 74|1@0+ (1,0) [0|1] "" ASDM,PAS
 SG_ ReSideRdrLeDetn127RdrDetnAzi : 31|11@0+ (0.1,-90.0) [-90.0|90.0] "Deg" ASDM,PAS
 SG_ ReSideRdrLeDetn127RdrDetnChks : 7|8@0+ (1.0,0.0) [0.0|255.0] "Unitless" ASDM,PAS
 SG_ ReSideRdrLeDetn127RdrDetnCntr : 15|4@0+ (1.0,0.0) [0.0|15.0] "Unitless" ASDM,PAS
 SG_ ReSideRdrLeDetn127RdrDetnConf : 71|7@0+ (1.0,0.0) [0.0|100.0] "%" ASDM,PAS
 SG_ ReSideRdrLeDetn127RdrDetnElevn : 79|5@0+ (1.0,-15.0) [-15.0|15.0] "Deg" ASDM,PAS
 SG_ ReSideRdrLeDetn127RdrDetnPwr : 8|9@0+ (0.1,0.0) [0.0|51.1] "dB" ASDM,PAS
 SG_ ReSideRdrLeDetn127RdrDetnRng : 55|14@0+ (0.02,-1.0) [-1.0|200.0] "m" ASDM,PAS
 SG_ ReSideRdrLeDetn127RdrDetnRngV : 36|13@0+ (0.02,-80.0) [-80.0|80.0] "m/s" ASDM,PAS
 SG_ ReSideRdrLeDetn127RdrDetnSts : 11|2@0+ (1,0) [0|3] "" ASDM,PAS
 SG_ ReSideRdrLeDetn128_UB : 154|1@0+ (1,0) [0|1] "" ASDM,PAS
 SG_ ReSideRdrLeDetn128RdrDetnAzi : 119|11@0+ (0.1,-90.0) [-90.0|90.0] "Deg" ASDM,PAS
 SG_ ReSideRdrLeDetn128RdrDetnChks : 87|8@0+ (1.0,0.0) [0.0|255.0] "Unitless" ASDM,PAS
 SG_ ReSideRdrLeDetn128RdrDetnCntr : 95|4@0+ (1.0,0.0) [0.0|15.0] "Unitless" ASDM,PAS
 SG_ ReSideRdrLeDetn128RdrDetnConf : 111|7@0+ (1.0,0.0) [0.0|100.0] "%" ASDM,PAS
 SG_ ReSideRdrLeDetn128RdrDetnElevn : 159|5@0+ (1.0,-15.0) [-15.0|15.0] "Deg" ASDM,PAS
 SG_ ReSideRdrLeDetn128RdrDetnPwr : 89|9@0+ (0.1,0.0) [0.0|51.1] "dB" ASDM,PAS
 SG_ ReSideRdrLeDetn128RdrDetnRng : 143|14@0+ (0.02,-1.0) [-1.0|200.0] "m" ASDM,PAS
 SG_ ReSideRdrLeDetn128RdrDetnRngV : 124|13@0+ (0.02,-80.0) [-80.0|80.0] "m/s" ASDM,PAS
 SG_ ReSideRdrLeDetn128RdrDetnSts : 91|2@0+ (1,0) [0|3] "" ASDM,PAS

BO_ 348 SODLSafetyCANFD3Frame23: 64 SODL
 SG_ ReSideRdrLeObj1_UB : 291|1@0+ (1,0) [0|1] "" ASDM,PAS
 SG_ ReSideRdrLeObj1Heading : 287|12@0+ (0.1,-180.0) [-180.0|180.0] "Deg" ASDM,PAS
 SG_ ReSideRdrLeObj1ObjBoxCenterLat : 23|9@0+ (0.1,-25.0) [-25.0|25.0] "m" ASDM,PAS
 SG_ ReSideRdrLeObj1ObjBoxCenterLgt : 30|9@0+ (0.1,-25.0) [-25.0|25.0] "m" ASDM,PAS
 SG_ ReSideRdrLeObj1ObservationHist : 63|32@0+ (1.0,0.0) [0.0|4294967295.0] "Unitless" ASDM,PAS
 SG_ ReSideRdrLeObj1RdrObjAx : 7|8@0- (0.1,0.0) [-12.8|12.700000000000001] "m/s^2" ASDM,PAS
 SG_ ReSideRdrLeObj1RdrObjAy : 15|8@0- (0.1,0.0) [-12.8|12.700000000000001] "m/s^2" ASDM,PAS
 SG_ ReSideRdrLeObj1RdrObjBoxLength : 37|9@0+ (0.1,0.0) [0.0|50.0] "m" ASDM,PAS
 SG_ ReSideRdrLeObj1RdrObjBoxWidth : 44|9@0+ (0.1,0.0) [0.0|50.0] "m" ASDM,PAS
 SG_ ReSideRdrLeObj1RdrObjChks : 95|8@0+ (1.0,0.0) [0.0|255.0] "Unitless" ASDM,PAS
 SG_ ReSideRdrLeObj1RdrObjCntr : 103|4@0+ (1.0,0.0) [0.0|15.0] "Unitless" ASDM,PAS
 SG_ ReSideRdrLeObj1RdrObjCoastCnt : 279|5@0+ (1.0,0.0) [0.0|31.0] "Unitless" ASDM,PAS
 SG_ ReSideRdrLeObj1RdrObjConf : 99|4@0+ (7.0,0.0) [0.0|105.0] "%" ASDM,PAS
 SG_ ReSideRdrLeObj1RdrObjDx : 191|13@0+ (0.05,-200.0) [-200.0|200.0] "m" ASDM,PAS
 SG_ ReSideRdrLeObj1RdrObjDxStdDe : 111|8@0+ (0.05,0.0) [0.0|12.700000000000001] "m" ASDM,PAS
 SG_ ReSideRdrLeObj1RdrObjDy : 119|13@0+ (0.05,-200.0) [-200.0|200.0] "m" ASDM,PAS
 SG_ ReSideRdrLeObj1RdrObjDyStdDe : 183|8@0+ (0.05,0.0) [0.0|12.700000000000001] "m" ASDM,PAS
 SG_ ReSideRdrLeObj1RdrObjElevnConf : 223|4@0+ (7.0,0.0) [0.0|105.0] "%" ASDM,PAS
 SG_ ReSideRdrLeObj1RdrObjElevnSts : 153|2@0+ (1,0) [0|3] "" ASDM,PAS
 SG_ ReSideRdrLeObj1RdrObjID : 167|8@0+ (1.0,0.0) [0.0|255.0] "Unitless" ASDM,PAS
 SG_ ReSideRdrLeObj1RdrObjIsInFreeSpace : 192|1@0+ (1,0) [0|1] "" ASDM,PAS
 SG_ ReSideRdrLeObj1RdrObjMirrProblty : 219|4@0+ (7.0,0.0) [0.0|105.0] "%" ASDM,PAS
 SG_ ReSideRdrLeObj1RdrObjMtnPat : 122|3@0+ (1,0) [0|7] "" ASDM,PAS
 SG_ ReSideRdrLeObj1RdrObjNotRealProblty : 231|4@0+ (7.0,0.0) [0.0|105.0] "%" ASDM,PAS
 SG_ ReSideRdrLeObj1RdrObjStatyCnt : 239|7@0+ (1.0,0.0) [0.0|127.0] "Unitless" ASDM,PAS
 SG_ ReSideRdrLeObj1RdrObjTiAlv : 247|7@0+ (1.0,0.0) [0.0|127.0] "Unitless" ASDM,PAS
 SG_ ReSideRdrLeObj1RdrObjTrackSts : 194|2@0+ (1,0) [0|3] "" ASDM,PAS
 SG_ ReSideRdrLeObj1RdrObjTyp : 51|4@0+ (1,0) [0|15] "" ASDM,PAS
 SG_ ReSideRdrLeObj1RdrObjTypConfBike : 175|4@0+ (7.0,0.0) [0.0|105.0] "%" ASDM,PAS
 SG_ ReSideRdrLeObj1RdrObjTypConfPed : 171|4@0+ (7.0,0.0) [0.0|105.0] "%" ASDM,PAS
 SG_ ReSideRdrLeObj1RdrObjTypConfVeh : 227|4@0+ (7.0,0.0) [0.0|105.0] "%" ASDM,PAS
 SG_ ReSideRdrLeObj1RdrObjVx : 255|14@0+ (0.02,-128.0) [-128.0|128.0] "m/s" ASDM,PAS
 SG_ ReSideRdrLeObj1RdrObjVxStdDe : 271|6@0+ (0.05,0.0) [0.0|2.0] "m/s" ASDM,PAS
 SG_ ReSideRdrLeObj1RdrObjVy : 207|14@0+ (0.02,-128.0) [-128.0|128.0] "m/s" ASDM,PAS
 SG_ ReSideRdrLeObj1RdrObjVyStdDe : 159|6@0+ (0.05,0.0) [0.0|2.0] "m/s" ASDM,PAS
 SG_ ReSideRdrLeObj1RelVx : 135|12@0+ (0.02,-35.6) [-35.6|35.6] "m/s" ASDM,PAS
 SG_ ReSideRdrLeObj1RelVy : 139|12@0+ (0.02,-35.6) [-35.6|35.6] "m/s" ASDM,PAS

CM_ SG_ 332 ReSideRdrLeDetn85RdrDetnAzi "Refer to the data element description in ReSideRdrLeDetn1 with the same data element name";
CM_ SG_ 332 ReSideRdrLeDetn85RdrDetnChks "Refer to the data element description in ReSideRdrLeDetn1 with the same data element name";
CM_ SG_ 332 ReSideRdrLeDetn85RdrDetnCntr "Refer to the data element description in ReSideRdrLeDetn1 with the same data element name";
CM_ SG_ 332 ReSideRdrLeDetn85RdrDetnConf "Refer to the data element description in ReSideRdrLeDetn1 with the same data element name";
CM_ SG_ 332 ReSideRdrLeDetn85RdrDetnElevn "Refer to the data element description in ReSideRdrLeDetn1 with the same data element name";
CM_ SG_ 332 ReSideRdrLeDetn85RdrDetnPwr "Refer to the data element description in ReSideRdrLeDetn1 with the same data element name";
CM_ SG_ 332 ReSideRdrLeDetn85RdrDetnRng "Refer to the data element description in ReSideRdrLeDetn1 with the same data element name";
CM_ SG_ 332 ReSideRdrLeDetn85RdrDetnRngV "Range Velocity";
CM_ SG_ 332 ReSideRdrLeDetn85RdrDetnSts "Refer to the data element description in ReSideRdrLeDetn1 with the same data element name";
CM_ SG_ 332 ReSideRdrLeDetn86RdrDetnAzi "Refer to the data element description in ReSideRdrLeDetn1 with the same data element name";
CM_ SG_ 332 ReSideRdrLeDetn86RdrDetnChks "Refer to the data element description in ReSideRdrLeDetn1 with the same data element name";
CM_ SG_ 332 ReSideRdrLeDetn86RdrDetnCntr "Refer to the data element description in ReSideRdrLeDetn1 with the same data element name";
CM_ SG_ 332 ReSideRdrLeDetn86RdrDetnConf "Refer to the data element description in ReSideRdrLeDetn1 with the same data element name";
CM_ SG_ 332 ReSideRdrLeDetn86RdrDetnElevn "Refer to the data element description in ReSideRdrLeDetn1 with the same data element name";
CM_ SG_ 332 ReSideRdrLeDetn86RdrDetnPwr "Refer to the data element description in ReSideRdrLeDetn1 with the same data element name";
CM_ SG_ 332 ReSideRdrLeDetn86RdrDetnRng "Refer to the data element description in ReSideRdrLeDetn1 with the same data element name";
CM_ SG_ 332 ReSideRdrLeDetn86RdrDetnRngV "Range Velocity";
CM_ SG_ 332 ReSideRdrLeDetn86RdrDetnSts "Refer to the data element description in ReSideRdrLeDetn1 with the same data element name";
CM_ SG_ 332 ReSideRdrLeDetn87RdrDetnAzi "Refer to the data element description in ReSideRdrLeDetn1 with the same data element name";
CM_ SG_ 332 ReSideRdrLeDetn87RdrDetnChks "Refer to the data element description in ReSideRdrLeDetn1 with the same data element name";
CM_ SG_ 332 ReSideRdrLeDetn87RdrDetnCntr "Refer to the data element description in ReSideRdrLeDetn1 with the same data element name";
CM_ SG_ 332 ReSideRdrLeDetn87RdrDetnConf "Refer to the data element description in ReSideRdrLeDetn1 with the same data element name";
CM_ SG_ 332 ReSideRdrLeDetn87RdrDetnElevn "Refer to the data element description in ReSideRdrLeDetn1 with the same data element name";
CM_ SG_ 332 ReSideRdrLeDetn87RdrDetnPwr "Refer to the data element description in ReSideRdrLeDetn1 with the same data element name";
CM_ SG_ 332 ReSideRdrLeDetn87RdrDetnRng "Refer to the data element description in ReSideRdrLeDetn1 with the same data element name";
CM_ SG_ 332 ReSideRdrLeDetn87RdrDetnRngV "Range Velocity";
CM_ SG_ 332 ReSideRdrLeDetn87RdrDetnSts "Refer to the data element description in ReSideRdrLeDetn1 with the same data element name";
CM_ SG_ 332 ReSideRdrLeDetn88RdrDetnAzi "Refer to the data element description in ReSideRdrLeDetn1 with the same data element name";
CM_ SG_ 332 ReSideRdrLeDetn88RdrDetnChks "Refer to the data element description in ReSideRdrLeDetn1 with the same data element name";
CM_ SG_ 332 ReSideRdrLeDetn88RdrDetnCntr "Refer to the data element description in ReSideRdrLeDetn1 with the same data element name";
CM_ SG_ 332 ReSideRdrLeDetn88RdrDetnConf "Refer to the data element description in ReSideRdrLeDetn1 with the same data element name";
CM_ SG_ 332 ReSideRdrLeDetn88RdrDetnElevn "Refer to the data element description in ReSideRdrLeDetn1 with the same data element name";
CM_ SG_ 332 ReSideRdrLeDetn88RdrDetnPwr "Refer to the data element description in ReSideRdrLeDetn1 with the same data element name";
CM_ SG_ 332 ReSideRdrLeDetn88RdrDetnRng "Refer to the data element description in ReSideRdrLeDetn1 with the same data element name";
CM_ SG_ 332 ReSideRdrLeDetn88RdrDetnRngV "Range Velocity";
CM_ SG_ 332 ReSideRdrLeDetn88RdrDetnSts "Refer to the data element description in ReSideRdrLeDetn1 with the same data element name";
CM_ SG_ 332 ReSideRdrLeDetn89RdrDetnAzi "Refer to the data element description in ReSideRdrLeDetn1 with the same data element name";
CM_ SG_ 332 ReSideRdrLeDetn89RdrDetnChks "Refer to the data element description in ReSideRdrLeDetn1 with the same data element name";
CM_ SG_ 332 ReSideRdrLeDetn89RdrDetnCntr "Refer to the data element description in ReSideRdrLeDetn1 with the same data element name";
CM_ SG_ 332 ReSideRdrLeDetn89RdrDetnConf "Refer to the data element description in ReSideRdrLeDetn1 with the same data element name";
CM_ SG_ 332 ReSideRdrLeDetn89RdrDetnElevn "Refer to the data element description in ReSideRdrLeDetn1 with the same data element name";
CM_ SG_ 332 ReSideRdrLeDetn89RdrDetnPwr "Refer to the data element description in ReSideRdrLeDetn1 with the same data element name";
CM_ SG_ 332 ReSideRdrLeDetn89RdrDetnRng "Refer to the data element description in ReSideRdrLeDetn1 with the same data element name";
CM_ SG_ 332 ReSideRdrLeDetn89RdrDetnRngV "Range Velocity";
CM_ SG_ 332 ReSideRdrLeDetn89RdrDetnSts "Refer to the data element description in ReSideRdrLeDetn1 with the same data element name";
CM_ SG_ 332 ReSideRdrLeDetn90RdrDetnAzi "Refer to the data element description in ReSideRdrLeDetn1 with the same data element name";
CM_ SG_ 332 ReSideRdrLeDetn90RdrDetnChks "Refer to the data element description in ReSideRdrLeDetn1 with the same data element name";
CM_ SG_ 332 ReSideRdrLeDetn90RdrDetnCntr "Refer to the data element description in ReSideRdrLeDetn1 with the same data element name";
CM_ SG_ 332 ReSideRdrLeDetn90RdrDetnConf "Refer to the data element description in ReSideRdrLeDetn1 with the same data element name";
CM_ SG_ 332 ReSideRdrLeDetn90RdrDetnElevn "Refer to the data element description in ReSideRdrLeDetn1 with the same data element name";
CM_ SG_ 332 ReSideRdrLeDetn90RdrDetnPwr "Refer to the data element description in ReSideRdrLeDetn1 with the same data element name";
CM_ SG_ 332 ReSideRdrLeDetn90RdrDetnRng "Refer to the data element description in ReSideRdrLeDetn1 with the same data element name";
CM_ SG_ 332 ReSideRdrLeDetn90RdrDetnRngV "Range Velocity";
CM_ SG_ 332 ReSideRdrLeDetn90RdrDetnSts "Refer to the data element description in ReSideRdrLeDetn1 with the same data element name";
CM_ SG_ 334 ReSideRdrLeDetn91RdrDetnAzi "Refer to the data element description in ReSideRdrLeDetn1 with the same data element name";
CM_ SG_ 334 ReSideRdrLeDetn91RdrDetnChks "Refer to the data element description in ReSideRdrLeDetn1 with the same data element name";
CM_ SG_ 334 ReSideRdrLeDetn91RdrDetnCntr "Refer to the data element description in ReSideRdrLeDetn1 with the same data element name";
CM_ SG_ 334 ReSideRdrLeDetn91RdrDetnConf "Refer to the data element description in ReSideRdrLeDetn1 with the same data element name";
CM_ SG_ 334 ReSideRdrLeDetn91RdrDetnElevn "Refer to the data element description in ReSideRdrLeDetn1 with the same data element name";
CM_ SG_ 334 ReSideRdrLeDetn91RdrDetnPwr "Refer to the data element description in ReSideRdrLeDetn1 with the same data element name";
CM_ SG_ 334 ReSideRdrLeDetn91RdrDetnRng "Refer to the data element description in ReSideRdrLeDetn1 with the same data element name";
CM_ SG_ 334 ReSideRdrLeDetn91RdrDetnRngV "Range Velocity";
CM_ SG_ 334 ReSideRdrLeDetn91RdrDetnSts "Refer to the data element description in ReSideRdrLeDetn1 with the same data element name";
CM_ SG_ 334 ReSideRdrLeDetn92RdrDetnAzi "Refer to the data element description in ReSideRdrLeDetn1 with the same data element name";
CM_ SG_ 334 ReSideRdrLeDetn92RdrDetnChks "Refer to the data element description in ReSideRdrLeDetn1 with the same data element name";
CM_ SG_ 334 ReSideRdrLeDetn92RdrDetnCntr "Refer to the data element description in ReSideRdrLeDetn1 with the same data element name";
CM_ SG_ 334 ReSideRdrLeDetn92RdrDetnConf "Refer to the data element description in ReSideRdrLeDetn1 with the same data element name";
CM_ SG_ 334 ReSideRdrLeDetn92RdrDetnElevn "Refer to the data element description in ReSideRdrLeDetn1 with the same data element name";
CM_ SG_ 334 ReSideRdrLeDetn92RdrDetnPwr "Refer to the data element description in ReSideRdrLeDetn1 with the same data element name";
CM_ SG_ 334 ReSideRdrLeDetn92RdrDetnRng "Refer to the data element description in ReSideRdrLeDetn1 with the same data element name";
CM_ SG_ 334 ReSideRdrLeDetn92RdrDetnRngV "Range Velocity";
CM_ SG_ 334 ReSideRdrLeDetn92RdrDetnSts "Refer to the data element description in ReSideRdrLeDetn1 with the same data element name";
CM_ SG_ 334 ReSideRdrLeDetn93RdrDetnAzi "Refer to the data element description in ReSideRdrLeDetn1 with the same data element name";
CM_ SG_ 334 ReSideRdrLeDetn93RdrDetnChks "Refer to the data element description in ReSideRdrLeDetn1 with the same data element name";
CM_ SG_ 334 ReSideRdrLeDetn93RdrDetnCntr "Refer to the data element description in ReSideRdrLeDetn1 with the same data element name";
CM_ SG_ 334 ReSideRdrLeDetn93RdrDetnConf "Refer to the data element description in ReSideRdrLeDetn1 with the same data element name";
CM_ SG_ 334 ReSideRdrLeDetn93RdrDetnElevn "Refer to the data element description in ReSideRdrLeDetn1 with the same data element name";
CM_ SG_ 334 ReSideRdrLeDetn93RdrDetnPwr "Refer to the data element description in ReSideRdrLeDetn1 with the same data element name";
CM_ SG_ 334 ReSideRdrLeDetn93RdrDetnRng "Refer to the data element description in ReSideRdrLeDetn1 with the same data element name";
CM_ SG_ 334 ReSideRdrLeDetn93RdrDetnRngV "Range Velocity";
CM_ SG_ 334 ReSideRdrLeDetn93RdrDetnSts "Refer to the data element description in ReSideRdrLeDetn1 with the same data element name";
CM_ SG_ 334 ReSideRdrLeDetn94RdrDetnAzi "vRefer to the data element description in ReSideRdrLeDetn1 with the same data element name";
CM_ SG_ 334 ReSideRdrLeDetn94RdrDetnChks "Refer to the data element description in ReSideRdrLeDetn1 with the same data element name";
CM_ SG_ 334 ReSideRdrLeDetn94RdrDetnCntr "Refer to the data element description in ReSideRdrLeDetn1 with the same data element name";
CM_ SG_ 334 ReSideRdrLeDetn94RdrDetnConf "Refer to the data element description in ReSideRdrLeDetn1 with the same data element name";
CM_ SG_ 334 ReSideRdrLeDetn94RdrDetnElevn "Refer to the data element description in ReSideRdrLeDetn1 with the same data element name";
CM_ SG_ 334 ReSideRdrLeDetn94RdrDetnPwr "Refer to the data element description in ReSideRdrLeDetn1 with the same data element name";
CM_ SG_ 334 ReSideRdrLeDetn94RdrDetnRng "Refer to the data element description in ReSideRdrLeDetn1 with the same data element name";
CM_ SG_ 334 ReSideRdrLeDetn94RdrDetnRngV "Range Velocity";
CM_ SG_ 334 ReSideRdrLeDetn94RdrDetnSts "Refer to the data element description in ReSideRdrLeDetn1 with the same data element name";
CM_ SG_ 334 ReSideRdrLeDetn95RdrDetnAzi "Refer to the data element description in ReSideRdrLeDetn1 with the same data element name";
CM_ SG_ 334 ReSideRdrLeDetn95RdrDetnChks "Refer to the data element description in ReSideRdrLeDetn1 with the same data element name";
CM_ SG_ 334 ReSideRdrLeDetn95RdrDetnCntr "Refer to the data element description in ReSideRdrLeDetn1 with the same data element name";
CM_ SG_ 334 ReSideRdrLeDetn95RdrDetnConf "Refer to the data element description in ReSideRdrLeDetn1 with the same data element name";
CM_ SG_ 334 ReSideRdrLeDetn95RdrDetnElevn "Refer to the data element description in ReSideRdrLeDetn1 with the same data element name";
CM_ SG_ 334 ReSideRdrLeDetn95RdrDetnPwr "Refer to the data element description in ReSideRdrLeDetn1 with the same data element name";
CM_ SG_ 334 ReSideRdrLeDetn95RdrDetnRng "Refer to the data element description in ReSideRdrLeDetn1 with the same data element name";
CM_ SG_ 334 ReSideRdrLeDetn95RdrDetnRngV "Range Velocity";
CM_ SG_ 334 ReSideRdrLeDetn95RdrDetnSts "Refer to the data element description in ReSideRdrLeDetn1 with the same data element name";
CM_ SG_ 334 ReSideRdrLeDetn96RdrDetnAzi "Refer to the data element description in ReSideRdrLeDetn1 with the same data element name";
CM_ SG_ 334 ReSideRdrLeDetn96RdrDetnChks "Refer to the data element description in ReSideRdrLeDetn1 with the same data element name";
CM_ SG_ 334 ReSideRdrLeDetn96RdrDetnCntr "Refer to the data element description in ReSideRdrLeDetn1 with the same data element name";
CM_ SG_ 334 ReSideRdrLeDetn96RdrDetnConf "Refer to the data element description in ReSideRdrLeDetn1 with the same data element name";
CM_ SG_ 334 ReSideRdrLeDetn96RdrDetnElevn "Refer to the data element description in ReSideRdrLeDetn1 with the same data element name";
CM_ SG_ 334 ReSideRdrLeDetn96RdrDetnPwr "Refer to the data element description in ReSideRdrLeDetn1 with the same data element name";
CM_ SG_ 334 ReSideRdrLeDetn96RdrDetnRng "Refer to the data element description in ReSideRdrLeDetn1 with the same data element name";
CM_ SG_ 334 ReSideRdrLeDetn96RdrDetnRngV "Range Velocity";
CM_ SG_ 334 ReSideRdrLeDetn96RdrDetnSts "Refer to the data element description in ReSideRdrLeDetn1 with the same data element name";
CM_ SG_ 336 ReSideRdrLeDetn100RdrDetnAzi "Refer to the data element description in ReSideRdrLeDetn1 with the same data element name";
CM_ SG_ 336 ReSideRdrLeDetn100RdrDetnChks "Refer to the data element description in ReSideRdrLeDetn1 with the same data element name";
CM_ SG_ 336 ReSideRdrLeDetn100RdrDetnCntr "Refer to the data element description in ReSideRdrLeDetn1 with the same data element name";
CM_ SG_ 336 ReSideRdrLeDetn100RdrDetnConf "Refer to the data element description in ReSideRdrLeDetn1 with the same data element name";
CM_ SG_ 336 ReSideRdrLeDetn100RdrDetnElevn "Refer to the data element description in ReSideRdrLeDetn1 with the same data element name";
CM_ SG_ 336 ReSideRdrLeDetn100RdrDetnPwr "Refer to the data element description in ReSideRdrLeDetn1 with the same data element name";
CM_ SG_ 336 ReSideRdrLeDetn100RdrDetnRng "Refer to the data element description in ReSideRdrLeDetn1 with the same data element name";
CM_ SG_ 336 ReSideRdrLeDetn100RdrDetnRngV "Range Velocity";
CM_ SG_ 336 ReSideRdrLeDetn100RdrDetnSts "Refer to the data element description in ReSideRdrLeDetn1 with the same data element name";
CM_ SG_ 336 ReSideRdrLeDetn101RdrDetnAzi "Refer to the data element description in ReSideRdrLeDetn1 with the same data element name";
CM_ SG_ 336 ReSideRdrLeDetn101RdrDetnChks "Refer to the data element description in ReSideRdrLeDetn1 with the same data element name";
CM_ SG_ 336 ReSideRdrLeDetn101RdrDetnCntr "Refer to the data element description in ReSideRdrLeDetn1 with the same data element name";
CM_ SG_ 336 ReSideRdrLeDetn101RdrDetnConf "Refer to the data element description in ReSideRdrLeDetn1 with the same data element name";
CM_ SG_ 336 ReSideRdrLeDetn101RdrDetnElevn "Refer to the data element description in ReSideRdrLeDetn1 with the same data element name";
CM_ SG_ 336 ReSideRdrLeDetn101RdrDetnPwr "Refer to the data element description in ReSideRdrLeDetn1 with the same data element name";
CM_ SG_ 336 ReSideRdrLeDetn101RdrDetnRng "Refer to the data element description in ReSideRdrLeDetn1 with the same data element name";
CM_ SG_ 336 ReSideRdrLeDetn101RdrDetnRngV "Range Velocity";
CM_ SG_ 336 ReSideRdrLeDetn101RdrDetnSts "Refer to the data element description in ReSideRdrLeDetn1 with the same data element name";
CM_ SG_ 336 ReSideRdrLeDetn102RdrDetnAzi "Refer to the data element description in ReSideRdrLeDetn1 with the same data element name";
CM_ SG_ 336 ReSideRdrLeDetn102RdrDetnChks "Refer to the data element description in ReSideRdrLeDetn1 with the same data element name";
CM_ SG_ 336 ReSideRdrLeDetn102RdrDetnCntr "Refer to the data element description in ReSideRdrLeDetn1 with the same data element name";
CM_ SG_ 336 ReSideRdrLeDetn102RdrDetnConf "Refer to the data element description in ReSideRdrLeDetn1 with the same data element name";
CM_ SG_ 336 ReSideRdrLeDetn102RdrDetnElevn "Refer to the data element description in ReSideRdrLeDetn1 with the same data element name";
CM_ SG_ 336 ReSideRdrLeDetn102RdrDetnPwr "Refer to the data element description in ReSideRdrLeDetn1 with the same data element name";
CM_ SG_ 336 ReSideRdrLeDetn102RdrDetnRng "Refer to the data element description in ReSideRdrLeDetn1 with the same data element name";
CM_ SG_ 336 ReSideRdrLeDetn102RdrDetnRngV "Range Velocity";
CM_ SG_ 336 ReSideRdrLeDetn102RdrDetnSts "Refer to the data element description in ReSideRdrLeDetn1 with the same data element name";
CM_ SG_ 336 ReSideRdrLeDetn97RdrDetnAzi "Refer to the data element description in ReSideRdrLeDetn1 with the same data element name";
CM_ SG_ 336 ReSideRdrLeDetn97RdrDetnChks "Refer to the data element description in ReSideRdrLeDetn1 with the same data element name";
CM_ SG_ 336 ReSideRdrLeDetn97RdrDetnCntr "Refer to the data element description in ReSideRdrLeDetn1 with the same data element name";
CM_ SG_ 336 ReSideRdrLeDetn97RdrDetnConf "Refer to the data element description in ReSideRdrLeDetn1 with the same data element name";
CM_ SG_ 336 ReSideRdrLeDetn97RdrDetnElevn "Refer to the data element description in ReSideRdrLeDetn1 with the same data element name";
CM_ SG_ 336 ReSideRdrLeDetn97RdrDetnPwr "Refer to the data element description in ReSideRdrLeDetn1 with the same data element name";
CM_ SG_ 336 ReSideRdrLeDetn97RdrDetnRng "Refer to the data element description in ReSideRdrLeDetn1 with the same data element name";
CM_ SG_ 336 ReSideRdrLeDetn97RdrDetnRngV "Range Velocity";
CM_ SG_ 336 ReSideRdrLeDetn97RdrDetnSts "Refer to the data element description in ReSideRdrLeDetn1 with the same data element name";
CM_ SG_ 336 ReSideRdrLeDetn98RdrDetnAzi "Refer to the data element description in ReSideRdrLeDetn1 with the same data element name";
CM_ SG_ 336 ReSideRdrLeDetn98RdrDetnChks "Refer to the data element description in ReSideRdrLeDetn1 with the same data element name";
CM_ SG_ 336 ReSideRdrLeDetn98RdrDetnCntr "Refer to the data element description in ReSideRdrLeDetn1 with the same data element name";
CM_ SG_ 336 ReSideRdrLeDetn98RdrDetnConf "Refer to the data element description in ReSideRdrLeDetn1 with the same data element name";
CM_ SG_ 336 ReSideRdrLeDetn98RdrDetnElevn "Refer to the data element description in ReSideRdrLeDetn1 with the same data element name";
CM_ SG_ 336 ReSideRdrLeDetn98RdrDetnPwr "Refer to the data element description in ReSideRdrLeDetn1 with the same data element name";
CM_ SG_ 336 ReSideRdrLeDetn98RdrDetnRng "Refer to the data element description in ReSideRdrLeDetn1 with the same data element name";
CM_ SG_ 336 ReSideRdrLeDetn98RdrDetnRngV "Range Velocity";
CM_ SG_ 336 ReSideRdrLeDetn98RdrDetnSts "Refer to the data element description in ReSideRdrLeDetn1 with the same data element name";
CM_ SG_ 336 ReSideRdrLeDetn99RdrDetnAzi "Refer to the data element description in ReSideRdrLeDetn1 with the same data element name";
CM_ SG_ 336 ReSideRdrLeDetn99RdrDetnChks "Refer to the data element description in ReSideRdrLeDetn1 with the same data element name";
CM_ SG_ 336 ReSideRdrLeDetn99RdrDetnCntr "Refer to the data element description in ReSideRdrLeDetn1 with the same data element name";
CM_ SG_ 336 ReSideRdrLeDetn99RdrDetnConf "Refer to the data element description in ReSideRdrLeDetn1 with the same data element name";
CM_ SG_ 336 ReSideRdrLeDetn99RdrDetnElevn "Refer to the data element description in ReSideRdrLeDetn1 with the same data element name";
CM_ SG_ 336 ReSideRdrLeDetn99RdrDetnPwr "Refer to the data element description in ReSideRdrLeDetn1 with the same data element name";
CM_ SG_ 336 ReSideRdrLeDetn99RdrDetnRng "Refer to the data element description in ReSideRdrLeDetn1 with the same data element name";
CM_ SG_ 336 ReSideRdrLeDetn99RdrDetnRngV "Range Velocity";
CM_ SG_ 336 ReSideRdrLeDetn99RdrDetnSts "Refer to the data element description in ReSideRdrLeDetn1 with the same data element name";
CM_ SG_ 338 ReSideRdrLeDetn103RdrDetnAzi "Refer to the data element description in ReSideRdrLeDetn1 with the same data element name";
CM_ SG_ 338 ReSideRdrLeDetn103RdrDetnChks "Refer to the data element description in ReSideRdrLeDetn1 with the same data element name";
CM_ SG_ 338 ReSideRdrLeDetn103RdrDetnCntr "Refer to the data element description in ReSideRdrLeDetn1 with the same data element name";
CM_ SG_ 338 ReSideRdrLeDetn103RdrDetnConf "Refer to the data element description in ReSideRdrLeDetn1 with the same data element name";
CM_ SG_ 338 ReSideRdrLeDetn103RdrDetnElevn "Refer to the data element description in ReSideRdrLeDetn1 with the same data element name";
CM_ SG_ 338 ReSideRdrLeDetn103RdrDetnPwr "Refer to the data element description in ReSideRdrLeDetn1 with the same data element name";
CM_ SG_ 338 ReSideRdrLeDetn103RdrDetnRng "Refer to the data element description in ReSideRdrLeDetn1 with the same data element name";
CM_ SG_ 338 ReSideRdrLeDetn103RdrDetnRngV "Range Velocity";
CM_ SG_ 338 ReSideRdrLeDetn103RdrDetnSts "Refer to the data element description in ReSideRdrLeDetn1 with the same data element name";
CM_ SG_ 338 ReSideRdrLeDetn104RdrDetnAzi "Refer to the data element description in ReSideRdrLeDetn1 with the same data element name";
CM_ SG_ 338 ReSideRdrLeDetn104RdrDetnChks "Refer to the data element description in ReSideRdrLeDetn1 with the same data element name";
CM_ SG_ 338 ReSideRdrLeDetn104RdrDetnCntr "Refer to the data element description in ReSideRdrLeDetn1 with the same data element name";
CM_ SG_ 338 ReSideRdrLeDetn104RdrDetnConf "Refer to the data element description in ReSideRdrLeDetn1 with the same data element name";
CM_ SG_ 338 ReSideRdrLeDetn104RdrDetnElevn "Refer to the data element description in ReSideRdrLeDetn1 with the same data element name";
CM_ SG_ 338 ReSideRdrLeDetn104RdrDetnPwr "Refer to the data element description in ReSideRdrLeDetn1 with the same data element name";
CM_ SG_ 338 ReSideRdrLeDetn104RdrDetnRng "Refer to the data element description in ReSideRdrLeDetn1 with the same data element name";
CM_ SG_ 338 ReSideRdrLeDetn104RdrDetnRngV "Range Velocity";
CM_ SG_ 338 ReSideRdrLeDetn104RdrDetnSts "Refer to the data element description in ReSideRdrLeDetn1 with the same data element name";
CM_ SG_ 338 ReSideRdrLeDetn105RdrDetnAzi "Refer to the data element description in ReSideRdrLeDetn1 with the same data element name";
CM_ SG_ 338 ReSideRdrLeDetn105RdrDetnChks "Refer to the data element description in ReSideRdrLeDetn1 with the same data element name";
CM_ SG_ 338 ReSideRdrLeDetn105RdrDetnCntr "Refer to the data element description in ReSideRdrLeDetn1 with the same data element name";
CM_ SG_ 338 ReSideRdrLeDetn105RdrDetnConf "Refer to the data element description in ReSideRdrLeDetn1 with the same data element name";
CM_ SG_ 338 ReSideRdrLeDetn105RdrDetnElevn "Refer to the data element description in ReSideRdrLeDetn1 with the same data element name";
CM_ SG_ 338 ReSideRdrLeDetn105RdrDetnPwr "Refer to the data element description in ReSideRdrLeDetn1 with the same data element name";
CM_ SG_ 338 ReSideRdrLeDetn105RdrDetnRng "Refer to the data element description in ReSideRdrLeDetn1 with the same data element name";
CM_ SG_ 338 ReSideRdrLeDetn105RdrDetnRngV "Range Velocity";
CM_ SG_ 338 ReSideRdrLeDetn105RdrDetnSts "Refer to the data element description in ReSideRdrLeDetn1 with the same data element name";
CM_ SG_ 338 ReSideRdrLeDetn106RdrDetnAzi "Refer to the data element description in ReSideRdrLeDetn1 with the same data element name";
CM_ SG_ 338 ReSideRdrLeDetn106RdrDetnChks "Refer to the data element description in ReSideRdrLeDetn1 with the same data element name";
CM_ SG_ 338 ReSideRdrLeDetn106RdrDetnCntr "Refer to the data element description in ReSideRdrLeDetn1 with the same data element name";
CM_ SG_ 338 ReSideRdrLeDetn106RdrDetnConf "Refer to the data element description in ReSideRdrLeDetn1 with the same data element name";
CM_ SG_ 338 ReSideRdrLeDetn106RdrDetnElevn "Refer to the data element description in ReSideRdrLeDetn1 with the same data element name";
CM_ SG_ 338 ReSideRdrLeDetn106RdrDetnPwr "Refer to the data element description in ReSideRdrLeDetn1 with the same data element name";
CM_ SG_ 338 ReSideRdrLeDetn106RdrDetnRng "Refer to the data element description in ReSideRdrLeDetn1 with the same data element name";
CM_ SG_ 338 ReSideRdrLeDetn106RdrDetnRngV "Range Velocity";
CM_ SG_ 338 ReSideRdrLeDetn106RdrDetnSts "Refer to the data element description in ReSideRdrLeDetn1 with the same data element name";
CM_ SG_ 338 ReSideRdrLeDetn107RdrDetnAzi "Refer to the data element description in ReSideRdrLeDetn1 with the same data element name";
CM_ SG_ 338 ReSideRdrLeDetn107RdrDetnChks "Refer to the data element description in ReSideRdrLeDetn1 with the same data element name";
CM_ SG_ 338 ReSideRdrLeDetn107RdrDetnCntr "Refer to the data element description in ReSideRdrLeDetn1 with the same data element name";
CM_ SG_ 338 ReSideRdrLeDetn107RdrDetnConf "Refer to the data element description in ReSideRdrLeDetn1 with the same data element name";
CM_ SG_ 338 ReSideRdrLeDetn107RdrDetnElevn "Refer to the data element description in ReSideRdrLeDetn1 with the same data element name";
CM_ SG_ 338 ReSideRdrLeDetn107RdrDetnPwr "Refer to the data element description in ReSideRdrLeDetn1 with the same data element name";
CM_ SG_ 338 ReSideRdrLeDetn107RdrDetnRng "Refer to the data element description in ReSideRdrLeDetn1 with the same data element name";
CM_ SG_ 338 ReSideRdrLeDetn107RdrDetnRngV "Range Velocity";
CM_ SG_ 338 ReSideRdrLeDetn107RdrDetnSts "Refer to the data element description in ReSideRdrLeDetn1 with the same data element name";
CM_ SG_ 338 ReSideRdrLeDetn108RdrDetnAzi "Refer to the data element description in ReSideRdrLeDetn1 with the same data element name";
CM_ SG_ 338 ReSideRdrLeDetn108RdrDetnChks "Refer to the data element description in ReSideRdrLeDetn1 with the same data element name";
CM_ SG_ 338 ReSideRdrLeDetn108RdrDetnCntr "Refer to the data element description in ReSideRdrLeDetn1 with the same data element name";
CM_ SG_ 338 ReSideRdrLeDetn108RdrDetnConf "Refer to the data element description in ReSideRdrLeDetn1 with the same data element name";
CM_ SG_ 338 ReSideRdrLeDetn108RdrDetnElevn "Refer to the data element description in ReSideRdrLeDetn1 with the same data element name";
CM_ SG_ 338 ReSideRdrLeDetn108RdrDetnPwr "Refer to the data element description in ReSideRdrLeDetn1 with the same data element name";
CM_ SG_ 338 ReSideRdrLeDetn108RdrDetnRng "Refer to the data element description in ReSideRdrLeDetn1 with the same data element name";
CM_ SG_ 338 ReSideRdrLeDetn108RdrDetnRngV "Range Velocity";
CM_ SG_ 338 ReSideRdrLeDetn108RdrDetnSts "Refer to the data element description in ReSideRdrLeDetn1 with the same data element name";
CM_ SG_ 340 ReSideRdrLeDetn109RdrDetnAzi "Refer to the data element description in ReSideRdrLeDetn1 with the same data element name";
CM_ SG_ 340 ReSideRdrLeDetn109RdrDetnChks "Refer to the data element description in ReSideRdrLeDetn1 with the same data element name";
CM_ SG_ 340 ReSideRdrLeDetn109RdrDetnCntr "Refer to the data element description in ReSideRdrLeDetn1 with the same data element name";
CM_ SG_ 340 ReSideRdrLeDetn109RdrDetnConf "Refer to the data element description in ReSideRdrLeDetn1 with the same data element name";
CM_ SG_ 340 ReSideRdrLeDetn109RdrDetnElevn "Refer to the data element description in ReSideRdrLeDetn1 with the same data element name";
CM_ SG_ 340 ReSideRdrLeDetn109RdrDetnPwr "Refer to the data element description in ReSideRdrLeDetn1 with the same data element name";
CM_ SG_ 340 ReSideRdrLeDetn109RdrDetnRng "Refer to the data element description in ReSideRdrLeDetn1 with the same data element name";
CM_ SG_ 340 ReSideRdrLeDetn109RdrDetnRngV "Range Velocity";
CM_ SG_ 340 ReSideRdrLeDetn109RdrDetnSts "Refer to the data element description in ReSideRdrLeDetn1 with the same data element name";
CM_ SG_ 340 ReSideRdrLeDetn110RdrDetnAzi "Refer to the data element description in ReSideRdrLeDetn1 with the same data element name";
CM_ SG_ 340 ReSideRdrLeDetn110RdrDetnChks "Refer to the data element description in ReSideRdrLeDetn1 with the same data element name";
CM_ SG_ 340 ReSideRdrLeDetn110RdrDetnCntr "Refer to the data element description in ReSideRdrLeDetn1 with the same data element name";
CM_ SG_ 340 ReSideRdrLeDetn110RdrDetnConf "Refer to the data element description in ReSideRdrLeDetn1 with the same data element name";
CM_ SG_ 340 ReSideRdrLeDetn110RdrDetnElevn "Refer to the data element description in ReSideRdrLeDetn1 with the same data element name";
CM_ SG_ 340 ReSideRdrLeDetn110RdrDetnPwr "Refer to the data element description in ReSideRdrLeDetn1 with the same data element name";
CM_ SG_ 340 ReSideRdrLeDetn110RdrDetnRng "Refer to the data element description in ReSideRdrLeDetn1 with the same data element name";
CM_ SG_ 340 ReSideRdrLeDetn110RdrDetnRngV "Range Velocity";
CM_ SG_ 340 ReSideRdrLeDetn110RdrDetnSts "Refer to the data element description in ReSideRdrLeDetn1 with the same data element name";
CM_ SG_ 340 ReSideRdrLeDetn111RdrDetnAzi "Refer to the data element description in ReSideRdrLeDetn1 with the same data element name";
CM_ SG_ 340 ReSideRdrLeDetn111RdrDetnChks "Refer to the data element description in ReSideRdrLeDetn1 with the same data element name";
CM_ SG_ 340 ReSideRdrLeDetn111RdrDetnCntr "Refer to the data element description in ReSideRdrLeDetn1 with the same data element name";
CM_ SG_ 340 ReSideRdrLeDetn111RdrDetnConf "Refer to the data element description in ReSideRdrLeDetn1 with the same data element name";
CM_ SG_ 340 ReSideRdrLeDetn111RdrDetnElevn "Refer to the data element description in ReSideRdrLeDetn1 with the same data element name";
CM_ SG_ 340 ReSideRdrLeDetn111RdrDetnPwr "Refer to the data element description in ReSideRdrLeDetn1 with the same data element name";
CM_ SG_ 340 ReSideRdrLeDetn111RdrDetnRng "Refer to the data element description in ReSideRdrLeDetn1 with the same data element name";
CM_ SG_ 340 ReSideRdrLeDetn111RdrDetnRngV "Range Velocity";
CM_ SG_ 340 ReSideRdrLeDetn111RdrDetnSts "Refer to the data element description in ReSideRdrLeDetn1 with the same data element name";
CM_ SG_ 340 ReSideRdrLeDetn112RdrDetnAzi "Refer to the data element description in ReSideRdrLeDetn1 with the same data element name";
CM_ SG_ 340 ReSideRdrLeDetn112RdrDetnChks "Refer to the data element description in ReSideRdrLeDetn1 with the same data element name";
CM_ SG_ 340 ReSideRdrLeDetn112RdrDetnCntr "Refer to the data element description in ReSideRdrLeDetn1 with the same data element name";
CM_ SG_ 340 ReSideRdrLeDetn112RdrDetnConf "Refer to the data element description in ReSideRdrLeDetn1 with the same data element name";
CM_ SG_ 340 ReSideRdrLeDetn112RdrDetnElevn "Refer to the data element description in ReSideRdrLeDetn1 with the same data element name";
CM_ SG_ 340 ReSideRdrLeDetn112RdrDetnPwr "Refer to the data element description in ReSideRdrLeDetn1 with the same data element name";
CM_ SG_ 340 ReSideRdrLeDetn112RdrDetnRng "Refer to the data element description in ReSideRdrLeDetn1 with the same data element name";
CM_ SG_ 340 ReSideRdrLeDetn112RdrDetnRngV "Range Velocity";
CM_ SG_ 340 ReSideRdrLeDetn112RdrDetnSts "Refer to the data element description in ReSideRdrLeDetn1 with the same data element name";
CM_ SG_ 340 ReSideRdrLeDetn113RdrDetnAzi "Refer to the data element description in ReSideRdrLeDetn1 with the same data element name";
CM_ SG_ 340 ReSideRdrLeDetn113RdrDetnChks "Refer to the data element description in ReSideRdrLeDetn1 with the same data element name";
CM_ SG_ 340 ReSideRdrLeDetn113RdrDetnCntr "Refer to the data element description in ReSideRdrLeDetn1 with the same data element name";
CM_ SG_ 340 ReSideRdrLeDetn113RdrDetnConf "Refer to the data element description in ReSideRdrLeDetn1 with the same data element name";
CM_ SG_ 340 ReSideRdrLeDetn113RdrDetnElevn "Refer to the data element description in ReSideRdrLeDetn1 with the same data element name";
CM_ SG_ 340 ReSideRdrLeDetn113RdrDetnPwr "Refer to the data element description in ReSideRdrLeDetn1 with the same data element name";
CM_ SG_ 340 ReSideRdrLeDetn113RdrDetnRng "Refer to the data element description in ReSideRdrLeDetn1 with the same data element name";
CM_ SG_ 340 ReSideRdrLeDetn113RdrDetnRngV "Range Velocity";
CM_ SG_ 340 ReSideRdrLeDetn113RdrDetnSts "Refer to the data element description in ReSideRdrLeDetn1 with the same data element name";
CM_ SG_ 340 ReSideRdrLeDetn114RdrDetnAzi "Refer to the data element description in ReSideRdrLeDetn1 with the same data element name";
CM_ SG_ 340 ReSideRdrLeDetn114RdrDetnChks "Refer to the data element description in ReSideRdrLeDetn1 with the same data element name";
CM_ SG_ 340 ReSideRdrLeDetn114RdrDetnCntr "Refer to the data element description in ReSideRdrLeDetn1 with the same data element name";
CM_ SG_ 340 ReSideRdrLeDetn114RdrDetnConf "Refer to the data element description in ReSideRdrLeDetn1 with the same data element name";
CM_ SG_ 340 ReSideRdrLeDetn114RdrDetnElevn "Refer to the data element description in ReSideRdrLeDetn1 with the same data element name";
CM_ SG_ 340 ReSideRdrLeDetn114RdrDetnPwr "Refer to the data element description in ReSideRdrLeDetn1 with the same data element name";
CM_ SG_ 340 ReSideRdrLeDetn114RdrDetnRng "Refer to the data element description in ReSideRdrLeDetn1 with the same data element name";
CM_ SG_ 340 ReSideRdrLeDetn114RdrDetnRngV "Range Velocity";
CM_ SG_ 340 ReSideRdrLeDetn114RdrDetnSts "Refer to the data element description in ReSideRdrLeDetn1 with the same data element name";
CM_ SG_ 342 ReSideRdrLeDetn115RdrDetnAzi "Refer to the data element description in ReSideRdrLeDetn1 with the same data element name";
CM_ SG_ 342 ReSideRdrLeDetn115RdrDetnChks "Refer to the data element description in ReSideRdrLeDetn1 with the same data element name";
CM_ SG_ 342 ReSideRdrLeDetn115RdrDetnCntr "Refer to the data element description in ReSideRdrLeDetn1 with the same data element name";
CM_ SG_ 342 ReSideRdrLeDetn115RdrDetnConf "Refer to the data element description in ReSideRdrLeDetn1 with the same data element name";
CM_ SG_ 342 ReSideRdrLeDetn115RdrDetnElevn "Refer to the data element description in ReSideRdrLeDetn1 with the same data element name";
CM_ SG_ 342 ReSideRdrLeDetn115RdrDetnPwr "Refer to the data element description in ReSideRdrLeDetn1 with the same data element name";
CM_ SG_ 342 ReSideRdrLeDetn115RdrDetnRng "Refer to the data element description in ReSideRdrLeDetn1 with the same data element name";
CM_ SG_ 342 ReSideRdrLeDetn115RdrDetnRngV "Range Velocity";
CM_ SG_ 342 ReSideRdrLeDetn115RdrDetnSts "Refer to the data element description in ReSideRdrLeDetn1 with the same data element name";
CM_ SG_ 342 ReSideRdrLeDetn116RdrDetnAzi "Refer to the data element description in ReSideRdrLeDetn1 with the same data element name";
CM_ SG_ 342 ReSideRdrLeDetn116RdrDetnChks "Refer to the data element description in ReSideRdrLeDetn1 with the same data element name";
CM_ SG_ 342 ReSideRdrLeDetn116RdrDetnCntr "Refer to the data element description in ReSideRdrLeDetn1 with the same data element name";
CM_ SG_ 342 ReSideRdrLeDetn116RdrDetnConf "Refer to the data element description in ReSideRdrLeDetn1 with the same data element name";
CM_ SG_ 342 ReSideRdrLeDetn116RdrDetnElevn "Refer to the data element description in ReSideRdrLeDetn1 with the same data element name";
CM_ SG_ 342 ReSideRdrLeDetn116RdrDetnPwr "Refer to the data element description in ReSideRdrLeDetn1 with the same data element name";
CM_ SG_ 342 ReSideRdrLeDetn116RdrDetnRng "Refer to the data element description in ReSideRdrLeDetn1 with the same data element name";
CM_ SG_ 342 ReSideRdrLeDetn116RdrDetnRngV "Range Velocity";
CM_ SG_ 342 ReSideRdrLeDetn116RdrDetnSts "Refer to the data element description in ReSideRdrLeDetn1 with the same data element name";
CM_ SG_ 342 ReSideRdrLeDetn117RdrDetnAzi "Refer to the data element description in ReSideRdrLeDetn1 with the same data element name";
CM_ SG_ 342 ReSideRdrLeDetn117RdrDetnChks "Refer to the data element description in ReSideRdrLeDetn1 with the same data element name";
CM_ SG_ 342 ReSideRdrLeDetn117RdrDetnCntr "Refer to the data element description in ReSideRdrLeDetn1 with the same data element name";
CM_ SG_ 342 ReSideRdrLeDetn117RdrDetnConf "Refer to the data element description in ReSideRdrLeDetn1 with the same data element name";
CM_ SG_ 342 ReSideRdrLeDetn117RdrDetnElevn "Refer to the data element description in ReSideRdrLeDetn1 with the same data element name";
CM_ SG_ 342 ReSideRdrLeDetn117RdrDetnPwr "Refer to the data element description in ReSideRdrLeDetn1 with the same data element name";
CM_ SG_ 342 ReSideRdrLeDetn117RdrDetnRng "Refer to the data element description in ReSideRdrLeDetn1 with the same data element name";
CM_ SG_ 342 ReSideRdrLeDetn117RdrDetnRngV "Range Velocity";
CM_ SG_ 342 ReSideRdrLeDetn117RdrDetnSts "Refer to the data element description in ReSideRdrLeDetn1 with the same data element name";
CM_ SG_ 342 ReSideRdrLeDetn118RdrDetnAzi "Refer to the data element description in ReSideRdrLeDetn1 with the same data element name";
CM_ SG_ 342 ReSideRdrLeDetn118RdrDetnChks "Refer to the data element description in ReSideRdrLeDetn1 with the same data element name";
CM_ SG_ 342 ReSideRdrLeDetn118RdrDetnCntr "Refer to the data element description in ReSideRdrLeDetn1 with the same data element name";
CM_ SG_ 342 ReSideRdrLeDetn118RdrDetnConf "Refer to the data element description in ReSideRdrLeDetn1 with the same data element name";
CM_ SG_ 342 ReSideRdrLeDetn118RdrDetnElevn "Refer to the data element description in ReSideRdrLeDetn1 with the same data element name";
CM_ SG_ 342 ReSideRdrLeDetn118RdrDetnPwr "Refer to the data element description in ReSideRdrLeDetn1 with the same data element name";
CM_ SG_ 342 ReSideRdrLeDetn118RdrDetnRng "Refer to the data element description in ReSideRdrLeDetn1 with the same data element name";
CM_ SG_ 342 ReSideRdrLeDetn118RdrDetnRngV "Range Velocity";
CM_ SG_ 342 ReSideRdrLeDetn118RdrDetnSts "Refer to the data element description in ReSideRdrLeDetn1 with the same data element name";
CM_ SG_ 342 ReSideRdrLeDetn119RdrDetnAzi "Refer to the data element description in ReSideRdrLeDetn1 with the same data element name";
CM_ SG_ 342 ReSideRdrLeDetn119RdrDetnChks "Refer to the data element description in ReSideRdrLeDetn1 with the same data element name";
CM_ SG_ 342 ReSideRdrLeDetn119RdrDetnCntr "Refer to the data element description in ReSideRdrLeDetn1 with the same data element name";
CM_ SG_ 342 ReSideRdrLeDetn119RdrDetnConf "Refer to the data element description in ReSideRdrLeDetn1 with the same data element name";
CM_ SG_ 342 ReSideRdrLeDetn119RdrDetnElevn "Refer to the data element description in ReSideRdrLeDetn1 with the same data element name";
CM_ SG_ 342 ReSideRdrLeDetn119RdrDetnPwr "Refer to the data element description in ReSideRdrLeDetn1 with the same data element name";
CM_ SG_ 342 ReSideRdrLeDetn119RdrDetnRng "Refer to the data element description in ReSideRdrLeDetn1 with the same data element name";
CM_ SG_ 342 ReSideRdrLeDetn119RdrDetnRngV "Range Velocity";
CM_ SG_ 342 ReSideRdrLeDetn119RdrDetnSts "Refer to the data element description in ReSideRdrLeDetn1 with the same data element name";
CM_ SG_ 342 ReSideRdrLeDetn120RdrDetnAzi "Refer to the data element description in ReSideRdrLeDetn1 with the same data element name";
CM_ SG_ 342 ReSideRdrLeDetn120RdrDetnChks "Refer to the data element description in ReSideRdrLeDetn1 with the same data element name";
CM_ SG_ 342 ReSideRdrLeDetn120RdrDetnCntr "Refer to the data element description in ReSideRdrLeDetn1 with the same data element name";
CM_ SG_ 342 ReSideRdrLeDetn120RdrDetnConf "Refer to the data element description in ReSideRdrLeDetn1 with the same data element name";
CM_ SG_ 342 ReSideRdrLeDetn120RdrDetnElevn "Refer to the data element description in ReSideRdrLeDetn1 with the same data element name";
CM_ SG_ 342 ReSideRdrLeDetn120RdrDetnPwr "Refer to the data element description in ReSideRdrLeDetn1 with the same data element name";
CM_ SG_ 342 ReSideRdrLeDetn120RdrDetnRng "Refer to the data element description in ReSideRdrLeDetn1 with the same data element name";
CM_ SG_ 342 ReSideRdrLeDetn120RdrDetnRngV "Range Velocity";
CM_ SG_ 342 ReSideRdrLeDetn120RdrDetnSts "Refer to the data element description in ReSideRdrLeDetn1 with the same data element name";
CM_ SG_ 344 ReSideRdrLeDetn121RdrDetnAzi "Refer to the data element description in ReSideRdrLeDetn1 with the same data element name";
CM_ SG_ 344 ReSideRdrLeDetn121RdrDetnChks "Refer to the data element description in ReSideRdrLeDetn1 with the same data element name";
CM_ SG_ 344 ReSideRdrLeDetn121RdrDetnCntr "Refer to the data element description in ReSideRdrLeDetn1 with the same data element name";
CM_ SG_ 344 ReSideRdrLeDetn121RdrDetnConf "Refer to the data element description in ReSideRdrLeDetn1 with the same data element name";
CM_ SG_ 344 ReSideRdrLeDetn121RdrDetnElevn "Refer to the data element description in ReSideRdrLeDetn1 with the same data element name";
CM_ SG_ 344 ReSideRdrLeDetn121RdrDetnPwr "Refer to the data element description in ReSideRdrLeDetn1 with the same data element name";
CM_ SG_ 344 ReSideRdrLeDetn121RdrDetnRng "Refer to the data element description in ReSideRdrLeDetn1 with the same data element name";
CM_ SG_ 344 ReSideRdrLeDetn121RdrDetnRngV "Range Velocity";
CM_ SG_ 344 ReSideRdrLeDetn121RdrDetnSts "Refer to the data element description in ReSideRdrLeDetn1 with the same data element name";
CM_ SG_ 344 ReSideRdrLeDetn122RdrDetnAzi "Refer to the data element description in ReSideRdrLeDetn1 with the same data element name";
CM_ SG_ 344 ReSideRdrLeDetn122RdrDetnChks "Refer to the data element description in ReSideRdrLeDetn1 with the same data element name";
CM_ SG_ 344 ReSideRdrLeDetn122RdrDetnCntr "Refer to the data element description in ReSideRdrLeDetn1 with the same data element name";
CM_ SG_ 344 ReSideRdrLeDetn122RdrDetnConf "Refer to the data element description in ReSideRdrLeDetn1 with the same data element name";
CM_ SG_ 344 ReSideRdrLeDetn122RdrDetnElevn "Refer to the data element description in ReSideRdrLeDetn1 with the same data element name";
CM_ SG_ 344 ReSideRdrLeDetn122RdrDetnPwr "Refer to the data element description in ReSideRdrLeDetn1 with the same data element name";
CM_ SG_ 344 ReSideRdrLeDetn122RdrDetnRng "Refer to the data element description in ReSideRdrLeDetn1 with the same data element name";
CM_ SG_ 344 ReSideRdrLeDetn122RdrDetnRngV "Range Velocity";
CM_ SG_ 344 ReSideRdrLeDetn122RdrDetnSts "Refer to the data element description in ReSideRdrLeDetn1 with the same data element name";
CM_ SG_ 344 ReSideRdrLeDetn123RdrDetnAzi "Refer to the data element description in ReSideRdrLeDetn1 with the same data element name";
CM_ SG_ 344 ReSideRdrLeDetn123RdrDetnChks "Refer to the data element description in ReSideRdrLeDetn1 with the same data element name";
CM_ SG_ 344 ReSideRdrLeDetn123RdrDetnCntr "Refer to the data element description in ReSideRdrLeDetn1 with the same data element name";
CM_ SG_ 344 ReSideRdrLeDetn123RdrDetnConf "Refer to the data element description in ReSideRdrLeDetn1 with the same data element name";
CM_ SG_ 344 ReSideRdrLeDetn123RdrDetnElevn "Refer to the data element description in ReSideRdrLeDetn1 with the same data element name";
CM_ SG_ 344 ReSideRdrLeDetn123RdrDetnPwr "Refer to the data element description in ReSideRdrLeDetn1 with the same data element name";
CM_ SG_ 344 ReSideRdrLeDetn123RdrDetnRng "Refer to the data element description in ReSideRdrLeDetn1 with the same data element name";
CM_ SG_ 344 ReSideRdrLeDetn123RdrDetnRngV "Range Velocity";
CM_ SG_ 344 ReSideRdrLeDetn123RdrDetnSts "Refer to the data element description in ReSideRdrLeDetn1 with the same data element name";
CM_ SG_ 344 ReSideRdrLeDetn124RdrDetnAzi "Refer to the data element description in ReSideRdrLeDetn1 with the same data element name";
CM_ SG_ 344 ReSideRdrLeDetn124RdrDetnChks "Refer to the data element description in ReSideRdrLeDetn1 with the same data element name";
CM_ SG_ 344 ReSideRdrLeDetn124RdrDetnCntr "Refer to the data element description in ReSideRdrLeDetn1 with the same data element name";
CM_ SG_ 344 ReSideRdrLeDetn124RdrDetnConf "Refer to the data element description in ReSideRdrLeDetn1 with the same data element name";
CM_ SG_ 344 ReSideRdrLeDetn124RdrDetnElevn "Refer to the data element description in ReSideRdrLeDetn1 with the same data element name";
CM_ SG_ 344 ReSideRdrLeDetn124RdrDetnPwr "Refer to the data element description in ReSideRdrLeDetn1 with the same data element name";
CM_ SG_ 344 ReSideRdrLeDetn124RdrDetnRng "Refer to the data element description in ReSideRdrLeDetn1 with the same data element name";
CM_ SG_ 344 ReSideRdrLeDetn124RdrDetnRngV "Range Velocity";
CM_ SG_ 344 ReSideRdrLeDetn124RdrDetnSts "Refer to the data element description in ReSideRdrLeDetn1 with the same data element name";
CM_ SG_ 344 ReSideRdrLeDetn125RdrDetnAzi "Refer to the data element description in ReSideRdrLeDetn1 with the same data element name";
CM_ SG_ 344 ReSideRdrLeDetn125RdrDetnChks "Refer to the data element description in ReSideRdrLeDetn1 with the same data element name";
CM_ SG_ 344 ReSideRdrLeDetn125RdrDetnCntr "Refer to the data element description in ReSideRdrLeDetn1 with the same data element name";
CM_ SG_ 344 ReSideRdrLeDetn125RdrDetnConf "Refer to the data element description in ReSideRdrLeDetn1 with the same data element name";
CM_ SG_ 344 ReSideRdrLeDetn125RdrDetnElevn "Refer to the data element description in ReSideRdrLeDetn1 with the same data element name";
CM_ SG_ 344 ReSideRdrLeDetn125RdrDetnPwr "Refer to the data element description in ReSideRdrLeDetn1 with the same data element name";
CM_ SG_ 344 ReSideRdrLeDetn125RdrDetnRng "Refer to the data element description in ReSideRdrLeDetn1 with the same data element name";
CM_ SG_ 344 ReSideRdrLeDetn125RdrDetnRngV "Range Velocity";
CM_ SG_ 344 ReSideRdrLeDetn125RdrDetnSts "Refer to the data element description in ReSideRdrLeDetn1 with the same data element name";
CM_ SG_ 344 ReSideRdrLeDetn126RdrDetnAzi "Refer to the data element description in ReSideRdrLeDetn1 with the same data element name";
CM_ SG_ 344 ReSideRdrLeDetn126RdrDetnChks "Refer to the data element description in ReSideRdrLeDetn1 with the same data element name";
CM_ SG_ 344 ReSideRdrLeDetn126RdrDetnCntr "Refer to the data element description in ReSideRdrLeDetn1 with the same data element name";
CM_ SG_ 344 ReSideRdrLeDetn126RdrDetnConf "Refer to the data element description in ReSideRdrLeDetn1 with the same data element name";
CM_ SG_ 344 ReSideRdrLeDetn126RdrDetnElevn "Refer to the data element description in ReSideRdrLeDetn1 with the same data element name";
CM_ SG_ 344 ReSideRdrLeDetn126RdrDetnPwr "Refer to the data element description in ReSideRdrLeDetn1 with the same data element name";
CM_ SG_ 344 ReSideRdrLeDetn126RdrDetnRng "Refer to the data element description in ReSideRdrLeDetn1 with the same data element name";
CM_ SG_ 344 ReSideRdrLeDetn126RdrDetnRngV "Range Velocity";
CM_ SG_ 344 ReSideRdrLeDetn126RdrDetnSts "Refer to the data element description in ReSideRdrLeDetn1 with the same data element name";
CM_ SG_ 346 ReSideRdrLeDetn127RdrDetnAzi "Refer to the data element description in ReSideRdrLeDetn1 with the same data element name";
CM_ SG_ 346 ReSideRdrLeDetn127RdrDetnChks "Refer to the data element description in ReSideRdrLeDetn1 with the same data element name";
CM_ SG_ 346 ReSideRdrLeDetn127RdrDetnCntr "Refer to the data element description in ReSideRdrLeDetn1 with the same data element name";
CM_ SG_ 346 ReSideRdrLeDetn127RdrDetnConf "Refer to the data element description in ReSideRdrLeDetn1 with the same data element name";
CM_ SG_ 346 ReSideRdrLeDetn127RdrDetnElevn "Refer to the data element description in ReSideRdrLeDetn1 with the same data element name";
CM_ SG_ 346 ReSideRdrLeDetn127RdrDetnPwr "Refer to the data element description in ReSideRdrLeDetn1 with the same data element name";
CM_ SG_ 346 ReSideRdrLeDetn127RdrDetnRng "Refer to the data element description in ReSideRdrLeDetn1 with the same data element name";
CM_ SG_ 346 ReSideRdrLeDetn127RdrDetnRngV "Range Velocity";
CM_ SG_ 346 ReSideRdrLeDetn127RdrDetnSts "Refer to the data element description in ReSideRdrLeDetn1 with the same data element name";
CM_ SG_ 346 ReSideRdrLeDetn128RdrDetnAzi "Refer to the data element description in ReSideRdrLeDetn1 with the same data element name";
CM_ SG_ 346 ReSideRdrLeDetn128RdrDetnChks "Refer to the data element description in ReSideRdrLeDetn1 with the same data element name";
CM_ SG_ 346 ReSideRdrLeDetn128RdrDetnCntr "Refer to the data element description in ReSideRdrLeDetn1 with the same data element name";
CM_ SG_ 346 ReSideRdrLeDetn128RdrDetnConf "Refer to the data element description in ReSideRdrLeDetn1 with the same data element name";
CM_ SG_ 346 ReSideRdrLeDetn128RdrDetnElevn "Refer to the data element description in ReSideRdrLeDetn1 with the same data element name";
CM_ SG_ 346 ReSideRdrLeDetn128RdrDetnPwr "Refer to the data element description in ReSideRdrLeDetn1 with the same data element name";
CM_ SG_ 346 ReSideRdrLeDetn128RdrDetnRng "Refer to the data element description in ReSideRdrLeDetn1 with the same data element name";
CM_ SG_ 346 ReSideRdrLeDetn128RdrDetnRngV "Range Velocity";
CM_ SG_ 346 ReSideRdrLeDetn128RdrDetnSts "Refer to the data element description in ReSideRdrLeDetn1 with the same data element name";
CM_ SG_ 348 ReSideRdrLeObj1Heading "Heading angle
";
CM_ SG_ 348 ReSideRdrLeObj1ObjBoxCenterLat "Box center y coordinate (relative closest point)";
CM_ SG_ 348 ReSideRdrLeObj1ObjBoxCenterLgt "Object extension (for moving objects) - longitudinal position of leftmost point";
CM_ SG_ 348 ReSideRdrLeObj1ObservationHist "The result of target association in each cycle, if target is associated,the bit value should be 1, if not,the bit value should be 0.there are 32 bits
";
CM_ SG_ 348 ReSideRdrLeObj1RdrObjAx "Longitudinal acceleration";
CM_ SG_ 348 ReSideRdrLeObj1RdrObjAy "Lateral acceleration";
CM_ SG_ 348 ReSideRdrLeObj1RdrObjBoxLength "Refer to the data element description in ReSideRdrRiObj1 with the same data element name";
CM_ SG_ 348 ReSideRdrLeObj1RdrObjBoxWidth "Refer to the data element description in ReSideRdrRiObj1 with the same data element name";
CM_ SG_ 348 ReSideRdrLeObj1RdrObjChks "CRC";
CM_ SG_ 348 ReSideRdrLeObj1RdrObjCntr "Counter";
CM_ SG_ 348 ReSideRdrLeObj1RdrObjCoastCnt "Number of cycles during which the object is not associated to anything";
CM_ SG_ 348 ReSideRdrLeObj1RdrObjConf "Confidence";
CM_ SG_ 348 ReSideRdrLeObj1RdrObjDx "Longitudinal position";
CM_ SG_ 348 ReSideRdrLeObj1RdrObjDxStdDe " Standard deviation longitudinal position";
CM_ SG_ 348 ReSideRdrLeObj1RdrObjDy "Lateral position";
CM_ SG_ 348 ReSideRdrLeObj1RdrObjDyStdDe " Standard deviation lateral position";
CM_ SG_ 348 ReSideRdrLeObj1RdrObjElevnConf "Elevation confidence";
CM_ SG_ 348 ReSideRdrLeObj1RdrObjElevnSts "Elevation Status";
CM_ SG_ 348 ReSideRdrLeObj1RdrObjID "Object ID";
CM_ SG_ 348 ReSideRdrLeObj1RdrObjIsInFreeSpace "Indication if the object is inside freespace";
CM_ SG_ 348 ReSideRdrLeObj1RdrObjMirrProblty "Probability of mirrored object";
CM_ SG_ 348 ReSideRdrLeObj1RdrObjMtnPat "Object Motion Pattern (crossing, receding and oncoming) is not used here, as reserved)";
CM_ SG_ 348 ReSideRdrLeObj1RdrObjNotRealProblty "Probability of ghost track";
CM_ SG_ 348 ReSideRdrLeObj1RdrObjStatyCnt "Stationary Count";
CM_ SG_ 348 ReSideRdrLeObj1RdrObjTiAlv "Lifetime";
CM_ SG_ 348 ReSideRdrLeObj1RdrObjTrackSts "Track Status 0. it is not a valid track 1. the track has been updated 2. the track is new 3. the track is coasted (means the result is a prediction and that there was no detected measurement in the current look interval";
CM_ SG_ 348 ReSideRdrLeObj1RdrObjTyp "Classification object (Only 0 Unkown, 4 Pedestrain, 9 Bicycle and 10 Vehicle of unknown class are used actually in radar, the other types are not used but the datatype is designed so that it can be reused with camera";
CM_ SG_ 348 ReSideRdrLeObj1RdrObjTypConfBike "Confidence of tracked object type classification bike";
CM_ SG_ 348 ReSideRdrLeObj1RdrObjTypConfPed "Confidence of tracked object type classification pedestrian";
CM_ SG_ 348 ReSideRdrLeObj1RdrObjTypConfVeh "Confidence of tracked object type classification pedestrian";
CM_ SG_ 348 ReSideRdrLeObj1RdrObjVx "Longitudinal velocity";
CM_ SG_ 348 ReSideRdrLeObj1RdrObjVxStdDe " Standard deviation longitudinal velocity";
CM_ SG_ 348 ReSideRdrLeObj1RdrObjVy "Lateral velocity";
CM_ SG_ 348 ReSideRdrLeObj1RdrObjVyStdDe " Standard deviation lateral velocity";
CM_ SG_ 348 ReSideRdrLeObj1RelVx "Relative velocity in X
";
CM_ SG_ 348 ReSideRdrLeObj1RelVy "Relative velocity in Y
";
BA_DEF_ BO_ "VFrameFormat" ENUM "StandardCAN","ExtendedCAN","reserved","J1939PG","reserved","reserved","reserved","reserved","reserved","reserved","reserved","reserved","reserved","reserved","StandardCAN_FD","ExtendedCAN_FD";
BA_DEF_ BO_ "CANFD_BRS" ENUM "0","1";
BA_DEF_ BO_ "GenMsgSendType" ENUM "cyclic", "spontaneous", "not-used", "not-used", "not-used", "cyclicAndSpontaneous", "not-used", "cyclicIfActive", "NoMsgSendType"; // [us]
BA_DEF_ BO_ "GenMsgCycleTime" INT 0 65536; // [ms]
BA_DEF_ BO_ "GenMsgStartDelayTime" INT 0 65536; // [ms]
BA_DEF_ BO_ "GenMsgDelayTime" INT 0 65536; // [ms]
BA_DEF_ SG_ "GenSigSendType" ENUM "Cyclic","OnWrite","OnWriteWithRepetition","OnChange","OnChangeWithRepetition","IfActive","IfActiveWithRepetition","NoSigSendType";
BA_DEF_ SG_ "GenSigStartValue" HEX 0 80000000;
BA_DEF_ BO_ "GenMsgILSupport" ENUM "No","Yes";
BA_DEF_ BO_ "NmAsrMessage" ENUM "No","Yes";
BA_DEF_ SG_ "GenSigFuncType" ENUM "NoFunction","n/a","n/a","n/a","n/a","n/a","n/a","n/a","n/a","n/a","n/a","n/a","n/a","n/a","n/a","CHK","CNTR","n/a","n/a","n/a","CNTR_AR_01","CRC_AR_01_BOTH","CRC_AR_01_ALT","CRC_AR_01_LOW","CRC_AR_01_NIBBLE","CNTR_AR_04","CRC_AR_04A","CNTR_AR_05","CRC_AR_05";
BA_DEF_ SG_ "GenSigDataID" STRING;

BA_DEF_DEF_ "VFrameFormat" "J1939PG";
BA_DEF_DEF_ "CANFD_BRS" "1";
BA_DEF_DEF_ "GenSigStartValue" 0;
BA_DEF_DEF_ "GenSigSendType" "NoSigSendType";
BA_DEF_DEF_ "GenMsgCycleTime" 0;
BA_DEF_DEF_ "GenMsgDelayTime" 0;
BA_DEF_DEF_ "GenMsgStartDelayTime" 0;
BA_DEF_DEF_ "GenMsgSendType" "NoMsgSendType";
BA_DEF_DEF_ "GenMsgILSupport" "Yes";
BA_DEF_DEF_ "NmAsrMessage" "No";
BA_DEF_DEF_ "GenSigFuncType" "NoFunction";
BA_DEF_DEF_ "GenSigDataID" "";
// Frame: SODLSafetyCANFD3Frame15
BA_ "VFrameFormat" BO_ 332 14;
BA_ "GenMsgSendType" BO_ 332 0;
BA_ "GenMsgCycleTime" BO_ 332 50.000;
BA_ "GenSigStartValue" SG_ 332 ReSideRdrLeDetn85RdrDetnAzi 900;
BA_ "GenSigSendType" SG_ 332 ReSideRdrLeDetn85RdrDetnAzi 0;
BA_ "GenSigSendType" SG_ 332 ReSideRdrLeDetn85RdrDetnChks 0;
BA_ "GenSigFuncType" SG_ 332 ReSideRdrLeDetn85RdrDetnChks 15;
BA_ "GenSigDataID" SG_ 332 ReSideRdrLeDetn85RdrDetnChks "0x9E6";
BA_ "GenSigSendType" SG_ 332 ReSideRdrLeDetn85RdrDetnCntr 0;
BA_ "GenSigFuncType" SG_ 332 ReSideRdrLeDetn85RdrDetnCntr 16;
BA_ "GenSigSendType" SG_ 332 ReSideRdrLeDetn85RdrDetnConf 0;
BA_ "GenSigStartValue" SG_ 332 ReSideRdrLeDetn85RdrDetnElevn 15;
BA_ "GenSigSendType" SG_ 332 ReSideRdrLeDetn85RdrDetnElevn 0;
BA_ "GenSigSendType" SG_ 332 ReSideRdrLeDetn85RdrDetnPwr 0;
BA_ "GenSigStartValue" SG_ 332 ReSideRdrLeDetn85RdrDetnRng 10050;
BA_ "GenSigSendType" SG_ 332 ReSideRdrLeDetn85RdrDetnRng 0;
BA_ "GenSigStartValue" SG_ 332 ReSideRdrLeDetn85RdrDetnRngV 4000;
BA_ "GenSigSendType" SG_ 332 ReSideRdrLeDetn85RdrDetnRngV 0;
BA_ "GenSigStartValue" SG_ 332 ReSideRdrLeDetn85RdrDetnSts 3;
BA_ "GenSigSendType" SG_ 332 ReSideRdrLeDetn85RdrDetnSts 0;
BA_ "GenSigStartValue" SG_ 332 ReSideRdrLeDetn86RdrDetnAzi 900;
BA_ "GenSigSendType" SG_ 332 ReSideRdrLeDetn86RdrDetnAzi 0;
BA_ "GenSigSendType" SG_ 332 ReSideRdrLeDetn86RdrDetnChks 0;
BA_ "GenSigFuncType" SG_ 332 ReSideRdrLeDetn86RdrDetnChks 15;
BA_ "GenSigDataID" SG_ 332 ReSideRdrLeDetn86RdrDetnChks "0x9E7";
BA_ "GenSigSendType" SG_ 332 ReSideRdrLeDetn86RdrDetnCntr 0;
BA_ "GenSigFuncType" SG_ 332 ReSideRdrLeDetn86RdrDetnCntr 16;
BA_ "GenSigSendType" SG_ 332 ReSideRdrLeDetn86RdrDetnConf 0;
BA_ "GenSigStartValue" SG_ 332 ReSideRdrLeDetn86RdrDetnElevn 15;
BA_ "GenSigSendType" SG_ 332 ReSideRdrLeDetn86RdrDetnElevn 0;
BA_ "GenSigSendType" SG_ 332 ReSideRdrLeDetn86RdrDetnPwr 0;
BA_ "GenSigStartValue" SG_ 332 ReSideRdrLeDetn86RdrDetnRng 10050;
BA_ "GenSigSendType" SG_ 332 ReSideRdrLeDetn86RdrDetnRng 0;
BA_ "GenSigStartValue" SG_ 332 ReSideRdrLeDetn86RdrDetnRngV 4000;
BA_ "GenSigSendType" SG_ 332 ReSideRdrLeDetn86RdrDetnRngV 0;
BA_ "GenSigStartValue" SG_ 332 ReSideRdrLeDetn86RdrDetnSts 3;
BA_ "GenSigSendType" SG_ 332 ReSideRdrLeDetn86RdrDetnSts 0;
BA_ "GenSigStartValue" SG_ 332 ReSideRdrLeDetn87RdrDetnAzi 900;
BA_ "GenSigSendType" SG_ 332 ReSideRdrLeDetn87RdrDetnAzi 0;
BA_ "GenSigSendType" SG_ 332 ReSideRdrLeDetn87RdrDetnChks 0;
BA_ "GenSigFuncType" SG_ 332 ReSideRdrLeDetn87RdrDetnChks 15;
BA_ "GenSigDataID" SG_ 332 ReSideRdrLeDetn87RdrDetnChks "0x9E8";
BA_ "GenSigSendType" SG_ 332 ReSideRdrLeDetn87RdrDetnCntr 0;
BA_ "GenSigFuncType" SG_ 332 ReSideRdrLeDetn87RdrDetnCntr 16;
BA_ "GenSigSendType" SG_ 332 ReSideRdrLeDetn87RdrDetnConf 0;
BA_ "GenSigStartValue" SG_ 332 ReSideRdrLeDetn87RdrDetnElevn 15;
BA_ "GenSigSendType" SG_ 332 ReSideRdrLeDetn87RdrDetnElevn 0;
BA_ "GenSigSendType" SG_ 332 ReSideRdrLeDetn87RdrDetnPwr 0;
BA_ "GenSigStartValue" SG_ 332 ReSideRdrLeDetn87RdrDetnRng 10050;
BA_ "GenSigSendType" SG_ 332 ReSideRdrLeDetn87RdrDetnRng 0;
BA_ "GenSigStartValue" SG_ 332 ReSideRdrLeDetn87RdrDetnRngV 4000;
BA_ "GenSigSendType" SG_ 332 ReSideRdrLeDetn87RdrDetnRngV 0;
BA_ "GenSigStartValue" SG_ 332 ReSideRdrLeDetn87RdrDetnSts 3;
BA_ "GenSigSendType" SG_ 332 ReSideRdrLeDetn87RdrDetnSts 0;
BA_ "GenSigStartValue" SG_ 332 ReSideRdrLeDetn88RdrDetnAzi 900;
BA_ "GenSigSendType" SG_ 332 ReSideRdrLeDetn88RdrDetnAzi 0;
BA_ "GenSigSendType" SG_ 332 ReSideRdrLeDetn88RdrDetnChks 0;
BA_ "GenSigFuncType" SG_ 332 ReSideRdrLeDetn88RdrDetnChks 15;
BA_ "GenSigDataID" SG_ 332 ReSideRdrLeDetn88RdrDetnChks "0x9E9";
BA_ "GenSigSendType" SG_ 332 ReSideRdrLeDetn88RdrDetnCntr 0;
BA_ "GenSigFuncType" SG_ 332 ReSideRdrLeDetn88RdrDetnCntr 16;
BA_ "GenSigSendType" SG_ 332 ReSideRdrLeDetn88RdrDetnConf 0;
BA_ "GenSigStartValue" SG_ 332 ReSideRdrLeDetn88RdrDetnElevn 15;
BA_ "GenSigSendType" SG_ 332 ReSideRdrLeDetn88RdrDetnElevn 0;
BA_ "GenSigSendType" SG_ 332 ReSideRdrLeDetn88RdrDetnPwr 0;
BA_ "GenSigStartValue" SG_ 332 ReSideRdrLeDetn88RdrDetnRng 10050;
BA_ "GenSigSendType" SG_ 332 ReSideRdrLeDetn88RdrDetnRng 0;
BA_ "GenSigStartValue" SG_ 332 ReSideRdrLeDetn88RdrDetnRngV 4000;
BA_ "GenSigSendType" SG_ 332 ReSideRdrLeDetn88RdrDetnRngV 0;
BA_ "GenSigStartValue" SG_ 332 ReSideRdrLeDetn88RdrDetnSts 3;
BA_ "GenSigSendType" SG_ 332 ReSideRdrLeDetn88RdrDetnSts 0;
BA_ "GenSigStartValue" SG_ 332 ReSideRdrLeDetn89RdrDetnAzi 900;
BA_ "GenSigSendType" SG_ 332 ReSideRdrLeDetn89RdrDetnAzi 0;
BA_ "GenSigSendType" SG_ 332 ReSideRdrLeDetn89RdrDetnChks 0;
BA_ "GenSigFuncType" SG_ 332 ReSideRdrLeDetn89RdrDetnChks 15;
BA_ "GenSigDataID" SG_ 332 ReSideRdrLeDetn89RdrDetnChks "0x9EA";
BA_ "GenSigSendType" SG_ 332 ReSideRdrLeDetn89RdrDetnCntr 0;
BA_ "GenSigFuncType" SG_ 332 ReSideRdrLeDetn89RdrDetnCntr 16;
BA_ "GenSigSendType" SG_ 332 ReSideRdrLeDetn89RdrDetnConf 0;
BA_ "GenSigStartValue" SG_ 332 ReSideRdrLeDetn89RdrDetnElevn 15;
BA_ "GenSigSendType" SG_ 332 ReSideRdrLeDetn89RdrDetnElevn 0;
BA_ "GenSigSendType" SG_ 332 ReSideRdrLeDetn89RdrDetnPwr 0;
BA_ "GenSigStartValue" SG_ 332 ReSideRdrLeDetn89RdrDetnRng 10050;
BA_ "GenSigSendType" SG_ 332 ReSideRdrLeDetn89RdrDetnRng 0;
BA_ "GenSigStartValue" SG_ 332 ReSideRdrLeDetn89RdrDetnRngV 4000;
BA_ "GenSigSendType" SG_ 332 ReSideRdrLeDetn89RdrDetnRngV 0;
BA_ "GenSigStartValue" SG_ 332 ReSideRdrLeDetn89RdrDetnSts 3;
BA_ "GenSigSendType" SG_ 332 ReSideRdrLeDetn89RdrDetnSts 0;
BA_ "GenSigStartValue" SG_ 332 ReSideRdrLeDetn90RdrDetnAzi 900;
BA_ "GenSigSendType" SG_ 332 ReSideRdrLeDetn90RdrDetnAzi 0;
BA_ "GenSigSendType" SG_ 332 ReSideRdrLeDetn90RdrDetnChks 0;
BA_ "GenSigFuncType" SG_ 332 ReSideRdrLeDetn90RdrDetnChks 15;
BA_ "GenSigDataID" SG_ 332 ReSideRdrLeDetn90RdrDetnChks "0x9EB";
BA_ "GenSigSendType" SG_ 332 ReSideRdrLeDetn90RdrDetnCntr 0;
BA_ "GenSigFuncType" SG_ 332 ReSideRdrLeDetn90RdrDetnCntr 16;
BA_ "GenSigSendType" SG_ 332 ReSideRdrLeDetn90RdrDetnConf 0;
BA_ "GenSigStartValue" SG_ 332 ReSideRdrLeDetn90RdrDetnElevn 15;
BA_ "GenSigSendType" SG_ 332 ReSideRdrLeDetn90RdrDetnElevn 0;
BA_ "GenSigSendType" SG_ 332 ReSideRdrLeDetn90RdrDetnPwr 0;
BA_ "GenSigStartValue" SG_ 332 ReSideRdrLeDetn90RdrDetnRng 10050;
BA_ "GenSigSendType" SG_ 332 ReSideRdrLeDetn90RdrDetnRng 0;
BA_ "GenSigStartValue" SG_ 332 ReSideRdrLeDetn90RdrDetnRngV 4000;
BA_ "GenSigSendType" SG_ 332 ReSideRdrLeDetn90RdrDetnRngV 0;
BA_ "GenSigStartValue" SG_ 332 ReSideRdrLeDetn90RdrDetnSts 3;
BA_ "GenSigSendType" SG_ 332 ReSideRdrLeDetn90RdrDetnSts 0;
// Frame: SODLSafetyCANFD3Frame16
BA_ "VFrameFormat" BO_ 334 14;
BA_ "GenMsgSendType" BO_ 334 0;
BA_ "GenMsgCycleTime" BO_ 334 50.000;
BA_ "GenSigStartValue" SG_ 334 ReSideRdrLeDetn91RdrDetnAzi 900;
BA_ "GenSigSendType" SG_ 334 ReSideRdrLeDetn91RdrDetnAzi 0;
BA_ "GenSigSendType" SG_ 334 ReSideRdrLeDetn91RdrDetnChks 0;
BA_ "GenSigFuncType" SG_ 334 ReSideRdrLeDetn91RdrDetnChks 15;
BA_ "GenSigDataID" SG_ 334 ReSideRdrLeDetn91RdrDetnChks "0x9EC";
BA_ "GenSigSendType" SG_ 334 ReSideRdrLeDetn91RdrDetnCntr 0;
BA_ "GenSigFuncType" SG_ 334 ReSideRdrLeDetn91RdrDetnCntr 16;
BA_ "GenSigSendType" SG_ 334 ReSideRdrLeDetn91RdrDetnConf 0;
BA_ "GenSigStartValue" SG_ 334 ReSideRdrLeDetn91RdrDetnElevn 15;
BA_ "GenSigSendType" SG_ 334 ReSideRdrLeDetn91RdrDetnElevn 0;
BA_ "GenSigSendType" SG_ 334 ReSideRdrLeDetn91RdrDetnPwr 0;
BA_ "GenSigStartValue" SG_ 334 ReSideRdrLeDetn91RdrDetnRng 10050;
BA_ "GenSigSendType" SG_ 334 ReSideRdrLeDetn91RdrDetnRng 0;
BA_ "GenSigStartValue" SG_ 334 ReSideRdrLeDetn91RdrDetnRngV 4000;
BA_ "GenSigSendType" SG_ 334 ReSideRdrLeDetn91RdrDetnRngV 0;
BA_ "GenSigStartValue" SG_ 334 ReSideRdrLeDetn91RdrDetnSts 3;
BA_ "GenSigSendType" SG_ 334 ReSideRdrLeDetn91RdrDetnSts 0;
BA_ "GenSigStartValue" SG_ 334 ReSideRdrLeDetn92RdrDetnAzi 900;
BA_ "GenSigSendType" SG_ 334 ReSideRdrLeDetn92RdrDetnAzi 0;
BA_ "GenSigSendType" SG_ 334 ReSideRdrLeDetn92RdrDetnChks 0;
BA_ "GenSigFuncType" SG_ 334 ReSideRdrLeDetn92RdrDetnChks 15;
BA_ "GenSigDataID" SG_ 334 ReSideRdrLeDetn92RdrDetnChks "0x9ED";
BA_ "GenSigSendType" SG_ 334 ReSideRdrLeDetn92RdrDetnCntr 0;
BA_ "GenSigFuncType" SG_ 334 ReSideRdrLeDetn92RdrDetnCntr 16;
BA_ "GenSigSendType" SG_ 334 ReSideRdrLeDetn92RdrDetnConf 0;
BA_ "GenSigStartValue" SG_ 334 ReSideRdrLeDetn92RdrDetnElevn 15;
BA_ "GenSigSendType" SG_ 334 ReSideRdrLeDetn92RdrDetnElevn 0;
BA_ "GenSigSendType" SG_ 334 ReSideRdrLeDetn92RdrDetnPwr 0;
BA_ "GenSigStartValue" SG_ 334 ReSideRdrLeDetn92RdrDetnRng 10050;
BA_ "GenSigSendType" SG_ 334 ReSideRdrLeDetn92RdrDetnRng 0;
BA_ "GenSigStartValue" SG_ 334 ReSideRdrLeDetn92RdrDetnRngV 4000;
BA_ "GenSigSendType" SG_ 334 ReSideRdrLeDetn92RdrDetnRngV 0;
BA_ "GenSigStartValue" SG_ 334 ReSideRdrLeDetn92RdrDetnSts 3;
BA_ "GenSigSendType" SG_ 334 ReSideRdrLeDetn92RdrDetnSts 0;
BA_ "GenSigStartValue" SG_ 334 ReSideRdrLeDetn93RdrDetnAzi 900;
BA_ "GenSigSendType" SG_ 334 ReSideRdrLeDetn93RdrDetnAzi 0;
BA_ "GenSigSendType" SG_ 334 ReSideRdrLeDetn93RdrDetnChks 0;
BA_ "GenSigFuncType" SG_ 334 ReSideRdrLeDetn93RdrDetnChks 15;
BA_ "GenSigDataID" SG_ 334 ReSideRdrLeDetn93RdrDetnChks "0x9EE";
BA_ "GenSigSendType" SG_ 334 ReSideRdrLeDetn93RdrDetnCntr 0;
BA_ "GenSigFuncType" SG_ 334 ReSideRdrLeDetn93RdrDetnCntr 16;
BA_ "GenSigSendType" SG_ 334 ReSideRdrLeDetn93RdrDetnConf 0;
BA_ "GenSigStartValue" SG_ 334 ReSideRdrLeDetn93RdrDetnElevn 15;
BA_ "GenSigSendType" SG_ 334 ReSideRdrLeDetn93RdrDetnElevn 0;
BA_ "GenSigSendType" SG_ 334 ReSideRdrLeDetn93RdrDetnPwr 0;
BA_ "GenSigStartValue" SG_ 334 ReSideRdrLeDetn93RdrDetnRng 10050;
BA_ "GenSigSendType" SG_ 334 ReSideRdrLeDetn93RdrDetnRng 0;
BA_ "GenSigStartValue" SG_ 334 ReSideRdrLeDetn93RdrDetnRngV 4000;
BA_ "GenSigSendType" SG_ 334 ReSideRdrLeDetn93RdrDetnRngV 0;
BA_ "GenSigStartValue" SG_ 334 ReSideRdrLeDetn93RdrDetnSts 3;
BA_ "GenSigSendType" SG_ 334 ReSideRdrLeDetn93RdrDetnSts 0;
BA_ "GenSigStartValue" SG_ 334 ReSideRdrLeDetn94RdrDetnAzi 900;
BA_ "GenSigSendType" SG_ 334 ReSideRdrLeDetn94RdrDetnAzi 0;
BA_ "GenSigSendType" SG_ 334 ReSideRdrLeDetn94RdrDetnChks 0;
BA_ "GenSigFuncType" SG_ 334 ReSideRdrLeDetn94RdrDetnChks 15;
BA_ "GenSigDataID" SG_ 334 ReSideRdrLeDetn94RdrDetnChks "0x9EF";
BA_ "GenSigSendType" SG_ 334 ReSideRdrLeDetn94RdrDetnCntr 0;
BA_ "GenSigFuncType" SG_ 334 ReSideRdrLeDetn94RdrDetnCntr 16;
BA_ "GenSigSendType" SG_ 334 ReSideRdrLeDetn94RdrDetnConf 0;
BA_ "GenSigStartValue" SG_ 334 ReSideRdrLeDetn94RdrDetnElevn 15;
BA_ "GenSigSendType" SG_ 334 ReSideRdrLeDetn94RdrDetnElevn 0;
BA_ "GenSigSendType" SG_ 334 ReSideRdrLeDetn94RdrDetnPwr 0;
BA_ "GenSigStartValue" SG_ 334 ReSideRdrLeDetn94RdrDetnRng 10050;
BA_ "GenSigSendType" SG_ 334 ReSideRdrLeDetn94RdrDetnRng 0;
BA_ "GenSigStartValue" SG_ 334 ReSideRdrLeDetn94RdrDetnRngV 4000;
BA_ "GenSigSendType" SG_ 334 ReSideRdrLeDetn94RdrDetnRngV 0;
BA_ "GenSigStartValue" SG_ 334 ReSideRdrLeDetn94RdrDetnSts 3;
BA_ "GenSigSendType" SG_ 334 ReSideRdrLeDetn94RdrDetnSts 0;
BA_ "GenSigStartValue" SG_ 334 ReSideRdrLeDetn95RdrDetnAzi 900;
BA_ "GenSigSendType" SG_ 334 ReSideRdrLeDetn95RdrDetnAzi 0;
BA_ "GenSigSendType" SG_ 334 ReSideRdrLeDetn95RdrDetnChks 0;
BA_ "GenSigFuncType" SG_ 334 ReSideRdrLeDetn95RdrDetnChks 15;
BA_ "GenSigDataID" SG_ 334 ReSideRdrLeDetn95RdrDetnChks "0x9F0";
BA_ "GenSigSendType" SG_ 334 ReSideRdrLeDetn95RdrDetnCntr 0;
BA_ "GenSigFuncType" SG_ 334 ReSideRdrLeDetn95RdrDetnCntr 16;
BA_ "GenSigSendType" SG_ 334 ReSideRdrLeDetn95RdrDetnConf 0;
BA_ "GenSigStartValue" SG_ 334 ReSideRdrLeDetn95RdrDetnElevn 15;
BA_ "GenSigSendType" SG_ 334 ReSideRdrLeDetn95RdrDetnElevn 0;
BA_ "GenSigSendType" SG_ 334 ReSideRdrLeDetn95RdrDetnPwr 0;
BA_ "GenSigStartValue" SG_ 334 ReSideRdrLeDetn95RdrDetnRng 10050;
BA_ "GenSigSendType" SG_ 334 ReSideRdrLeDetn95RdrDetnRng 0;
BA_ "GenSigStartValue" SG_ 334 ReSideRdrLeDetn95RdrDetnRngV 4000;
BA_ "GenSigSendType" SG_ 334 ReSideRdrLeDetn95RdrDetnRngV 0;
BA_ "GenSigStartValue" SG_ 334 ReSideRdrLeDetn95RdrDetnSts 3;
BA_ "GenSigSendType" SG_ 334 ReSideRdrLeDetn95RdrDetnSts 0;
BA_ "GenSigStartValue" SG_ 334 ReSideRdrLeDetn96RdrDetnAzi 900;
BA_ "GenSigSendType" SG_ 334 ReSideRdrLeDetn96RdrDetnAzi 0;
BA_ "GenSigSendType" SG_ 334 ReSideRdrLeDetn96RdrDetnChks 0;
BA_ "GenSigFuncType" SG_ 334 ReSideRdrLeDetn96RdrDetnChks 15;
BA_ "GenSigDataID" SG_ 334 ReSideRdrLeDetn96RdrDetnChks "0x9F1";
BA_ "GenSigSendType" SG_ 334 ReSideRdrLeDetn96RdrDetnCntr 0;
BA_ "GenSigFuncType" SG_ 334 ReSideRdrLeDetn96RdrDetnCntr 16;
BA_ "GenSigSendType" SG_ 334 ReSideRdrLeDetn96RdrDetnConf 0;
BA_ "GenSigStartValue" SG_ 334 ReSideRdrLeDetn96RdrDetnElevn 15;
BA_ "GenSigSendType" SG_ 334 ReSideRdrLeDetn96RdrDetnElevn 0;
BA_ "GenSigSendType" SG_ 334 ReSideRdrLeDetn96RdrDetnPwr 0;
BA_ "GenSigStartValue" SG_ 334 ReSideRdrLeDetn96RdrDetnRng 10050;
BA_ "GenSigSendType" SG_ 334 ReSideRdrLeDetn96RdrDetnRng 0;
BA_ "GenSigStartValue" SG_ 334 ReSideRdrLeDetn96RdrDetnRngV 4000;
BA_ "GenSigSendType" SG_ 334 ReSideRdrLeDetn96RdrDetnRngV 0;
BA_ "GenSigStartValue" SG_ 334 ReSideRdrLeDetn96RdrDetnSts 3;
BA_ "GenSigSendType" SG_ 334 ReSideRdrLeDetn96RdrDetnSts 0;
// Frame: SODLSafetyCANFD3Frame17
BA_ "VFrameFormat" BO_ 336 14;
BA_ "GenMsgSendType" BO_ 336 0;
BA_ "GenMsgCycleTime" BO_ 336 50.000;
BA_ "GenSigStartValue" SG_ 336 ReSideRdrLeDetn100RdrDetnAzi 900;
BA_ "GenSigSendType" SG_ 336 ReSideRdrLeDetn100RdrDetnAzi 0;
BA_ "GenSigSendType" SG_ 336 ReSideRdrLeDetn100RdrDetnChks 0;
BA_ "GenSigFuncType" SG_ 336 ReSideRdrLeDetn100RdrDetnChks 15;
BA_ "GenSigDataID" SG_ 336 ReSideRdrLeDetn100RdrDetnChks "0x9F5";
BA_ "GenSigSendType" SG_ 336 ReSideRdrLeDetn100RdrDetnCntr 0;
BA_ "GenSigFuncType" SG_ 336 ReSideRdrLeDetn100RdrDetnCntr 16;
BA_ "GenSigSendType" SG_ 336 ReSideRdrLeDetn100RdrDetnConf 0;
BA_ "GenSigStartValue" SG_ 336 ReSideRdrLeDetn100RdrDetnElevn 15;
BA_ "GenSigSendType" SG_ 336 ReSideRdrLeDetn100RdrDetnElevn 0;
BA_ "GenSigSendType" SG_ 336 ReSideRdrLeDetn100RdrDetnPwr 0;
BA_ "GenSigStartValue" SG_ 336 ReSideRdrLeDetn100RdrDetnRng 10050;
BA_ "GenSigSendType" SG_ 336 ReSideRdrLeDetn100RdrDetnRng 0;
BA_ "GenSigStartValue" SG_ 336 ReSideRdrLeDetn100RdrDetnRngV 4000;
BA_ "GenSigSendType" SG_ 336 ReSideRdrLeDetn100RdrDetnRngV 0;
BA_ "GenSigStartValue" SG_ 336 ReSideRdrLeDetn100RdrDetnSts 3;
BA_ "GenSigSendType" SG_ 336 ReSideRdrLeDetn100RdrDetnSts 0;
BA_ "GenSigStartValue" SG_ 336 ReSideRdrLeDetn101RdrDetnAzi 900;
BA_ "GenSigSendType" SG_ 336 ReSideRdrLeDetn101RdrDetnAzi 0;
BA_ "GenSigSendType" SG_ 336 ReSideRdrLeDetn101RdrDetnChks 0;
BA_ "GenSigFuncType" SG_ 336 ReSideRdrLeDetn101RdrDetnChks 15;
BA_ "GenSigDataID" SG_ 336 ReSideRdrLeDetn101RdrDetnChks "0x9F6";
BA_ "GenSigSendType" SG_ 336 ReSideRdrLeDetn101RdrDetnCntr 0;
BA_ "GenSigFuncType" SG_ 336 ReSideRdrLeDetn101RdrDetnCntr 16;
BA_ "GenSigSendType" SG_ 336 ReSideRdrLeDetn101RdrDetnConf 0;
BA_ "GenSigStartValue" SG_ 336 ReSideRdrLeDetn101RdrDetnElevn 15;
BA_ "GenSigSendType" SG_ 336 ReSideRdrLeDetn101RdrDetnElevn 0;
BA_ "GenSigSendType" SG_ 336 ReSideRdrLeDetn101RdrDetnPwr 0;
BA_ "GenSigStartValue" SG_ 336 ReSideRdrLeDetn101RdrDetnRng 10050;
BA_ "GenSigSendType" SG_ 336 ReSideRdrLeDetn101RdrDetnRng 0;
BA_ "GenSigStartValue" SG_ 336 ReSideRdrLeDetn101RdrDetnRngV 4000;
BA_ "GenSigSendType" SG_ 336 ReSideRdrLeDetn101RdrDetnRngV 0;
BA_ "GenSigStartValue" SG_ 336 ReSideRdrLeDetn101RdrDetnSts 3;
BA_ "GenSigSendType" SG_ 336 ReSideRdrLeDetn101RdrDetnSts 0;
BA_ "GenSigStartValue" SG_ 336 ReSideRdrLeDetn102RdrDetnAzi 900;
BA_ "GenSigSendType" SG_ 336 ReSideRdrLeDetn102RdrDetnAzi 0;
BA_ "GenSigSendType" SG_ 336 ReSideRdrLeDetn102RdrDetnChks 0;
BA_ "GenSigFuncType" SG_ 336 ReSideRdrLeDetn102RdrDetnChks 15;
BA_ "GenSigDataID" SG_ 336 ReSideRdrLeDetn102RdrDetnChks "0x9F7";
BA_ "GenSigSendType" SG_ 336 ReSideRdrLeDetn102RdrDetnCntr 0;
BA_ "GenSigFuncType" SG_ 336 ReSideRdrLeDetn102RdrDetnCntr 16;
BA_ "GenSigSendType" SG_ 336 ReSideRdrLeDetn102RdrDetnConf 0;
BA_ "GenSigStartValue" SG_ 336 ReSideRdrLeDetn102RdrDetnElevn 15;
BA_ "GenSigSendType" SG_ 336 ReSideRdrLeDetn102RdrDetnElevn 0;
BA_ "GenSigSendType" SG_ 336 ReSideRdrLeDetn102RdrDetnPwr 0;
BA_ "GenSigStartValue" SG_ 336 ReSideRdrLeDetn102RdrDetnRng 10050;
BA_ "GenSigSendType" SG_ 336 ReSideRdrLeDetn102RdrDetnRng 0;
BA_ "GenSigStartValue" SG_ 336 ReSideRdrLeDetn102RdrDetnRngV 4000;
BA_ "GenSigSendType" SG_ 336 ReSideRdrLeDetn102RdrDetnRngV 0;
BA_ "GenSigStartValue" SG_ 336 ReSideRdrLeDetn102RdrDetnSts 3;
BA_ "GenSigSendType" SG_ 336 ReSideRdrLeDetn102RdrDetnSts 0;
BA_ "GenSigStartValue" SG_ 336 ReSideRdrLeDetn97RdrDetnAzi 900;
BA_ "GenSigSendType" SG_ 336 ReSideRdrLeDetn97RdrDetnAzi 0;
BA_ "GenSigSendType" SG_ 336 ReSideRdrLeDetn97RdrDetnChks 0;
BA_ "GenSigFuncType" SG_ 336 ReSideRdrLeDetn97RdrDetnChks 15;
BA_ "GenSigDataID" SG_ 336 ReSideRdrLeDetn97RdrDetnChks "0x9F2";
BA_ "GenSigSendType" SG_ 336 ReSideRdrLeDetn97RdrDetnCntr 0;
BA_ "GenSigFuncType" SG_ 336 ReSideRdrLeDetn97RdrDetnCntr 16;
BA_ "GenSigSendType" SG_ 336 ReSideRdrLeDetn97RdrDetnConf 0;
BA_ "GenSigStartValue" SG_ 336 ReSideRdrLeDetn97RdrDetnElevn 15;
BA_ "GenSigSendType" SG_ 336 ReSideRdrLeDetn97RdrDetnElevn 0;
BA_ "GenSigSendType" SG_ 336 ReSideRdrLeDetn97RdrDetnPwr 0;
BA_ "GenSigStartValue" SG_ 336 ReSideRdrLeDetn97RdrDetnRng 10050;
BA_ "GenSigSendType" SG_ 336 ReSideRdrLeDetn97RdrDetnRng 0;
BA_ "GenSigStartValue" SG_ 336 ReSideRdrLeDetn97RdrDetnRngV 4000;
BA_ "GenSigSendType" SG_ 336 ReSideRdrLeDetn97RdrDetnRngV 0;
BA_ "GenSigStartValue" SG_ 336 ReSideRdrLeDetn97RdrDetnSts 3;
BA_ "GenSigSendType" SG_ 336 ReSideRdrLeDetn97RdrDetnSts 0;
BA_ "GenSigStartValue" SG_ 336 ReSideRdrLeDetn98RdrDetnAzi 900;
BA_ "GenSigSendType" SG_ 336 ReSideRdrLeDetn98RdrDetnAzi 0;
BA_ "GenSigSendType" SG_ 336 ReSideRdrLeDetn98RdrDetnChks 0;
BA_ "GenSigFuncType" SG_ 336 ReSideRdrLeDetn98RdrDetnChks 15;
BA_ "GenSigDataID" SG_ 336 ReSideRdrLeDetn98RdrDetnChks "0x9F3";
BA_ "GenSigSendType" SG_ 336 ReSideRdrLeDetn98RdrDetnCntr 0;
BA_ "GenSigFuncType" SG_ 336 ReSideRdrLeDetn98RdrDetnCntr 16;
BA_ "GenSigSendType" SG_ 336 ReSideRdrLeDetn98RdrDetnConf 0;
BA_ "GenSigStartValue" SG_ 336 ReSideRdrLeDetn98RdrDetnElevn 15;
BA_ "GenSigSendType" SG_ 336 ReSideRdrLeDetn98RdrDetnElevn 0;
BA_ "GenSigSendType" SG_ 336 ReSideRdrLeDetn98RdrDetnPwr 0;
BA_ "GenSigStartValue" SG_ 336 ReSideRdrLeDetn98RdrDetnRng 10050;
BA_ "GenSigSendType" SG_ 336 ReSideRdrLeDetn98RdrDetnRng 0;
BA_ "GenSigStartValue" SG_ 336 ReSideRdrLeDetn98RdrDetnRngV 4000;
BA_ "GenSigSendType" SG_ 336 ReSideRdrLeDetn98RdrDetnRngV 0;
BA_ "GenSigStartValue" SG_ 336 ReSideRdrLeDetn98RdrDetnSts 3;
BA_ "GenSigSendType" SG_ 336 ReSideRdrLeDetn98RdrDetnSts 0;
BA_ "GenSigStartValue" SG_ 336 ReSideRdrLeDetn99RdrDetnAzi 900;
BA_ "GenSigSendType" SG_ 336 ReSideRdrLeDetn99RdrDetnAzi 0;
BA_ "GenSigSendType" SG_ 336 ReSideRdrLeDetn99RdrDetnChks 0;
BA_ "GenSigFuncType" SG_ 336 ReSideRdrLeDetn99RdrDetnChks 15;
BA_ "GenSigDataID" SG_ 336 ReSideRdrLeDetn99RdrDetnChks "0x9F4";
BA_ "GenSigSendType" SG_ 336 ReSideRdrLeDetn99RdrDetnCntr 0;
BA_ "GenSigFuncType" SG_ 336 ReSideRdrLeDetn99RdrDetnCntr 16;
BA_ "GenSigSendType" SG_ 336 ReSideRdrLeDetn99RdrDetnConf 0;
BA_ "GenSigStartValue" SG_ 336 ReSideRdrLeDetn99RdrDetnElevn 15;
BA_ "GenSigSendType" SG_ 336 ReSideRdrLeDetn99RdrDetnElevn 0;
BA_ "GenSigSendType" SG_ 336 ReSideRdrLeDetn99RdrDetnPwr 0;
BA_ "GenSigStartValue" SG_ 336 ReSideRdrLeDetn99RdrDetnRng 10050;
BA_ "GenSigSendType" SG_ 336 ReSideRdrLeDetn99RdrDetnRng 0;
BA_ "GenSigStartValue" SG_ 336 ReSideRdrLeDetn99RdrDetnRngV 4000;
BA_ "GenSigSendType" SG_ 336 ReSideRdrLeDetn99RdrDetnRngV 0;
BA_ "GenSigStartValue" SG_ 336 ReSideRdrLeDetn99RdrDetnSts 3;
BA_ "GenSigSendType" SG_ 336 ReSideRdrLeDetn99RdrDetnSts 0;
// Frame: SODLSafetyCANFD3Frame18
BA_ "VFrameFormat" BO_ 338 14;
BA_ "GenMsgSendType" BO_ 338 0;
BA_ "GenMsgCycleTime" BO_ 338 50.000;
BA_ "GenSigStartValue" SG_ 338 ReSideRdrLeDetn103RdrDetnAzi 900;
BA_ "GenSigSendType" SG_ 338 ReSideRdrLeDetn103RdrDetnAzi 0;
BA_ "GenSigSendType" SG_ 338 ReSideRdrLeDetn103RdrDetnChks 0;
BA_ "GenSigFuncType" SG_ 338 ReSideRdrLeDetn103RdrDetnChks 15;
BA_ "GenSigDataID" SG_ 338 ReSideRdrLeDetn103RdrDetnChks "0x9F8";
BA_ "GenSigSendType" SG_ 338 ReSideRdrLeDetn103RdrDetnCntr 0;
BA_ "GenSigFuncType" SG_ 338 ReSideRdrLeDetn103RdrDetnCntr 16;
BA_ "GenSigSendType" SG_ 338 ReSideRdrLeDetn103RdrDetnConf 0;
BA_ "GenSigStartValue" SG_ 338 ReSideRdrLeDetn103RdrDetnElevn 15;
BA_ "GenSigSendType" SG_ 338 ReSideRdrLeDetn103RdrDetnElevn 0;
BA_ "GenSigSendType" SG_ 338 ReSideRdrLeDetn103RdrDetnPwr 0;
BA_ "GenSigStartValue" SG_ 338 ReSideRdrLeDetn103RdrDetnRng 10050;
BA_ "GenSigSendType" SG_ 338 ReSideRdrLeDetn103RdrDetnRng 0;
BA_ "GenSigStartValue" SG_ 338 ReSideRdrLeDetn103RdrDetnRngV 4000;
BA_ "GenSigSendType" SG_ 338 ReSideRdrLeDetn103RdrDetnRngV 0;
BA_ "GenSigStartValue" SG_ 338 ReSideRdrLeDetn103RdrDetnSts 3;
BA_ "GenSigSendType" SG_ 338 ReSideRdrLeDetn103RdrDetnSts 0;
BA_ "GenSigStartValue" SG_ 338 ReSideRdrLeDetn104RdrDetnAzi 900;
BA_ "GenSigSendType" SG_ 338 ReSideRdrLeDetn104RdrDetnAzi 0;
BA_ "GenSigSendType" SG_ 338 ReSideRdrLeDetn104RdrDetnChks 0;
BA_ "GenSigFuncType" SG_ 338 ReSideRdrLeDetn104RdrDetnChks 15;
BA_ "GenSigDataID" SG_ 338 ReSideRdrLeDetn104RdrDetnChks "0x9F9";
BA_ "GenSigSendType" SG_ 338 ReSideRdrLeDetn104RdrDetnCntr 0;
BA_ "GenSigFuncType" SG_ 338 ReSideRdrLeDetn104RdrDetnCntr 16;
BA_ "GenSigSendType" SG_ 338 ReSideRdrLeDetn104RdrDetnConf 0;
BA_ "GenSigStartValue" SG_ 338 ReSideRdrLeDetn104RdrDetnElevn 15;
BA_ "GenSigSendType" SG_ 338 ReSideRdrLeDetn104RdrDetnElevn 0;
BA_ "GenSigSendType" SG_ 338 ReSideRdrLeDetn104RdrDetnPwr 0;
BA_ "GenSigStartValue" SG_ 338 ReSideRdrLeDetn104RdrDetnRng 10050;
BA_ "GenSigSendType" SG_ 338 ReSideRdrLeDetn104RdrDetnRng 0;
BA_ "GenSigStartValue" SG_ 338 ReSideRdrLeDetn104RdrDetnRngV 4000;
BA_ "GenSigSendType" SG_ 338 ReSideRdrLeDetn104RdrDetnRngV 0;
BA_ "GenSigStartValue" SG_ 338 ReSideRdrLeDetn104RdrDetnSts 3;
BA_ "GenSigSendType" SG_ 338 ReSideRdrLeDetn104RdrDetnSts 0;
BA_ "GenSigStartValue" SG_ 338 ReSideRdrLeDetn105RdrDetnAzi 900;
BA_ "GenSigSendType" SG_ 338 ReSideRdrLeDetn105RdrDetnAzi 0;
BA_ "GenSigSendType" SG_ 338 ReSideRdrLeDetn105RdrDetnChks 0;
BA_ "GenSigFuncType" SG_ 338 ReSideRdrLeDetn105RdrDetnChks 15;
BA_ "GenSigDataID" SG_ 338 ReSideRdrLeDetn105RdrDetnChks "0x9FA";
BA_ "GenSigSendType" SG_ 338 ReSideRdrLeDetn105RdrDetnCntr 0;
BA_ "GenSigFuncType" SG_ 338 ReSideRdrLeDetn105RdrDetnCntr 16;
BA_ "GenSigSendType" SG_ 338 ReSideRdrLeDetn105RdrDetnConf 0;
BA_ "GenSigStartValue" SG_ 338 ReSideRdrLeDetn105RdrDetnElevn 15;
BA_ "GenSigSendType" SG_ 338 ReSideRdrLeDetn105RdrDetnElevn 0;
BA_ "GenSigSendType" SG_ 338 ReSideRdrLeDetn105RdrDetnPwr 0;
BA_ "GenSigStartValue" SG_ 338 ReSideRdrLeDetn105RdrDetnRng 10050;
BA_ "GenSigSendType" SG_ 338 ReSideRdrLeDetn105RdrDetnRng 0;
BA_ "GenSigStartValue" SG_ 338 ReSideRdrLeDetn105RdrDetnRngV 4000;
BA_ "GenSigSendType" SG_ 338 ReSideRdrLeDetn105RdrDetnRngV 0;
BA_ "GenSigStartValue" SG_ 338 ReSideRdrLeDetn105RdrDetnSts 3;
BA_ "GenSigSendType" SG_ 338 ReSideRdrLeDetn105RdrDetnSts 0;
BA_ "GenSigStartValue" SG_ 338 ReSideRdrLeDetn106RdrDetnAzi 900;
BA_ "GenSigSendType" SG_ 338 ReSideRdrLeDetn106RdrDetnAzi 0;
BA_ "GenSigSendType" SG_ 338 ReSideRdrLeDetn106RdrDetnChks 0;
BA_ "GenSigFuncType" SG_ 338 ReSideRdrLeDetn106RdrDetnChks 15;
BA_ "GenSigDataID" SG_ 338 ReSideRdrLeDetn106RdrDetnChks "0x9FB";
BA_ "GenSigSendType" SG_ 338 ReSideRdrLeDetn106RdrDetnCntr 0;
BA_ "GenSigFuncType" SG_ 338 ReSideRdrLeDetn106RdrDetnCntr 16;
BA_ "GenSigSendType" SG_ 338 ReSideRdrLeDetn106RdrDetnConf 0;
BA_ "GenSigStartValue" SG_ 338 ReSideRdrLeDetn106RdrDetnElevn 15;
BA_ "GenSigSendType" SG_ 338 ReSideRdrLeDetn106RdrDetnElevn 0;
BA_ "GenSigSendType" SG_ 338 ReSideRdrLeDetn106RdrDetnPwr 0;
BA_ "GenSigStartValue" SG_ 338 ReSideRdrLeDetn106RdrDetnRng 10050;
BA_ "GenSigSendType" SG_ 338 ReSideRdrLeDetn106RdrDetnRng 0;
BA_ "GenSigStartValue" SG_ 338 ReSideRdrLeDetn106RdrDetnRngV 4000;
BA_ "GenSigSendType" SG_ 338 ReSideRdrLeDetn106RdrDetnRngV 0;
BA_ "GenSigStartValue" SG_ 338 ReSideRdrLeDetn106RdrDetnSts 3;
BA_ "GenSigSendType" SG_ 338 ReSideRdrLeDetn106RdrDetnSts 0;
BA_ "GenSigStartValue" SG_ 338 ReSideRdrLeDetn107RdrDetnAzi 900;
BA_ "GenSigSendType" SG_ 338 ReSideRdrLeDetn107RdrDetnAzi 0;
BA_ "GenSigSendType" SG_ 338 ReSideRdrLeDetn107RdrDetnChks 0;
BA_ "GenSigFuncType" SG_ 338 ReSideRdrLeDetn107RdrDetnChks 15;
BA_ "GenSigDataID" SG_ 338 ReSideRdrLeDetn107RdrDetnChks "0x9FC";
BA_ "GenSigSendType" SG_ 338 ReSideRdrLeDetn107RdrDetnCntr 0;
BA_ "GenSigFuncType" SG_ 338 ReSideRdrLeDetn107RdrDetnCntr 16;
BA_ "GenSigSendType" SG_ 338 ReSideRdrLeDetn107RdrDetnConf 0;
BA_ "GenSigStartValue" SG_ 338 ReSideRdrLeDetn107RdrDetnElevn 15;
BA_ "GenSigSendType" SG_ 338 ReSideRdrLeDetn107RdrDetnElevn 0;
BA_ "GenSigSendType" SG_ 338 ReSideRdrLeDetn107RdrDetnPwr 0;
BA_ "GenSigStartValue" SG_ 338 ReSideRdrLeDetn107RdrDetnRng 10050;
BA_ "GenSigSendType" SG_ 338 ReSideRdrLeDetn107RdrDetnRng 0;
BA_ "GenSigStartValue" SG_ 338 ReSideRdrLeDetn107RdrDetnRngV 4000;
BA_ "GenSigSendType" SG_ 338 ReSideRdrLeDetn107RdrDetnRngV 0;
BA_ "GenSigStartValue" SG_ 338 ReSideRdrLeDetn107RdrDetnSts 3;
BA_ "GenSigSendType" SG_ 338 ReSideRdrLeDetn107RdrDetnSts 0;
BA_ "GenSigStartValue" SG_ 338 ReSideRdrLeDetn108RdrDetnAzi 900;
BA_ "GenSigSendType" SG_ 338 ReSideRdrLeDetn108RdrDetnAzi 0;
BA_ "GenSigSendType" SG_ 338 ReSideRdrLeDetn108RdrDetnChks 0;
BA_ "GenSigFuncType" SG_ 338 ReSideRdrLeDetn108RdrDetnChks 15;
BA_ "GenSigDataID" SG_ 338 ReSideRdrLeDetn108RdrDetnChks "0x9FD";
BA_ "GenSigSendType" SG_ 338 ReSideRdrLeDetn108RdrDetnCntr 0;
BA_ "GenSigFuncType" SG_ 338 ReSideRdrLeDetn108RdrDetnCntr 16;
BA_ "GenSigSendType" SG_ 338 ReSideRdrLeDetn108RdrDetnConf 0;
BA_ "GenSigStartValue" SG_ 338 ReSideRdrLeDetn108RdrDetnElevn 15;
BA_ "GenSigSendType" SG_ 338 ReSideRdrLeDetn108RdrDetnElevn 0;
BA_ "GenSigSendType" SG_ 338 ReSideRdrLeDetn108RdrDetnPwr 0;
BA_ "GenSigStartValue" SG_ 338 ReSideRdrLeDetn108RdrDetnRng 10050;
BA_ "GenSigSendType" SG_ 338 ReSideRdrLeDetn108RdrDetnRng 0;
BA_ "GenSigStartValue" SG_ 338 ReSideRdrLeDetn108RdrDetnRngV 4000;
BA_ "GenSigSendType" SG_ 338 ReSideRdrLeDetn108RdrDetnRngV 0;
BA_ "GenSigStartValue" SG_ 338 ReSideRdrLeDetn108RdrDetnSts 3;
BA_ "GenSigSendType" SG_ 338 ReSideRdrLeDetn108RdrDetnSts 0;
// Frame: SODLSafetyCANFD3Frame19
BA_ "VFrameFormat" BO_ 340 14;
BA_ "GenMsgSendType" BO_ 340 0;
BA_ "GenMsgCycleTime" BO_ 340 50.000;
BA_ "GenSigStartValue" SG_ 340 ReSideRdrLeDetn109RdrDetnAzi 900;
BA_ "GenSigSendType" SG_ 340 ReSideRdrLeDetn109RdrDetnAzi 0;
BA_ "GenSigSendType" SG_ 340 ReSideRdrLeDetn109RdrDetnChks 0;
BA_ "GenSigFuncType" SG_ 340 ReSideRdrLeDetn109RdrDetnChks 15;
BA_ "GenSigDataID" SG_ 340 ReSideRdrLeDetn109RdrDetnChks "0x9FE";
BA_ "GenSigSendType" SG_ 340 ReSideRdrLeDetn109RdrDetnCntr 0;
BA_ "GenSigFuncType" SG_ 340 ReSideRdrLeDetn109RdrDetnCntr 16;
BA_ "GenSigSendType" SG_ 340 ReSideRdrLeDetn109RdrDetnConf 0;
BA_ "GenSigStartValue" SG_ 340 ReSideRdrLeDetn109RdrDetnElevn 15;
BA_ "GenSigSendType" SG_ 340 ReSideRdrLeDetn109RdrDetnElevn 0;
BA_ "GenSigSendType" SG_ 340 ReSideRdrLeDetn109RdrDetnPwr 0;
BA_ "GenSigStartValue" SG_ 340 ReSideRdrLeDetn109RdrDetnRng 10050;
BA_ "GenSigSendType" SG_ 340 ReSideRdrLeDetn109RdrDetnRng 0;
BA_ "GenSigStartValue" SG_ 340 ReSideRdrLeDetn109RdrDetnRngV 4000;
BA_ "GenSigSendType" SG_ 340 ReSideRdrLeDetn109RdrDetnRngV 0;
BA_ "GenSigStartValue" SG_ 340 ReSideRdrLeDetn109RdrDetnSts 3;
BA_ "GenSigSendType" SG_ 340 ReSideRdrLeDetn109RdrDetnSts 0;
BA_ "GenSigStartValue" SG_ 340 ReSideRdrLeDetn110RdrDetnAzi 900;
BA_ "GenSigSendType" SG_ 340 ReSideRdrLeDetn110RdrDetnAzi 0;
BA_ "GenSigSendType" SG_ 340 ReSideRdrLeDetn110RdrDetnChks 0;
BA_ "GenSigFuncType" SG_ 340 ReSideRdrLeDetn110RdrDetnChks 15;
BA_ "GenSigDataID" SG_ 340 ReSideRdrLeDetn110RdrDetnChks "0x9FF";
BA_ "GenSigSendType" SG_ 340 ReSideRdrLeDetn110RdrDetnCntr 0;
BA_ "GenSigFuncType" SG_ 340 ReSideRdrLeDetn110RdrDetnCntr 16;
BA_ "GenSigSendType" SG_ 340 ReSideRdrLeDetn110RdrDetnConf 0;
BA_ "GenSigStartValue" SG_ 340 ReSideRdrLeDetn110RdrDetnElevn 15;
BA_ "GenSigSendType" SG_ 340 ReSideRdrLeDetn110RdrDetnElevn 0;
BA_ "GenSigSendType" SG_ 340 ReSideRdrLeDetn110RdrDetnPwr 0;
BA_ "GenSigStartValue" SG_ 340 ReSideRdrLeDetn110RdrDetnRng 10050;
BA_ "GenSigSendType" SG_ 340 ReSideRdrLeDetn110RdrDetnRng 0;
BA_ "GenSigStartValue" SG_ 340 ReSideRdrLeDetn110RdrDetnRngV 4000;
BA_ "GenSigSendType" SG_ 340 ReSideRdrLeDetn110RdrDetnRngV 0;
BA_ "GenSigStartValue" SG_ 340 ReSideRdrLeDetn110RdrDetnSts 3;
BA_ "GenSigSendType" SG_ 340 ReSideRdrLeDetn110RdrDetnSts 0;
BA_ "GenSigStartValue" SG_ 340 ReSideRdrLeDetn111RdrDetnAzi 900;
BA_ "GenSigSendType" SG_ 340 ReSideRdrLeDetn111RdrDetnAzi 0;
BA_ "GenSigSendType" SG_ 340 ReSideRdrLeDetn111RdrDetnChks 0;
BA_ "GenSigFuncType" SG_ 340 ReSideRdrLeDetn111RdrDetnChks 15;
BA_ "GenSigDataID" SG_ 340 ReSideRdrLeDetn111RdrDetnChks "0xA00";
BA_ "GenSigSendType" SG_ 340 ReSideRdrLeDetn111RdrDetnCntr 0;
BA_ "GenSigFuncType" SG_ 340 ReSideRdrLeDetn111RdrDetnCntr 16;
BA_ "GenSigSendType" SG_ 340 ReSideRdrLeDetn111RdrDetnConf 0;
BA_ "GenSigStartValue" SG_ 340 ReSideRdrLeDetn111RdrDetnElevn 15;
BA_ "GenSigSendType" SG_ 340 ReSideRdrLeDetn111RdrDetnElevn 0;
BA_ "GenSigSendType" SG_ 340 ReSideRdrLeDetn111RdrDetnPwr 0;
BA_ "GenSigStartValue" SG_ 340 ReSideRdrLeDetn111RdrDetnRng 10050;
BA_ "GenSigSendType" SG_ 340 ReSideRdrLeDetn111RdrDetnRng 0;
BA_ "GenSigStartValue" SG_ 340 ReSideRdrLeDetn111RdrDetnRngV 4000;
BA_ "GenSigSendType" SG_ 340 ReSideRdrLeDetn111RdrDetnRngV 0;
BA_ "GenSigStartValue" SG_ 340 ReSideRdrLeDetn111RdrDetnSts 3;
BA_ "GenSigSendType" SG_ 340 ReSideRdrLeDetn111RdrDetnSts 0;
BA_ "GenSigStartValue" SG_ 340 ReSideRdrLeDetn112RdrDetnAzi 900;
BA_ "GenSigSendType" SG_ 340 ReSideRdrLeDetn112RdrDetnAzi 0;
BA_ "GenSigSendType" SG_ 340 ReSideRdrLeDetn112RdrDetnChks 0;
BA_ "GenSigFuncType" SG_ 340 ReSideRdrLeDetn112RdrDetnChks 15;
BA_ "GenSigDataID" SG_ 340 ReSideRdrLeDetn112RdrDetnChks "0xA01";
BA_ "GenSigSendType" SG_ 340 ReSideRdrLeDetn112RdrDetnCntr 0;
BA_ "GenSigFuncType" SG_ 340 ReSideRdrLeDetn112RdrDetnCntr 16;
BA_ "GenSigSendType" SG_ 340 ReSideRdrLeDetn112RdrDetnConf 0;
BA_ "GenSigStartValue" SG_ 340 ReSideRdrLeDetn112RdrDetnElevn 15;
BA_ "GenSigSendType" SG_ 340 ReSideRdrLeDetn112RdrDetnElevn 0;
BA_ "GenSigSendType" SG_ 340 ReSideRdrLeDetn112RdrDetnPwr 0;
BA_ "GenSigStartValue" SG_ 340 ReSideRdrLeDetn112RdrDetnRng 10050;
BA_ "GenSigSendType" SG_ 340 ReSideRdrLeDetn112RdrDetnRng 0;
BA_ "GenSigStartValue" SG_ 340 ReSideRdrLeDetn112RdrDetnRngV 4000;
BA_ "GenSigSendType" SG_ 340 ReSideRdrLeDetn112RdrDetnRngV 0;
BA_ "GenSigStartValue" SG_ 340 ReSideRdrLeDetn112RdrDetnSts 3;
BA_ "GenSigSendType" SG_ 340 ReSideRdrLeDetn112RdrDetnSts 0;
BA_ "GenSigStartValue" SG_ 340 ReSideRdrLeDetn113RdrDetnAzi 900;
BA_ "GenSigSendType" SG_ 340 ReSideRdrLeDetn113RdrDetnAzi 0;
BA_ "GenSigSendType" SG_ 340 ReSideRdrLeDetn113RdrDetnChks 0;
BA_ "GenSigFuncType" SG_ 340 ReSideRdrLeDetn113RdrDetnChks 15;
BA_ "GenSigDataID" SG_ 340 ReSideRdrLeDetn113RdrDetnChks "0xA02";
BA_ "GenSigSendType" SG_ 340 ReSideRdrLeDetn113RdrDetnCntr 0;
BA_ "GenSigFuncType" SG_ 340 ReSideRdrLeDetn113RdrDetnCntr 16;
BA_ "GenSigSendType" SG_ 340 ReSideRdrLeDetn113RdrDetnConf 0;
BA_ "GenSigStartValue" SG_ 340 ReSideRdrLeDetn113RdrDetnElevn 15;
BA_ "GenSigSendType" SG_ 340 ReSideRdrLeDetn113RdrDetnElevn 0;
BA_ "GenSigSendType" SG_ 340 ReSideRdrLeDetn113RdrDetnPwr 0;
BA_ "GenSigStartValue" SG_ 340 ReSideRdrLeDetn113RdrDetnRng 10050;
BA_ "GenSigSendType" SG_ 340 ReSideRdrLeDetn113RdrDetnRng 0;
BA_ "GenSigStartValue" SG_ 340 ReSideRdrLeDetn113RdrDetnRngV 4000;
BA_ "GenSigSendType" SG_ 340 ReSideRdrLeDetn113RdrDetnRngV 0;
BA_ "GenSigStartValue" SG_ 340 ReSideRdrLeDetn113RdrDetnSts 3;
BA_ "GenSigSendType" SG_ 340 ReSideRdrLeDetn113RdrDetnSts 0;
BA_ "GenSigStartValue" SG_ 340 ReSideRdrLeDetn114RdrDetnAzi 900;
BA_ "GenSigSendType" SG_ 340 ReSideRdrLeDetn114RdrDetnAzi 0;
BA_ "GenSigSendType" SG_ 340 ReSideRdrLeDetn114RdrDetnChks 0;
BA_ "GenSigFuncType" SG_ 340 ReSideRdrLeDetn114RdrDetnChks 15;
BA_ "GenSigDataID" SG_ 340 ReSideRdrLeDetn114RdrDetnChks "0xA03";
BA_ "GenSigSendType" SG_ 340 ReSideRdrLeDetn114RdrDetnCntr 0;
BA_ "GenSigFuncType" SG_ 340 ReSideRdrLeDetn114RdrDetnCntr 16;
BA_ "GenSigSendType" SG_ 340 ReSideRdrLeDetn114RdrDetnConf 0;
BA_ "GenSigStartValue" SG_ 340 ReSideRdrLeDetn114RdrDetnElevn 15;
BA_ "GenSigSendType" SG_ 340 ReSideRdrLeDetn114RdrDetnElevn 0;
BA_ "GenSigSendType" SG_ 340 ReSideRdrLeDetn114RdrDetnPwr 0;
BA_ "GenSigStartValue" SG_ 340 ReSideRdrLeDetn114RdrDetnRng 10050;
BA_ "GenSigSendType" SG_ 340 ReSideRdrLeDetn114RdrDetnRng 0;
BA_ "GenSigStartValue" SG_ 340 ReSideRdrLeDetn114RdrDetnRngV 4000;
BA_ "GenSigSendType" SG_ 340 ReSideRdrLeDetn114RdrDetnRngV 0;
BA_ "GenSigStartValue" SG_ 340 ReSideRdrLeDetn114RdrDetnSts 3;
BA_ "GenSigSendType" SG_ 340 ReSideRdrLeDetn114RdrDetnSts 0;
// Frame: SODLSafetyCANFD3Frame20
BA_ "VFrameFormat" BO_ 342 14;
BA_ "GenMsgSendType" BO_ 342 0;
BA_ "GenMsgCycleTime" BO_ 342 50.000;
BA_ "GenSigStartValue" SG_ 342 ReSideRdrLeDetn115RdrDetnAzi 900;
BA_ "GenSigSendType" SG_ 342 ReSideRdrLeDetn115RdrDetnAzi 0;
BA_ "GenSigSendType" SG_ 342 ReSideRdrLeDetn115RdrDetnChks 0;
BA_ "GenSigFuncType" SG_ 342 ReSideRdrLeDetn115RdrDetnChks 15;
BA_ "GenSigDataID" SG_ 342 ReSideRdrLeDetn115RdrDetnChks "0xA04";
BA_ "GenSigSendType" SG_ 342 ReSideRdrLeDetn115RdrDetnCntr 0;
BA_ "GenSigFuncType" SG_ 342 ReSideRdrLeDetn115RdrDetnCntr 16;
BA_ "GenSigSendType" SG_ 342 ReSideRdrLeDetn115RdrDetnConf 0;
BA_ "GenSigStartValue" SG_ 342 ReSideRdrLeDetn115RdrDetnElevn 15;
BA_ "GenSigSendType" SG_ 342 ReSideRdrLeDetn115RdrDetnElevn 0;
BA_ "GenSigSendType" SG_ 342 ReSideRdrLeDetn115RdrDetnPwr 0;
BA_ "GenSigStartValue" SG_ 342 ReSideRdrLeDetn115RdrDetnRng 10050;
BA_ "GenSigSendType" SG_ 342 ReSideRdrLeDetn115RdrDetnRng 0;
BA_ "GenSigStartValue" SG_ 342 ReSideRdrLeDetn115RdrDetnRngV 4000;
BA_ "GenSigSendType" SG_ 342 ReSideRdrLeDetn115RdrDetnRngV 0;
BA_ "GenSigStartValue" SG_ 342 ReSideRdrLeDetn115RdrDetnSts 3;
BA_ "GenSigSendType" SG_ 342 ReSideRdrLeDetn115RdrDetnSts 0;
BA_ "GenSigStartValue" SG_ 342 ReSideRdrLeDetn116RdrDetnAzi 900;
BA_ "GenSigSendType" SG_ 342 ReSideRdrLeDetn116RdrDetnAzi 0;
BA_ "GenSigSendType" SG_ 342 ReSideRdrLeDetn116RdrDetnChks 0;
BA_ "GenSigFuncType" SG_ 342 ReSideRdrLeDetn116RdrDetnChks 15;
BA_ "GenSigDataID" SG_ 342 ReSideRdrLeDetn116RdrDetnChks "0xA05";
BA_ "GenSigSendType" SG_ 342 ReSideRdrLeDetn116RdrDetnCntr 0;
BA_ "GenSigFuncType" SG_ 342 ReSideRdrLeDetn116RdrDetnCntr 16;
BA_ "GenSigSendType" SG_ 342 ReSideRdrLeDetn116RdrDetnConf 0;
BA_ "GenSigStartValue" SG_ 342 ReSideRdrLeDetn116RdrDetnElevn 15;
BA_ "GenSigSendType" SG_ 342 ReSideRdrLeDetn116RdrDetnElevn 0;
BA_ "GenSigSendType" SG_ 342 ReSideRdrLeDetn116RdrDetnPwr 0;
BA_ "GenSigStartValue" SG_ 342 ReSideRdrLeDetn116RdrDetnRng 10050;
BA_ "GenSigSendType" SG_ 342 ReSideRdrLeDetn116RdrDetnRng 0;
BA_ "GenSigStartValue" SG_ 342 ReSideRdrLeDetn116RdrDetnRngV 4000;
BA_ "GenSigSendType" SG_ 342 ReSideRdrLeDetn116RdrDetnRngV 0;
BA_ "GenSigStartValue" SG_ 342 ReSideRdrLeDetn116RdrDetnSts 3;
BA_ "GenSigSendType" SG_ 342 ReSideRdrLeDetn116RdrDetnSts 0;
BA_ "GenSigStartValue" SG_ 342 ReSideRdrLeDetn117RdrDetnAzi 900;
BA_ "GenSigSendType" SG_ 342 ReSideRdrLeDetn117RdrDetnAzi 0;
BA_ "GenSigSendType" SG_ 342 ReSideRdrLeDetn117RdrDetnChks 0;
BA_ "GenSigFuncType" SG_ 342 ReSideRdrLeDetn117RdrDetnChks 15;
BA_ "GenSigDataID" SG_ 342 ReSideRdrLeDetn117RdrDetnChks "0xA06";
BA_ "GenSigSendType" SG_ 342 ReSideRdrLeDetn117RdrDetnCntr 0;
BA_ "GenSigFuncType" SG_ 342 ReSideRdrLeDetn117RdrDetnCntr 16;
BA_ "GenSigSendType" SG_ 342 ReSideRdrLeDetn117RdrDetnConf 0;
BA_ "GenSigStartValue" SG_ 342 ReSideRdrLeDetn117RdrDetnElevn 15;
BA_ "GenSigSendType" SG_ 342 ReSideRdrLeDetn117RdrDetnElevn 0;
BA_ "GenSigSendType" SG_ 342 ReSideRdrLeDetn117RdrDetnPwr 0;
BA_ "GenSigStartValue" SG_ 342 ReSideRdrLeDetn117RdrDetnRng 10050;
BA_ "GenSigSendType" SG_ 342 ReSideRdrLeDetn117RdrDetnRng 0;
BA_ "GenSigStartValue" SG_ 342 ReSideRdrLeDetn117RdrDetnRngV 4000;
BA_ "GenSigSendType" SG_ 342 ReSideRdrLeDetn117RdrDetnRngV 0;
BA_ "GenSigStartValue" SG_ 342 ReSideRdrLeDetn117RdrDetnSts 3;
BA_ "GenSigSendType" SG_ 342 ReSideRdrLeDetn117RdrDetnSts 0;
BA_ "GenSigStartValue" SG_ 342 ReSideRdrLeDetn118RdrDetnAzi 900;
BA_ "GenSigSendType" SG_ 342 ReSideRdrLeDetn118RdrDetnAzi 0;
BA_ "GenSigSendType" SG_ 342 ReSideRdrLeDetn118RdrDetnChks 0;
BA_ "GenSigFuncType" SG_ 342 ReSideRdrLeDetn118RdrDetnChks 15;
BA_ "GenSigDataID" SG_ 342 ReSideRdrLeDetn118RdrDetnChks "0xA07";
BA_ "GenSigSendType" SG_ 342 ReSideRdrLeDetn118RdrDetnCntr 0;
BA_ "GenSigFuncType" SG_ 342 ReSideRdrLeDetn118RdrDetnCntr 16;
BA_ "GenSigSendType" SG_ 342 ReSideRdrLeDetn118RdrDetnConf 0;
BA_ "GenSigStartValue" SG_ 342 ReSideRdrLeDetn118RdrDetnElevn 15;
BA_ "GenSigSendType" SG_ 342 ReSideRdrLeDetn118RdrDetnElevn 0;
BA_ "GenSigSendType" SG_ 342 ReSideRdrLeDetn118RdrDetnPwr 0;
BA_ "GenSigStartValue" SG_ 342 ReSideRdrLeDetn118RdrDetnRng 10050;
BA_ "GenSigSendType" SG_ 342 ReSideRdrLeDetn118RdrDetnRng 0;
BA_ "GenSigStartValue" SG_ 342 ReSideRdrLeDetn118RdrDetnRngV 4000;
BA_ "GenSigSendType" SG_ 342 ReSideRdrLeDetn118RdrDetnRngV 0;
BA_ "GenSigStartValue" SG_ 342 ReSideRdrLeDetn118RdrDetnSts 3;
BA_ "GenSigSendType" SG_ 342 ReSideRdrLeDetn118RdrDetnSts 0;
BA_ "GenSigStartValue" SG_ 342 ReSideRdrLeDetn119RdrDetnAzi 900;
BA_ "GenSigSendType" SG_ 342 ReSideRdrLeDetn119RdrDetnAzi 0;
BA_ "GenSigSendType" SG_ 342 ReSideRdrLeDetn119RdrDetnChks 0;
BA_ "GenSigFuncType" SG_ 342 ReSideRdrLeDetn119RdrDetnChks 15;
BA_ "GenSigDataID" SG_ 342 ReSideRdrLeDetn119RdrDetnChks "0xA08";
BA_ "GenSigSendType" SG_ 342 ReSideRdrLeDetn119RdrDetnCntr 0;
BA_ "GenSigFuncType" SG_ 342 ReSideRdrLeDetn119RdrDetnCntr 16;
BA_ "GenSigSendType" SG_ 342 ReSideRdrLeDetn119RdrDetnConf 0;
BA_ "GenSigStartValue" SG_ 342 ReSideRdrLeDetn119RdrDetnElevn 15;
BA_ "GenSigSendType" SG_ 342 ReSideRdrLeDetn119RdrDetnElevn 0;
BA_ "GenSigSendType" SG_ 342 ReSideRdrLeDetn119RdrDetnPwr 0;
BA_ "GenSigStartValue" SG_ 342 ReSideRdrLeDetn119RdrDetnRng 10050;
BA_ "GenSigSendType" SG_ 342 ReSideRdrLeDetn119RdrDetnRng 0;
BA_ "GenSigStartValue" SG_ 342 ReSideRdrLeDetn119RdrDetnRngV 4000;
BA_ "GenSigSendType" SG_ 342 ReSideRdrLeDetn119RdrDetnRngV 0;
BA_ "GenSigStartValue" SG_ 342 ReSideRdrLeDetn119RdrDetnSts 3;
BA_ "GenSigSendType" SG_ 342 ReSideRdrLeDetn119RdrDetnSts 0;
BA_ "GenSigStartValue" SG_ 342 ReSideRdrLeDetn120RdrDetnAzi 900;
BA_ "GenSigSendType" SG_ 342 ReSideRdrLeDetn120RdrDetnAzi 0;
BA_ "GenSigSendType" SG_ 342 ReSideRdrLeDetn120RdrDetnChks 0;
BA_ "GenSigFuncType" SG_ 342 ReSideRdrLeDetn120RdrDetnChks 15;
BA_ "GenSigDataID" SG_ 342 ReSideRdrLeDetn120RdrDetnChks "0xA09";
BA_ "GenSigSendType" SG_ 342 ReSideRdrLeDetn120RdrDetnCntr 0;
BA_ "GenSigFuncType" SG_ 342 ReSideRdrLeDetn120RdrDetnCntr 16;
BA_ "GenSigSendType" SG_ 342 ReSideRdrLeDetn120RdrDetnConf 0;
BA_ "GenSigStartValue" SG_ 342 ReSideRdrLeDetn120RdrDetnElevn 15;
BA_ "GenSigSendType" SG_ 342 ReSideRdrLeDetn120RdrDetnElevn 0;
BA_ "GenSigSendType" SG_ 342 ReSideRdrLeDetn120RdrDetnPwr 0;
BA_ "GenSigStartValue" SG_ 342 ReSideRdrLeDetn120RdrDetnRng 10050;
BA_ "GenSigSendType" SG_ 342 ReSideRdrLeDetn120RdrDetnRng 0;
BA_ "GenSigStartValue" SG_ 342 ReSideRdrLeDetn120RdrDetnRngV 4000;
BA_ "GenSigSendType" SG_ 342 ReSideRdrLeDetn120RdrDetnRngV 0;
BA_ "GenSigStartValue" SG_ 342 ReSideRdrLeDetn120RdrDetnSts 3;
BA_ "GenSigSendType" SG_ 342 ReSideRdrLeDetn120RdrDetnSts 0;
// Frame: SODLSafetyCANFD3Frame21
BA_ "VFrameFormat" BO_ 344 14;
BA_ "GenMsgSendType" BO_ 344 0;
BA_ "GenMsgCycleTime" BO_ 344 50.000;
BA_ "GenSigStartValue" SG_ 344 ReSideRdrLeDetn121RdrDetnAzi 900;
BA_ "GenSigSendType" SG_ 344 ReSideRdrLeDetn121RdrDetnAzi 0;
BA_ "GenSigSendType" SG_ 344 ReSideRdrLeDetn121RdrDetnChks 0;
BA_ "GenSigFuncType" SG_ 344 ReSideRdrLeDetn121RdrDetnChks 15;
BA_ "GenSigDataID" SG_ 344 ReSideRdrLeDetn121RdrDetnChks "0xA0A";
BA_ "GenSigSendType" SG_ 344 ReSideRdrLeDetn121RdrDetnCntr 0;
BA_ "GenSigFuncType" SG_ 344 ReSideRdrLeDetn121RdrDetnCntr 16;
BA_ "GenSigSendType" SG_ 344 ReSideRdrLeDetn121RdrDetnConf 0;
BA_ "GenSigStartValue" SG_ 344 ReSideRdrLeDetn121RdrDetnElevn 15;
BA_ "GenSigSendType" SG_ 344 ReSideRdrLeDetn121RdrDetnElevn 0;
BA_ "GenSigSendType" SG_ 344 ReSideRdrLeDetn121RdrDetnPwr 0;
BA_ "GenSigStartValue" SG_ 344 ReSideRdrLeDetn121RdrDetnRng 10050;
BA_ "GenSigSendType" SG_ 344 ReSideRdrLeDetn121RdrDetnRng 0;
BA_ "GenSigStartValue" SG_ 344 ReSideRdrLeDetn121RdrDetnRngV 4000;
BA_ "GenSigSendType" SG_ 344 ReSideRdrLeDetn121RdrDetnRngV 0;
BA_ "GenSigStartValue" SG_ 344 ReSideRdrLeDetn121RdrDetnSts 3;
BA_ "GenSigSendType" SG_ 344 ReSideRdrLeDetn121RdrDetnSts 0;
BA_ "GenSigStartValue" SG_ 344 ReSideRdrLeDetn122RdrDetnAzi 900;
BA_ "GenSigSendType" SG_ 344 ReSideRdrLeDetn122RdrDetnAzi 0;
BA_ "GenSigSendType" SG_ 344 ReSideRdrLeDetn122RdrDetnChks 0;
BA_ "GenSigFuncType" SG_ 344 ReSideRdrLeDetn122RdrDetnChks 15;
BA_ "GenSigDataID" SG_ 344 ReSideRdrLeDetn122RdrDetnChks "0xA0B";
BA_ "GenSigSendType" SG_ 344 ReSideRdrLeDetn122RdrDetnCntr 0;
BA_ "GenSigFuncType" SG_ 344 ReSideRdrLeDetn122RdrDetnCntr 16;
BA_ "GenSigSendType" SG_ 344 ReSideRdrLeDetn122RdrDetnConf 0;
BA_ "GenSigStartValue" SG_ 344 ReSideRdrLeDetn122RdrDetnElevn 15;
BA_ "GenSigSendType" SG_ 344 ReSideRdrLeDetn122RdrDetnElevn 0;
BA_ "GenSigSendType" SG_ 344 ReSideRdrLeDetn122RdrDetnPwr 0;
BA_ "GenSigStartValue" SG_ 344 ReSideRdrLeDetn122RdrDetnRng 10050;
BA_ "GenSigSendType" SG_ 344 ReSideRdrLeDetn122RdrDetnRng 0;
BA_ "GenSigStartValue" SG_ 344 ReSideRdrLeDetn122RdrDetnRngV 4000;
BA_ "GenSigSendType" SG_ 344 ReSideRdrLeDetn122RdrDetnRngV 0;
BA_ "GenSigStartValue" SG_ 344 ReSideRdrLeDetn122RdrDetnSts 3;
BA_ "GenSigSendType" SG_ 344 ReSideRdrLeDetn122RdrDetnSts 0;
BA_ "GenSigStartValue" SG_ 344 ReSideRdrLeDetn123RdrDetnAzi 900;
BA_ "GenSigSendType" SG_ 344 ReSideRdrLeDetn123RdrDetnAzi 0;
BA_ "GenSigSendType" SG_ 344 ReSideRdrLeDetn123RdrDetnChks 0;
BA_ "GenSigFuncType" SG_ 344 ReSideRdrLeDetn123RdrDetnChks 15;
BA_ "GenSigDataID" SG_ 344 ReSideRdrLeDetn123RdrDetnChks "0xA0C";
BA_ "GenSigSendType" SG_ 344 ReSideRdrLeDetn123RdrDetnCntr 0;
BA_ "GenSigFuncType" SG_ 344 ReSideRdrLeDetn123RdrDetnCntr 16;
BA_ "GenSigSendType" SG_ 344 ReSideRdrLeDetn123RdrDetnConf 0;
BA_ "GenSigStartValue" SG_ 344 ReSideRdrLeDetn123RdrDetnElevn 15;
BA_ "GenSigSendType" SG_ 344 ReSideRdrLeDetn123RdrDetnElevn 0;
BA_ "GenSigSendType" SG_ 344 ReSideRdrLeDetn123RdrDetnPwr 0;
BA_ "GenSigStartValue" SG_ 344 ReSideRdrLeDetn123RdrDetnRng 10050;
BA_ "GenSigSendType" SG_ 344 ReSideRdrLeDetn123RdrDetnRng 0;
BA_ "GenSigStartValue" SG_ 344 ReSideRdrLeDetn123RdrDetnRngV 4000;
BA_ "GenSigSendType" SG_ 344 ReSideRdrLeDetn123RdrDetnRngV 0;
BA_ "GenSigStartValue" SG_ 344 ReSideRdrLeDetn123RdrDetnSts 3;
BA_ "GenSigSendType" SG_ 344 ReSideRdrLeDetn123RdrDetnSts 0;
BA_ "GenSigStartValue" SG_ 344 ReSideRdrLeDetn124RdrDetnAzi 900;
BA_ "GenSigSendType" SG_ 344 ReSideRdrLeDetn124RdrDetnAzi 0;
BA_ "GenSigSendType" SG_ 344 ReSideRdrLeDetn124RdrDetnChks 0;
BA_ "GenSigFuncType" SG_ 344 ReSideRdrLeDetn124RdrDetnChks 15;
BA_ "GenSigDataID" SG_ 344 ReSideRdrLeDetn124RdrDetnChks "0xA0D";
BA_ "GenSigSendType" SG_ 344 ReSideRdrLeDetn124RdrDetnCntr 0;
BA_ "GenSigFuncType" SG_ 344 ReSideRdrLeDetn124RdrDetnCntr 16;
BA_ "GenSigSendType" SG_ 344 ReSideRdrLeDetn124RdrDetnConf 0;
BA_ "GenSigStartValue" SG_ 344 ReSideRdrLeDetn124RdrDetnElevn 15;
BA_ "GenSigSendType" SG_ 344 ReSideRdrLeDetn124RdrDetnElevn 0;
BA_ "GenSigSendType" SG_ 344 ReSideRdrLeDetn124RdrDetnPwr 0;
BA_ "GenSigStartValue" SG_ 344 ReSideRdrLeDetn124RdrDetnRng 10050;
BA_ "GenSigSendType" SG_ 344 ReSideRdrLeDetn124RdrDetnRng 0;
BA_ "GenSigStartValue" SG_ 344 ReSideRdrLeDetn124RdrDetnRngV 4000;
BA_ "GenSigSendType" SG_ 344 ReSideRdrLeDetn124RdrDetnRngV 0;
BA_ "GenSigStartValue" SG_ 344 ReSideRdrLeDetn124RdrDetnSts 3;
BA_ "GenSigSendType" SG_ 344 ReSideRdrLeDetn124RdrDetnSts 0;
BA_ "GenSigStartValue" SG_ 344 ReSideRdrLeDetn125RdrDetnAzi 900;
BA_ "GenSigSendType" SG_ 344 ReSideRdrLeDetn125RdrDetnAzi 0;
BA_ "GenSigSendType" SG_ 344 ReSideRdrLeDetn125RdrDetnChks 0;
BA_ "GenSigFuncType" SG_ 344 ReSideRdrLeDetn125RdrDetnChks 15;
BA_ "GenSigDataID" SG_ 344 ReSideRdrLeDetn125RdrDetnChks "0xA0E";
BA_ "GenSigSendType" SG_ 344 ReSideRdrLeDetn125RdrDetnCntr 0;
BA_ "GenSigFuncType" SG_ 344 ReSideRdrLeDetn125RdrDetnCntr 16;
BA_ "GenSigSendType" SG_ 344 ReSideRdrLeDetn125RdrDetnConf 0;
BA_ "GenSigStartValue" SG_ 344 ReSideRdrLeDetn125RdrDetnElevn 15;
BA_ "GenSigSendType" SG_ 344 ReSideRdrLeDetn125RdrDetnElevn 0;
BA_ "GenSigSendType" SG_ 344 ReSideRdrLeDetn125RdrDetnPwr 0;
BA_ "GenSigStartValue" SG_ 344 ReSideRdrLeDetn125RdrDetnRng 10050;
BA_ "GenSigSendType" SG_ 344 ReSideRdrLeDetn125RdrDetnRng 0;
BA_ "GenSigStartValue" SG_ 344 ReSideRdrLeDetn125RdrDetnRngV 4000;
BA_ "GenSigSendType" SG_ 344 ReSideRdrLeDetn125RdrDetnRngV 0;
BA_ "GenSigStartValue" SG_ 344 ReSideRdrLeDetn125RdrDetnSts 3;
BA_ "GenSigSendType" SG_ 344 ReSideRdrLeDetn125RdrDetnSts 0;
BA_ "GenSigStartValue" SG_ 344 ReSideRdrLeDetn126RdrDetnAzi 900;
BA_ "GenSigSendType" SG_ 344 ReSideRdrLeDetn126RdrDetnAzi 0;
BA_ "GenSigSendType" SG_ 344 ReSideRdrLeDetn126RdrDetnChks 0;
BA_ "GenSigFuncType" SG_ 344 ReSideRdrLeDetn126RdrDetnChks 15;
BA_ "GenSigDataID" SG_ 344 ReSideRdrLeDetn126RdrDetnChks "0xA0F";
BA_ "GenSigSendType" SG_ 344 ReSideRdrLeDetn126RdrDetnCntr 0;
BA_ "GenSigFuncType" SG_ 344 ReSideRdrLeDetn126RdrDetnCntr 16;
BA_ "GenSigSendType" SG_ 344 ReSideRdrLeDetn126RdrDetnConf 0;
BA_ "GenSigStartValue" SG_ 344 ReSideRdrLeDetn126RdrDetnElevn 15;
BA_ "GenSigSendType" SG_ 344 ReSideRdrLeDetn126RdrDetnElevn 0;
BA_ "GenSigSendType" SG_ 344 ReSideRdrLeDetn126RdrDetnPwr 0;
BA_ "GenSigStartValue" SG_ 344 ReSideRdrLeDetn126RdrDetnRng 10050;
BA_ "GenSigSendType" SG_ 344 ReSideRdrLeDetn126RdrDetnRng 0;
BA_ "GenSigStartValue" SG_ 344 ReSideRdrLeDetn126RdrDetnRngV 4000;
BA_ "GenSigSendType" SG_ 344 ReSideRdrLeDetn126RdrDetnRngV 0;
BA_ "GenSigStartValue" SG_ 344 ReSideRdrLeDetn126RdrDetnSts 3;
BA_ "GenSigSendType" SG_ 344 ReSideRdrLeDetn126RdrDetnSts 0;
// Frame: SODLSafetyCANFD3Frame22
BA_ "VFrameFormat" BO_ 346 14;
BA_ "GenMsgSendType" BO_ 346 0;
BA_ "GenMsgCycleTime" BO_ 346 50.000;
BA_ "GenSigStartValue" SG_ 346 ReSideRdrLeDetn127RdrDetnAzi 900;
BA_ "GenSigSendType" SG_ 346 ReSideRdrLeDetn127RdrDetnAzi 0;
BA_ "GenSigSendType" SG_ 346 ReSideRdrLeDetn127RdrDetnChks 0;
BA_ "GenSigFuncType" SG_ 346 ReSideRdrLeDetn127RdrDetnChks 15;
BA_ "GenSigDataID" SG_ 346 ReSideRdrLeDetn127RdrDetnChks "0xA10";
BA_ "GenSigSendType" SG_ 346 ReSideRdrLeDetn127RdrDetnCntr 0;
BA_ "GenSigFuncType" SG_ 346 ReSideRdrLeDetn127RdrDetnCntr 16;
BA_ "GenSigSendType" SG_ 346 ReSideRdrLeDetn127RdrDetnConf 0;
BA_ "GenSigStartValue" SG_ 346 ReSideRdrLeDetn127RdrDetnElevn 15;
BA_ "GenSigSendType" SG_ 346 ReSideRdrLeDetn127RdrDetnElevn 0;
BA_ "GenSigSendType" SG_ 346 ReSideRdrLeDetn127RdrDetnPwr 0;
BA_ "GenSigStartValue" SG_ 346 ReSideRdrLeDetn127RdrDetnRng 10050;
BA_ "GenSigSendType" SG_ 346 ReSideRdrLeDetn127RdrDetnRng 0;
BA_ "GenSigStartValue" SG_ 346 ReSideRdrLeDetn127RdrDetnRngV 4000;
BA_ "GenSigSendType" SG_ 346 ReSideRdrLeDetn127RdrDetnRngV 0;
BA_ "GenSigStartValue" SG_ 346 ReSideRdrLeDetn127RdrDetnSts 3;
BA_ "GenSigSendType" SG_ 346 ReSideRdrLeDetn127RdrDetnSts 0;
BA_ "GenSigStartValue" SG_ 346 ReSideRdrLeDetn128RdrDetnAzi 900;
BA_ "GenSigSendType" SG_ 346 ReSideRdrLeDetn128RdrDetnAzi 0;
BA_ "GenSigSendType" SG_ 346 ReSideRdrLeDetn128RdrDetnChks 0;
BA_ "GenSigFuncType" SG_ 346 ReSideRdrLeDetn128RdrDetnChks 15;
BA_ "GenSigDataID" SG_ 346 ReSideRdrLeDetn128RdrDetnChks "0xA11";
BA_ "GenSigSendType" SG_ 346 ReSideRdrLeDetn128RdrDetnCntr 0;
BA_ "GenSigFuncType" SG_ 346 ReSideRdrLeDetn128RdrDetnCntr 16;
BA_ "GenSigSendType" SG_ 346 ReSideRdrLeDetn128RdrDetnConf 0;
BA_ "GenSigStartValue" SG_ 346 ReSideRdrLeDetn128RdrDetnElevn 15;
BA_ "GenSigSendType" SG_ 346 ReSideRdrLeDetn128RdrDetnElevn 0;
BA_ "GenSigSendType" SG_ 346 ReSideRdrLeDetn128RdrDetnPwr 0;
BA_ "GenSigStartValue" SG_ 346 ReSideRdrLeDetn128RdrDetnRng 10050;
BA_ "GenSigSendType" SG_ 346 ReSideRdrLeDetn128RdrDetnRng 0;
BA_ "GenSigStartValue" SG_ 346 ReSideRdrLeDetn128RdrDetnRngV 4000;
BA_ "GenSigSendType" SG_ 346 ReSideRdrLeDetn128RdrDetnRngV 0;
BA_ "GenSigStartValue" SG_ 346 ReSideRdrLeDetn128RdrDetnSts 3;
BA_ "GenSigSendType" SG_ 346 ReSideRdrLeDetn128RdrDetnSts 0;
// Frame: SODLSafetyCANFD3Frame23
BA_ "VFrameFormat" BO_ 348 14;
BA_ "GenMsgSendType" BO_ 348 0;
BA_ "GenMsgCycleTime" BO_ 348 50.000;
BA_ "GenSigStartValue" SG_ 348 ReSideRdrLeObj1Heading 1800;
BA_ "GenSigSendType" SG_ 348 ReSideRdrLeObj1Heading 0;
BA_ "GenSigStartValue" SG_ 348 ReSideRdrLeObj1ObjBoxCenterLat 250;
BA_ "GenSigSendType" SG_ 348 ReSideRdrLeObj1ObjBoxCenterLat 0;
BA_ "GenSigStartValue" SG_ 348 ReSideRdrLeObj1ObjBoxCenterLgt 250;
BA_ "GenSigSendType" SG_ 348 ReSideRdrLeObj1ObjBoxCenterLgt 0;
BA_ "GenSigSendType" SG_ 348 ReSideRdrLeObj1ObservationHist 0;
BA_ "GenSigSendType" SG_ 348 ReSideRdrLeObj1RdrObjAx 0;
BA_ "GenSigSendType" SG_ 348 ReSideRdrLeObj1RdrObjAy 0;
BA_ "GenSigSendType" SG_ 348 ReSideRdrLeObj1RdrObjBoxLength 0;
BA_ "GenSigSendType" SG_ 348 ReSideRdrLeObj1RdrObjBoxWidth 0;
BA_ "GenSigSendType" SG_ 348 ReSideRdrLeObj1RdrObjChks 0;
BA_ "GenSigFuncType" SG_ 348 ReSideRdrLeObj1RdrObjChks 15;
BA_ "GenSigDataID" SG_ 348 ReSideRdrLeObj1RdrObjChks "0xA12";
BA_ "GenSigSendType" SG_ 348 ReSideRdrLeObj1RdrObjCntr 0;
BA_ "GenSigFuncType" SG_ 348 ReSideRdrLeObj1RdrObjCntr 16;
BA_ "GenSigStartValue" SG_ 348 ReSideRdrLeObj1RdrObjCoastCnt 31;
BA_ "GenSigSendType" SG_ 348 ReSideRdrLeObj1RdrObjCoastCnt 0;
BA_ "GenSigSendType" SG_ 348 ReSideRdrLeObj1RdrObjConf 0;
BA_ "GenSigSendType" SG_ 348 ReSideRdrLeObj1RdrObjDx 0;
BA_ "GenSigSendType" SG_ 348 ReSideRdrLeObj1RdrObjDxStdDe 0;
BA_ "GenSigStartValue" SG_ 348 ReSideRdrLeObj1RdrObjDy 4000;
BA_ "GenSigSendType" SG_ 348 ReSideRdrLeObj1RdrObjDy 0;
BA_ "GenSigSendType" SG_ 348 ReSideRdrLeObj1RdrObjDyStdDe 0;
BA_ "GenSigSendType" SG_ 348 ReSideRdrLeObj1RdrObjElevnConf 0;
BA_ "GenSigSendType" SG_ 348 ReSideRdrLeObj1RdrObjElevnSts 0;
BA_ "GenSigSendType" SG_ 348 ReSideRdrLeObj1RdrObjID 0;
BA_ "GenSigStartValue" SG_ 348 ReSideRdrLeObj1RdrObjIsInFreeSpace 1;
BA_ "GenSigSendType" SG_ 348 ReSideRdrLeObj1RdrObjIsInFreeSpace 0;
BA_ "GenSigSendType" SG_ 348 ReSideRdrLeObj1RdrObjMirrProblty 0;
BA_ "GenSigStartValue" SG_ 348 ReSideRdrLeObj1RdrObjMtnPat 3;
BA_ "GenSigSendType" SG_ 348 ReSideRdrLeObj1RdrObjMtnPat 0;
BA_ "GenSigSendType" SG_ 348 ReSideRdrLeObj1RdrObjNotRealProblty 0;
BA_ "GenSigSendType" SG_ 348 ReSideRdrLeObj1RdrObjStatyCnt 0;
BA_ "GenSigSendType" SG_ 348 ReSideRdrLeObj1RdrObjTiAlv 0;
BA_ "GenSigSendType" SG_ 348 ReSideRdrLeObj1RdrObjTrackSts 0;
BA_ "GenSigSendType" SG_ 348 ReSideRdrLeObj1RdrObjTyp 0;
BA_ "GenSigSendType" SG_ 348 ReSideRdrLeObj1RdrObjTypConfBike 0;
BA_ "GenSigSendType" SG_ 348 ReSideRdrLeObj1RdrObjTypConfPed 0;
BA_ "GenSigSendType" SG_ 348 ReSideRdrLeObj1RdrObjTypConfVeh 0;
BA_ "GenSigStartValue" SG_ 348 ReSideRdrLeObj1RdrObjVx 6400;
BA_ "GenSigSendType" SG_ 348 ReSideRdrLeObj1RdrObjVx 0;
BA_ "GenSigSendType" SG_ 348 ReSideRdrLeObj1RdrObjVxStdDe 0;
BA_ "GenSigStartValue" SG_ 348 ReSideRdrLeObj1RdrObjVy 6400;
BA_ "GenSigSendType" SG_ 348 ReSideRdrLeObj1RdrObjVy 0;
BA_ "GenSigSendType" SG_ 348 ReSideRdrLeObj1RdrObjVyStdDe 0;
BA_ "GenSigStartValue" SG_ 348 ReSideRdrLeObj1RelVx 1780;
BA_ "GenSigSendType" SG_ 348 ReSideRdrLeObj1RelVx 0;
BA_ "GenSigStartValue" SG_ 348 ReSideRdrLeObj1RelVy 1780;
BA_ "GenSigSendType" SG_ 348 ReSideRdrLeObj1RelVy 0;
VAL_ 332 ReSideRdrLeDetn85RdrDetnSts 0 "RdrDetnSts_Ukwn" 1 "RdrDetnSts_Movg" 2 "RdrDetnSts_Staty" 3 "RdrDetnSts_Invalid";
VAL_ 332 ReSideRdrLeDetn86RdrDetnSts 0 "RdrDetnSts_Ukwn" 1 "RdrDetnSts_Movg" 2 "RdrDetnSts_Staty" 3 "RdrDetnSts_Invalid";
VAL_ 332 ReSideRdrLeDetn87RdrDetnSts 0 "RdrDetnSts_Ukwn" 1 "RdrDetnSts_Movg" 2 "RdrDetnSts_Staty" 3 "RdrDetnSts_Invalid";
VAL_ 332 ReSideRdrLeDetn88RdrDetnSts 0 "RdrDetnSts_Ukwn" 1 "RdrDetnSts_Movg" 2 "RdrDetnSts_Staty" 3 "RdrDetnSts_Invalid";
VAL_ 332 ReSideRdrLeDetn89RdrDetnSts 0 "RdrDetnSts_Ukwn" 1 "RdrDetnSts_Movg" 2 "RdrDetnSts_Staty" 3 "RdrDetnSts_Invalid";
VAL_ 332 ReSideRdrLeDetn90RdrDetnSts 0 "RdrDetnSts_Ukwn" 1 "RdrDetnSts_Movg" 2 "RdrDetnSts_Staty" 3 "RdrDetnSts_Invalid";
VAL_ 334 ReSideRdrLeDetn91RdrDetnSts 0 "RdrDetnSts_Ukwn" 1 "RdrDetnSts_Movg" 2 "RdrDetnSts_Staty" 3 "RdrDetnSts_Invalid";
VAL_ 334 ReSideRdrLeDetn92RdrDetnSts 0 "RdrDetnSts_Ukwn" 1 "RdrDetnSts_Movg" 2 "RdrDetnSts_Staty" 3 "RdrDetnSts_Invalid";
VAL_ 334 ReSideRdrLeDetn93RdrDetnSts 0 "RdrDetnSts_Ukwn" 1 "RdrDetnSts_Movg" 2 "RdrDetnSts_Staty" 3 "RdrDetnSts_Invalid";
VAL_ 334 ReSideRdrLeDetn94RdrDetnSts 0 "RdrDetnSts_Ukwn" 1 "RdrDetnSts_Movg" 2 "RdrDetnSts_Staty" 3 "RdrDetnSts_Invalid";
VAL_ 334 ReSideRdrLeDetn95RdrDetnSts 0 "RdrDetnSts_Ukwn" 1 "RdrDetnSts_Movg" 2 "RdrDetnSts_Staty" 3 "RdrDetnSts_Invalid";
VAL_ 334 ReSideRdrLeDetn96RdrDetnSts 0 "RdrDetnSts_Ukwn" 1 "RdrDetnSts_Movg" 2 "RdrDetnSts_Staty" 3 "RdrDetnSts_Invalid";
VAL_ 336 ReSideRdrLeDetn100RdrDetnSts 0 "RdrDetnSts_Ukwn" 1 "RdrDetnSts_Movg" 2 "RdrDetnSts_Staty" 3 "RdrDetnSts_Invalid";
VAL_ 336 ReSideRdrLeDetn101RdrDetnSts 0 "RdrDetnSts_Ukwn" 1 "RdrDetnSts_Movg" 2 "RdrDetnSts_Staty" 3 "RdrDetnSts_Invalid";
VAL_ 336 ReSideRdrLeDetn102RdrDetnSts 0 "RdrDetnSts_Ukwn" 1 "RdrDetnSts_Movg" 2 "RdrDetnSts_Staty" 3 "RdrDetnSts_Invalid";
VAL_ 336 ReSideRdrLeDetn97RdrDetnSts 0 "RdrDetnSts_Ukwn" 1 "RdrDetnSts_Movg" 2 "RdrDetnSts_Staty" 3 "RdrDetnSts_Invalid";
VAL_ 336 ReSideRdrLeDetn98RdrDetnSts 0 "RdrDetnSts_Ukwn" 1 "RdrDetnSts_Movg" 2 "RdrDetnSts_Staty" 3 "RdrDetnSts_Invalid";
VAL_ 336 ReSideRdrLeDetn99RdrDetnSts 0 "RdrDetnSts_Ukwn" 1 "RdrDetnSts_Movg" 2 "RdrDetnSts_Staty" 3 "RdrDetnSts_Invalid";
VAL_ 338 ReSideRdrLeDetn103RdrDetnSts 0 "RdrDetnSts_Ukwn" 1 "RdrDetnSts_Movg" 2 "RdrDetnSts_Staty" 3 "RdrDetnSts_Invalid";
VAL_ 338 ReSideRdrLeDetn104RdrDetnSts 0 "RdrDetnSts_Ukwn" 1 "RdrDetnSts_Movg" 2 "RdrDetnSts_Staty" 3 "RdrDetnSts_Invalid";
VAL_ 338 ReSideRdrLeDetn105RdrDetnSts 0 "RdrDetnSts_Ukwn" 1 "RdrDetnSts_Movg" 2 "RdrDetnSts_Staty" 3 "RdrDetnSts_Invalid";
VAL_ 338 ReSideRdrLeDetn106RdrDetnSts 0 "RdrDetnSts_Ukwn" 1 "RdrDetnSts_Movg" 2 "RdrDetnSts_Staty" 3 "RdrDetnSts_Invalid";
VAL_ 338 ReSideRdrLeDetn107RdrDetnSts 0 "RdrDetnSts_Ukwn" 1 "RdrDetnSts_Movg" 2 "RdrDetnSts_Staty" 3 "RdrDetnSts_Invalid";
VAL_ 338 ReSideRdrLeDetn108RdrDetnSts 0 "RdrDetnSts_Ukwn" 1 "RdrDetnSts_Movg" 2 "RdrDetnSts_Staty" 3 "RdrDetnSts_Invalid";
VAL_ 340 ReSideRdrLeDetn109RdrDetnSts 0 "RdrDetnSts_Ukwn" 1 "RdrDetnSts_Movg" 2 "RdrDetnSts_Staty" 3 "RdrDetnSts_Invalid";
VAL_ 340 ReSideRdrLeDetn110RdrDetnSts 0 "RdrDetnSts_Ukwn" 1 "RdrDetnSts_Movg" 2 "RdrDetnSts_Staty" 3 "RdrDetnSts_Invalid";
VAL_ 340 ReSideRdrLeDetn111RdrDetnSts 0 "RdrDetnSts_Ukwn" 1 "RdrDetnSts_Movg" 2 "RdrDetnSts_Staty" 3 "RdrDetnSts_Invalid";
VAL_ 340 ReSideRdrLeDetn112RdrDetnSts 0 "RdrDetnSts_Ukwn" 1 "RdrDetnSts_Movg" 2 "RdrDetnSts_Staty" 3 "RdrDetnSts_Invalid";
VAL_ 340 ReSideRdrLeDetn113RdrDetnSts 0 "RdrDetnSts_Ukwn" 1 "RdrDetnSts_Movg" 2 "RdrDetnSts_Staty" 3 "RdrDetnSts_Invalid";
VAL_ 340 ReSideRdrLeDetn114RdrDetnSts 0 "RdrDetnSts_Ukwn" 1 "RdrDetnSts_Movg" 2 "RdrDetnSts_Staty" 3 "RdrDetnSts_Invalid";
VAL_ 342 ReSideRdrLeDetn115RdrDetnSts 0 "RdrDetnSts_Ukwn" 1 "RdrDetnSts_Movg" 2 "RdrDetnSts_Staty" 3 "RdrDetnSts_Invalid";
VAL_ 342 ReSideRdrLeDetn116RdrDetnSts 0 "RdrDetnSts_Ukwn" 1 "RdrDetnSts_Movg" 2 "RdrDetnSts_Staty" 3 "RdrDetnSts_Invalid";
VAL_ 342 ReSideRdrLeDetn117RdrDetnSts 0 "RdrDetnSts_Ukwn" 1 "RdrDetnSts_Movg" 2 "RdrDetnSts_Staty" 3 "RdrDetnSts_Invalid";
VAL_ 342 ReSideRdrLeDetn118RdrDetnSts 0 "RdrDetnSts_Ukwn" 1 "RdrDetnSts_Movg" 2 "RdrDetnSts_Staty" 3 "RdrDetnSts_Invalid";
VAL_ 342 ReSideRdrLeDetn119RdrDetnSts 0 "RdrDetnSts_Ukwn" 1 "RdrDetnSts_Movg" 2 "RdrDetnSts_Staty" 3 "RdrDetnSts_Invalid";
VAL_ 342 ReSideRdrLeDetn120RdrDetnSts 0 "RdrDetnSts_Ukwn" 1 "RdrDetnSts_Movg" 2 "RdrDetnSts_Staty" 3 "RdrDetnSts_Invalid";
VAL_ 344 ReSideRdrLeDetn121RdrDetnSts 0 "RdrDetnSts_Ukwn" 1 "RdrDetnSts_Movg" 2 "RdrDetnSts_Staty" 3 "RdrDetnSts_Invalid";
VAL_ 344 ReSideRdrLeDetn122RdrDetnSts 0 "RdrDetnSts_Ukwn" 1 "RdrDetnSts_Movg" 2 "RdrDetnSts_Staty" 3 "RdrDetnSts_Invalid";
VAL_ 344 ReSideRdrLeDetn123RdrDetnSts 0 "RdrDetnSts_Ukwn" 1 "RdrDetnSts_Movg" 2 "RdrDetnSts_Staty" 3 "RdrDetnSts_Invalid";
VAL_ 344 ReSideRdrLeDetn124RdrDetnSts 0 "RdrDetnSts_Ukwn" 1 "RdrDetnSts_Movg" 2 "RdrDetnSts_Staty" 3 "RdrDetnSts_Invalid";
VAL_ 344 ReSideRdrLeDetn125RdrDetnSts 0 "RdrDetnSts_Ukwn" 1 "RdrDetnSts_Movg" 2 "RdrDetnSts_Staty" 3 "RdrDetnSts_Invalid";
VAL_ 344 ReSideRdrLeDetn126RdrDetnSts 0 "RdrDetnSts_Ukwn" 1 "RdrDetnSts_Movg" 2 "RdrDetnSts_Staty" 3 "RdrDetnSts_Invalid";
VAL_ 346 ReSideRdrLeDetn127RdrDetnSts 0 "RdrDetnSts_Ukwn" 1 "RdrDetnSts_Movg" 2 "RdrDetnSts_Staty" 3 "RdrDetnSts_Invalid";
VAL_ 346 ReSideRdrLeDetn128RdrDetnSts 0 "RdrDetnSts_Ukwn" 1 "RdrDetnSts_Movg" 2 "RdrDetnSts_Staty" 3 "RdrDetnSts_Invalid";
VAL_ 348 ReSideRdrLeObj1RdrObjElevnSts 0 "RdrObjElevnSts_Unknown" 1 "RdrObjElevnSts_OverRidable" 2 "RdrObjElevnSts_Rlv" 3 "RdrObjElevnSts_UnderRidable";
VAL_ 348 ReSideRdrLeObj1RdrObjIsInFreeSpace 0 "YesNo2_No" 1 "YesNo2_Yes";
VAL_ 348 ReSideRdrLeObj1RdrObjMtnPat 0 "RdrObjMtnPat_Ukwn" 1 "RdrObjMtnPat_Staty" 2 "RdrObjMtnPat_StatyFromMovg" 3 "RdrObjMtnPat_Movg" 4 "RdrObjMtnPat_Receding" 5 "RdrObjMtnPat_Oncoming" 6 "RdrObjMtnPat_CrossingFromLe" 7 "RdrObjMtnPat_CrossingFromRi";
VAL_ 348 ReSideRdrLeObj1RdrObjTrackSts 0 "RdrObjTrackSts_Invld" 1 "RdrObjTrackSts_Updated" 2 "RdrObjTrackSts_New" 3 "RdrObjTrackSts_Coasted";
VAL_ 348 ReSideRdrLeObj1RdrObjTyp 0 "RdrObjTyp_Ukwn" 1 "RdrObjTyp_Car" 2 "RdrObjTyp_MotorCycle" 3 "RdrObjTyp_Truck" 4 "RdrObjTyp_Ped" 5 "RdrObjTyp_ObstdVert1" 6 "RdrObjTyp_ObstdVert2" 7 "RdrObjTyp_Anim" 8 "RdrObjTyp_ObjGen" 9 "RdrObjTyp_Bicycle" 10 "RdrObjTyp_VehofUkwnClass" 11 "RdrObjTyp_Reserved";
SIG_GROUP_ 336 ReSideRdrLeDetn100 1 : ReSideRdrLeDetn100RdrDetnAzi ReSideRdrLeDetn100RdrDetnChks ReSideRdrLeDetn100RdrDetnCntr ReSideRdrLeDetn100RdrDetnConf ReSideRdrLeDetn100RdrDetnElevn ReSideRdrLeDetn100RdrDetnPwr ReSideRdrLeDetn100RdrDetnRng ReSideRdrLeDetn100RdrDetnRngV ReSideRdrLeDetn100RdrDetnSts;
SIG_GROUP_ 336 ReSideRdrLeDetn101 1 : ReSideRdrLeDetn101RdrDetnAzi ReSideRdrLeDetn101RdrDetnChks ReSideRdrLeDetn101RdrDetnCntr ReSideRdrLeDetn101RdrDetnConf ReSideRdrLeDetn101RdrDetnElevn ReSideRdrLeDetn101RdrDetnPwr ReSideRdrLeDetn101RdrDetnRng ReSideRdrLeDetn101RdrDetnRngV ReSideRdrLeDetn101RdrDetnSts;
SIG_GROUP_ 336 ReSideRdrLeDetn102 1 : ReSideRdrLeDetn102RdrDetnAzi ReSideRdrLeDetn102RdrDetnChks ReSideRdrLeDetn102RdrDetnCntr ReSideRdrLeDetn102RdrDetnConf ReSideRdrLeDetn102RdrDetnElevn ReSideRdrLeDetn102RdrDetnPwr ReSideRdrLeDetn102RdrDetnRng ReSideRdrLeDetn102RdrDetnRngV ReSideRdrLeDetn102RdrDetnSts;
SIG_GROUP_ 338 ReSideRdrLeDetn103 1 : ReSideRdrLeDetn103RdrDetnAzi ReSideRdrLeDetn103RdrDetnChks ReSideRdrLeDetn103RdrDetnCntr ReSideRdrLeDetn103RdrDetnConf ReSideRdrLeDetn103RdrDetnElevn ReSideRdrLeDetn103RdrDetnPwr ReSideRdrLeDetn103RdrDetnRng ReSideRdrLeDetn103RdrDetnRngV ReSideRdrLeDetn103RdrDetnSts;
SIG_GROUP_ 338 ReSideRdrLeDetn104 1 : ReSideRdrLeDetn104RdrDetnAzi ReSideRdrLeDetn104RdrDetnChks ReSideRdrLeDetn104RdrDetnCntr ReSideRdrLeDetn104RdrDetnConf ReSideRdrLeDetn104RdrDetnElevn ReSideRdrLeDetn104RdrDetnPwr ReSideRdrLeDetn104RdrDetnRng ReSideRdrLeDetn104RdrDetnRngV ReSideRdrLeDetn104RdrDetnSts;
SIG_GROUP_ 338 ReSideRdrLeDetn105 1 : ReSideRdrLeDetn105RdrDetnAzi ReSideRdrLeDetn105RdrDetnChks ReSideRdrLeDetn105RdrDetnCntr ReSideRdrLeDetn105RdrDetnConf ReSideRdrLeDetn105RdrDetnElevn ReSideRdrLeDetn105RdrDetnPwr ReSideRdrLeDetn105RdrDetnRng ReSideRdrLeDetn105RdrDetnRngV ReSideRdrLeDetn105RdrDetnSts;
SIG_GROUP_ 338 ReSideRdrLeDetn106 1 : ReSideRdrLeDetn106RdrDetnAzi ReSideRdrLeDetn106RdrDetnChks ReSideRdrLeDetn106RdrDetnCntr ReSideRdrLeDetn106RdrDetnConf ReSideRdrLeDetn106RdrDetnElevn ReSideRdrLeDetn106RdrDetnPwr ReSideRdrLeDetn106RdrDetnRng ReSideRdrLeDetn106RdrDetnRngV ReSideRdrLeDetn106RdrDetnSts;
SIG_GROUP_ 338 ReSideRdrLeDetn107 1 : ReSideRdrLeDetn107RdrDetnAzi ReSideRdrLeDetn107RdrDetnChks ReSideRdrLeDetn107RdrDetnCntr ReSideRdrLeDetn107RdrDetnConf ReSideRdrLeDetn107RdrDetnElevn ReSideRdrLeDetn107RdrDetnPwr ReSideRdrLeDetn107RdrDetnRng ReSideRdrLeDetn107RdrDetnRngV ReSideRdrLeDetn107RdrDetnSts;
SIG_GROUP_ 338 ReSideRdrLeDetn108 1 : ReSideRdrLeDetn108RdrDetnAzi ReSideRdrLeDetn108RdrDetnChks ReSideRdrLeDetn108RdrDetnCntr ReSideRdrLeDetn108RdrDetnConf ReSideRdrLeDetn108RdrDetnElevn ReSideRdrLeDetn108RdrDetnPwr ReSideRdrLeDetn108RdrDetnRng ReSideRdrLeDetn108RdrDetnRngV ReSideRdrLeDetn108RdrDetnSts;
SIG_GROUP_ 340 ReSideRdrLeDetn109 1 : ReSideRdrLeDetn109RdrDetnAzi ReSideRdrLeDetn109RdrDetnChks ReSideRdrLeDetn109RdrDetnCntr ReSideRdrLeDetn109RdrDetnConf ReSideRdrLeDetn109RdrDetnElevn ReSideRdrLeDetn109RdrDetnPwr ReSideRdrLeDetn109RdrDetnRng ReSideRdrLeDetn109RdrDetnRngV ReSideRdrLeDetn109RdrDetnSts;
SIG_GROUP_ 340 ReSideRdrLeDetn110 1 : ReSideRdrLeDetn110RdrDetnAzi ReSideRdrLeDetn110RdrDetnChks ReSideRdrLeDetn110RdrDetnCntr ReSideRdrLeDetn110RdrDetnConf ReSideRdrLeDetn110RdrDetnElevn ReSideRdrLeDetn110RdrDetnPwr ReSideRdrLeDetn110RdrDetnRng ReSideRdrLeDetn110RdrDetnRngV ReSideRdrLeDetn110RdrDetnSts;
SIG_GROUP_ 340 ReSideRdrLeDetn111 1 : ReSideRdrLeDetn111RdrDetnAzi ReSideRdrLeDetn111RdrDetnChks ReSideRdrLeDetn111RdrDetnCntr ReSideRdrLeDetn111RdrDetnConf ReSideRdrLeDetn111RdrDetnElevn ReSideRdrLeDetn111RdrDetnPwr ReSideRdrLeDetn111RdrDetnRng ReSideRdrLeDetn111RdrDetnRngV ReSideRdrLeDetn111RdrDetnSts;
SIG_GROUP_ 340 ReSideRdrLeDetn112 1 : ReSideRdrLeDetn112RdrDetnAzi ReSideRdrLeDetn112RdrDetnChks ReSideRdrLeDetn112RdrDetnCntr ReSideRdrLeDetn112RdrDetnConf ReSideRdrLeDetn112RdrDetnElevn ReSideRdrLeDetn112RdrDetnPwr ReSideRdrLeDetn112RdrDetnRng ReSideRdrLeDetn112RdrDetnRngV ReSideRdrLeDetn112RdrDetnSts;
SIG_GROUP_ 340 ReSideRdrLeDetn113 1 : ReSideRdrLeDetn113RdrDetnAzi ReSideRdrLeDetn113RdrDetnChks ReSideRdrLeDetn113RdrDetnCntr ReSideRdrLeDetn113RdrDetnConf ReSideRdrLeDetn113RdrDetnElevn ReSideRdrLeDetn113RdrDetnPwr ReSideRdrLeDetn113RdrDetnRng ReSideRdrLeDetn113RdrDetnRngV ReSideRdrLeDetn113RdrDetnSts;
SIG_GROUP_ 340 ReSideRdrLeDetn114 1 : ReSideRdrLeDetn114RdrDetnAzi ReSideRdrLeDetn114RdrDetnChks ReSideRdrLeDetn114RdrDetnCntr ReSideRdrLeDetn114RdrDetnConf ReSideRdrLeDetn114RdrDetnElevn ReSideRdrLeDetn114RdrDetnPwr ReSideRdrLeDetn114RdrDetnRng ReSideRdrLeDetn114RdrDetnRngV ReSideRdrLeDetn114RdrDetnSts;
SIG_GROUP_ 342 ReSideRdrLeDetn115 1 : ReSideRdrLeDetn115RdrDetnAzi ReSideRdrLeDetn115RdrDetnChks ReSideRdrLeDetn115RdrDetnCntr ReSideRdrLeDetn115RdrDetnConf ReSideRdrLeDetn115RdrDetnElevn ReSideRdrLeDetn115RdrDetnPwr ReSideRdrLeDetn115RdrDetnRng ReSideRdrLeDetn115RdrDetnRngV ReSideRdrLeDetn115RdrDetnSts;
SIG_GROUP_ 342 ReSideRdrLeDetn116 1 : ReSideRdrLeDetn116RdrDetnAzi ReSideRdrLeDetn116RdrDetnChks ReSideRdrLeDetn116RdrDetnCntr ReSideRdrLeDetn116RdrDetnConf ReSideRdrLeDetn116RdrDetnElevn ReSideRdrLeDetn116RdrDetnPwr ReSideRdrLeDetn116RdrDetnRng ReSideRdrLeDetn116RdrDetnRngV ReSideRdrLeDetn116RdrDetnSts;
SIG_GROUP_ 342 ReSideRdrLeDetn117 1 : ReSideRdrLeDetn117RdrDetnAzi ReSideRdrLeDetn117RdrDetnChks ReSideRdrLeDetn117RdrDetnCntr ReSideRdrLeDetn117RdrDetnConf ReSideRdrLeDetn117RdrDetnElevn ReSideRdrLeDetn117RdrDetnPwr ReSideRdrLeDetn117RdrDetnRng ReSideRdrLeDetn117RdrDetnRngV ReSideRdrLeDetn117RdrDetnSts;
SIG_GROUP_ 342 ReSideRdrLeDetn118 1 : ReSideRdrLeDetn118RdrDetnAzi ReSideRdrLeDetn118RdrDetnChks ReSideRdrLeDetn118RdrDetnCntr ReSideRdrLeDetn118RdrDetnConf ReSideRdrLeDetn118RdrDetnElevn ReSideRdrLeDetn118RdrDetnPwr ReSideRdrLeDetn118RdrDetnRng ReSideRdrLeDetn118RdrDetnRngV ReSideRdrLeDetn118RdrDetnSts;
SIG_GROUP_ 342 ReSideRdrLeDetn119 1 : ReSideRdrLeDetn119RdrDetnAzi ReSideRdrLeDetn119RdrDetnChks ReSideRdrLeDetn119RdrDetnCntr ReSideRdrLeDetn119RdrDetnConf ReSideRdrLeDetn119RdrDetnElevn ReSideRdrLeDetn119RdrDetnPwr ReSideRdrLeDetn119RdrDetnRng ReSideRdrLeDetn119RdrDetnRngV ReSideRdrLeDetn119RdrDetnSts;
SIG_GROUP_ 342 ReSideRdrLeDetn120 1 : ReSideRdrLeDetn120RdrDetnAzi ReSideRdrLeDetn120RdrDetnChks ReSideRdrLeDetn120RdrDetnCntr ReSideRdrLeDetn120RdrDetnConf ReSideRdrLeDetn120RdrDetnElevn ReSideRdrLeDetn120RdrDetnPwr ReSideRdrLeDetn120RdrDetnRng ReSideRdrLeDetn120RdrDetnRngV ReSideRdrLeDetn120RdrDetnSts;
SIG_GROUP_ 344 ReSideRdrLeDetn121 1 : ReSideRdrLeDetn121RdrDetnAzi ReSideRdrLeDetn121RdrDetnChks ReSideRdrLeDetn121RdrDetnCntr ReSideRdrLeDetn121RdrDetnConf ReSideRdrLeDetn121RdrDetnElevn ReSideRdrLeDetn121RdrDetnPwr ReSideRdrLeDetn121RdrDetnRng ReSideRdrLeDetn121RdrDetnRngV ReSideRdrLeDetn121RdrDetnSts;
SIG_GROUP_ 344 ReSideRdrLeDetn122 1 : ReSideRdrLeDetn122RdrDetnAzi ReSideRdrLeDetn122RdrDetnChks ReSideRdrLeDetn122RdrDetnCntr ReSideRdrLeDetn122RdrDetnConf ReSideRdrLeDetn122RdrDetnElevn ReSideRdrLeDetn122RdrDetnPwr ReSideRdrLeDetn122RdrDetnRng ReSideRdrLeDetn122RdrDetnRngV ReSideRdrLeDetn122RdrDetnSts;
SIG_GROUP_ 344 ReSideRdrLeDetn123 1 : ReSideRdrLeDetn123RdrDetnAzi ReSideRdrLeDetn123RdrDetnChks ReSideRdrLeDetn123RdrDetnCntr ReSideRdrLeDetn123RdrDetnConf ReSideRdrLeDetn123RdrDetnElevn ReSideRdrLeDetn123RdrDetnPwr ReSideRdrLeDetn123RdrDetnRng ReSideRdrLeDetn123RdrDetnRngV ReSideRdrLeDetn123RdrDetnSts;
SIG_GROUP_ 344 ReSideRdrLeDetn124 1 : ReSideRdrLeDetn124RdrDetnAzi ReSideRdrLeDetn124RdrDetnChks ReSideRdrLeDetn124RdrDetnCntr ReSideRdrLeDetn124RdrDetnConf ReSideRdrLeDetn124RdrDetnElevn ReSideRdrLeDetn124RdrDetnPwr ReSideRdrLeDetn124RdrDetnRng ReSideRdrLeDetn124RdrDetnRngV ReSideRdrLeDetn124RdrDetnSts;
SIG_GROUP_ 344 ReSideRdrLeDetn125 1 : ReSideRdrLeDetn125RdrDetnAzi ReSideRdrLeDetn125RdrDetnChks ReSideRdrLeDetn125RdrDetnCntr ReSideRdrLeDetn125RdrDetnConf ReSideRdrLeDetn125RdrDetnElevn ReSideRdrLeDetn125RdrDetnPwr ReSideRdrLeDetn125RdrDetnRng ReSideRdrLeDetn125RdrDetnRngV ReSideRdrLeDetn125RdrDetnSts;
SIG_GROUP_ 344 ReSideRdrLeDetn126 1 : ReSideRdrLeDetn126RdrDetnAzi ReSideRdrLeDetn126RdrDetnChks ReSideRdrLeDetn126RdrDetnCntr ReSideRdrLeDetn126RdrDetnConf ReSideRdrLeDetn126RdrDetnElevn ReSideRdrLeDetn126RdrDetnPwr ReSideRdrLeDetn126RdrDetnRng ReSideRdrLeDetn126RdrDetnRngV ReSideRdrLeDetn126RdrDetnSts;
SIG_GROUP_ 346 ReSideRdrLeDetn127 1 : ReSideRdrLeDetn127RdrDetnAzi ReSideRdrLeDetn127RdrDetnChks ReSideRdrLeDetn127RdrDetnCntr ReSideRdrLeDetn127RdrDetnConf ReSideRdrLeDetn127RdrDetnElevn ReSideRdrLeDetn127RdrDetnPwr ReSideRdrLeDetn127RdrDetnRng ReSideRdrLeDetn127RdrDetnRngV ReSideRdrLeDetn127RdrDetnSts;
SIG_GROUP_ 346 ReSideRdrLeDetn128 1 : ReSideRdrLeDetn128RdrDetnAzi ReSideRdrLeDetn128RdrDetnChks ReSideRdrLeDetn128RdrDetnCntr ReSideRdrLeDetn128RdrDetnConf ReSideRdrLeDetn128RdrDetnElevn ReSideRdrLeDetn128RdrDetnPwr ReSideRdrLeDetn128RdrDetnRng ReSideRdrLeDetn128RdrDetnRngV ReSideRdrLeDetn128RdrDetnSts;
SIG_GROUP_ 332 ReSideRdrLeDetn85 1 : ReSideRdrLeDetn85RdrDetnAzi ReSideRdrLeDetn85RdrDetnChks ReSideRdrLeDetn85RdrDetnCntr ReSideRdrLeDetn85RdrDetnConf ReSideRdrLeDetn85RdrDetnElevn ReSideRdrLeDetn85RdrDetnPwr ReSideRdrLeDetn85RdrDetnRng ReSideRdrLeDetn85RdrDetnRngV ReSideRdrLeDetn85RdrDetnSts;
SIG_GROUP_ 332 ReSideRdrLeDetn86 1 : ReSideRdrLeDetn86RdrDetnAzi ReSideRdrLeDetn86RdrDetnChks ReSideRdrLeDetn86RdrDetnCntr ReSideRdrLeDetn86RdrDetnConf ReSideRdrLeDetn86RdrDetnElevn ReSideRdrLeDetn86RdrDetnPwr ReSideRdrLeDetn86RdrDetnRng ReSideRdrLeDetn86RdrDetnRngV ReSideRdrLeDetn86RdrDetnSts;
SIG_GROUP_ 332 ReSideRdrLeDetn87 1 : ReSideRdrLeDetn87RdrDetnAzi ReSideRdrLeDetn87RdrDetnChks ReSideRdrLeDetn87RdrDetnCntr ReSideRdrLeDetn87RdrDetnConf ReSideRdrLeDetn87RdrDetnElevn ReSideRdrLeDetn87RdrDetnPwr ReSideRdrLeDetn87RdrDetnRng ReSideRdrLeDetn87RdrDetnRngV ReSideRdrLeDetn87RdrDetnSts;
SIG_GROUP_ 332 ReSideRdrLeDetn88 1 : ReSideRdrLeDetn88RdrDetnAzi ReSideRdrLeDetn88RdrDetnChks ReSideRdrLeDetn88RdrDetnCntr ReSideRdrLeDetn88RdrDetnConf ReSideRdrLeDetn88RdrDetnElevn ReSideRdrLeDetn88RdrDetnPwr ReSideRdrLeDetn88RdrDetnRng ReSideRdrLeDetn88RdrDetnRngV ReSideRdrLeDetn88RdrDetnSts;
SIG_GROUP_ 332 ReSideRdrLeDetn89 1 : ReSideRdrLeDetn89RdrDetnAzi ReSideRdrLeDetn89RdrDetnChks ReSideRdrLeDetn89RdrDetnCntr ReSideRdrLeDetn89RdrDetnConf ReSideRdrLeDetn89RdrDetnElevn ReSideRdrLeDetn89RdrDetnPwr ReSideRdrLeDetn89RdrDetnRng ReSideRdrLeDetn89RdrDetnRngV ReSideRdrLeDetn89RdrDetnSts;
SIG_GROUP_ 332 ReSideRdrLeDetn90 1 : ReSideRdrLeDetn90RdrDetnAzi ReSideRdrLeDetn90RdrDetnChks ReSideRdrLeDetn90RdrDetnCntr ReSideRdrLeDetn90RdrDetnConf ReSideRdrLeDetn90RdrDetnElevn ReSideRdrLeDetn90RdrDetnPwr ReSideRdrLeDetn90RdrDetnRng ReSideRdrLeDetn90RdrDetnRngV ReSideRdrLeDetn90RdrDetnSts;
SIG_GROUP_ 334 ReSideRdrLeDetn91 1 : ReSideRdrLeDetn91RdrDetnAzi ReSideRdrLeDetn91RdrDetnChks ReSideRdrLeDetn91RdrDetnCntr ReSideRdrLeDetn91RdrDetnConf ReSideRdrLeDetn91RdrDetnElevn ReSideRdrLeDetn91RdrDetnPwr ReSideRdrLeDetn91RdrDetnRng ReSideRdrLeDetn91RdrDetnRngV ReSideRdrLeDetn91RdrDetnSts;
SIG_GROUP_ 334 ReSideRdrLeDetn92 1 : ReSideRdrLeDetn92RdrDetnAzi ReSideRdrLeDetn92RdrDetnChks ReSideRdrLeDetn92RdrDetnCntr ReSideRdrLeDetn92RdrDetnConf ReSideRdrLeDetn92RdrDetnElevn ReSideRdrLeDetn92RdrDetnPwr ReSideRdrLeDetn92RdrDetnRng ReSideRdrLeDetn92RdrDetnRngV ReSideRdrLeDetn92RdrDetnSts;
SIG_GROUP_ 334 ReSideRdrLeDetn93 1 : ReSideRdrLeDetn93RdrDetnAzi ReSideRdrLeDetn93RdrDetnChks ReSideRdrLeDetn93RdrDetnCntr ReSideRdrLeDetn93RdrDetnConf ReSideRdrLeDetn93RdrDetnElevn ReSideRdrLeDetn93RdrDetnPwr ReSideRdrLeDetn93RdrDetnRng ReSideRdrLeDetn93RdrDetnRngV ReSideRdrLeDetn93RdrDetnSts;
SIG_GROUP_ 334 ReSideRdrLeDetn94 1 : ReSideRdrLeDetn94RdrDetnAzi ReSideRdrLeDetn94RdrDetnChks ReSideRdrLeDetn94RdrDetnCntr ReSideRdrLeDetn94RdrDetnConf ReSideRdrLeDetn94RdrDetnElevn ReSideRdrLeDetn94RdrDetnPwr ReSideRdrLeDetn94RdrDetnRng ReSideRdrLeDetn94RdrDetnRngV ReSideRdrLeDetn94RdrDetnSts;
SIG_GROUP_ 334 ReSideRdrLeDetn95 1 : ReSideRdrLeDetn95RdrDetnAzi ReSideRdrLeDetn95RdrDetnChks ReSideRdrLeDetn95RdrDetnCntr ReSideRdrLeDetn95RdrDetnConf ReSideRdrLeDetn95RdrDetnElevn ReSideRdrLeDetn95RdrDetnPwr ReSideRdrLeDetn95RdrDetnRng ReSideRdrLeDetn95RdrDetnRngV ReSideRdrLeDetn95RdrDetnSts;
SIG_GROUP_ 334 ReSideRdrLeDetn96 1 : ReSideRdrLeDetn96RdrDetnAzi ReSideRdrLeDetn96RdrDetnChks ReSideRdrLeDetn96RdrDetnCntr ReSideRdrLeDetn96RdrDetnConf ReSideRdrLeDetn96RdrDetnElevn ReSideRdrLeDetn96RdrDetnPwr ReSideRdrLeDetn96RdrDetnRng ReSideRdrLeDetn96RdrDetnRngV ReSideRdrLeDetn96RdrDetnSts;
SIG_GROUP_ 336 ReSideRdrLeDetn97 1 : ReSideRdrLeDetn97RdrDetnAzi ReSideRdrLeDetn97RdrDetnChks ReSideRdrLeDetn97RdrDetnCntr ReSideRdrLeDetn97RdrDetnConf ReSideRdrLeDetn97RdrDetnElevn ReSideRdrLeDetn97RdrDetnPwr ReSideRdrLeDetn97RdrDetnRng ReSideRdrLeDetn97RdrDetnRngV ReSideRdrLeDetn97RdrDetnSts;
SIG_GROUP_ 336 ReSideRdrLeDetn98 1 : ReSideRdrLeDetn98RdrDetnAzi ReSideRdrLeDetn98RdrDetnChks ReSideRdrLeDetn98RdrDetnCntr ReSideRdrLeDetn98RdrDetnConf ReSideRdrLeDetn98RdrDetnElevn ReSideRdrLeDetn98RdrDetnPwr ReSideRdrLeDetn98RdrDetnRng ReSideRdrLeDetn98RdrDetnRngV ReSideRdrLeDetn98RdrDetnSts;
SIG_GROUP_ 336 ReSideRdrLeDetn99 1 : ReSideRdrLeDetn99RdrDetnAzi ReSideRdrLeDetn99RdrDetnChks ReSideRdrLeDetn99RdrDetnCntr ReSideRdrLeDetn99RdrDetnConf ReSideRdrLeDetn99RdrDetnElevn ReSideRdrLeDetn99RdrDetnPwr ReSideRdrLeDetn99RdrDetnRng ReSideRdrLeDetn99RdrDetnRngV ReSideRdrLeDetn99RdrDetnSts;
SIG_GROUP_ 348 ReSideRdrLeObj1 1 : ReSideRdrLeObj1Heading ReSideRdrLeObj1ObjBoxCenterLat ReSideRdrLeObj1ObjBoxCenterLgt ReSideRdrLeObj1ObservationHist ReSideRdrLeObj1RdrObjAx ReSideRdrLeObj1RdrObjAy ReSideRdrLeObj1RdrObjBoxLength ReSideRdrLeObj1RdrObjBoxWidth ReSideRdrLeObj1RdrObjChks ReSideRdrLeObj1RdrObjCntr ReSideRdrLeObj1RdrObjCoastCnt ReSideRdrLeObj1RdrObjConf ReSideRdrLeObj1RdrObjDx ReSideRdrLeObj1RdrObjDxStdDe ReSideRdrLeObj1RdrObjDy ReSideRdrLeObj1RdrObjDyStdDe ReSideRdrLeObj1RdrObjElevnConf ReSideRdrLeObj1RdrObjElevnSts ReSideRdrLeObj1RdrObjID ReSideRdrLeObj1RdrObjIsInFreeSpace ReSideRdrLeObj1RdrObjMirrProblty ReSideRdrLeObj1RdrObjMtnPat ReSideRdrLeObj1RdrObjNotRealProblty ReSideRdrLeObj1RdrObjStatyCnt ReSideRdrLeObj1RdrObjTiAlv ReSideRdrLeObj1RdrObjTrackSts ReSideRdrLeObj1RdrObjTyp ReSideRdrLeObj1RdrObjTypConfBike ReSideRdrLeObj1RdrObjTypConfPed ReSideRdrLeObj1RdrObjTypConfVeh ReSideRdrLeObj1RdrObjVx ReSideRdrLeObj1RdrObjVxStdDe ReSideRdrLeObj1RdrObjVy ReSideRdrLeObj1RdrObjVyStdDe ReSideRdrLeObj1RelVx ReSideRdrLeObj1RelVy;
