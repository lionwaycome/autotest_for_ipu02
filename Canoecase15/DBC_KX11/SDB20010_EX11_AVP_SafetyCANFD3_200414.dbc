// *************************************************************************** *
// *                                                                           *
// *                      Mentor Graphics Corporation                          *
// *                          All rights reserved                              *
// *                                                                           *
// *************************************************************************** *
// *                                                                           *
// * Description:         CANDB File                                           *
// * Generated at:        2020-04-14 13:14:03                                  *
// * System:              SDB20010                                             *
// * Variant:             EX11_AVP                                             *
// * Network:             SafetyCANFD3                                         *
// *                                                                           *
// *************************************************************************** *
// *                                                                           *
// *             THIS CONFIGURATION MIGHT CONTAIN SOME ERRORS                  *
// *              IF THE INPUT MODEL WAS NOT PROPERLY FORMED!                  *
// *                    Do Not Use this File directly!                         *
// *                                                                           *
// *************************************************************************** *
VERSION "SafetyCANFD3"

NS_ :

BS_:

BU_:  ASDM ETC PAS SODL SODR

BO_ 335 SODRSafetyCANFD3Frame16: 64 SODR
 SG_ ReSideRdrRiDetn91_UB : 74|1@0+ (1,0) [0|1] "" ASDM,PAS
 SG_ ReSideRdrRiDetn91RdrDetnAzi : 31|11@0+ (0.1,-90.0) [-90.0|90.0] "Deg" ASDM,PAS
 SG_ ReSideRdrRiDetn91RdrDetnChks : 7|8@0+ (1.0,0.0) [0.0|255.0] "Unitless" ASDM,PAS
 SG_ ReSideRdrRiDetn91RdrDetnCntr : 15|4@0+ (1.0,0.0) [0.0|15.0] "Unitless" ASDM,PAS
 SG_ ReSideRdrRiDetn91RdrDetnConf : 71|7@0+ (1.0,0.0) [0.0|100.0] "%" ASDM,PAS
 SG_ ReSideRdrRiDetn91RdrDetnElevn : 79|5@0+ (1.0,-15.0) [-15.0|15.0] "Deg" ASDM,PAS
 SG_ ReSideRdrRiDetn91RdrDetnPwr : 8|9@0+ (0.1,0.0) [0.0|51.1] "dB" ASDM,PAS
 SG_ ReSideRdrRiDetn91RdrDetnRng : 55|14@0+ (0.02,-1.0) [-1.0|200.0] "m" ASDM,PAS
 SG_ ReSideRdrRiDetn91RdrDetnRngV : 36|13@0+ (0.02,-80.0) [-80.0|80.0] "m/s" ASDM,PAS
 SG_ ReSideRdrRiDetn91RdrDetnSts : 11|2@0+ (1,0) [0|3] "" ASDM,PAS
 SG_ ReSideRdrRiDetn92_UB : 154|1@0+ (1,0) [0|1] "" ASDM,PAS
 SG_ ReSideRdrRiDetn92RdrDetnAzi : 119|11@0+ (0.1,-90.0) [-90.0|90.0] "Deg" ASDM,PAS
 SG_ ReSideRdrRiDetn92RdrDetnChks : 87|8@0+ (1.0,0.0) [0.0|255.0] "Unitless" ASDM,PAS
 SG_ ReSideRdrRiDetn92RdrDetnCntr : 95|4@0+ (1.0,0.0) [0.0|15.0] "Unitless" ASDM,PAS
 SG_ ReSideRdrRiDetn92RdrDetnConf : 111|7@0+ (1.0,0.0) [0.0|100.0] "%" ASDM,PAS
 SG_ ReSideRdrRiDetn92RdrDetnElevn : 159|5@0+ (1.0,-15.0) [-15.0|15.0] "Deg" ASDM,PAS
 SG_ ReSideRdrRiDetn92RdrDetnPwr : 89|9@0+ (0.1,0.0) [0.0|51.1] "dB" ASDM,PAS
 SG_ ReSideRdrRiDetn92RdrDetnRng : 143|14@0+ (0.02,-1.0) [-1.0|200.0] "m" ASDM,PAS
 SG_ ReSideRdrRiDetn92RdrDetnRngV : 124|13@0+ (0.02,-80.0) [-80.0|80.0] "m/s" ASDM,PAS
 SG_ ReSideRdrRiDetn92RdrDetnSts : 91|2@0+ (1,0) [0|3] "" ASDM,PAS
 SG_ ReSideRdrRiDetn93_UB : 234|1@0+ (1,0) [0|1] "" ASDM,PAS
 SG_ ReSideRdrRiDetn93RdrDetnAzi : 199|11@0+ (0.1,-90.0) [-90.0|90.0] "Deg" ASDM,PAS
 SG_ ReSideRdrRiDetn93RdrDetnChks : 167|8@0+ (1.0,0.0) [0.0|255.0] "Unitless" ASDM,PAS
 SG_ ReSideRdrRiDetn93RdrDetnCntr : 175|4@0+ (1.0,0.0) [0.0|15.0] "Unitless" ASDM,PAS
 SG_ ReSideRdrRiDetn93RdrDetnConf : 191|7@0+ (1.0,0.0) [0.0|100.0] "%" ASDM,PAS
 SG_ ReSideRdrRiDetn93RdrDetnElevn : 239|5@0+ (1.0,-15.0) [-15.0|15.0] "Deg" ASDM,PAS
 SG_ ReSideRdrRiDetn93RdrDetnPwr : 169|9@0+ (0.1,0.0) [0.0|51.1] "dB" ASDM,PAS
 SG_ ReSideRdrRiDetn93RdrDetnRng : 223|14@0+ (0.02,-1.0) [-1.0|200.0] "m" ASDM,PAS
 SG_ ReSideRdrRiDetn93RdrDetnRngV : 204|13@0+ (0.02,-80.0) [-80.0|80.0] "m/s" ASDM,PAS
 SG_ ReSideRdrRiDetn93RdrDetnSts : 171|2@0+ (1,0) [0|3] "" ASDM,PAS
 SG_ ReSideRdrRiDetn94_UB : 314|1@0+ (1,0) [0|1] "" ASDM,PAS
 SG_ ReSideRdrRiDetn94RdrDetnAzi : 287|11@0+ (0.1,-90.0) [-90.0|90.0] "Deg" ASDM,PAS
 SG_ ReSideRdrRiDetn94RdrDetnChks : 247|8@0+ (1.0,0.0) [0.0|255.0] "Unitless" ASDM,PAS
 SG_ ReSideRdrRiDetn94RdrDetnCntr : 255|4@0+ (1.0,0.0) [0.0|15.0] "Unitless" ASDM,PAS
 SG_ ReSideRdrRiDetn94RdrDetnConf : 311|7@0+ (1.0,0.0) [0.0|100.0] "%" ASDM,PAS
 SG_ ReSideRdrRiDetn94RdrDetnElevn : 319|5@0+ (1.0,-15.0) [-15.0|15.0] "Deg" ASDM,PAS
 SG_ ReSideRdrRiDetn94RdrDetnPwr : 249|9@0+ (0.1,0.0) [0.0|51.1] "dB" ASDM,PAS
 SG_ ReSideRdrRiDetn94RdrDetnRng : 271|14@0+ (0.02,-1.0) [-1.0|200.0] "m" ASDM,PAS
 SG_ ReSideRdrRiDetn94RdrDetnRngV : 292|13@0+ (0.02,-80.0) [-80.0|80.0] "m/s" ASDM,PAS
 SG_ ReSideRdrRiDetn94RdrDetnSts : 251|2@0+ (1,0) [0|3] "" ASDM,PAS
 SG_ ReSideRdrRiDetn95_UB : 394|1@0+ (1,0) [0|1] "" ASDM,PAS
 SG_ ReSideRdrRiDetn95RdrDetnAzi : 351|11@0+ (0.1,-90.0) [-90.0|90.0] "Deg" ASDM,PAS
 SG_ ReSideRdrRiDetn95RdrDetnChks : 327|8@0+ (1.0,0.0) [0.0|255.0] "Unitless" ASDM,PAS
 SG_ ReSideRdrRiDetn95RdrDetnCntr : 335|4@0+ (1.0,0.0) [0.0|15.0] "Unitless" ASDM,PAS
 SG_ ReSideRdrRiDetn95RdrDetnConf : 391|7@0+ (1.0,0.0) [0.0|100.0] "%" ASDM,PAS
 SG_ ReSideRdrRiDetn95RdrDetnElevn : 399|5@0+ (1.0,-15.0) [-15.0|15.0] "Deg" ASDM,PAS
 SG_ ReSideRdrRiDetn95RdrDetnPwr : 329|9@0+ (0.1,0.0) [0.0|51.1] "dB" ASDM,PAS
 SG_ ReSideRdrRiDetn95RdrDetnRng : 375|14@0+ (0.02,-1.0) [-1.0|200.0] "m" ASDM,PAS
 SG_ ReSideRdrRiDetn95RdrDetnRngV : 356|13@0+ (0.02,-80.0) [-80.0|80.0] "m/s" ASDM,PAS
 SG_ ReSideRdrRiDetn95RdrDetnSts : 331|2@0+ (1,0) [0|3] "" ASDM,PAS
 SG_ ReSideRdrRiDetn96_UB : 474|1@0+ (1,0) [0|1] "" ASDM,PAS
 SG_ ReSideRdrRiDetn96RdrDetnAzi : 447|11@0+ (0.1,-90.0) [-90.0|90.0] "Deg" ASDM,PAS
 SG_ ReSideRdrRiDetn96RdrDetnChks : 407|8@0+ (1.0,0.0) [0.0|255.0] "Unitless" ASDM,PAS
 SG_ ReSideRdrRiDetn96RdrDetnCntr : 415|4@0+ (1.0,0.0) [0.0|15.0] "Unitless" ASDM,PAS
 SG_ ReSideRdrRiDetn96RdrDetnConf : 471|7@0+ (1.0,0.0) [0.0|100.0] "%" ASDM,PAS
 SG_ ReSideRdrRiDetn96RdrDetnElevn : 479|5@0+ (1.0,-15.0) [-15.0|15.0] "Deg" ASDM,PAS
 SG_ ReSideRdrRiDetn96RdrDetnPwr : 409|9@0+ (0.1,0.0) [0.0|51.1] "dB" ASDM,PAS
 SG_ ReSideRdrRiDetn96RdrDetnRng : 431|14@0+ (0.02,-1.0) [-1.0|200.0] "m" ASDM,PAS
 SG_ ReSideRdrRiDetn96RdrDetnRngV : 452|13@0+ (0.02,-80.0) [-80.0|80.0] "m/s" ASDM,PAS
 SG_ ReSideRdrRiDetn96RdrDetnSts : 411|2@0+ (1,0) [0|3] "" ASDM,PAS

BO_ 337 SODRSafetyCANFD3Frame17: 64 SODR
 SG_ ReSideRdrRiDetn100_UB : 314|1@0+ (1,0) [0|1] "" ASDM,PAS
 SG_ ReSideRdrRiDetn100RdrDetnAzi : 287|11@0+ (0.1,-90.0) [-90.0|90.0] "Deg" ASDM,PAS
 SG_ ReSideRdrRiDetn100RdrDetnChks : 247|8@0+ (1.0,0.0) [0.0|255.0] "Unitless" ASDM,PAS
 SG_ ReSideRdrRiDetn100RdrDetnCntr : 255|4@0+ (1.0,0.0) [0.0|15.0] "Unitless" ASDM,PAS
 SG_ ReSideRdrRiDetn100RdrDetnConf : 311|7@0+ (1.0,0.0) [0.0|100.0] "%" ASDM,PAS
 SG_ ReSideRdrRiDetn100RdrDetnElevn : 319|5@0+ (1.0,-15.0) [-15.0|15.0] "Deg" ASDM,PAS
 SG_ ReSideRdrRiDetn100RdrDetnPwr : 249|9@0+ (0.1,0.0) [0.0|51.1] "dB" ASDM,PAS
 SG_ ReSideRdrRiDetn100RdrDetnRng : 271|14@0+ (0.02,-1.0) [-1.0|200.0] "m" ASDM,PAS
 SG_ ReSideRdrRiDetn100RdrDetnRngV : 292|13@0+ (0.02,-80.0) [-80.0|80.0] "m/s" ASDM,PAS
 SG_ ReSideRdrRiDetn100RdrDetnSts : 251|2@0+ (1,0) [0|3] "" ASDM,PAS
 SG_ ReSideRdrRiDetn101_UB : 394|1@0+ (1,0) [0|1] "" ASDM,PAS
 SG_ ReSideRdrRiDetn101RdrDetnAzi : 351|11@0+ (0.1,-90.0) [-90.0|90.0] "Deg" ASDM,PAS
 SG_ ReSideRdrRiDetn101RdrDetnChks : 327|8@0+ (1.0,0.0) [0.0|255.0] "Unitless" ASDM,PAS
 SG_ ReSideRdrRiDetn101RdrDetnCntr : 335|4@0+ (1.0,0.0) [0.0|15.0] "Unitless" ASDM,PAS
 SG_ ReSideRdrRiDetn101RdrDetnConf : 391|7@0+ (1.0,0.0) [0.0|100.0] "%" ASDM,PAS
 SG_ ReSideRdrRiDetn101RdrDetnElevn : 399|5@0+ (1.0,-15.0) [-15.0|15.0] "Deg" ASDM,PAS
 SG_ ReSideRdrRiDetn101RdrDetnPwr : 329|9@0+ (0.1,0.0) [0.0|51.1] "dB" ASDM,PAS
 SG_ ReSideRdrRiDetn101RdrDetnRng : 375|14@0+ (0.02,-1.0) [-1.0|200.0] "m" ASDM,PAS
 SG_ ReSideRdrRiDetn101RdrDetnRngV : 356|13@0+ (0.02,-80.0) [-80.0|80.0] "m/s" ASDM,PAS
 SG_ ReSideRdrRiDetn101RdrDetnSts : 331|2@0+ (1,0) [0|3] "" ASDM,PAS
 SG_ ReSideRdrRiDetn102_UB : 474|1@0+ (1,0) [0|1] "" ASDM,PAS
 SG_ ReSideRdrRiDetn102RdrDetnAzi : 447|11@0+ (0.1,-90.0) [-90.0|90.0] "Deg" ASDM,PAS
 SG_ ReSideRdrRiDetn102RdrDetnChks : 407|8@0+ (1.0,0.0) [0.0|255.0] "Unitless" ASDM,PAS
 SG_ ReSideRdrRiDetn102RdrDetnCntr : 415|4@0+ (1.0,0.0) [0.0|15.0] "Unitless" ASDM,PAS
 SG_ ReSideRdrRiDetn102RdrDetnConf : 471|7@0+ (1.0,0.0) [0.0|100.0] "%" ASDM,PAS
 SG_ ReSideRdrRiDetn102RdrDetnElevn : 479|5@0+ (1.0,-15.0) [-15.0|15.0] "Deg" ASDM,PAS
 SG_ ReSideRdrRiDetn102RdrDetnPwr : 409|9@0+ (0.1,0.0) [0.0|51.1] "dB" ASDM,PAS
 SG_ ReSideRdrRiDetn102RdrDetnRng : 431|14@0+ (0.02,-1.0) [-1.0|200.0] "m" ASDM,PAS
 SG_ ReSideRdrRiDetn102RdrDetnRngV : 452|13@0+ (0.02,-80.0) [-80.0|80.0] "m/s" ASDM,PAS
 SG_ ReSideRdrRiDetn102RdrDetnSts : 411|2@0+ (1,0) [0|3] "" ASDM,PAS
 SG_ ReSideRdrRiDetn97_UB : 74|1@0+ (1,0) [0|1] "" ASDM,PAS
 SG_ ReSideRdrRiDetn97RdrDetnAzi : 31|11@0+ (0.1,-90.0) [-90.0|90.0] "Deg" ASDM,PAS
 SG_ ReSideRdrRiDetn97RdrDetnChks : 7|8@0+ (1.0,0.0) [0.0|255.0] "Unitless" ASDM,PAS
 SG_ ReSideRdrRiDetn97RdrDetnCntr : 15|4@0+ (1.0,0.0) [0.0|15.0] "Unitless" ASDM,PAS
 SG_ ReSideRdrRiDetn97RdrDetnConf : 71|7@0+ (1.0,0.0) [0.0|100.0] "%" ASDM,PAS
 SG_ ReSideRdrRiDetn97RdrDetnElevn : 79|5@0+ (1.0,-15.0) [-15.0|15.0] "Deg" ASDM,PAS
 SG_ ReSideRdrRiDetn97RdrDetnPwr : 8|9@0+ (0.1,0.0) [0.0|51.1] "dB" ASDM,PAS
 SG_ ReSideRdrRiDetn97RdrDetnRng : 55|14@0+ (0.02,-1.0) [-1.0|200.0] "m" ASDM,PAS
 SG_ ReSideRdrRiDetn97RdrDetnRngV : 36|13@0+ (0.02,-80.0) [-80.0|80.0] "m/s" ASDM,PAS
 SG_ ReSideRdrRiDetn97RdrDetnSts : 11|2@0+ (1,0) [0|3] "" ASDM,PAS
 SG_ ReSideRdrRiDetn98_UB : 154|1@0+ (1,0) [0|1] "" ASDM,PAS
 SG_ ReSideRdrRiDetn98RdrDetnAzi : 119|11@0+ (0.1,-90.0) [-90.0|90.0] "Deg" ASDM,PAS
 SG_ ReSideRdrRiDetn98RdrDetnChks : 87|8@0+ (1.0,0.0) [0.0|255.0] "Unitless" ASDM,PAS
 SG_ ReSideRdrRiDetn98RdrDetnCntr : 95|4@0+ (1.0,0.0) [0.0|15.0] "Unitless" ASDM,PAS
 SG_ ReSideRdrRiDetn98RdrDetnConf : 111|7@0+ (1.0,0.0) [0.0|100.0] "%" ASDM,PAS
 SG_ ReSideRdrRiDetn98RdrDetnElevn : 159|5@0+ (1.0,-15.0) [-15.0|15.0] "Deg" ASDM,PAS
 SG_ ReSideRdrRiDetn98RdrDetnPwr : 89|9@0+ (0.1,0.0) [0.0|51.1] "dB" ASDM,PAS
 SG_ ReSideRdrRiDetn98RdrDetnRng : 143|14@0+ (0.02,-1.0) [-1.0|200.0] "m" ASDM,PAS
 SG_ ReSideRdrRiDetn98RdrDetnRngV : 124|13@0+ (0.02,-80.0) [-80.0|80.0] "m/s" ASDM,PAS
 SG_ ReSideRdrRiDetn98RdrDetnSts : 91|2@0+ (1,0) [0|3] "" ASDM,PAS
 SG_ ReSideRdrRiDetn99_UB : 234|1@0+ (1,0) [0|1] "" ASDM,PAS
 SG_ ReSideRdrRiDetn99RdrDetnAzi : 199|11@0+ (0.1,-90.0) [-90.0|90.0] "Deg" ASDM,PAS
 SG_ ReSideRdrRiDetn99RdrDetnChks : 167|8@0+ (1.0,0.0) [0.0|255.0] "Unitless" ASDM,PAS
 SG_ ReSideRdrRiDetn99RdrDetnCntr : 175|4@0+ (1.0,0.0) [0.0|15.0] "Unitless" ASDM,PAS
 SG_ ReSideRdrRiDetn99RdrDetnConf : 191|7@0+ (1.0,0.0) [0.0|100.0] "%" ASDM,PAS
 SG_ ReSideRdrRiDetn99RdrDetnElevn : 239|5@0+ (1.0,-15.0) [-15.0|15.0] "Deg" ASDM,PAS
 SG_ ReSideRdrRiDetn99RdrDetnPwr : 169|9@0+ (0.1,0.0) [0.0|51.1] "dB" ASDM,PAS
 SG_ ReSideRdrRiDetn99RdrDetnRng : 223|14@0+ (0.02,-1.0) [-1.0|200.0] "m" ASDM,PAS
 SG_ ReSideRdrRiDetn99RdrDetnRngV : 204|13@0+ (0.02,-80.0) [-80.0|80.0] "m/s" ASDM,PAS
 SG_ ReSideRdrRiDetn99RdrDetnSts : 171|2@0+ (1,0) [0|3] "" ASDM,PAS

BO_ 339 SODRSafetyCANFD3Frame18: 64 SODR
 SG_ ReSideRdrRiDetn103_UB : 74|1@0+ (1,0) [0|1] "" ASDM,PAS
 SG_ ReSideRdrRiDetn103RdrDetnAzi : 31|11@0+ (0.1,-90.0) [-90.0|90.0] "Deg" ASDM,PAS
 SG_ ReSideRdrRiDetn103RdrDetnChks : 7|8@0+ (1.0,0.0) [0.0|255.0] "Unitless" ASDM,PAS
 SG_ ReSideRdrRiDetn103RdrDetnCntr : 15|4@0+ (1.0,0.0) [0.0|15.0] "Unitless" ASDM,PAS
 SG_ ReSideRdrRiDetn103RdrDetnConf : 71|7@0+ (1.0,0.0) [0.0|100.0] "%" ASDM,PAS
 SG_ ReSideRdrRiDetn103RdrDetnElevn : 79|5@0+ (1.0,-15.0) [-15.0|15.0] "Deg" ASDM,PAS
 SG_ ReSideRdrRiDetn103RdrDetnPwr : 8|9@0+ (0.1,0.0) [0.0|51.1] "dB" ASDM,PAS
 SG_ ReSideRdrRiDetn103RdrDetnRng : 55|14@0+ (0.02,-1.0) [-1.0|200.0] "m" ASDM,PAS
 SG_ ReSideRdrRiDetn103RdrDetnRngV : 36|13@0+ (0.02,-80.0) [-80.0|80.0] "m/s" ASDM,PAS
 SG_ ReSideRdrRiDetn103RdrDetnSts : 11|2@0+ (1,0) [0|3] "" ASDM,PAS
 SG_ ReSideRdrRiDetn104_UB : 154|1@0+ (1,0) [0|1] "" ASDM,PAS
 SG_ ReSideRdrRiDetn104RdrDetnAzi : 119|11@0+ (0.1,-90.0) [-90.0|90.0] "Deg" ASDM,PAS
 SG_ ReSideRdrRiDetn104RdrDetnChks : 87|8@0+ (1.0,0.0) [0.0|255.0] "Unitless" ASDM,PAS
 SG_ ReSideRdrRiDetn104RdrDetnCntr : 95|4@0+ (1.0,0.0) [0.0|15.0] "Unitless" ASDM,PAS
 SG_ ReSideRdrRiDetn104RdrDetnConf : 111|7@0+ (1.0,0.0) [0.0|100.0] "%" ASDM,PAS
 SG_ ReSideRdrRiDetn104RdrDetnElevn : 159|5@0+ (1.0,-15.0) [-15.0|15.0] "Deg" ASDM,PAS
 SG_ ReSideRdrRiDetn104RdrDetnPwr : 89|9@0+ (0.1,0.0) [0.0|51.1] "dB" ASDM,PAS
 SG_ ReSideRdrRiDetn104RdrDetnRng : 143|14@0+ (0.02,-1.0) [-1.0|200.0] "m" ASDM,PAS
 SG_ ReSideRdrRiDetn104RdrDetnRngV : 124|13@0+ (0.02,-80.0) [-80.0|80.0] "m/s" ASDM,PAS
 SG_ ReSideRdrRiDetn104RdrDetnSts : 91|2@0+ (1,0) [0|3] "" ASDM,PAS
 SG_ ReSideRdrRiDetn105_UB : 234|1@0+ (1,0) [0|1] "" ASDM,PAS
 SG_ ReSideRdrRiDetn105RdrDetnAzi : 199|11@0+ (0.1,-90.0) [-90.0|90.0] "Deg" ASDM,PAS
 SG_ ReSideRdrRiDetn105RdrDetnChks : 167|8@0+ (1.0,0.0) [0.0|255.0] "Unitless" ASDM,PAS
 SG_ ReSideRdrRiDetn105RdrDetnCntr : 175|4@0+ (1.0,0.0) [0.0|15.0] "Unitless" ASDM,PAS
 SG_ ReSideRdrRiDetn105RdrDetnConf : 191|7@0+ (1.0,0.0) [0.0|100.0] "%" ASDM,PAS
 SG_ ReSideRdrRiDetn105RdrDetnElevn : 239|5@0+ (1.0,-15.0) [-15.0|15.0] "Deg" ASDM,PAS
 SG_ ReSideRdrRiDetn105RdrDetnPwr : 169|9@0+ (0.1,0.0) [0.0|51.1] "dB" ASDM,PAS
 SG_ ReSideRdrRiDetn105RdrDetnRng : 223|14@0+ (0.02,-1.0) [-1.0|200.0] "m" ASDM,PAS
 SG_ ReSideRdrRiDetn105RdrDetnRngV : 204|13@0+ (0.02,-80.0) [-80.0|80.0] "m/s" ASDM,PAS
 SG_ ReSideRdrRiDetn105RdrDetnSts : 171|2@0+ (1,0) [0|3] "" ASDM,PAS
 SG_ ReSideRdrRiDetn106_UB : 314|1@0+ (1,0) [0|1] "" ASDM,PAS
 SG_ ReSideRdrRiDetn106RdrDetnAzi : 287|11@0+ (0.1,-90.0) [-90.0|90.0] "Deg" ASDM,PAS
 SG_ ReSideRdrRiDetn106RdrDetnChks : 247|8@0+ (1.0,0.0) [0.0|255.0] "Unitless" ASDM,PAS
 SG_ ReSideRdrRiDetn106RdrDetnCntr : 255|4@0+ (1.0,0.0) [0.0|15.0] "Unitless" ASDM,PAS
 SG_ ReSideRdrRiDetn106RdrDetnConf : 311|7@0+ (1.0,0.0) [0.0|100.0] "%" ASDM,PAS
 SG_ ReSideRdrRiDetn106RdrDetnElevn : 319|5@0+ (1.0,-15.0) [-15.0|15.0] "Deg" ASDM,PAS
 SG_ ReSideRdrRiDetn106RdrDetnPwr : 249|9@0+ (0.1,0.0) [0.0|51.1] "dB" ASDM,PAS
 SG_ ReSideRdrRiDetn106RdrDetnRng : 271|14@0+ (0.02,-1.0) [-1.0|200.0] "m" ASDM,PAS
 SG_ ReSideRdrRiDetn106RdrDetnRngV : 292|13@0+ (0.02,-80.0) [-80.0|80.0] "m/s" ASDM,PAS
 SG_ ReSideRdrRiDetn106RdrDetnSts : 251|2@0+ (1,0) [0|3] "" ASDM,PAS
 SG_ ReSideRdrRiDetn107_UB : 394|1@0+ (1,0) [0|1] "" ASDM,PAS
 SG_ ReSideRdrRiDetn107RdrDetnAzi : 351|11@0+ (0.1,-90.0) [-90.0|90.0] "Deg" ASDM,PAS
 SG_ ReSideRdrRiDetn107RdrDetnChks : 327|8@0+ (1.0,0.0) [0.0|255.0] "Unitless" ASDM,PAS
 SG_ ReSideRdrRiDetn107RdrDetnCntr : 335|4@0+ (1.0,0.0) [0.0|15.0] "Unitless" ASDM,PAS
 SG_ ReSideRdrRiDetn107RdrDetnConf : 391|7@0+ (1.0,0.0) [0.0|100.0] "%" ASDM,PAS
 SG_ ReSideRdrRiDetn107RdrDetnElevn : 399|5@0+ (1.0,-15.0) [-15.0|15.0] "Deg" ASDM,PAS
 SG_ ReSideRdrRiDetn107RdrDetnPwr : 329|9@0+ (0.1,0.0) [0.0|51.1] "dB" ASDM,PAS
 SG_ ReSideRdrRiDetn107RdrDetnRng : 375|14@0+ (0.02,-1.0) [-1.0|200.0] "m" ASDM,PAS
 SG_ ReSideRdrRiDetn107RdrDetnRngV : 356|13@0+ (0.02,-80.0) [-80.0|80.0] "m/s" ASDM,PAS
 SG_ ReSideRdrRiDetn107RdrDetnSts : 331|2@0+ (1,0) [0|3] "" ASDM,PAS
 SG_ ReSideRdrRiDetn108_UB : 474|1@0+ (1,0) [0|1] "" ASDM,PAS
 SG_ ReSideRdrRiDetn108RdrDetnAzi : 447|11@0+ (0.1,-90.0) [-90.0|90.0] "Deg" ASDM,PAS
 SG_ ReSideRdrRiDetn108RdrDetnChks : 407|8@0+ (1.0,0.0) [0.0|255.0] "Unitless" ASDM,PAS
 SG_ ReSideRdrRiDetn108RdrDetnCntr : 415|4@0+ (1.0,0.0) [0.0|15.0] "Unitless" ASDM,PAS
 SG_ ReSideRdrRiDetn108RdrDetnConf : 471|7@0+ (1.0,0.0) [0.0|100.0] "%" ASDM,PAS
 SG_ ReSideRdrRiDetn108RdrDetnElevn : 479|5@0+ (1.0,-15.0) [-15.0|15.0] "Deg" ASDM,PAS
 SG_ ReSideRdrRiDetn108RdrDetnPwr : 409|9@0+ (0.1,0.0) [0.0|51.1] "dB" ASDM,PAS
 SG_ ReSideRdrRiDetn108RdrDetnRng : 431|14@0+ (0.02,-1.0) [-1.0|200.0] "m" ASDM,PAS
 SG_ ReSideRdrRiDetn108RdrDetnRngV : 452|13@0+ (0.02,-80.0) [-80.0|80.0] "m/s" ASDM,PAS
 SG_ ReSideRdrRiDetn108RdrDetnSts : 411|2@0+ (1,0) [0|3] "" ASDM,PAS

BO_ 341 SODRSafetyCANFD3Frame19: 64 SODR
 SG_ ReSideRdrRiDetn109_UB : 74|1@0+ (1,0) [0|1] "" ASDM,PAS
 SG_ ReSideRdrRiDetn109RdrDetnAzi : 31|11@0+ (0.1,-90.0) [-90.0|90.0] "Deg" ASDM,PAS
 SG_ ReSideRdrRiDetn109RdrDetnChks : 7|8@0+ (1.0,0.0) [0.0|255.0] "Unitless" ASDM,PAS
 SG_ ReSideRdrRiDetn109RdrDetnCntr : 15|4@0+ (1.0,0.0) [0.0|15.0] "Unitless" ASDM,PAS
 SG_ ReSideRdrRiDetn109RdrDetnConf : 71|7@0+ (1.0,0.0) [0.0|100.0] "%" ASDM,PAS
 SG_ ReSideRdrRiDetn109RdrDetnElevn : 79|5@0+ (1.0,-15.0) [-15.0|15.0] "Deg" ASDM,PAS
 SG_ ReSideRdrRiDetn109RdrDetnPwr : 8|9@0+ (0.1,0.0) [0.0|51.1] "dB" ASDM,PAS
 SG_ ReSideRdrRiDetn109RdrDetnRng : 55|14@0+ (0.02,-1.0) [-1.0|200.0] "m" ASDM,PAS
 SG_ ReSideRdrRiDetn109RdrDetnRngV : 36|13@0+ (0.02,-80.0) [-80.0|80.0] "m/s" ASDM,PAS
 SG_ ReSideRdrRiDetn109RdrDetnSts : 11|2@0+ (1,0) [0|3] "" ASDM,PAS
 SG_ ReSideRdrRiDetn110_UB : 154|1@0+ (1,0) [0|1] "" ASDM,PAS
 SG_ ReSideRdrRiDetn110RdrDetnAzi : 119|11@0+ (0.1,-90.0) [-90.0|90.0] "Deg" ASDM,PAS
 SG_ ReSideRdrRiDetn110RdrDetnChks : 87|8@0+ (1.0,0.0) [0.0|255.0] "Unitless" ASDM,PAS
 SG_ ReSideRdrRiDetn110RdrDetnCntr : 95|4@0+ (1.0,0.0) [0.0|15.0] "Unitless" ASDM,PAS
 SG_ ReSideRdrRiDetn110RdrDetnConf : 111|7@0+ (1.0,0.0) [0.0|100.0] "%" ASDM,PAS
 SG_ ReSideRdrRiDetn110RdrDetnElevn : 159|5@0+ (1.0,-15.0) [-15.0|15.0] "Deg" ASDM,PAS
 SG_ ReSideRdrRiDetn110RdrDetnPwr : 89|9@0+ (0.1,0.0) [0.0|51.1] "dB" ASDM,PAS
 SG_ ReSideRdrRiDetn110RdrDetnRng : 143|14@0+ (0.02,-1.0) [-1.0|200.0] "m" ASDM,PAS
 SG_ ReSideRdrRiDetn110RdrDetnRngV : 124|13@0+ (0.02,-80.0) [-80.0|80.0] "m/s" ASDM,PAS
 SG_ ReSideRdrRiDetn110RdrDetnSts : 91|2@0+ (1,0) [0|3] "" ASDM,PAS
 SG_ ReSideRdrRiDetn111_UB : 234|1@0+ (1,0) [0|1] "" ASDM,PAS
 SG_ ReSideRdrRiDetn111RdrDetnAzi : 199|11@0+ (0.1,-90.0) [-90.0|90.0] "Deg" ASDM,PAS
 SG_ ReSideRdrRiDetn111RdrDetnChks : 167|8@0+ (1.0,0.0) [0.0|255.0] "Unitless" ASDM,PAS
 SG_ ReSideRdrRiDetn111RdrDetnCntr : 175|4@0+ (1.0,0.0) [0.0|15.0] "Unitless" ASDM,PAS
 SG_ ReSideRdrRiDetn111RdrDetnConf : 191|7@0+ (1.0,0.0) [0.0|100.0] "%" ASDM,PAS
 SG_ ReSideRdrRiDetn111RdrDetnElevn : 239|5@0+ (1.0,-15.0) [-15.0|15.0] "Deg" ASDM,PAS
 SG_ ReSideRdrRiDetn111RdrDetnPwr : 169|9@0+ (0.1,0.0) [0.0|51.1] "dB" ASDM,PAS
 SG_ ReSideRdrRiDetn111RdrDetnRng : 223|14@0+ (0.02,-1.0) [-1.0|200.0] "m" ASDM,PAS
 SG_ ReSideRdrRiDetn111RdrDetnRngV : 204|13@0+ (0.02,-80.0) [-80.0|80.0] "m/s" ASDM,PAS
 SG_ ReSideRdrRiDetn111RdrDetnSts : 171|2@0+ (1,0) [0|3] "" ASDM,PAS
 SG_ ReSideRdrRiDetn112_UB : 314|1@0+ (1,0) [0|1] "" ASDM,PAS
 SG_ ReSideRdrRiDetn112RdrDetnAzi : 287|11@0+ (0.1,-90.0) [-90.0|90.0] "Deg" ASDM,PAS
 SG_ ReSideRdrRiDetn112RdrDetnChks : 247|8@0+ (1.0,0.0) [0.0|255.0] "Unitless" ASDM,PAS
 SG_ ReSideRdrRiDetn112RdrDetnCntr : 255|4@0+ (1.0,0.0) [0.0|15.0] "Unitless" ASDM,PAS
 SG_ ReSideRdrRiDetn112RdrDetnConf : 311|7@0+ (1.0,0.0) [0.0|100.0] "%" ASDM,PAS
 SG_ ReSideRdrRiDetn112RdrDetnElevn : 319|5@0+ (1.0,-15.0) [-15.0|15.0] "Deg" ASDM,PAS
 SG_ ReSideRdrRiDetn112RdrDetnPwr : 249|9@0+ (0.1,0.0) [0.0|51.1] "dB" ASDM,PAS
 SG_ ReSideRdrRiDetn112RdrDetnRng : 271|14@0+ (0.02,-1.0) [-1.0|200.0] "m" ASDM,PAS
 SG_ ReSideRdrRiDetn112RdrDetnRngV : 292|13@0+ (0.02,-80.0) [-80.0|80.0] "m/s" ASDM,PAS
 SG_ ReSideRdrRiDetn112RdrDetnSts : 251|2@0+ (1,0) [0|3] "" ASDM,PAS
 SG_ ReSideRdrRiDetn113_UB : 394|1@0+ (1,0) [0|1] "" ASDM,PAS
 SG_ ReSideRdrRiDetn113RdrDetnAzi : 351|11@0+ (0.1,-90.0) [-90.0|90.0] "Deg" ASDM,PAS
 SG_ ReSideRdrRiDetn113RdrDetnChks : 327|8@0+ (1.0,0.0) [0.0|255.0] "Unitless" ASDM,PAS
 SG_ ReSideRdrRiDetn113RdrDetnCntr : 335|4@0+ (1.0,0.0) [0.0|15.0] "Unitless" ASDM,PAS
 SG_ ReSideRdrRiDetn113RdrDetnConf : 391|7@0+ (1.0,0.0) [0.0|100.0] "%" ASDM,PAS
 SG_ ReSideRdrRiDetn113RdrDetnElevn : 399|5@0+ (1.0,-15.0) [-15.0|15.0] "Deg" ASDM,PAS
 SG_ ReSideRdrRiDetn113RdrDetnPwr : 329|9@0+ (0.1,0.0) [0.0|51.1] "dB" ASDM,PAS
 SG_ ReSideRdrRiDetn113RdrDetnRng : 375|14@0+ (0.02,-1.0) [-1.0|200.0] "m" ASDM,PAS
 SG_ ReSideRdrRiDetn113RdrDetnRngV : 356|13@0+ (0.02,-80.0) [-80.0|80.0] "m/s" ASDM,PAS
 SG_ ReSideRdrRiDetn113RdrDetnSts : 331|2@0+ (1,0) [0|3] "" ASDM,PAS
 SG_ ReSideRdrRiDetn114_UB : 474|1@0+ (1,0) [0|1] "" ASDM,PAS
 SG_ ReSideRdrRiDetn114RdrDetnAzi : 447|11@0+ (0.1,-90.0) [-90.0|90.0] "Deg" ASDM,PAS
 SG_ ReSideRdrRiDetn114RdrDetnChks : 407|8@0+ (1.0,0.0) [0.0|255.0] "Unitless" ASDM,PAS
 SG_ ReSideRdrRiDetn114RdrDetnCntr : 415|4@0+ (1.0,0.0) [0.0|15.0] "Unitless" ASDM,PAS
 SG_ ReSideRdrRiDetn114RdrDetnConf : 471|7@0+ (1.0,0.0) [0.0|100.0] "%" ASDM,PAS
 SG_ ReSideRdrRiDetn114RdrDetnElevn : 479|5@0+ (1.0,-15.0) [-15.0|15.0] "Deg" ASDM,PAS
 SG_ ReSideRdrRiDetn114RdrDetnPwr : 409|9@0+ (0.1,0.0) [0.0|51.1] "dB" ASDM,PAS
 SG_ ReSideRdrRiDetn114RdrDetnRng : 431|14@0+ (0.02,-1.0) [-1.0|200.0] "m" ASDM,PAS
 SG_ ReSideRdrRiDetn114RdrDetnRngV : 452|13@0+ (0.02,-80.0) [-80.0|80.0] "m/s" ASDM,PAS
 SG_ ReSideRdrRiDetn114RdrDetnSts : 411|2@0+ (1,0) [0|3] "" ASDM,PAS

BO_ 343 SODRSafetyCANFD3Frame20: 64 SODR
 SG_ ReSideRdrRiDetn115_UB : 74|1@0+ (1,0) [0|1] "" ASDM,PAS
 SG_ ReSideRdrRiDetn115RdrDetnAzi : 31|11@0+ (0.1,-90.0) [-90.0|90.0] "Deg" ASDM,PAS
 SG_ ReSideRdrRiDetn115RdrDetnChks : 7|8@0+ (1.0,0.0) [0.0|255.0] "Unitless" ASDM,PAS
 SG_ ReSideRdrRiDetn115RdrDetnCntr : 15|4@0+ (1.0,0.0) [0.0|15.0] "Unitless" ASDM,PAS
 SG_ ReSideRdrRiDetn115RdrDetnConf : 71|7@0+ (1.0,0.0) [0.0|100.0] "%" ASDM,PAS
 SG_ ReSideRdrRiDetn115RdrDetnElevn : 79|5@0+ (1.0,-15.0) [-15.0|15.0] "Deg" ASDM,PAS
 SG_ ReSideRdrRiDetn115RdrDetnPwr : 8|9@0+ (0.1,0.0) [0.0|51.1] "dB" ASDM,PAS
 SG_ ReSideRdrRiDetn115RdrDetnRng : 55|14@0+ (0.02,-1.0) [-1.0|200.0] "m" ASDM,PAS
 SG_ ReSideRdrRiDetn115RdrDetnRngV : 36|13@0+ (0.02,-80.0) [-80.0|80.0] "m/s" ASDM,PAS
 SG_ ReSideRdrRiDetn115RdrDetnSts : 11|2@0+ (1,0) [0|3] "" ASDM,PAS
 SG_ ReSideRdrRiDetn116_UB : 154|1@0+ (1,0) [0|1] "" ASDM,PAS
 SG_ ReSideRdrRiDetn116RdrDetnAzi : 119|11@0+ (0.1,-90.0) [-90.0|90.0] "Deg" ASDM,PAS
 SG_ ReSideRdrRiDetn116RdrDetnChks : 87|8@0+ (1.0,0.0) [0.0|255.0] "Unitless" ASDM,PAS
 SG_ ReSideRdrRiDetn116RdrDetnCntr : 95|4@0+ (1.0,0.0) [0.0|15.0] "Unitless" ASDM,PAS
 SG_ ReSideRdrRiDetn116RdrDetnConf : 111|7@0+ (1.0,0.0) [0.0|100.0] "%" ASDM,PAS
 SG_ ReSideRdrRiDetn116RdrDetnElevn : 159|5@0+ (1.0,-15.0) [-15.0|15.0] "Deg" ASDM,PAS
 SG_ ReSideRdrRiDetn116RdrDetnPwr : 89|9@0+ (0.1,0.0) [0.0|51.1] "dB" ASDM,PAS
 SG_ ReSideRdrRiDetn116RdrDetnRng : 143|14@0+ (0.02,-1.0) [-1.0|200.0] "m" ASDM,PAS
 SG_ ReSideRdrRiDetn116RdrDetnRngV : 124|13@0+ (0.02,-80.0) [-80.0|80.0] "m/s" ASDM,PAS
 SG_ ReSideRdrRiDetn116RdrDetnSts : 91|2@0+ (1,0) [0|3] "" ASDM,PAS
 SG_ ReSideRdrRiDetn117_UB : 234|1@0+ (1,0) [0|1] "" ASDM,PAS
 SG_ ReSideRdrRiDetn117RdrDetnAzi : 199|11@0+ (0.1,-90.0) [-90.0|90.0] "Deg" ASDM,PAS
 SG_ ReSideRdrRiDetn117RdrDetnChks : 167|8@0+ (1.0,0.0) [0.0|255.0] "Unitless" ASDM,PAS
 SG_ ReSideRdrRiDetn117RdrDetnCntr : 175|4@0+ (1.0,0.0) [0.0|15.0] "Unitless" ASDM,PAS
 SG_ ReSideRdrRiDetn117RdrDetnConf : 191|7@0+ (1.0,0.0) [0.0|100.0] "%" ASDM,PAS
 SG_ ReSideRdrRiDetn117RdrDetnElevn : 239|5@0+ (1.0,-15.0) [-15.0|15.0] "Deg" ASDM,PAS
 SG_ ReSideRdrRiDetn117RdrDetnPwr : 169|9@0+ (0.1,0.0) [0.0|51.1] "dB" ASDM,PAS
 SG_ ReSideRdrRiDetn117RdrDetnRng : 223|14@0+ (0.02,-1.0) [-1.0|200.0] "m" ASDM,PAS
 SG_ ReSideRdrRiDetn117RdrDetnRngV : 204|13@0+ (0.02,-80.0) [-80.0|80.0] "m/s" ASDM,PAS
 SG_ ReSideRdrRiDetn117RdrDetnSts : 171|2@0+ (1,0) [0|3] "" ASDM,PAS
 SG_ ReSideRdrRiDetn118_UB : 314|1@0+ (1,0) [0|1] "" ASDM,PAS
 SG_ ReSideRdrRiDetn118RdrDetnAzi : 287|11@0+ (0.1,-90.0) [-90.0|90.0] "Deg" ASDM,PAS
 SG_ ReSideRdrRiDetn118RdrDetnChks : 247|8@0+ (1.0,0.0) [0.0|255.0] "Unitless" ASDM,PAS
 SG_ ReSideRdrRiDetn118RdrDetnCntr : 255|4@0+ (1.0,0.0) [0.0|15.0] "Unitless" ASDM,PAS
 SG_ ReSideRdrRiDetn118RdrDetnConf : 311|7@0+ (1.0,0.0) [0.0|100.0] "%" ASDM,PAS
 SG_ ReSideRdrRiDetn118RdrDetnElevn : 319|5@0+ (1.0,-15.0) [-15.0|15.0] "Deg" ASDM,PAS
 SG_ ReSideRdrRiDetn118RdrDetnPwr : 249|9@0+ (0.1,0.0) [0.0|51.1] "dB" ASDM,PAS
 SG_ ReSideRdrRiDetn118RdrDetnRng : 271|14@0+ (0.02,-1.0) [-1.0|200.0] "m" ASDM,PAS
 SG_ ReSideRdrRiDetn118RdrDetnRngV : 292|13@0+ (0.02,-80.0) [-80.0|80.0] "m/s" ASDM,PAS
 SG_ ReSideRdrRiDetn118RdrDetnSts : 251|2@0+ (1,0) [0|3] "" ASDM,PAS
 SG_ ReSideRdrRiDetn119_UB : 394|1@0+ (1,0) [0|1] "" ASDM,PAS
 SG_ ReSideRdrRiDetn119RdrDetnAzi : 351|11@0+ (0.1,-90.0) [-90.0|90.0] "Deg" ASDM,PAS
 SG_ ReSideRdrRiDetn119RdrDetnChks : 327|8@0+ (1.0,0.0) [0.0|255.0] "Unitless" ASDM,PAS
 SG_ ReSideRdrRiDetn119RdrDetnCntr : 335|4@0+ (1.0,0.0) [0.0|15.0] "Unitless" ASDM,PAS
 SG_ ReSideRdrRiDetn119RdrDetnConf : 391|7@0+ (1.0,0.0) [0.0|100.0] "%" ASDM,PAS
 SG_ ReSideRdrRiDetn119RdrDetnElevn : 399|5@0+ (1.0,-15.0) [-15.0|15.0] "Deg" ASDM,PAS
 SG_ ReSideRdrRiDetn119RdrDetnPwr : 329|9@0+ (0.1,0.0) [0.0|51.1] "dB" ASDM,PAS
 SG_ ReSideRdrRiDetn119RdrDetnRng : 375|14@0+ (0.02,-1.0) [-1.0|200.0] "m" ASDM,PAS
 SG_ ReSideRdrRiDetn119RdrDetnRngV : 356|13@0+ (0.02,-80.0) [-80.0|80.0] "m/s" ASDM,PAS
 SG_ ReSideRdrRiDetn119RdrDetnSts : 331|2@0+ (1,0) [0|3] "" ASDM,PAS
 SG_ ReSideRdrRiDetn120_UB : 474|1@0+ (1,0) [0|1] "" ASDM,PAS
 SG_ ReSideRdrRiDetn120RdrDetnAzi : 447|11@0+ (0.1,-90.0) [-90.0|90.0] "Deg" ASDM,PAS
 SG_ ReSideRdrRiDetn120RdrDetnChks : 407|8@0+ (1.0,0.0) [0.0|255.0] "Unitless" ASDM,PAS
 SG_ ReSideRdrRiDetn120RdrDetnCntr : 415|4@0+ (1.0,0.0) [0.0|15.0] "Unitless" ASDM,PAS
 SG_ ReSideRdrRiDetn120RdrDetnConf : 471|7@0+ (1.0,0.0) [0.0|100.0] "%" ASDM,PAS
 SG_ ReSideRdrRiDetn120RdrDetnElevn : 479|5@0+ (1.0,-15.0) [-15.0|15.0] "Deg" ASDM,PAS
 SG_ ReSideRdrRiDetn120RdrDetnPwr : 409|9@0+ (0.1,0.0) [0.0|51.1] "dB" ASDM,PAS
 SG_ ReSideRdrRiDetn120RdrDetnRng : 431|14@0+ (0.02,-1.0) [-1.0|200.0] "m" ASDM,PAS
 SG_ ReSideRdrRiDetn120RdrDetnRngV : 452|13@0+ (0.02,-80.0) [-80.0|80.0] "m/s" ASDM,PAS
 SG_ ReSideRdrRiDetn120RdrDetnSts : 411|2@0+ (1,0) [0|3] "" ASDM,PAS

BO_ 345 SODRSafetyCANFD3Frame21: 64 SODR
 SG_ ReSideRdrRiDetn121_UB : 74|1@0+ (1,0) [0|1] "" ASDM,PAS
 SG_ ReSideRdrRiDetn121RdrDetnAzi : 31|11@0+ (0.1,-90.0) [-90.0|90.0] "Deg" ASDM,PAS
 SG_ ReSideRdrRiDetn121RdrDetnChks : 7|8@0+ (1.0,0.0) [0.0|255.0] "Unitless" ASDM,PAS
 SG_ ReSideRdrRiDetn121RdrDetnCntr : 15|4@0+ (1.0,0.0) [0.0|15.0] "Unitless" ASDM,PAS
 SG_ ReSideRdrRiDetn121RdrDetnConf : 71|7@0+ (1.0,0.0) [0.0|100.0] "%" ASDM,PAS
 SG_ ReSideRdrRiDetn121RdrDetnElevn : 79|5@0+ (1.0,-15.0) [-15.0|15.0] "Deg" ASDM,PAS
 SG_ ReSideRdrRiDetn121RdrDetnPwr : 8|9@0+ (0.1,0.0) [0.0|51.1] "dB" ASDM,PAS
 SG_ ReSideRdrRiDetn121RdrDetnRng : 55|14@0+ (0.02,-1.0) [-1.0|200.0] "m" ASDM,PAS
 SG_ ReSideRdrRiDetn121RdrDetnRngV : 36|13@0+ (0.02,-80.0) [-80.0|80.0] "m/s" ASDM,PAS
 SG_ ReSideRdrRiDetn121RdrDetnSts : 11|2@0+ (1,0) [0|3] "" ASDM,PAS
 SG_ ReSideRdrRiDetn122_UB : 154|1@0+ (1,0) [0|1] "" ASDM,PAS
 SG_ ReSideRdrRiDetn122RdrDetnAzi : 119|11@0+ (0.1,-90.0) [-90.0|90.0] "Deg" ASDM,PAS
 SG_ ReSideRdrRiDetn122RdrDetnChks : 87|8@0+ (1.0,0.0) [0.0|255.0] "Unitless" ASDM,PAS
 SG_ ReSideRdrRiDetn122RdrDetnCntr : 95|4@0+ (1.0,0.0) [0.0|15.0] "Unitless" ASDM,PAS
 SG_ ReSideRdrRiDetn122RdrDetnConf : 111|7@0+ (1.0,0.0) [0.0|100.0] "%" ASDM,PAS
 SG_ ReSideRdrRiDetn122RdrDetnElevn : 159|5@0+ (1.0,-15.0) [-15.0|15.0] "Deg" ASDM,PAS
 SG_ ReSideRdrRiDetn122RdrDetnPwr : 89|9@0+ (0.1,0.0) [0.0|51.1] "dB" ASDM,PAS
 SG_ ReSideRdrRiDetn122RdrDetnRng : 143|14@0+ (0.02,-1.0) [-1.0|200.0] "m" ASDM,PAS
 SG_ ReSideRdrRiDetn122RdrDetnRngV : 124|13@0+ (0.02,-80.0) [-80.0|80.0] "m/s" ASDM,PAS
 SG_ ReSideRdrRiDetn122RdrDetnSts : 91|2@0+ (1,0) [0|3] "" ASDM,PAS
 SG_ ReSideRdrRiDetn123_UB : 234|1@0+ (1,0) [0|1] "" ASDM,PAS
 SG_ ReSideRdrRiDetn123RdrDetnAzi : 199|11@0+ (0.1,-90.0) [-90.0|90.0] "Deg" ASDM,PAS
 SG_ ReSideRdrRiDetn123RdrDetnChks : 167|8@0+ (1.0,0.0) [0.0|255.0] "Unitless" ASDM,PAS
 SG_ ReSideRdrRiDetn123RdrDetnCntr : 175|4@0+ (1.0,0.0) [0.0|15.0] "Unitless" ASDM,PAS
 SG_ ReSideRdrRiDetn123RdrDetnConf : 191|7@0+ (1.0,0.0) [0.0|100.0] "%" ASDM,PAS
 SG_ ReSideRdrRiDetn123RdrDetnElevn : 239|5@0+ (1.0,-15.0) [-15.0|15.0] "Deg" ASDM,PAS
 SG_ ReSideRdrRiDetn123RdrDetnPwr : 169|9@0+ (0.1,0.0) [0.0|51.1] "dB" ASDM,PAS
 SG_ ReSideRdrRiDetn123RdrDetnRng : 223|14@0+ (0.02,-1.0) [-1.0|200.0] "m" ASDM,PAS
 SG_ ReSideRdrRiDetn123RdrDetnRngV : 204|13@0+ (0.02,-80.0) [-80.0|80.0] "m/s" ASDM,PAS
 SG_ ReSideRdrRiDetn123RdrDetnSts : 171|2@0+ (1,0) [0|3] "" ASDM,PAS
 SG_ ReSideRdrRiDetn124_UB : 314|1@0+ (1,0) [0|1] "" ASDM,PAS
 SG_ ReSideRdrRiDetn124RdrDetnAzi : 287|11@0+ (0.1,-90.0) [-90.0|90.0] "Deg" ASDM,PAS
 SG_ ReSideRdrRiDetn124RdrDetnChks : 247|8@0+ (1.0,0.0) [0.0|255.0] "Unitless" ASDM,PAS
 SG_ ReSideRdrRiDetn124RdrDetnCntr : 255|4@0+ (1.0,0.0) [0.0|15.0] "Unitless" ASDM,PAS
 SG_ ReSideRdrRiDetn124RdrDetnConf : 311|7@0+ (1.0,0.0) [0.0|100.0] "%" ASDM,PAS
 SG_ ReSideRdrRiDetn124RdrDetnElevn : 319|5@0+ (1.0,-15.0) [-15.0|15.0] "Deg" ASDM,PAS
 SG_ ReSideRdrRiDetn124RdrDetnPwr : 249|9@0+ (0.1,0.0) [0.0|51.1] "dB" ASDM,PAS
 SG_ ReSideRdrRiDetn124RdrDetnRng : 271|14@0+ (0.02,-1.0) [-1.0|200.0] "m" ASDM,PAS
 SG_ ReSideRdrRiDetn124RdrDetnRngV : 292|13@0+ (0.02,-80.0) [-80.0|80.0] "m/s" ASDM,PAS
 SG_ ReSideRdrRiDetn124RdrDetnSts : 251|2@0+ (1,0) [0|3] "" ASDM,PAS
 SG_ ReSideRdrRiDetn125_UB : 394|1@0+ (1,0) [0|1] "" ASDM,PAS
 SG_ ReSideRdrRiDetn125RdrDetnAzi : 351|11@0+ (0.1,-90.0) [-90.0|90.0] "Deg" ASDM,PAS
 SG_ ReSideRdrRiDetn125RdrDetnChks : 327|8@0+ (1.0,0.0) [0.0|255.0] "Unitless" ASDM,PAS
 SG_ ReSideRdrRiDetn125RdrDetnCntr : 335|4@0+ (1.0,0.0) [0.0|15.0] "Unitless" ASDM,PAS
 SG_ ReSideRdrRiDetn125RdrDetnConf : 391|7@0+ (1.0,0.0) [0.0|100.0] "%" ASDM,PAS
 SG_ ReSideRdrRiDetn125RdrDetnElevn : 399|5@0+ (1.0,-15.0) [-15.0|15.0] "Deg" ASDM,PAS
 SG_ ReSideRdrRiDetn125RdrDetnPwr : 329|9@0+ (0.1,0.0) [0.0|51.1] "dB" ASDM,PAS
 SG_ ReSideRdrRiDetn125RdrDetnRng : 375|14@0+ (0.02,-1.0) [-1.0|200.0] "m" ASDM,PAS
 SG_ ReSideRdrRiDetn125RdrDetnRngV : 356|13@0+ (0.02,-80.0) [-80.0|80.0] "m/s" ASDM,PAS
 SG_ ReSideRdrRiDetn125RdrDetnSts : 331|2@0+ (1,0) [0|3] "" ASDM,PAS
 SG_ ReSideRdrRiDetn126_UB : 474|1@0+ (1,0) [0|1] "" ASDM,PAS
 SG_ ReSideRdrRiDetn126RdrDetnAzi : 447|11@0+ (0.1,-90.0) [-90.0|90.0] "Deg" ASDM,PAS
 SG_ ReSideRdrRiDetn126RdrDetnChks : 407|8@0+ (1.0,0.0) [0.0|255.0] "Unitless" ASDM,PAS
 SG_ ReSideRdrRiDetn126RdrDetnCntr : 415|4@0+ (1.0,0.0) [0.0|15.0] "Unitless" ASDM,PAS
 SG_ ReSideRdrRiDetn126RdrDetnConf : 471|7@0+ (1.0,0.0) [0.0|100.0] "%" ASDM,PAS
 SG_ ReSideRdrRiDetn126RdrDetnElevn : 479|5@0+ (1.0,-15.0) [-15.0|15.0] "Deg" ASDM,PAS
 SG_ ReSideRdrRiDetn126RdrDetnPwr : 409|9@0+ (0.1,0.0) [0.0|51.1] "dB" ASDM,PAS
 SG_ ReSideRdrRiDetn126RdrDetnRng : 431|14@0+ (0.02,-1.0) [-1.0|200.0] "m" ASDM,PAS
 SG_ ReSideRdrRiDetn126RdrDetnRngV : 452|13@0+ (0.02,-80.0) [-80.0|80.0] "m/s" ASDM,PAS
 SG_ ReSideRdrRiDetn126RdrDetnSts : 411|2@0+ (1,0) [0|3] "" ASDM,PAS

BO_ 347 SODRSafetyCANFD3Frame22: 64 SODR
 SG_ ReSideRdrRiDetn127_UB : 74|1@0+ (1,0) [0|1] "" ASDM,PAS
 SG_ ReSideRdrRiDetn127RdrDetnAzi : 31|11@0+ (0.1,-90.0) [-90.0|90.0] "Deg" ASDM,PAS
 SG_ ReSideRdrRiDetn127RdrDetnChks : 7|8@0+ (1.0,0.0) [0.0|255.0] "Unitless" ASDM,PAS
 SG_ ReSideRdrRiDetn127RdrDetnCntr : 15|4@0+ (1.0,0.0) [0.0|15.0] "Unitless" ASDM,PAS
 SG_ ReSideRdrRiDetn127RdrDetnConf : 71|7@0+ (1.0,0.0) [0.0|100.0] "%" ASDM,PAS
 SG_ ReSideRdrRiDetn127RdrDetnElevn : 79|5@0+ (1.0,-15.0) [-15.0|15.0] "Deg" ASDM,PAS
 SG_ ReSideRdrRiDetn127RdrDetnPwr : 8|9@0+ (0.1,0.0) [0.0|51.1] "dB" ASDM,PAS
 SG_ ReSideRdrRiDetn127RdrDetnRng : 55|14@0+ (0.02,-1.0) [-1.0|200.0] "m" ASDM,PAS
 SG_ ReSideRdrRiDetn127RdrDetnRngV : 36|13@0+ (0.02,-80.0) [-80.0|80.0] "m/s" ASDM,PAS
 SG_ ReSideRdrRiDetn127RdrDetnSts : 11|2@0+ (1,0) [0|3] "" ASDM,PAS
 SG_ ReSideRdrRiDetn128_UB : 154|1@0+ (1,0) [0|1] "" ASDM,PAS
 SG_ ReSideRdrRiDetn128RdrDetnAzi : 119|11@0+ (0.1,-90.0) [-90.0|90.0] "Deg" ASDM,PAS
 SG_ ReSideRdrRiDetn128RdrDetnChks : 87|8@0+ (1.0,0.0) [0.0|255.0] "Unitless" ASDM,PAS
 SG_ ReSideRdrRiDetn128RdrDetnCntr : 95|4@0+ (1.0,0.0) [0.0|15.0] "Unitless" ASDM,PAS
 SG_ ReSideRdrRiDetn128RdrDetnConf : 111|7@0+ (1.0,0.0) [0.0|100.0] "%" ASDM,PAS
 SG_ ReSideRdrRiDetn128RdrDetnElevn : 159|5@0+ (1.0,-15.0) [-15.0|15.0] "Deg" ASDM,PAS
 SG_ ReSideRdrRiDetn128RdrDetnPwr : 89|9@0+ (0.1,0.0) [0.0|51.1] "dB" ASDM,PAS
 SG_ ReSideRdrRiDetn128RdrDetnRng : 143|14@0+ (0.02,-1.0) [-1.0|200.0] "m" ASDM,PAS
 SG_ ReSideRdrRiDetn128RdrDetnRngV : 124|13@0+ (0.02,-80.0) [-80.0|80.0] "m/s" ASDM,PAS
 SG_ ReSideRdrRiDetn128RdrDetnSts : 91|2@0+ (1,0) [0|3] "" ASDM,PAS

BO_ 349 SODRSafetyCANFD3Frame23: 64 SODR
 SG_ ReSideRdrRiObj1_UB : 291|1@0+ (1,0) [0|1] "" ASDM,PAS
 SG_ ReSideRdrRiObj1Heading : 287|12@0+ (0.1,-180.0) [-180.0|180.0] "Deg" ASDM,PAS
 SG_ ReSideRdrRiObj1ObjBoxCenterLat : 23|9@0+ (0.1,-25.0) [-25.0|25.0] "m" ASDM,PAS
 SG_ ReSideRdrRiObj1ObjBoxCenterLgt : 30|9@0+ (0.1,-25.0) [-25.0|25.0] "m" ASDM,PAS
 SG_ ReSideRdrRiObj1ObservationHist : 63|32@0+ (1.0,0.0) [0.0|4294967295.0] "Unitless" ASDM,PAS
 SG_ ReSideRdrRiObj1RdrObjAx : 7|8@0- (0.1,0.0) [-12.8|12.700000000000001] "m/s^2" ASDM,PAS
 SG_ ReSideRdrRiObj1RdrObjAy : 15|8@0- (0.1,0.0) [-12.8|12.700000000000001] "m/s^2" ASDM,PAS
 SG_ ReSideRdrRiObj1RdrObjBoxLength : 37|9@0+ (0.1,0.0) [0.0|50.0] "m" ASDM,PAS
 SG_ ReSideRdrRiObj1RdrObjBoxWidth : 44|9@0+ (0.1,0.0) [0.0|50.0] "m" ASDM,PAS
 SG_ ReSideRdrRiObj1RdrObjChks : 95|8@0+ (1.0,0.0) [0.0|255.0] "Unitless" ASDM,PAS
 SG_ ReSideRdrRiObj1RdrObjCntr : 103|4@0+ (1.0,0.0) [0.0|15.0] "Unitless" ASDM,PAS
 SG_ ReSideRdrRiObj1RdrObjCoastCnt : 279|5@0+ (1.0,0.0) [0.0|31.0] "Unitless" ASDM,PAS
 SG_ ReSideRdrRiObj1RdrObjConf : 99|4@0+ (7.0,0.0) [0.0|105.0] "%" ASDM,PAS
 SG_ ReSideRdrRiObj1RdrObjDx : 191|13@0+ (0.05,-200.0) [-200.0|200.0] "m" ASDM,PAS
 SG_ ReSideRdrRiObj1RdrObjDxStdDe : 111|8@0+ (0.05,0.0) [0.0|12.700000000000001] "m" ASDM,PAS
 SG_ ReSideRdrRiObj1RdrObjDy : 119|13@0+ (0.05,-200.0) [-200.0|200.0] "m" ASDM,PAS
 SG_ ReSideRdrRiObj1RdrObjDyStdDe : 183|8@0+ (0.05,0.0) [0.0|12.700000000000001] "m" ASDM,PAS
 SG_ ReSideRdrRiObj1RdrObjElevnConf : 223|4@0+ (7.0,0.0) [0.0|105.0] "%" ASDM,PAS
 SG_ ReSideRdrRiObj1RdrObjElevnSts : 153|2@0+ (1,0) [0|3] "" ASDM,PAS
 SG_ ReSideRdrRiObj1RdrObjID : 167|8@0+ (1.0,0.0) [0.0|255.0] "Unitless" ASDM,PAS
 SG_ ReSideRdrRiObj1RdrObjIsInFreeSpace : 192|1@0+ (1,0) [0|1] "" ASDM,PAS
 SG_ ReSideRdrRiObj1RdrObjMirrProblty : 219|4@0+ (7.0,0.0) [0.0|105.0] "%" ASDM,PAS
 SG_ ReSideRdrRiObj1RdrObjMtnPat : 122|3@0+ (1,0) [0|7] "" ASDM,PAS
 SG_ ReSideRdrRiObj1RdrObjNotRealProblty : 231|4@0+ (7.0,0.0) [0.0|105.0] "%" ASDM,PAS
 SG_ ReSideRdrRiObj1RdrObjStatyCnt : 239|7@0+ (1.0,0.0) [0.0|127.0] "Unitless" ASDM,PAS
 SG_ ReSideRdrRiObj1RdrObjTiAlv : 247|7@0+ (1.0,0.0) [0.0|127.0] "Unitless" ASDM,PAS
 SG_ ReSideRdrRiObj1RdrObjTrackSts : 194|2@0+ (1,0) [0|3] "" ASDM,PAS
 SG_ ReSideRdrRiObj1RdrObjTyp : 51|4@0+ (1,0) [0|15] "" ASDM,PAS
 SG_ ReSideRdrRiObj1RdrObjTypConfBike : 175|4@0+ (7.0,0.0) [0.0|105.0] "%" ASDM,PAS
 SG_ ReSideRdrRiObj1RdrObjTypConfPed : 171|4@0+ (7.0,0.0) [0.0|105.0] "%" ASDM,PAS
 SG_ ReSideRdrRiObj1RdrObjTypConfVeh : 227|4@0+ (7.0,0.0) [0.0|105.0] "%" ASDM,PAS
 SG_ ReSideRdrRiObj1RdrObjVx : 255|14@0+ (0.02,-128.0) [-128.0|128.0] "m/s" ASDM,PAS
 SG_ ReSideRdrRiObj1RdrObjVxStdDe : 271|6@0+ (0.05,0.0) [0.0|2.0] "m/s" ASDM,PAS
 SG_ ReSideRdrRiObj1RdrObjVy : 207|14@0+ (0.02,-128.0) [-128.0|128.0] "m/s" ASDM,PAS
 SG_ ReSideRdrRiObj1RdrObjVyStdDe : 159|6@0+ (0.05,0.0) [0.0|2.0] "m/s" ASDM,PAS
 SG_ ReSideRdrRiObj1RelVx : 135|12@0+ (0.02,-35.6) [-35.6|35.6] "m/s" ASDM,PAS
 SG_ ReSideRdrRiObj1RelVy : 139|12@0+ (0.02,-35.6) [-35.6|35.6] "m/s" ASDM,PAS

BO_ 351 SODRSafetyCANFD3Frame24: 64 SODR
 SG_ ReSideRdrRiObj2_UB : 291|1@0+ (1,0) [0|1] "" ASDM,PAS
 SG_ ReSideRdrRiObj2Heading : 287|12@0+ (0.1,-180.0) [-180.0|180.0] "Deg" ASDM,PAS
 SG_ ReSideRdrRiObj2ObjBoxCenterLat : 23|9@0+ (0.1,-25.0) [-25.0|25.0] "m" ASDM,PAS
 SG_ ReSideRdrRiObj2ObjBoxCenterLgt : 30|9@0+ (0.1,-25.0) [-25.0|25.0] "m" ASDM,PAS
 SG_ ReSideRdrRiObj2ObservationHist : 63|32@0+ (1.0,0.0) [0.0|4294967295.0] "Unitless" ASDM,PAS
 SG_ ReSideRdrRiObj2RdrObjAx : 7|8@0- (0.1,0.0) [-12.8|12.700000000000001] "m/s^2" ASDM,PAS
 SG_ ReSideRdrRiObj2RdrObjAy : 15|8@0- (0.1,0.0) [-12.8|12.700000000000001] "m/s^2" ASDM,PAS
 SG_ ReSideRdrRiObj2RdrObjBoxLength : 37|9@0+ (0.1,0.0) [0.0|50.0] "m" ASDM,PAS
 SG_ ReSideRdrRiObj2RdrObjBoxWidth : 44|9@0+ (0.1,0.0) [0.0|50.0] "m" ASDM,PAS
 SG_ ReSideRdrRiObj2RdrObjChks : 95|8@0+ (1.0,0.0) [0.0|255.0] "Unitless" ASDM,PAS
 SG_ ReSideRdrRiObj2RdrObjCntr : 103|4@0+ (1.0,0.0) [0.0|15.0] "Unitless" ASDM,PAS
 SG_ ReSideRdrRiObj2RdrObjCoastCnt : 279|5@0+ (1.0,0.0) [0.0|31.0] "Unitless" ASDM,PAS
 SG_ ReSideRdrRiObj2RdrObjConf : 99|4@0+ (7.0,0.0) [0.0|105.0] "%" ASDM,PAS
 SG_ ReSideRdrRiObj2RdrObjDx : 191|13@0+ (0.05,-200.0) [-200.0|200.0] "m" ASDM,PAS
 SG_ ReSideRdrRiObj2RdrObjDxStdDe : 111|8@0+ (0.05,0.0) [0.0|12.700000000000001] "m" ASDM,PAS
 SG_ ReSideRdrRiObj2RdrObjDy : 119|13@0+ (0.05,-200.0) [-200.0|200.0] "m" ASDM,PAS
 SG_ ReSideRdrRiObj2RdrObjDyStdDe : 183|8@0+ (0.05,0.0) [0.0|12.700000000000001] "m" ASDM,PAS
 SG_ ReSideRdrRiObj2RdrObjElevnConf : 223|4@0+ (7.0,0.0) [0.0|105.0] "%" ASDM,PAS
 SG_ ReSideRdrRiObj2RdrObjElevnSts : 153|2@0+ (1,0) [0|3] "" ASDM,PAS
 SG_ ReSideRdrRiObj2RdrObjID : 167|8@0+ (1.0,0.0) [0.0|255.0] "Unitless" ASDM,PAS
 SG_ ReSideRdrRiObj2RdrObjIsInFreeSpace : 192|1@0+ (1,0) [0|1] "" ASDM,PAS
 SG_ ReSideRdrRiObj2RdrObjMirrProblty : 219|4@0+ (7.0,0.0) [0.0|105.0] "%" ASDM,PAS
 SG_ ReSideRdrRiObj2RdrObjMtnPat : 122|3@0+ (1,0) [0|7] "" ASDM,PAS
 SG_ ReSideRdrRiObj2RdrObjNotRealProblty : 231|4@0+ (7.0,0.0) [0.0|105.0] "%" ASDM,PAS
 SG_ ReSideRdrRiObj2RdrObjStatyCnt : 239|7@0+ (1.0,0.0) [0.0|127.0] "Unitless" ASDM,PAS
 SG_ ReSideRdrRiObj2RdrObjTiAlv : 247|7@0+ (1.0,0.0) [0.0|127.0] "Unitless" ASDM,PAS
 SG_ ReSideRdrRiObj2RdrObjTrackSts : 194|2@0+ (1,0) [0|3] "" ASDM,PAS
 SG_ ReSideRdrRiObj2RdrObjTyp : 51|4@0+ (1,0) [0|15] "" ASDM,PAS
 SG_ ReSideRdrRiObj2RdrObjTypConfBike : 175|4@0+ (7.0,0.0) [0.0|105.0] "%" ASDM,PAS
 SG_ ReSideRdrRiObj2RdrObjTypConfPed : 171|4@0+ (7.0,0.0) [0.0|105.0] "%" ASDM,PAS
 SG_ ReSideRdrRiObj2RdrObjTypConfVeh : 227|4@0+ (7.0,0.0) [0.0|105.0] "%" ASDM,PAS
 SG_ ReSideRdrRiObj2RdrObjVx : 255|14@0+ (0.02,-128.0) [-128.0|128.0] "m/s" ASDM,PAS
 SG_ ReSideRdrRiObj2RdrObjVxStdDe : 271|6@0+ (0.05,0.0) [0.0|2.0] "m/s" ASDM,PAS
 SG_ ReSideRdrRiObj2RdrObjVy : 207|14@0+ (0.02,-128.0) [-128.0|128.0] "m/s" ASDM,PAS
 SG_ ReSideRdrRiObj2RdrObjVyStdDe : 159|6@0+ (0.05,0.0) [0.0|2.0] "m/s" ASDM,PAS
 SG_ ReSideRdrRiObj2RelVx : 135|12@0+ (0.02,-35.6) [-35.6|35.6] "m/s" ASDM,PAS
 SG_ ReSideRdrRiObj2RelVy : 139|12@0+ (0.02,-35.6) [-35.6|35.6] "m/s" ASDM,PAS

BO_ 353 SODRSafetyCANFD3Frame25: 64 SODR
 SG_ ReSideRdrRiObj3_UB : 291|1@0+ (1,0) [0|1] "" ASDM,PAS
 SG_ ReSideRdrRiObj3Heading : 287|12@0+ (0.1,-180.0) [-180.0|180.0] "Deg" ASDM,PAS
 SG_ ReSideRdrRiObj3ObjBoxCenterLat : 23|9@0+ (0.1,-25.0) [-25.0|25.0] "m" ASDM,PAS
 SG_ ReSideRdrRiObj3ObjBoxCenterLgt : 30|9@0+ (0.1,-25.0) [-25.0|25.0] "m" ASDM,PAS
 SG_ ReSideRdrRiObj3ObservationHist : 63|32@0+ (1.0,0.0) [0.0|4294967295.0] "Unitless" ASDM,PAS
 SG_ ReSideRdrRiObj3RdrObjAx : 7|8@0- (0.1,0.0) [-12.8|12.700000000000001] "m/s^2" ASDM,PAS
 SG_ ReSideRdrRiObj3RdrObjAy : 15|8@0- (0.1,0.0) [-12.8|12.700000000000001] "m/s^2" ASDM,PAS
 SG_ ReSideRdrRiObj3RdrObjBoxLength : 37|9@0+ (0.1,0.0) [0.0|50.0] "m" ASDM,PAS
 SG_ ReSideRdrRiObj3RdrObjBoxWidth : 44|9@0+ (0.1,0.0) [0.0|50.0] "m" ASDM,PAS
 SG_ ReSideRdrRiObj3RdrObjChks : 95|8@0+ (1.0,0.0) [0.0|255.0] "Unitless" ASDM,PAS
 SG_ ReSideRdrRiObj3RdrObjCntr : 103|4@0+ (1.0,0.0) [0.0|15.0] "Unitless" ASDM,PAS
 SG_ ReSideRdrRiObj3RdrObjCoastCnt : 279|5@0+ (1.0,0.0) [0.0|31.0] "Unitless" ASDM,PAS
 SG_ ReSideRdrRiObj3RdrObjConf : 99|4@0+ (7.0,0.0) [0.0|105.0] "%" ASDM,PAS
 SG_ ReSideRdrRiObj3RdrObjDx : 191|13@0+ (0.05,-200.0) [-200.0|200.0] "m" ASDM,PAS
 SG_ ReSideRdrRiObj3RdrObjDxStdDe : 111|8@0+ (0.05,0.0) [0.0|12.700000000000001] "m" ASDM,PAS
 SG_ ReSideRdrRiObj3RdrObjDy : 119|13@0+ (0.05,-200.0) [-200.0|200.0] "m" ASDM,PAS
 SG_ ReSideRdrRiObj3RdrObjDyStdDe : 183|8@0+ (0.05,0.0) [0.0|12.700000000000001] "m" ASDM,PAS
 SG_ ReSideRdrRiObj3RdrObjElevnConf : 223|4@0+ (7.0,0.0) [0.0|105.0] "%" ASDM,PAS
 SG_ ReSideRdrRiObj3RdrObjElevnSts : 153|2@0+ (1,0) [0|3] "" ASDM,PAS
 SG_ ReSideRdrRiObj3RdrObjID : 167|8@0+ (1.0,0.0) [0.0|255.0] "Unitless" ASDM,PAS
 SG_ ReSideRdrRiObj3RdrObjIsInFreeSpace : 192|1@0+ (1,0) [0|1] "" ASDM,PAS
 SG_ ReSideRdrRiObj3RdrObjMirrProblty : 219|4@0+ (7.0,0.0) [0.0|105.0] "%" ASDM,PAS
 SG_ ReSideRdrRiObj3RdrObjMtnPat : 122|3@0+ (1,0) [0|7] "" ASDM,PAS
 SG_ ReSideRdrRiObj3RdrObjNotRealProblty : 231|4@0+ (7.0,0.0) [0.0|105.0] "%" ASDM,PAS
 SG_ ReSideRdrRiObj3RdrObjStatyCnt : 239|7@0+ (1.0,0.0) [0.0|127.0] "Unitless" ASDM,PAS
 SG_ ReSideRdrRiObj3RdrObjTiAlv : 247|7@0+ (1.0,0.0) [0.0|127.0] "Unitless" ASDM,PAS
 SG_ ReSideRdrRiObj3RdrObjTrackSts : 194|2@0+ (1,0) [0|3] "" ASDM,PAS
 SG_ ReSideRdrRiObj3RdrObjTyp : 51|4@0+ (1,0) [0|15] "" ASDM,PAS
 SG_ ReSideRdrRiObj3RdrObjTypConfBike : 175|4@0+ (7.0,0.0) [0.0|105.0] "%" ASDM,PAS
 SG_ ReSideRdrRiObj3RdrObjTypConfPed : 171|4@0+ (7.0,0.0) [0.0|105.0] "%" ASDM,PAS
 SG_ ReSideRdrRiObj3RdrObjTypConfVeh : 227|4@0+ (7.0,0.0) [0.0|105.0] "%" ASDM,PAS
 SG_ ReSideRdrRiObj3RdrObjVx : 255|14@0+ (0.02,-128.0) [-128.0|128.0] "m/s" ASDM,PAS
 SG_ ReSideRdrRiObj3RdrObjVxStdDe : 271|6@0+ (0.05,0.0) [0.0|2.0] "m/s" ASDM,PAS
 SG_ ReSideRdrRiObj3RdrObjVy : 207|14@0+ (0.02,-128.0) [-128.0|128.0] "m/s" ASDM,PAS
 SG_ ReSideRdrRiObj3RdrObjVyStdDe : 159|6@0+ (0.05,0.0) [0.0|2.0] "m/s" ASDM,PAS
 SG_ ReSideRdrRiObj3RelVx : 135|12@0+ (0.02,-35.6) [-35.6|35.6] "m/s" ASDM,PAS
 SG_ ReSideRdrRiObj3RelVy : 139|12@0+ (0.02,-35.6) [-35.6|35.6] "m/s" ASDM,PAS

CM_ SG_ 335 ReSideRdrRiDetn91RdrDetnAzi "Refer to the data element description in ReSideRdrRiDetn1 with the same data element name";
CM_ SG_ 335 ReSideRdrRiDetn91RdrDetnChks "Refer to the data element description in ReSideRdrRiDetn1 with the same data element name";
CM_ SG_ 335 ReSideRdrRiDetn91RdrDetnCntr "Refer to the data element description in ReSideRdrRiDetn1 with the same data element name";
CM_ SG_ 335 ReSideRdrRiDetn91RdrDetnConf "Refer to the data element description in ReSideRdrRiDetn1 with the same data element name";
CM_ SG_ 335 ReSideRdrRiDetn91RdrDetnElevn "Refer to the data element description in ReSideRdrRiDetn1 with the same data element name";
CM_ SG_ 335 ReSideRdrRiDetn91RdrDetnPwr "Refer to the data element description in ReSideRdrRiDetn1 with the same data element name";
CM_ SG_ 335 ReSideRdrRiDetn91RdrDetnRng "Refer to the data element description in ReSideRdrRiDetn1 with the same data element name";
CM_ SG_ 335 ReSideRdrRiDetn91RdrDetnRngV "Range Velocity";
CM_ SG_ 335 ReSideRdrRiDetn91RdrDetnSts "Refer to the data element description in ReSideRdrRiDetn1 with the same data element name";
CM_ SG_ 335 ReSideRdrRiDetn92RdrDetnAzi "Refer to the data element description in ReSideRdrRiDetn1 with the same data element name";
CM_ SG_ 335 ReSideRdrRiDetn92RdrDetnChks "Refer to the data element description in ReSideRdrRiDetn1 with the same data element name";
CM_ SG_ 335 ReSideRdrRiDetn92RdrDetnCntr "Refer to the data element description in ReSideRdrRiDetn1 with the same data element name";
CM_ SG_ 335 ReSideRdrRiDetn92RdrDetnConf "Refer to the data element description in ReSideRdrRiDetn1 with the same data element name";
CM_ SG_ 335 ReSideRdrRiDetn92RdrDetnElevn "Refer to the data element description in ReSideRdrRiDetn1 with the same data element name";
CM_ SG_ 335 ReSideRdrRiDetn92RdrDetnPwr "Refer to the data element description in ReSideRdrRiDetn1 with the same data element name";
CM_ SG_ 335 ReSideRdrRiDetn92RdrDetnRng "Refer to the data element description in ReSideRdrRiDetn1 with the same data element name";
CM_ SG_ 335 ReSideRdrRiDetn92RdrDetnRngV "Range Velocity";
CM_ SG_ 335 ReSideRdrRiDetn92RdrDetnSts "Refer to the data element description in ReSideRdrRiDetn1 with the same data element name";
CM_ SG_ 335 ReSideRdrRiDetn93RdrDetnAzi "Refer to the data element description in ReSideRdrRiDetn1 with the same data element name";
CM_ SG_ 335 ReSideRdrRiDetn93RdrDetnChks "Refer to the data element description in ReSideRdrRiDetn1 with the same data element name";
CM_ SG_ 335 ReSideRdrRiDetn93RdrDetnCntr "Refer to the data element description in ReSideRdrRiDetn1 with the same data element name";
CM_ SG_ 335 ReSideRdrRiDetn93RdrDetnConf "Refer to the data element description in ReSideRdrRiDetn1 with the same data element name";
CM_ SG_ 335 ReSideRdrRiDetn93RdrDetnElevn "Refer to the data element description in ReSideRdrRiDetn1 with the same data element name";
CM_ SG_ 335 ReSideRdrRiDetn93RdrDetnPwr "Refer to the data element description in ReSideRdrRiDetn1 with the same data element name";
CM_ SG_ 335 ReSideRdrRiDetn93RdrDetnRng "Refer to the data element description in ReSideRdrRiDetn1 with the same data element name";
CM_ SG_ 335 ReSideRdrRiDetn93RdrDetnRngV "Range Velocity";
CM_ SG_ 335 ReSideRdrRiDetn93RdrDetnSts "Refer to the data element description in ReSideRdrRiDetn1 with the same data element name";
CM_ SG_ 335 ReSideRdrRiDetn94RdrDetnAzi "Refer to the data element description in ReSideRdrRiDetn1 with the same data element name";
CM_ SG_ 335 ReSideRdrRiDetn94RdrDetnChks "Refer to the data element description in ReSideRdrRiDetn1 with the same data element name";
CM_ SG_ 335 ReSideRdrRiDetn94RdrDetnCntr "Refer to the data element description in ReSideRdrRiDetn1 with the same data element name";
CM_ SG_ 335 ReSideRdrRiDetn94RdrDetnConf "Refer to the data element description in ReSideRdrRiDetn1 with the same data element name";
CM_ SG_ 335 ReSideRdrRiDetn94RdrDetnElevn "Refer to the data element description in ReSideRdrRiDetn1 with the same data element name";
CM_ SG_ 335 ReSideRdrRiDetn94RdrDetnPwr "Refer to the data element description in ReSideRdrRiDetn1 with the same data element name";
CM_ SG_ 335 ReSideRdrRiDetn94RdrDetnRng "Refer to the data element description in ReSideRdrRiDetn1 with the same data element name";
CM_ SG_ 335 ReSideRdrRiDetn94RdrDetnRngV "Range Velocity";
CM_ SG_ 335 ReSideRdrRiDetn94RdrDetnSts "Refer to the data element description in ReSideRdrRiDetn1 with the same data element name";
CM_ SG_ 335 ReSideRdrRiDetn95RdrDetnAzi "Refer to the data element description in ReSideRdrRiDetn1 with the same data element name";
CM_ SG_ 335 ReSideRdrRiDetn95RdrDetnChks "Refer to the data element description in ReSideRdrRiDetn1 with the same data element name";
CM_ SG_ 335 ReSideRdrRiDetn95RdrDetnCntr "Refer to the data element description in ReSideRdrRiDetn1 with the same data element name";
CM_ SG_ 335 ReSideRdrRiDetn95RdrDetnConf "Refer to the data element description in ReSideRdrRiDetn1 with the same data element name";
CM_ SG_ 335 ReSideRdrRiDetn95RdrDetnElevn "Refer to the data element description in ReSideRdrRiDetn1 with the same data element name";
CM_ SG_ 335 ReSideRdrRiDetn95RdrDetnPwr "Refer to the data element description in ReSideRdrRiDetn1 with the same data element name";
CM_ SG_ 335 ReSideRdrRiDetn95RdrDetnRng "Refer to the data element description in ReSideRdrRiDetn1 with the same data element name";
CM_ SG_ 335 ReSideRdrRiDetn95RdrDetnRngV "Range Velocity";
CM_ SG_ 335 ReSideRdrRiDetn95RdrDetnSts "Refer to the data element description in ReSideRdrRiDetn1 with the same data element name";
CM_ SG_ 335 ReSideRdrRiDetn96RdrDetnAzi "Refer to the data element description in ReSideRdrRiDetn1 with the same data element name";
CM_ SG_ 335 ReSideRdrRiDetn96RdrDetnChks "Refer to the data element description in ReSideRdrRiDetn1 with the same data element name";
CM_ SG_ 335 ReSideRdrRiDetn96RdrDetnCntr "Refer to the data element description in ReSideRdrRiDetn1 with the same data element name";
CM_ SG_ 335 ReSideRdrRiDetn96RdrDetnConf "Refer to the data element description in ReSideRdrRiDetn1 with the same data element name";
CM_ SG_ 335 ReSideRdrRiDetn96RdrDetnElevn "Refer to the data element description in ReSideRdrRiDetn1 with the same data element name";
CM_ SG_ 335 ReSideRdrRiDetn96RdrDetnPwr "Refer to the data element description in ReSideRdrRiDetn1 with the same data element name";
CM_ SG_ 335 ReSideRdrRiDetn96RdrDetnRng "Refer to the data element description in ReSideRdrRiDetn1 with the same data element name";
CM_ SG_ 335 ReSideRdrRiDetn96RdrDetnRngV "Range Velocity";
CM_ SG_ 335 ReSideRdrRiDetn96RdrDetnSts "Refer to the data element description in ReSideRdrRiDetn1 with the same data element name";
CM_ SG_ 337 ReSideRdrRiDetn100RdrDetnAzi "Refer to the data element description in ReSideRdrRiDetn1 with the same data element name";
CM_ SG_ 337 ReSideRdrRiDetn100RdrDetnChks "Refer to the data element description in ReSideRdrRiDetn1 with the same data element name";
CM_ SG_ 337 ReSideRdrRiDetn100RdrDetnCntr "Refer to the data element description in ReSideRdrRiDetn1 with the same data element name";
CM_ SG_ 337 ReSideRdrRiDetn100RdrDetnConf "Refer to the data element description in ReSideRdrRiDetn1 with the same data element name";
CM_ SG_ 337 ReSideRdrRiDetn100RdrDetnElevn "Refer to the data element description in ReSideRdrRiDetn1 with the same data element name";
CM_ SG_ 337 ReSideRdrRiDetn100RdrDetnPwr "Refer to the data element description in ReSideRdrRiDetn1 with the same data element name";
CM_ SG_ 337 ReSideRdrRiDetn100RdrDetnRng "Refer to the data element description in ReSideRdrRiDetn1 with the same data element name";
CM_ SG_ 337 ReSideRdrRiDetn100RdrDetnRngV "Range Velocity";
CM_ SG_ 337 ReSideRdrRiDetn100RdrDetnSts "Refer to the data element description in ReSideRdrRiDetn1 with the same data element name";
CM_ SG_ 337 ReSideRdrRiDetn101RdrDetnAzi "Refer to the data element description in ReSideRdrRiDetn1 with the same data element name";
CM_ SG_ 337 ReSideRdrRiDetn101RdrDetnChks "Refer to the data element description in ReSideRdrRiDetn1 with the same data element name";
CM_ SG_ 337 ReSideRdrRiDetn101RdrDetnCntr "Refer to the data element description in ReSideRdrRiDetn1 with the same data element name";
CM_ SG_ 337 ReSideRdrRiDetn101RdrDetnConf "Refer to the data element description in ReSideRdrRiDetn1 with the same data element name";
CM_ SG_ 337 ReSideRdrRiDetn101RdrDetnElevn "Refer to the data element description in ReSideRdrRiDetn1 with the same data element name";
CM_ SG_ 337 ReSideRdrRiDetn101RdrDetnPwr "Refer to the data element description in ReSideRdrRiDetn1 with the same data element name";
CM_ SG_ 337 ReSideRdrRiDetn101RdrDetnRng "Refer to the data element description in ReSideRdrRiDetn1 with the same data element name";
CM_ SG_ 337 ReSideRdrRiDetn101RdrDetnRngV "Range Velocity";
CM_ SG_ 337 ReSideRdrRiDetn101RdrDetnSts "Refer to the data element description in ReSideRdrRiDetn1 with the same data element name";
CM_ SG_ 337 ReSideRdrRiDetn102RdrDetnAzi "Refer to the data element description in ReSideRdrRiDetn1 with the same data element name";
CM_ SG_ 337 ReSideRdrRiDetn102RdrDetnChks "Refer to the data element description in ReSideRdrRiDetn1 with the same data element name";
CM_ SG_ 337 ReSideRdrRiDetn102RdrDetnCntr "Refer to the data element description in ReSideRdrRiDetn1 with the same data element name";
CM_ SG_ 337 ReSideRdrRiDetn102RdrDetnConf "Refer to the data element description in ReSideRdrRiDetn1 with the same data element name";
CM_ SG_ 337 ReSideRdrRiDetn102RdrDetnElevn "Refer to the data element description in ReSideRdrRiDetn1 with the same data element name";
CM_ SG_ 337 ReSideRdrRiDetn102RdrDetnPwr "Refer to the data element description in ReSideRdrRiDetn1 with the same data element name";
CM_ SG_ 337 ReSideRdrRiDetn102RdrDetnRng "Refer to the data element description in ReSideRdrRiDetn1 with the same data element name";
CM_ SG_ 337 ReSideRdrRiDetn102RdrDetnRngV "Range Velocity";
CM_ SG_ 337 ReSideRdrRiDetn102RdrDetnSts "Refer to the data element description in ReSideRdrRiDetn1 with the same data element name";
CM_ SG_ 337 ReSideRdrRiDetn97RdrDetnAzi "Refer to the data element description in ReSideRdrRiDetn1 with the same data element name";
CM_ SG_ 337 ReSideRdrRiDetn97RdrDetnChks "Refer to the data element description in ReSideRdrRiDetn1 with the same data element name";
CM_ SG_ 337 ReSideRdrRiDetn97RdrDetnCntr "Refer to the data element description in ReSideRdrRiDetn1 with the same data element name";
CM_ SG_ 337 ReSideRdrRiDetn97RdrDetnConf "Refer to the data element description in ReSideRdrRiDetn1 with the same data element name";
CM_ SG_ 337 ReSideRdrRiDetn97RdrDetnElevn "Refer to the data element description in ReSideRdrRiDetn1 with the same data element name";
CM_ SG_ 337 ReSideRdrRiDetn97RdrDetnPwr "Refer to the data element description in ReSideRdrRiDetn1 with the same data element name";
CM_ SG_ 337 ReSideRdrRiDetn97RdrDetnRng "Refer to the data element description in ReSideRdrRiDetn1 with the same data element name";
CM_ SG_ 337 ReSideRdrRiDetn97RdrDetnRngV "Range Velocity";
CM_ SG_ 337 ReSideRdrRiDetn97RdrDetnSts "Refer to the data element description in ReSideRdrRiDetn1 with the same data element name";
CM_ SG_ 337 ReSideRdrRiDetn98RdrDetnAzi "Refer to the data element description in ReSideRdrRiDetn1 with the same data element name";
CM_ SG_ 337 ReSideRdrRiDetn98RdrDetnChks "Refer to the data element description in ReSideRdrRiDetn1 with the same data element name";
CM_ SG_ 337 ReSideRdrRiDetn98RdrDetnCntr "Refer to the data element description in ReSideRdrRiDetn1 with the same data element name";
CM_ SG_ 337 ReSideRdrRiDetn98RdrDetnConf "Refer to the data element description in ReSideRdrRiDetn1 with the same data element name";
CM_ SG_ 337 ReSideRdrRiDetn98RdrDetnElevn "Refer to the data element description in ReSideRdrRiDetn1 with the same data element name";
CM_ SG_ 337 ReSideRdrRiDetn98RdrDetnPwr "Refer to the data element description in ReSideRdrRiDetn1 with the same data element name";
CM_ SG_ 337 ReSideRdrRiDetn98RdrDetnRng "Refer to the data element description in ReSideRdrRiDetn1 with the same data element name";
CM_ SG_ 337 ReSideRdrRiDetn98RdrDetnRngV "Range Velocity";
CM_ SG_ 337 ReSideRdrRiDetn98RdrDetnSts "Refer to the data element description in ReSideRdrRiDetn1 with the same data element name";
CM_ SG_ 337 ReSideRdrRiDetn99RdrDetnAzi "Refer to the data element description in ReSideRdrRiDetn1 with the same data element name";
CM_ SG_ 337 ReSideRdrRiDetn99RdrDetnChks "Refer to the data element description in ReSideRdrRiDetn1 with the same data element name";
CM_ SG_ 337 ReSideRdrRiDetn99RdrDetnCntr "Refer to the data element description in ReSideRdrRiDetn1 with the same data element name";
CM_ SG_ 337 ReSideRdrRiDetn99RdrDetnConf "Refer to the data element description in ReSideRdrRiDetn1 with the same data element name";
CM_ SG_ 337 ReSideRdrRiDetn99RdrDetnElevn "Refer to the data element description in ReSideRdrRiDetn1 with the same data element name";
CM_ SG_ 337 ReSideRdrRiDetn99RdrDetnPwr "Refer to the data element description in ReSideRdrRiDetn1 with the same data element name";
CM_ SG_ 337 ReSideRdrRiDetn99RdrDetnRng "Refer to the data element description in ReSideRdrRiDetn1 with the same data element name";
CM_ SG_ 337 ReSideRdrRiDetn99RdrDetnRngV "Range Velocity";
CM_ SG_ 337 ReSideRdrRiDetn99RdrDetnSts "Refer to the data element description in ReSideRdrRiDetn1 with the same data element name";
CM_ SG_ 339 ReSideRdrRiDetn103RdrDetnAzi "Refer to the data element description in ReSideRdrRiDetn1 with the same data element name";
CM_ SG_ 339 ReSideRdrRiDetn103RdrDetnChks "Refer to the data element description in ReSideRdrRiDetn1 with the same data element name";
CM_ SG_ 339 ReSideRdrRiDetn103RdrDetnCntr "Refer to the data element description in ReSideRdrRiDetn1 with the same data element name";
CM_ SG_ 339 ReSideRdrRiDetn103RdrDetnConf "Refer to the data element description in ReSideRdrRiDetn1 with the same data element name";
CM_ SG_ 339 ReSideRdrRiDetn103RdrDetnElevn "Refer to the data element description in ReSideRdrRiDetn1 with the same data element name";
CM_ SG_ 339 ReSideRdrRiDetn103RdrDetnPwr "Refer to the data element description in ReSideRdrRiDetn1 with the same data element name";
CM_ SG_ 339 ReSideRdrRiDetn103RdrDetnRng "Refer to the data element description in ReSideRdrRiDetn1 with the same data element name";
CM_ SG_ 339 ReSideRdrRiDetn103RdrDetnRngV "Range Velocity";
CM_ SG_ 339 ReSideRdrRiDetn103RdrDetnSts "Refer to the data element description in ReSideRdrRiDetn1 with the same data element name";
CM_ SG_ 339 ReSideRdrRiDetn104RdrDetnAzi "Refer to the data element description in ReSideRdrRiDetn1 with the same data element name";
CM_ SG_ 339 ReSideRdrRiDetn104RdrDetnChks "Refer to the data element description in ReSideRdrRiDetn1 with the same data element name";
CM_ SG_ 339 ReSideRdrRiDetn104RdrDetnCntr "Refer to the data element description in ReSideRdrRiDetn1 with the same data element name";
CM_ SG_ 339 ReSideRdrRiDetn104RdrDetnConf "Refer to the data element description in ReSideRdrRiDetn1 with the same data element name";
CM_ SG_ 339 ReSideRdrRiDetn104RdrDetnElevn "Refer to the data element description in ReSideRdrRiDetn1 with the same data element name";
CM_ SG_ 339 ReSideRdrRiDetn104RdrDetnPwr "Refer to the data element description in ReSideRdrRiDetn1 with the same data element name";
CM_ SG_ 339 ReSideRdrRiDetn104RdrDetnRng "Refer to the data element description in ReSideRdrRiDetn1 with the same data element name";
CM_ SG_ 339 ReSideRdrRiDetn104RdrDetnRngV "Range Velocity";
CM_ SG_ 339 ReSideRdrRiDetn104RdrDetnSts "Refer to the data element description in ReSideRdrRiDetn1 with the same data element name";
CM_ SG_ 339 ReSideRdrRiDetn105RdrDetnAzi "Refer to the data element description in ReSideRdrRiDetn1 with the same data element name";
CM_ SG_ 339 ReSideRdrRiDetn105RdrDetnChks "Refer to the data element description in ReSideRdrRiDetn1 with the same data element name";
CM_ SG_ 339 ReSideRdrRiDetn105RdrDetnCntr "Refer to the data element description in ReSideRdrRiDetn1 with the same data element name";
CM_ SG_ 339 ReSideRdrRiDetn105RdrDetnConf "Refer to the data element description in ReSideRdrRiDetn1 with the same data element name";
CM_ SG_ 339 ReSideRdrRiDetn105RdrDetnElevn "Refer to the data element description in ReSideRdrRiDetn1 with the same data element name";
CM_ SG_ 339 ReSideRdrRiDetn105RdrDetnPwr "Refer to the data element description in ReSideRdrRiDetn1 with the same data element name";
CM_ SG_ 339 ReSideRdrRiDetn105RdrDetnRng "Refer to the data element description in ReSideRdrRiDetn1 with the same data element name";
CM_ SG_ 339 ReSideRdrRiDetn105RdrDetnRngV "Range Velocity";
CM_ SG_ 339 ReSideRdrRiDetn105RdrDetnSts "Refer to the data element description in ReSideRdrRiDetn1 with the same data element name";
CM_ SG_ 339 ReSideRdrRiDetn106RdrDetnAzi "Refer to the data element description in ReSideRdrRiDetn1 with the same data element name";
CM_ SG_ 339 ReSideRdrRiDetn106RdrDetnChks "Refer to the data element description in ReSideRdrRiDetn1 with the same data element name";
CM_ SG_ 339 ReSideRdrRiDetn106RdrDetnCntr "Refer to the data element description in ReSideRdrRiDetn1 with the same data element name";
CM_ SG_ 339 ReSideRdrRiDetn106RdrDetnConf "Refer to the data element description in ReSideRdrRiDetn1 with the same data element name";
CM_ SG_ 339 ReSideRdrRiDetn106RdrDetnElevn "Refer to the data element description in ReSideRdrRiDetn1 with the same data element name";
CM_ SG_ 339 ReSideRdrRiDetn106RdrDetnPwr "Refer to the data element description in ReSideRdrRiDetn1 with the same data element name";
CM_ SG_ 339 ReSideRdrRiDetn106RdrDetnRng "Refer to the data element description in ReSideRdrRiDetn1 with the same data element name";
CM_ SG_ 339 ReSideRdrRiDetn106RdrDetnRngV "Range Velocity";
CM_ SG_ 339 ReSideRdrRiDetn106RdrDetnSts "Refer to the data element description in ReSideRdrRiDetn1 with the same data element name";
CM_ SG_ 339 ReSideRdrRiDetn107RdrDetnAzi "Refer to the data element description in ReSideRdrRiDetn1 with the same data element name";
CM_ SG_ 339 ReSideRdrRiDetn107RdrDetnChks "Refer to the data element description in ReSideRdrRiDetn1 with the same data element name";
CM_ SG_ 339 ReSideRdrRiDetn107RdrDetnCntr "Refer to the data element description in ReSideRdrRiDetn1 with the same data element name";
CM_ SG_ 339 ReSideRdrRiDetn107RdrDetnConf "Refer to the data element description in ReSideRdrRiDetn1 with the same data element name";
CM_ SG_ 339 ReSideRdrRiDetn107RdrDetnElevn "Refer to the data element description in ReSideRdrRiDetn1 with the same data element name";
CM_ SG_ 339 ReSideRdrRiDetn107RdrDetnPwr "Refer to the data element description in ReSideRdrRiDetn1 with the same data element name";
CM_ SG_ 339 ReSideRdrRiDetn107RdrDetnRng "Refer to the data element description in ReSideRdrRiDetn1 with the same data element name";
CM_ SG_ 339 ReSideRdrRiDetn107RdrDetnRngV "Range Velocity";
CM_ SG_ 339 ReSideRdrRiDetn107RdrDetnSts "Refer to the data element description in ReSideRdrRiDetn1 with the same data element name";
CM_ SG_ 339 ReSideRdrRiDetn108RdrDetnAzi "Refer to the data element description in ReSideRdrRiDetn1 with the same data element name";
CM_ SG_ 339 ReSideRdrRiDetn108RdrDetnChks "Refer to the data element description in ReSideRdrRiDetn1 with the same data element name";
CM_ SG_ 339 ReSideRdrRiDetn108RdrDetnCntr "Refer to the data element description in ReSideRdrRiDetn1 with the same data element name";
CM_ SG_ 339 ReSideRdrRiDetn108RdrDetnConf "Refer to the data element description in ReSideRdrRiDetn1 with the same data element name";
CM_ SG_ 339 ReSideRdrRiDetn108RdrDetnElevn "Refer to the data element description in ReSideRdrRiDetn1 with the same data element name";
CM_ SG_ 339 ReSideRdrRiDetn108RdrDetnPwr "Refer to the data element description in ReSideRdrRiDetn1 with the same data element name";
CM_ SG_ 339 ReSideRdrRiDetn108RdrDetnRng "Refer to the data element description in ReSideRdrRiDetn1 with the same data element name";
CM_ SG_ 339 ReSideRdrRiDetn108RdrDetnRngV "Range Velocity";
CM_ SG_ 339 ReSideRdrRiDetn108RdrDetnSts "Refer to the data element description in ReSideRdrRiDetn1 with the same data element name";
CM_ SG_ 341 ReSideRdrRiDetn109RdrDetnAzi "Refer to the data element description in ReSideRdrRiDetn1 with the same data element name";
CM_ SG_ 341 ReSideRdrRiDetn109RdrDetnChks "Refer to the data element description in ReSideRdrRiDetn1 with the same data element name";
CM_ SG_ 341 ReSideRdrRiDetn109RdrDetnCntr "Refer to the data element description in ReSideRdrRiDetn1 with the same data element name";
CM_ SG_ 341 ReSideRdrRiDetn109RdrDetnConf "Refer to the data element description in ReSideRdrRiDetn1 with the same data element name";
CM_ SG_ 341 ReSideRdrRiDetn109RdrDetnElevn "Refer to the data element description in ReSideRdrRiDetn1 with the same data element name";
CM_ SG_ 341 ReSideRdrRiDetn109RdrDetnPwr "Refer to the data element description in ReSideRdrRiDetn1 with the same data element name";
CM_ SG_ 341 ReSideRdrRiDetn109RdrDetnRng "Refer to the data element description in ReSideRdrRiDetn1 with the same data element name";
CM_ SG_ 341 ReSideRdrRiDetn109RdrDetnRngV "Range Velocity";
CM_ SG_ 341 ReSideRdrRiDetn109RdrDetnSts "Refer to the data element description in ReSideRdrRiDetn1 with the same data element name";
CM_ SG_ 341 ReSideRdrRiDetn110RdrDetnAzi "Refer to the data element description in ReSideRdrRiDetn1 with the same data element name";
CM_ SG_ 341 ReSideRdrRiDetn110RdrDetnChks "Refer to the data element description in ReSideRdrRiDetn1 with the same data element name";
CM_ SG_ 341 ReSideRdrRiDetn110RdrDetnCntr "Refer to the data element description in ReSideRdrRiDetn1 with the same data element name";
CM_ SG_ 341 ReSideRdrRiDetn110RdrDetnConf "Refer to the data element description in ReSideRdrRiDetn1 with the same data element name";
CM_ SG_ 341 ReSideRdrRiDetn110RdrDetnElevn "Refer to the data element description in ReSideRdrRiDetn1 with the same data element name";
CM_ SG_ 341 ReSideRdrRiDetn110RdrDetnPwr "Refer to the data element description in ReSideRdrRiDetn1 with the same data element name";
CM_ SG_ 341 ReSideRdrRiDetn110RdrDetnRng "Refer to the data element description in ReSideRdrRiDetn1 with the same data element name";
CM_ SG_ 341 ReSideRdrRiDetn110RdrDetnRngV "Range Velocity";
CM_ SG_ 341 ReSideRdrRiDetn110RdrDetnSts "Refer to the data element description in ReSideRdrRiDetn1 with the same data element name";
CM_ SG_ 341 ReSideRdrRiDetn111RdrDetnAzi "Refer to the data element description in ReSideRdrRiDetn1 with the same data element name";
CM_ SG_ 341 ReSideRdrRiDetn111RdrDetnChks "Refer to the data element description in ReSideRdrRiDetn1 with the same data element name";
CM_ SG_ 341 ReSideRdrRiDetn111RdrDetnCntr "Refer to the data element description in ReSideRdrRiDetn1 with the same data element name";
CM_ SG_ 341 ReSideRdrRiDetn111RdrDetnConf "Refer to the data element description in ReSideRdrRiDetn1 with the same data element name";
CM_ SG_ 341 ReSideRdrRiDetn111RdrDetnElevn "Refer to the data element description in ReSideRdrRiDetn1 with the same data element name";
CM_ SG_ 341 ReSideRdrRiDetn111RdrDetnPwr "Refer to the data element description in ReSideRdrRiDetn1 with the same data element name";
CM_ SG_ 341 ReSideRdrRiDetn111RdrDetnRng "Refer to the data element description in ReSideRdrRiDetn1 with the same data element name";
CM_ SG_ 341 ReSideRdrRiDetn111RdrDetnRngV "Range Velocity";
CM_ SG_ 341 ReSideRdrRiDetn111RdrDetnSts "Refer to the data element description in ReSideRdrRiDetn1 with the same data element name";
CM_ SG_ 341 ReSideRdrRiDetn112RdrDetnAzi "Refer to the data element description in ReSideRdrRiDetn1 with the same data element name";
CM_ SG_ 341 ReSideRdrRiDetn112RdrDetnChks "Refer to the data element description in ReSideRdrRiDetn1 with the same data element name";
CM_ SG_ 341 ReSideRdrRiDetn112RdrDetnCntr "Refer to the data element description in ReSideRdrRiDetn1 with the same data element name";
CM_ SG_ 341 ReSideRdrRiDetn112RdrDetnConf "Refer to the data element description in ReSideRdrRiDetn1 with the same data element name";
CM_ SG_ 341 ReSideRdrRiDetn112RdrDetnElevn "Refer to the data element description in ReSideRdrRiDetn1 with the same data element name";
CM_ SG_ 341 ReSideRdrRiDetn112RdrDetnPwr "Refer to the data element description in ReSideRdrRiDetn1 with the same data element name";
CM_ SG_ 341 ReSideRdrRiDetn112RdrDetnRng "Refer to the data element description in ReSideRdrRiDetn1 with the same data element name";
CM_ SG_ 341 ReSideRdrRiDetn112RdrDetnRngV "Range Velocity";
CM_ SG_ 341 ReSideRdrRiDetn112RdrDetnSts "Refer to the data element description in ReSideRdrRiDetn1 with the same data element name";
CM_ SG_ 341 ReSideRdrRiDetn113RdrDetnAzi "Refer to the data element description in ReSideRdrRiDetn1 with the same data element name";
CM_ SG_ 341 ReSideRdrRiDetn113RdrDetnChks "Refer to the data element description in ReSideRdrRiDetn1 with the same data element name";
CM_ SG_ 341 ReSideRdrRiDetn113RdrDetnCntr "Refer to the data element description in ReSideRdrRiDetn1 with the same data element name";
CM_ SG_ 341 ReSideRdrRiDetn113RdrDetnConf "Refer to the data element description in ReSideRdrRiDetn1 with the same data element name";
CM_ SG_ 341 ReSideRdrRiDetn113RdrDetnElevn "Refer to the data element description in ReSideRdrRiDetn1 with the same data element name";
CM_ SG_ 341 ReSideRdrRiDetn113RdrDetnPwr "Refer to the data element description in ReSideRdrRiDetn1 with the same data element name";
CM_ SG_ 341 ReSideRdrRiDetn113RdrDetnRng "Refer to the data element description in ReSideRdrRiDetn1 with the same data element name";
CM_ SG_ 341 ReSideRdrRiDetn113RdrDetnRngV "Range Velocity";
CM_ SG_ 341 ReSideRdrRiDetn113RdrDetnSts "Refer to the data element description in ReSideRdrRiDetn1 with the same data element name";
CM_ SG_ 341 ReSideRdrRiDetn114RdrDetnAzi "Refer to the data element description in ReSideRdrRiDetn1 with the same data element name";
CM_ SG_ 341 ReSideRdrRiDetn114RdrDetnChks "Refer to the data element description in ReSideRdrRiDetn1 with the same data element name";
CM_ SG_ 341 ReSideRdrRiDetn114RdrDetnCntr "Refer to the data element description in ReSideRdrRiDetn1 with the same data element name";
CM_ SG_ 341 ReSideRdrRiDetn114RdrDetnConf "Refer to the data element description in ReSideRdrRiDetn1 with the same data element name";
CM_ SG_ 341 ReSideRdrRiDetn114RdrDetnElevn "Refer to the data element description in ReSideRdrRiDetn1 with the same data element name";
CM_ SG_ 341 ReSideRdrRiDetn114RdrDetnPwr "Refer to the data element description in ReSideRdrRiDetn1 with the same data element name";
CM_ SG_ 341 ReSideRdrRiDetn114RdrDetnRng "Refer to the data element description in ReSideRdrRiDetn1 with the same data element name";
CM_ SG_ 341 ReSideRdrRiDetn114RdrDetnRngV "Range Velocity";
CM_ SG_ 341 ReSideRdrRiDetn114RdrDetnSts "Refer to the data element description in ReSideRdrRiDetn1 with the same data element name";
CM_ SG_ 343 ReSideRdrRiDetn115RdrDetnAzi "Refer to the data element description in ReSideRdrRiDetn1 with the same data element name";
CM_ SG_ 343 ReSideRdrRiDetn115RdrDetnChks "Refer to the data element description in ReSideRdrRiDetn1 with the same data element name";
CM_ SG_ 343 ReSideRdrRiDetn115RdrDetnCntr "Refer to the data element description in ReSideRdrRiDetn1 with the same data element name";
CM_ SG_ 343 ReSideRdrRiDetn115RdrDetnConf "Refer to the data element description in ReSideRdrRiDetn1 with the same data element name";
CM_ SG_ 343 ReSideRdrRiDetn115RdrDetnElevn "Refer to the data element description in ReSideRdrRiDetn1 with the same data element name";
CM_ SG_ 343 ReSideRdrRiDetn115RdrDetnPwr "Refer to the data element description in ReSideRdrRiDetn1 with the same data element name";
CM_ SG_ 343 ReSideRdrRiDetn115RdrDetnRng "Refer to the data element description in ReSideRdrRiDetn1 with the same data element name";
CM_ SG_ 343 ReSideRdrRiDetn115RdrDetnRngV "Range Velocity";
CM_ SG_ 343 ReSideRdrRiDetn115RdrDetnSts "Refer to the data element description in ReSideRdrRiDetn1 with the same data element name";
CM_ SG_ 343 ReSideRdrRiDetn116RdrDetnAzi "Refer to the data element description in ReSideRdrRiDetn1 with the same data element name";
CM_ SG_ 343 ReSideRdrRiDetn116RdrDetnChks "Refer to the data element description in ReSideRdrRiDetn1 with the same data element name";
CM_ SG_ 343 ReSideRdrRiDetn116RdrDetnCntr "Refer to the data element description in ReSideRdrRiDetn1 with the same data element name";
CM_ SG_ 343 ReSideRdrRiDetn116RdrDetnConf "Refer to the data element description in ReSideRdrRiDetn1 with the same data element name";
CM_ SG_ 343 ReSideRdrRiDetn116RdrDetnElevn "Refer to the data element description in ReSideRdrRiDetn1 with the same data element name";
CM_ SG_ 343 ReSideRdrRiDetn116RdrDetnPwr "Refer to the data element description in ReSideRdrRiDetn1 with the same data element name";
CM_ SG_ 343 ReSideRdrRiDetn116RdrDetnRng "Refer to the data element description in ReSideRdrRiDetn1 with the same data element name";
CM_ SG_ 343 ReSideRdrRiDetn116RdrDetnRngV "Range Velocity";
CM_ SG_ 343 ReSideRdrRiDetn116RdrDetnSts "Refer to the data element description in ReSideRdrRiDetn1 with the same data element name";
CM_ SG_ 343 ReSideRdrRiDetn117RdrDetnAzi "Refer to the data element description in ReSideRdrRiDetn1 with the same data element name";
CM_ SG_ 343 ReSideRdrRiDetn117RdrDetnChks "Refer to the data element description in ReSideRdrRiDetn1 with the same data element name";
CM_ SG_ 343 ReSideRdrRiDetn117RdrDetnCntr "Refer to the data element description in ReSideRdrRiDetn1 with the same data element name";
CM_ SG_ 343 ReSideRdrRiDetn117RdrDetnConf "Refer to the data element description in ReSideRdrRiDetn1 with the same data element name";
CM_ SG_ 343 ReSideRdrRiDetn117RdrDetnElevn "Refer to the data element description in ReSideRdrRiDetn1 with the same data element name";
CM_ SG_ 343 ReSideRdrRiDetn117RdrDetnPwr "Refer to the data element description in ReSideRdrRiDetn1 with the same data element name";
CM_ SG_ 343 ReSideRdrRiDetn117RdrDetnRng "Refer to the data element description in ReSideRdrRiDetn1 with the same data element name";
CM_ SG_ 343 ReSideRdrRiDetn117RdrDetnRngV "Range Velocity";
CM_ SG_ 343 ReSideRdrRiDetn117RdrDetnSts "Refer to the data element description in ReSideRdrRiDetn1 with the same data element name";
CM_ SG_ 343 ReSideRdrRiDetn118RdrDetnAzi "Refer to the data element description in ReSideRdrRiDetn1 with the same data element name";
CM_ SG_ 343 ReSideRdrRiDetn118RdrDetnChks "Refer to the data element description in ReSideRdrRiDetn1 with the same data element name";
CM_ SG_ 343 ReSideRdrRiDetn118RdrDetnCntr "Refer to the data element description in ReSideRdrRiDetn1 with the same data element name";
CM_ SG_ 343 ReSideRdrRiDetn118RdrDetnConf "Refer to the data element description in ReSideRdrRiDetn1 with the same data element name";
CM_ SG_ 343 ReSideRdrRiDetn118RdrDetnElevn "Refer to the data element description in ReSideRdrRiDetn1 with the same data element name";
CM_ SG_ 343 ReSideRdrRiDetn118RdrDetnPwr "Refer to the data element description in ReSideRdrRiDetn1 with the same data element name";
CM_ SG_ 343 ReSideRdrRiDetn118RdrDetnRng "Refer to the data element description in ReSideRdrRiDetn1 with the same data element name";
CM_ SG_ 343 ReSideRdrRiDetn118RdrDetnRngV "Range Velocity";
CM_ SG_ 343 ReSideRdrRiDetn118RdrDetnSts "Refer to the data element description in ReSideRdrRiDetn1 with the same data element name";
CM_ SG_ 343 ReSideRdrRiDetn119RdrDetnAzi "Refer to the data element description in ReSideRdrRiDetn1 with the same data element name";
CM_ SG_ 343 ReSideRdrRiDetn119RdrDetnChks "Refer to the data element description in ReSideRdrRiDetn1 with the same data element name";
CM_ SG_ 343 ReSideRdrRiDetn119RdrDetnCntr "Refer to the data element description in ReSideRdrRiDetn1 with the same data element name";
CM_ SG_ 343 ReSideRdrRiDetn119RdrDetnConf "Refer to the data element description in ReSideRdrRiDetn1 with the same data element name";
CM_ SG_ 343 ReSideRdrRiDetn119RdrDetnElevn "Refer to the data element description in ReSideRdrRiDetn1 with the same data element name";
CM_ SG_ 343 ReSideRdrRiDetn119RdrDetnPwr "Refer to the data element description in ReSideRdrRiDetn1 with the same data element name";
CM_ SG_ 343 ReSideRdrRiDetn119RdrDetnRng "Refer to the data element description in ReSideRdrRiDetn1 with the same data element name";
CM_ SG_ 343 ReSideRdrRiDetn119RdrDetnRngV "Range Velocity";
CM_ SG_ 343 ReSideRdrRiDetn119RdrDetnSts "Refer to the data element description in ReSideRdrRiDetn1 with the same data element name";
CM_ SG_ 343 ReSideRdrRiDetn120RdrDetnAzi "Refer to the data element description in ReSideRdrRiDetn1 with the same data element name";
CM_ SG_ 343 ReSideRdrRiDetn120RdrDetnChks "Refer to the data element description in ReSideRdrRiDetn1 with the same data element name";
CM_ SG_ 343 ReSideRdrRiDetn120RdrDetnCntr "Refer to the data element description in ReSideRdrRiDetn1 with the same data element name";
CM_ SG_ 343 ReSideRdrRiDetn120RdrDetnConf "Refer to the data element description in ReSideRdrRiDetn1 with the same data element name";
CM_ SG_ 343 ReSideRdrRiDetn120RdrDetnElevn "Refer to the data element description in ReSideRdrRiDetn1 with the same data element name";
CM_ SG_ 343 ReSideRdrRiDetn120RdrDetnPwr "Refer to the data element description in ReSideRdrRiDetn1 with the same data element name";
CM_ SG_ 343 ReSideRdrRiDetn120RdrDetnRng "Refer to the data element description in ReSideRdrRiDetn1 with the same data element name";
CM_ SG_ 343 ReSideRdrRiDetn120RdrDetnRngV "Range Velocity";
CM_ SG_ 343 ReSideRdrRiDetn120RdrDetnSts "Refer to the data element description in ReSideRdrRiDetn1 with the same data element name";
CM_ SG_ 345 ReSideRdrRiDetn121RdrDetnAzi "Refer to the data element description in ReSideRdrRiDetn1 with the same data element name";
CM_ SG_ 345 ReSideRdrRiDetn121RdrDetnChks "Refer to the data element description in ReSideRdrRiDetn1 with the same data element name";
CM_ SG_ 345 ReSideRdrRiDetn121RdrDetnCntr "Refer to the data element description in ReSideRdrRiDetn1 with the same data element name";
CM_ SG_ 345 ReSideRdrRiDetn121RdrDetnConf "Refer to the data element description in ReSideRdrRiDetn1 with the same data element name";
CM_ SG_ 345 ReSideRdrRiDetn121RdrDetnElevn "Refer to the data element description in ReSideRdrRiDetn1 with the same data element name";
CM_ SG_ 345 ReSideRdrRiDetn121RdrDetnPwr "Refer to the data element description in ReSideRdrRiDetn1 with the same data element name";
CM_ SG_ 345 ReSideRdrRiDetn121RdrDetnRng "Refer to the data element description in ReSideRdrRiDetn1 with the same data element name";
CM_ SG_ 345 ReSideRdrRiDetn121RdrDetnRngV "Range Velocity";
CM_ SG_ 345 ReSideRdrRiDetn121RdrDetnSts "Refer to the data element description in ReSideRdrRiDetn1 with the same data element name";
CM_ SG_ 345 ReSideRdrRiDetn122RdrDetnAzi "Refer to the data element description in ReSideRdrRiDetn1 with the same data element name";
CM_ SG_ 345 ReSideRdrRiDetn122RdrDetnChks "Refer to the data element description in ReSideRdrRiDetn1 with the same data element name";
CM_ SG_ 345 ReSideRdrRiDetn122RdrDetnCntr "Refer to the data element description in ReSideRdrRiDetn1 with the same data element name";
CM_ SG_ 345 ReSideRdrRiDetn122RdrDetnConf "Refer to the data element description in ReSideRdrRiDetn1 with the same data element name";
CM_ SG_ 345 ReSideRdrRiDetn122RdrDetnElevn "Refer to the data element description in ReSideRdrRiDetn1 with the same data element name";
CM_ SG_ 345 ReSideRdrRiDetn122RdrDetnPwr "Refer to the data element description in ReSideRdrRiDetn1 with the same data element name";
CM_ SG_ 345 ReSideRdrRiDetn122RdrDetnRng "Refer to the data element description in ReSideRdrRiDetn1 with the same data element name";
CM_ SG_ 345 ReSideRdrRiDetn122RdrDetnRngV "Range Velocity";
CM_ SG_ 345 ReSideRdrRiDetn122RdrDetnSts "Refer to the data element description in ReSideRdrRiDetn1 with the same data element name";
CM_ SG_ 345 ReSideRdrRiDetn123RdrDetnAzi "Refer to the data element description in ReSideRdrRiDetn1 with the same data element name";
CM_ SG_ 345 ReSideRdrRiDetn123RdrDetnChks "Refer to the data element description in ReSideRdrRiDetn1 with the same data element name";
CM_ SG_ 345 ReSideRdrRiDetn123RdrDetnCntr "Refer to the data element description in ReSideRdrRiDetn1 with the same data element name";
CM_ SG_ 345 ReSideRdrRiDetn123RdrDetnConf "Refer to the data element description in ReSideRdrRiDetn1 with the same data element name";
CM_ SG_ 345 ReSideRdrRiDetn123RdrDetnElevn "Refer to the data element description in ReSideRdrRiDetn1 with the same data element name";
CM_ SG_ 345 ReSideRdrRiDetn123RdrDetnPwr "Refer to the data element description in ReSideRdrRiDetn1 with the same data element name";
CM_ SG_ 345 ReSideRdrRiDetn123RdrDetnRng "Refer to the data element description in ReSideRdrRiDetn1 with the same data element name";
CM_ SG_ 345 ReSideRdrRiDetn123RdrDetnRngV "Range Velocity";
CM_ SG_ 345 ReSideRdrRiDetn123RdrDetnSts "Refer to the data element description in ReSideRdrRiDetn1 with the same data element name";
CM_ SG_ 345 ReSideRdrRiDetn124RdrDetnAzi "Refer to the data element description in ReSideRdrRiDetn1 with the same data element name";
CM_ SG_ 345 ReSideRdrRiDetn124RdrDetnChks "Refer to the data element description in ReSideRdrRiDetn1 with the same data element name";
CM_ SG_ 345 ReSideRdrRiDetn124RdrDetnCntr "Refer to the data element description in ReSideRdrRiDetn1 with the same data element name";
CM_ SG_ 345 ReSideRdrRiDetn124RdrDetnConf "Refer to the data element description in ReSideRdrRiDetn1 with the same data element name";
CM_ SG_ 345 ReSideRdrRiDetn124RdrDetnElevn "Refer to the data element description in ReSideRdrRiDetn1 with the same data element name";
CM_ SG_ 345 ReSideRdrRiDetn124RdrDetnPwr "Refer to the data element description in ReSideRdrRiDetn1 with the same data element name";
CM_ SG_ 345 ReSideRdrRiDetn124RdrDetnRng "Refer to the data element description in ReSideRdrRiDetn1 with the same data element name";
CM_ SG_ 345 ReSideRdrRiDetn124RdrDetnRngV "Range Velocity";
CM_ SG_ 345 ReSideRdrRiDetn124RdrDetnSts "Refer to the data element description in ReSideRdrRiDetn1 with the same data element name";
CM_ SG_ 345 ReSideRdrRiDetn125RdrDetnAzi "Refer to the data element description in ReSideRdrRiDetn1 with the same data element name";
CM_ SG_ 345 ReSideRdrRiDetn125RdrDetnChks "Refer to the data element description in ReSideRdrRiDetn1 with the same data element name";
CM_ SG_ 345 ReSideRdrRiDetn125RdrDetnCntr "Refer to the data element description in ReSideRdrRiDetn1 with the same data element name";
CM_ SG_ 345 ReSideRdrRiDetn125RdrDetnConf "Refer to the data element description in ReSideRdrRiDetn1 with the same data element name";
CM_ SG_ 345 ReSideRdrRiDetn125RdrDetnElevn "Refer to the data element description in ReSideRdrRiDetn1 with the same data element name";
CM_ SG_ 345 ReSideRdrRiDetn125RdrDetnPwr "Refer to the data element description in ReSideRdrRiDetn1 with the same data element name";
CM_ SG_ 345 ReSideRdrRiDetn125RdrDetnRng "Refer to the data element description in ReSideRdrRiDetn1 with the same data element name";
CM_ SG_ 345 ReSideRdrRiDetn125RdrDetnRngV "Range Velocity";
CM_ SG_ 345 ReSideRdrRiDetn125RdrDetnSts "Refer to the data element description in ReSideRdrRiDetn1 with the same data element name";
CM_ SG_ 345 ReSideRdrRiDetn126RdrDetnAzi "Refer to the data element description in ReSideRdrRiDetn1 with the same data element name";
CM_ SG_ 345 ReSideRdrRiDetn126RdrDetnChks "Refer to the data element description in ReSideRdrRiDetn1 with the same data element name";
CM_ SG_ 345 ReSideRdrRiDetn126RdrDetnCntr "Refer to the data element description in ReSideRdrRiDetn1 with the same data element name";
CM_ SG_ 345 ReSideRdrRiDetn126RdrDetnConf "Refer to the data element description in ReSideRdrRiDetn1 with the same data element name";
CM_ SG_ 345 ReSideRdrRiDetn126RdrDetnElevn "Refer to the data element description in ReSideRdrRiDetn1 with the same data element name";
CM_ SG_ 345 ReSideRdrRiDetn126RdrDetnPwr "Refer to the data element description in ReSideRdrRiDetn1 with the same data element name";
CM_ SG_ 345 ReSideRdrRiDetn126RdrDetnRng "Refer to the data element description in ReSideRdrRiDetn1 with the same data element name";
CM_ SG_ 345 ReSideRdrRiDetn126RdrDetnRngV "Range Velocity";
CM_ SG_ 345 ReSideRdrRiDetn126RdrDetnSts "Refer to the data element description in ReSideRdrRiDetn1 with the same data element name";
CM_ SG_ 347 ReSideRdrRiDetn127RdrDetnAzi "Refer to the data element description in ReSideRdrRiDetn1 with the same data element name";
CM_ SG_ 347 ReSideRdrRiDetn127RdrDetnChks "Refer to the data element description in ReSideRdrRiDetn1 with the same data element name";
CM_ SG_ 347 ReSideRdrRiDetn127RdrDetnCntr "Refer to the data element description in ReSideRdrRiDetn1 with the same data element name";
CM_ SG_ 347 ReSideRdrRiDetn127RdrDetnConf "Refer to the data element description in ReSideRdrRiDetn1 with the same data element name";
CM_ SG_ 347 ReSideRdrRiDetn127RdrDetnElevn "Refer to the data element description in ReSideRdrRiDetn1 with the same data element name";
CM_ SG_ 347 ReSideRdrRiDetn127RdrDetnPwr "Refer to the data element description in ReSideRdrRiDetn1 with the same data element name";
CM_ SG_ 347 ReSideRdrRiDetn127RdrDetnRng "Refer to the data element description in ReSideRdrRiDetn1 with the same data element name";
CM_ SG_ 347 ReSideRdrRiDetn127RdrDetnRngV "Range Velocity";
CM_ SG_ 347 ReSideRdrRiDetn127RdrDetnSts "Refer to the data element description in ReSideRdrRiDetn1 with the same data element name";
CM_ SG_ 347 ReSideRdrRiDetn128RdrDetnAzi "Refer to the data element description in ReSideRdrRiDetn1 with the same data element name";
CM_ SG_ 347 ReSideRdrRiDetn128RdrDetnChks "Refer to the data element description in ReSideRdrRiDetn1 with the same data element name";
CM_ SG_ 347 ReSideRdrRiDetn128RdrDetnCntr "Refer to the data element description in ReSideRdrRiDetn1 with the same data element name";
CM_ SG_ 347 ReSideRdrRiDetn128RdrDetnConf "Refer to the data element description in ReSideRdrRiDetn1 with the same data element name";
CM_ SG_ 347 ReSideRdrRiDetn128RdrDetnElevn "Refer to the data element description in ReSideRdrRiDetn1 with the same data element name";
CM_ SG_ 347 ReSideRdrRiDetn128RdrDetnPwr "Refer to the data element description in ReSideRdrRiDetn1 with the same data element name";
CM_ SG_ 347 ReSideRdrRiDetn128RdrDetnRng "Refer to the data element description in ReSideRdrRiDetn1 with the same data element name";
CM_ SG_ 347 ReSideRdrRiDetn128RdrDetnRngV "Range Velocity";
CM_ SG_ 347 ReSideRdrRiDetn128RdrDetnSts "Refer to the data element description in ReSideRdrRiDetn1 with the same data element name";
CM_ SG_ 349 ReSideRdrRiObj1Heading "Heading angle
";
CM_ SG_ 349 ReSideRdrRiObj1ObjBoxCenterLat "Box center y coordinate (relative closest point)";
CM_ SG_ 349 ReSideRdrRiObj1ObjBoxCenterLgt "Box center x coordinate (relative closest point)";
CM_ SG_ 349 ReSideRdrRiObj1ObservationHist "The result of target association in each cycle, if target is associated,the bit value should be 1, if not,the bit value should be 0.there are 32 bits
";
CM_ SG_ 349 ReSideRdrRiObj1RdrObjAx "Longitudinal acceleration";
CM_ SG_ 349 ReSideRdrRiObj1RdrObjAy "Lateral acceleration";
CM_ SG_ 349 ReSideRdrRiObj1RdrObjBoxLength "Box length (box extent that is parallel to objects heading angle)";
CM_ SG_ 349 ReSideRdrRiObj1RdrObjBoxWidth "Box width (box extent that is perpendicular to objects heading angle)";
CM_ SG_ 349 ReSideRdrRiObj1RdrObjChks "CRC";
CM_ SG_ 349 ReSideRdrRiObj1RdrObjCntr "Counter";
CM_ SG_ 349 ReSideRdrRiObj1RdrObjCoastCnt "Number of cycles during which the object is not associated to anything";
CM_ SG_ 349 ReSideRdrRiObj1RdrObjConf "Confidence";
CM_ SG_ 349 ReSideRdrRiObj1RdrObjDx "Longitudinal position";
CM_ SG_ 349 ReSideRdrRiObj1RdrObjDxStdDe " Standard deviation longitudinal position";
CM_ SG_ 349 ReSideRdrRiObj1RdrObjDy "Lateral position";
CM_ SG_ 349 ReSideRdrRiObj1RdrObjDyStdDe " Standard deviation lateral position";
CM_ SG_ 349 ReSideRdrRiObj1RdrObjElevnConf "Elevation confidence";
CM_ SG_ 349 ReSideRdrRiObj1RdrObjElevnSts "Elevation Status";
CM_ SG_ 349 ReSideRdrRiObj1RdrObjID "Object ID";
CM_ SG_ 349 ReSideRdrRiObj1RdrObjIsInFreeSpace "Indication if the object is inside freespace";
CM_ SG_ 349 ReSideRdrRiObj1RdrObjMirrProblty "Probability of mirrored object";
CM_ SG_ 349 ReSideRdrRiObj1RdrObjMtnPat "Object Motion Pattern (crossing, receding and oncoming) is not used here, as reserved)";
CM_ SG_ 349 ReSideRdrRiObj1RdrObjNotRealProblty "Probability of ghost track";
CM_ SG_ 349 ReSideRdrRiObj1RdrObjStatyCnt "Stationary Count";
CM_ SG_ 349 ReSideRdrRiObj1RdrObjTiAlv "Lifetime";
CM_ SG_ 349 ReSideRdrRiObj1RdrObjTrackSts "Track Status 0. it is not a valid track 1. the track has been updated 2. the track is new 3. the track is coasted (means the result is a prediction and that there was no detected measurement in the current look interval";
CM_ SG_ 349 ReSideRdrRiObj1RdrObjTyp "Classification object (Only 0 Unkown, 4 Pedestrain, 9 Bicycle and 10 Vehicle of unknown class are used actually in radar, the other types are not used but the datatype is designed so that it can be reused with camera";
CM_ SG_ 349 ReSideRdrRiObj1RdrObjTypConfBike "Confidence of tracked object type classification bike";
CM_ SG_ 349 ReSideRdrRiObj1RdrObjTypConfPed "Confidence of tracked object type classification pedestrian";
CM_ SG_ 349 ReSideRdrRiObj1RdrObjTypConfVeh "Confidence of tracked object type classification vehicle";
CM_ SG_ 349 ReSideRdrRiObj1RdrObjVx "Longitudinal velocity";
CM_ SG_ 349 ReSideRdrRiObj1RdrObjVxStdDe " Standard deviation longitudinal velocity";
CM_ SG_ 349 ReSideRdrRiObj1RdrObjVy "Lateral velocity";
CM_ SG_ 349 ReSideRdrRiObj1RdrObjVyStdDe " Standard deviation lateral velocity";
CM_ SG_ 349 ReSideRdrRiObj1RelVx "Relative velocity in X
";
CM_ SG_ 349 ReSideRdrRiObj1RelVy "Relative velocity in Y
";
CM_ SG_ 351 ReSideRdrRiObj2Heading "Refer to the data element description in ReSideRdrRiObj1 with the same data element name";
CM_ SG_ 351 ReSideRdrRiObj2ObjBoxCenterLat "Refer to the data element description in ReSideRdrRiObj1 with the same data element name";
CM_ SG_ 351 ReSideRdrRiObj2ObjBoxCenterLgt "Refer to the data element description in ReSideRdrRiObj1 with the same data element name";
CM_ SG_ 351 ReSideRdrRiObj2ObservationHist "Refer to the data element description in ReSideRdrRiObj1 with the same data element name";
CM_ SG_ 351 ReSideRdrRiObj2RdrObjAx "Refer to the data element description in ReSideRdrRiObj1 with the same data element name";
CM_ SG_ 351 ReSideRdrRiObj2RdrObjAy "Refer to the data element description in ReSideRdrRiObj1 with the same data element name";
CM_ SG_ 351 ReSideRdrRiObj2RdrObjBoxLength "Refer to the data element description in ReSideRdrRiObj1 with the same data element name";
CM_ SG_ 351 ReSideRdrRiObj2RdrObjBoxWidth "Refer to the data element description in ReSideRdrRiObj1 with the same data element name";
CM_ SG_ 351 ReSideRdrRiObj2RdrObjChks "Refer to the data element description in ReSideRdrRiObj1 with the same data element name";
CM_ SG_ 351 ReSideRdrRiObj2RdrObjCntr "Refer to the data element description in ReSideRdrRiObj1 with the same data element name";
CM_ SG_ 351 ReSideRdrRiObj2RdrObjCoastCnt "Refer to the data element description in ReSideRdrRiObj1 with the same data element name";
CM_ SG_ 351 ReSideRdrRiObj2RdrObjConf "Refer to the data element description in ReSideRdrRiObj1 with the same data element name";
CM_ SG_ 351 ReSideRdrRiObj2RdrObjDx "Refer to the data element description in ReSideRdrRiObj1 with the same data element name";
CM_ SG_ 351 ReSideRdrRiObj2RdrObjDxStdDe "Refer to the data element description in ReSideRdrRiObj1 with the same data element name";
CM_ SG_ 351 ReSideRdrRiObj2RdrObjDy "Refer to the data element description in ReSideRdrRiObj1 with the same data element name";
CM_ SG_ 351 ReSideRdrRiObj2RdrObjDyStdDe "Refer to the data element description in ReSideRdrRiObj1 with the same data element name";
CM_ SG_ 351 ReSideRdrRiObj2RdrObjElevnConf "Refer to the data element description in ReSideRdrRiObj1 with the same data element name";
CM_ SG_ 351 ReSideRdrRiObj2RdrObjElevnSts "Refer to the data element description in ReSideRdrRiObj1 with the same data element name";
CM_ SG_ 351 ReSideRdrRiObj2RdrObjID "Refer to the data element description in ReSideRdrRiObj1 with the same data element name";
CM_ SG_ 351 ReSideRdrRiObj2RdrObjIsInFreeSpace "Refer to the data element description in ReSideRdrRiObj1 with the same data element name";
CM_ SG_ 351 ReSideRdrRiObj2RdrObjMirrProblty "Refer to the data element description in ReSideRdrRiObj1 with the same data element name";
CM_ SG_ 351 ReSideRdrRiObj2RdrObjMtnPat "Refer to the data element description in ReSideRdrRiObj1 with the same data element name";
CM_ SG_ 351 ReSideRdrRiObj2RdrObjNotRealProblty "Refer to the data element description in ReSideRdrRiObj1 with the same data element name";
CM_ SG_ 351 ReSideRdrRiObj2RdrObjStatyCnt "Refer to the data element description in ReSideRdrRiObj1 with the same data element name";
CM_ SG_ 351 ReSideRdrRiObj2RdrObjTiAlv "Refer to the data element description in ReSideRdrRiObj1 with the same data element name";
CM_ SG_ 351 ReSideRdrRiObj2RdrObjTrackSts "Refer to the data element description in ReSideRdrRiObj1 with the same data element name";
CM_ SG_ 351 ReSideRdrRiObj2RdrObjTyp "Refer to the data element description in ReSideRdrRiObj1 with the same data element name";
CM_ SG_ 351 ReSideRdrRiObj2RdrObjTypConfBike "Refer to the data element description in ReSideRdrRiObj1 with the same data element name";
CM_ SG_ 351 ReSideRdrRiObj2RdrObjTypConfPed "Refer to the data element description in ReSideRdrRiObj1 with the same data element name";
CM_ SG_ 351 ReSideRdrRiObj2RdrObjTypConfVeh "Refer to the data element description in ReSideRdrRiObj1 with the same data element name";
CM_ SG_ 351 ReSideRdrRiObj2RdrObjVx "Refer to the data element description in ReSideRdrRiObj1 with the same data element name";
CM_ SG_ 351 ReSideRdrRiObj2RdrObjVxStdDe "Refer to the data element description in ReSideRdrRiObj1 with the same data element name";
CM_ SG_ 351 ReSideRdrRiObj2RdrObjVy "Refer to the data element description in ReSideRdrRiObj1 with the same data element name";
CM_ SG_ 351 ReSideRdrRiObj2RdrObjVyStdDe "Refer to the data element description in ReSideRdrRiObj1 with the same data element name";
CM_ SG_ 351 ReSideRdrRiObj2RelVx "Refer to the data element description in ReSideRdrRiObj1 with the same data element name";
CM_ SG_ 351 ReSideRdrRiObj2RelVy "Refer to the data element description in ReSideRdrRiObj1 with the same data element name";
CM_ SG_ 353 ReSideRdrRiObj3Heading "Refer to the data element description in ReSideRdrRiObj1 with the same data element name";
CM_ SG_ 353 ReSideRdrRiObj3ObjBoxCenterLat "Refer to the data element description in ReSideRdrRiObj1 with the same data element name";
CM_ SG_ 353 ReSideRdrRiObj3ObjBoxCenterLgt "Refer to the data element description in ReSideRdrRiObj1 with the same data element name";
CM_ SG_ 353 ReSideRdrRiObj3ObservationHist "Refer to the data element description in ReSideRdrRiObj1 with the same data element name";
CM_ SG_ 353 ReSideRdrRiObj3RdrObjAx "Refer to the data element description in ReSideRdrRiObj1 with the same data element name";
CM_ SG_ 353 ReSideRdrRiObj3RdrObjAy "Refer to the data element description in ReSideRdrRiObj1 with the same data element name";
CM_ SG_ 353 ReSideRdrRiObj3RdrObjBoxLength "Refer to the data element description in ReSideRdrRiObj1 with the same data element name";
CM_ SG_ 353 ReSideRdrRiObj3RdrObjBoxWidth "Refer to the data element description in ReSideRdrRiObj1 with the same data element name";
CM_ SG_ 353 ReSideRdrRiObj3RdrObjChks "Refer to the data element description in ReSideRdrRiObj1 with the same data element name";
CM_ SG_ 353 ReSideRdrRiObj3RdrObjCntr "Refer to the data element description in ReSideRdrRiObj1 with the same data element name";
CM_ SG_ 353 ReSideRdrRiObj3RdrObjCoastCnt "Refer to the data element description in ReSideRdrRiObj1 with the same data element name";
CM_ SG_ 353 ReSideRdrRiObj3RdrObjConf "Refer to the data element description in ReSideRdrRiObj1 with the same data element name";
CM_ SG_ 353 ReSideRdrRiObj3RdrObjDx "Refer to the data element description in ReSideRdrRiObj1 with the same data element name";
CM_ SG_ 353 ReSideRdrRiObj3RdrObjDxStdDe "Refer to the data element description in ReSideRdrRiObj1 with the same data element name";
CM_ SG_ 353 ReSideRdrRiObj3RdrObjDy "Refer to the data element description in ReSideRdrRiObj1 with the same data element name";
CM_ SG_ 353 ReSideRdrRiObj3RdrObjDyStdDe "Refer to the data element description in ReSideRdrRiObj1 with the same data element name";
CM_ SG_ 353 ReSideRdrRiObj3RdrObjElevnConf "Refer to the data element description in ReSideRdrRiObj1 with the same data element name";
CM_ SG_ 353 ReSideRdrRiObj3RdrObjElevnSts "Refer to the data element description in ReSideRdrRiObj1 with the same data element name";
CM_ SG_ 353 ReSideRdrRiObj3RdrObjID "Refer to the data element description in ReSideRdrRiObj1 with the same data element name";
CM_ SG_ 353 ReSideRdrRiObj3RdrObjIsInFreeSpace "Refer to the data element description in ReSideRdrRiObj1 with the same data element name";
CM_ SG_ 353 ReSideRdrRiObj3RdrObjMirrProblty "Refer to the data element description in ReSideRdrRiObj1 with the same data element name";
CM_ SG_ 353 ReSideRdrRiObj3RdrObjMtnPat "Refer to the data element description in ReSideRdrRiObj1 with the same data element name";
CM_ SG_ 353 ReSideRdrRiObj3RdrObjNotRealProblty "Refer to the data element description in ReSideRdrRiObj1 with the same data element name";
CM_ SG_ 353 ReSideRdrRiObj3RdrObjStatyCnt "Refer to the data element description in ReSideRdrRiObj1 with the same data element name";
CM_ SG_ 353 ReSideRdrRiObj3RdrObjTiAlv "Refer to the data element description in ReSideRdrRiObj1 with the same data element name";
CM_ SG_ 353 ReSideRdrRiObj3RdrObjTrackSts "Refer to the data element description in ReSideRdrRiObj1 with the same data element name";
CM_ SG_ 353 ReSideRdrRiObj3RdrObjTyp "Refer to the data element description in ReSideRdrRiObj1 with the same data element name";
CM_ SG_ 353 ReSideRdrRiObj3RdrObjTypConfBike "Refer to the data element description in ReSideRdrRiObj1 with the same data element name";
CM_ SG_ 353 ReSideRdrRiObj3RdrObjTypConfPed "Refer to the data element description in ReSideRdrRiObj1 with the same data element name";
CM_ SG_ 353 ReSideRdrRiObj3RdrObjTypConfVeh "Refer to the data element description in ReSideRdrRiObj1 with the same data element name";
CM_ SG_ 353 ReSideRdrRiObj3RdrObjVx "Refer to the data element description in ReSideRdrRiObj1 with the same data element name";
CM_ SG_ 353 ReSideRdrRiObj3RdrObjVxStdDe "Refer to the data element description in ReSideRdrRiObj1 with the same data element name";
CM_ SG_ 353 ReSideRdrRiObj3RdrObjVy "Refer to the data element description in ReSideRdrRiObj1 with the same data element name";
CM_ SG_ 353 ReSideRdrRiObj3RdrObjVyStdDe "Refer to the data element description in ReSideRdrRiObj1 with the same data element name";
CM_ SG_ 353 ReSideRdrRiObj3RelVx "Refer to the data element description in ReSideRdrRiObj1 with the same data element name";
CM_ SG_ 353 ReSideRdrRiObj3RelVy "Refer to the data element description in ReSideRdrRiObj1 with the same data element name";
BA_DEF_ BO_ "VFrameFormat" ENUM "StandardCAN","ExtendedCAN","reserved","J1939PG","reserved","reserved","reserved","reserved","reserved","reserved","reserved","reserved","reserved","reserved","StandardCAN_FD","ExtendedCAN_FD";
BA_DEF_ BO_ "CANFD_BRS" ENUM "0","1";
BA_DEF_ BO_ "GenMsgSendType" ENUM "cyclic", "spontaneous", "not-used", "not-used", "not-used", "cyclicAndSpontaneous", "not-used", "cyclicIfActive", "NoMsgSendType"; // [us]
BA_DEF_ BO_ "GenMsgCycleTime" INT 0 65536; // [ms]
BA_DEF_ BO_ "GenMsgStartDelayTime" INT 0 65536; // [ms]
BA_DEF_ BO_ "GenMsgDelayTime" INT 0 65536; // [ms]
BA_DEF_ SG_ "GenSigSendType" ENUM "Cyclic","OnWrite","OnWriteWithRepetition","OnChange","OnChangeWithRepetition","IfActive","IfActiveWithRepetition","NoSigSendType";
BA_DEF_ SG_ "GenSigStartValue" HEX 0 80000000;
BA_DEF_ BO_ "GenMsgILSupport" ENUM "No","Yes";
BA_DEF_ BO_ "NmAsrMessage" ENUM "No","Yes";
BA_DEF_ SG_ "GenSigFuncType" ENUM "NoFunction","n/a","n/a","n/a","n/a","n/a","n/a","n/a","n/a","n/a","n/a","n/a","n/a","n/a","n/a","CHK","CNTR","n/a","n/a","n/a","CNTR_AR_01","CRC_AR_01_BOTH","CRC_AR_01_ALT","CRC_AR_01_LOW","CRC_AR_01_NIBBLE","CNTR_AR_04","CRC_AR_04A","CNTR_AR_05","CRC_AR_05";
BA_DEF_ SG_ "GenSigDataID" STRING;

BA_DEF_DEF_ "VFrameFormat" "J1939PG";
BA_DEF_DEF_ "CANFD_BRS" "1";
BA_DEF_DEF_ "GenSigStartValue" 0;
BA_DEF_DEF_ "GenSigSendType" "NoSigSendType";
BA_DEF_DEF_ "GenMsgCycleTime" 0;
BA_DEF_DEF_ "GenMsgDelayTime" 0;
BA_DEF_DEF_ "GenMsgStartDelayTime" 0;
BA_DEF_DEF_ "GenMsgSendType" "NoMsgSendType";
BA_DEF_DEF_ "GenMsgILSupport" "Yes";
BA_DEF_DEF_ "NmAsrMessage" "No";
BA_DEF_DEF_ "GenSigFuncType" "NoFunction";
BA_DEF_DEF_ "GenSigDataID" "";
// Frame: SODRSafetyCANFD3Frame16
BA_ "VFrameFormat" BO_ 335 14;
BA_ "GenMsgSendType" BO_ 335 0;
BA_ "GenMsgCycleTime" BO_ 335 50.000;
BA_ "GenSigStartValue" SG_ 335 ReSideRdrRiDetn91RdrDetnAzi 900;
BA_ "GenSigSendType" SG_ 335 ReSideRdrRiDetn91RdrDetnAzi 0;
BA_ "GenSigSendType" SG_ 335 ReSideRdrRiDetn91RdrDetnChks 0;
BA_ "GenSigFuncType" SG_ 335 ReSideRdrRiDetn91RdrDetnChks 15;
BA_ "GenSigDataID" SG_ 335 ReSideRdrRiDetn91RdrDetnChks "0xA9B";
BA_ "GenSigSendType" SG_ 335 ReSideRdrRiDetn91RdrDetnCntr 0;
BA_ "GenSigFuncType" SG_ 335 ReSideRdrRiDetn91RdrDetnCntr 16;
BA_ "GenSigSendType" SG_ 335 ReSideRdrRiDetn91RdrDetnConf 0;
BA_ "GenSigStartValue" SG_ 335 ReSideRdrRiDetn91RdrDetnElevn 15;
BA_ "GenSigSendType" SG_ 335 ReSideRdrRiDetn91RdrDetnElevn 0;
BA_ "GenSigSendType" SG_ 335 ReSideRdrRiDetn91RdrDetnPwr 0;
BA_ "GenSigStartValue" SG_ 335 ReSideRdrRiDetn91RdrDetnRng 10050;
BA_ "GenSigSendType" SG_ 335 ReSideRdrRiDetn91RdrDetnRng 0;
BA_ "GenSigStartValue" SG_ 335 ReSideRdrRiDetn91RdrDetnRngV 4000;
BA_ "GenSigSendType" SG_ 335 ReSideRdrRiDetn91RdrDetnRngV 0;
BA_ "GenSigStartValue" SG_ 335 ReSideRdrRiDetn91RdrDetnSts 3;
BA_ "GenSigSendType" SG_ 335 ReSideRdrRiDetn91RdrDetnSts 0;
BA_ "GenSigStartValue" SG_ 335 ReSideRdrRiDetn92RdrDetnAzi 900;
BA_ "GenSigSendType" SG_ 335 ReSideRdrRiDetn92RdrDetnAzi 0;
BA_ "GenSigSendType" SG_ 335 ReSideRdrRiDetn92RdrDetnChks 0;
BA_ "GenSigFuncType" SG_ 335 ReSideRdrRiDetn92RdrDetnChks 15;
BA_ "GenSigDataID" SG_ 335 ReSideRdrRiDetn92RdrDetnChks "0xA9C";
BA_ "GenSigSendType" SG_ 335 ReSideRdrRiDetn92RdrDetnCntr 0;
BA_ "GenSigFuncType" SG_ 335 ReSideRdrRiDetn92RdrDetnCntr 16;
BA_ "GenSigSendType" SG_ 335 ReSideRdrRiDetn92RdrDetnConf 0;
BA_ "GenSigStartValue" SG_ 335 ReSideRdrRiDetn92RdrDetnElevn 15;
BA_ "GenSigSendType" SG_ 335 ReSideRdrRiDetn92RdrDetnElevn 0;
BA_ "GenSigSendType" SG_ 335 ReSideRdrRiDetn92RdrDetnPwr 0;
BA_ "GenSigStartValue" SG_ 335 ReSideRdrRiDetn92RdrDetnRng 10050;
BA_ "GenSigSendType" SG_ 335 ReSideRdrRiDetn92RdrDetnRng 0;
BA_ "GenSigStartValue" SG_ 335 ReSideRdrRiDetn92RdrDetnRngV 4000;
BA_ "GenSigSendType" SG_ 335 ReSideRdrRiDetn92RdrDetnRngV 0;
BA_ "GenSigStartValue" SG_ 335 ReSideRdrRiDetn92RdrDetnSts 3;
BA_ "GenSigSendType" SG_ 335 ReSideRdrRiDetn92RdrDetnSts 0;
BA_ "GenSigStartValue" SG_ 335 ReSideRdrRiDetn93RdrDetnAzi 900;
BA_ "GenSigSendType" SG_ 335 ReSideRdrRiDetn93RdrDetnAzi 0;
BA_ "GenSigSendType" SG_ 335 ReSideRdrRiDetn93RdrDetnChks 0;
BA_ "GenSigFuncType" SG_ 335 ReSideRdrRiDetn93RdrDetnChks 15;
BA_ "GenSigDataID" SG_ 335 ReSideRdrRiDetn93RdrDetnChks "0xA9D";
BA_ "GenSigSendType" SG_ 335 ReSideRdrRiDetn93RdrDetnCntr 0;
BA_ "GenSigFuncType" SG_ 335 ReSideRdrRiDetn93RdrDetnCntr 16;
BA_ "GenSigSendType" SG_ 335 ReSideRdrRiDetn93RdrDetnConf 0;
BA_ "GenSigStartValue" SG_ 335 ReSideRdrRiDetn93RdrDetnElevn 15;
BA_ "GenSigSendType" SG_ 335 ReSideRdrRiDetn93RdrDetnElevn 0;
BA_ "GenSigSendType" SG_ 335 ReSideRdrRiDetn93RdrDetnPwr 0;
BA_ "GenSigStartValue" SG_ 335 ReSideRdrRiDetn93RdrDetnRng 10050;
BA_ "GenSigSendType" SG_ 335 ReSideRdrRiDetn93RdrDetnRng 0;
BA_ "GenSigStartValue" SG_ 335 ReSideRdrRiDetn93RdrDetnRngV 4000;
BA_ "GenSigSendType" SG_ 335 ReSideRdrRiDetn93RdrDetnRngV 0;
BA_ "GenSigStartValue" SG_ 335 ReSideRdrRiDetn93RdrDetnSts 3;
BA_ "GenSigSendType" SG_ 335 ReSideRdrRiDetn93RdrDetnSts 0;
BA_ "GenSigStartValue" SG_ 335 ReSideRdrRiDetn94RdrDetnAzi 900;
BA_ "GenSigSendType" SG_ 335 ReSideRdrRiDetn94RdrDetnAzi 0;
BA_ "GenSigSendType" SG_ 335 ReSideRdrRiDetn94RdrDetnChks 0;
BA_ "GenSigFuncType" SG_ 335 ReSideRdrRiDetn94RdrDetnChks 15;
BA_ "GenSigDataID" SG_ 335 ReSideRdrRiDetn94RdrDetnChks "0xA9E";
BA_ "GenSigSendType" SG_ 335 ReSideRdrRiDetn94RdrDetnCntr 0;
BA_ "GenSigFuncType" SG_ 335 ReSideRdrRiDetn94RdrDetnCntr 16;
BA_ "GenSigSendType" SG_ 335 ReSideRdrRiDetn94RdrDetnConf 0;
BA_ "GenSigStartValue" SG_ 335 ReSideRdrRiDetn94RdrDetnElevn 15;
BA_ "GenSigSendType" SG_ 335 ReSideRdrRiDetn94RdrDetnElevn 0;
BA_ "GenSigSendType" SG_ 335 ReSideRdrRiDetn94RdrDetnPwr 0;
BA_ "GenSigStartValue" SG_ 335 ReSideRdrRiDetn94RdrDetnRng 10050;
BA_ "GenSigSendType" SG_ 335 ReSideRdrRiDetn94RdrDetnRng 0;
BA_ "GenSigStartValue" SG_ 335 ReSideRdrRiDetn94RdrDetnRngV 4000;
BA_ "GenSigSendType" SG_ 335 ReSideRdrRiDetn94RdrDetnRngV 0;
BA_ "GenSigStartValue" SG_ 335 ReSideRdrRiDetn94RdrDetnSts 3;
BA_ "GenSigSendType" SG_ 335 ReSideRdrRiDetn94RdrDetnSts 0;
BA_ "GenSigStartValue" SG_ 335 ReSideRdrRiDetn95RdrDetnAzi 900;
BA_ "GenSigSendType" SG_ 335 ReSideRdrRiDetn95RdrDetnAzi 0;
BA_ "GenSigSendType" SG_ 335 ReSideRdrRiDetn95RdrDetnChks 0;
BA_ "GenSigFuncType" SG_ 335 ReSideRdrRiDetn95RdrDetnChks 15;
BA_ "GenSigDataID" SG_ 335 ReSideRdrRiDetn95RdrDetnChks "0xA9F";
BA_ "GenSigSendType" SG_ 335 ReSideRdrRiDetn95RdrDetnCntr 0;
BA_ "GenSigFuncType" SG_ 335 ReSideRdrRiDetn95RdrDetnCntr 16;
BA_ "GenSigSendType" SG_ 335 ReSideRdrRiDetn95RdrDetnConf 0;
BA_ "GenSigStartValue" SG_ 335 ReSideRdrRiDetn95RdrDetnElevn 15;
BA_ "GenSigSendType" SG_ 335 ReSideRdrRiDetn95RdrDetnElevn 0;
BA_ "GenSigSendType" SG_ 335 ReSideRdrRiDetn95RdrDetnPwr 0;
BA_ "GenSigStartValue" SG_ 335 ReSideRdrRiDetn95RdrDetnRng 10050;
BA_ "GenSigSendType" SG_ 335 ReSideRdrRiDetn95RdrDetnRng 0;
BA_ "GenSigStartValue" SG_ 335 ReSideRdrRiDetn95RdrDetnRngV 4000;
BA_ "GenSigSendType" SG_ 335 ReSideRdrRiDetn95RdrDetnRngV 0;
BA_ "GenSigStartValue" SG_ 335 ReSideRdrRiDetn95RdrDetnSts 3;
BA_ "GenSigSendType" SG_ 335 ReSideRdrRiDetn95RdrDetnSts 0;
BA_ "GenSigStartValue" SG_ 335 ReSideRdrRiDetn96RdrDetnAzi 900;
BA_ "GenSigSendType" SG_ 335 ReSideRdrRiDetn96RdrDetnAzi 0;
BA_ "GenSigSendType" SG_ 335 ReSideRdrRiDetn96RdrDetnChks 0;
BA_ "GenSigFuncType" SG_ 335 ReSideRdrRiDetn96RdrDetnChks 15;
BA_ "GenSigDataID" SG_ 335 ReSideRdrRiDetn96RdrDetnChks "0xAA0";
BA_ "GenSigSendType" SG_ 335 ReSideRdrRiDetn96RdrDetnCntr 0;
BA_ "GenSigFuncType" SG_ 335 ReSideRdrRiDetn96RdrDetnCntr 16;
BA_ "GenSigSendType" SG_ 335 ReSideRdrRiDetn96RdrDetnConf 0;
BA_ "GenSigStartValue" SG_ 335 ReSideRdrRiDetn96RdrDetnElevn 15;
BA_ "GenSigSendType" SG_ 335 ReSideRdrRiDetn96RdrDetnElevn 0;
BA_ "GenSigSendType" SG_ 335 ReSideRdrRiDetn96RdrDetnPwr 0;
BA_ "GenSigStartValue" SG_ 335 ReSideRdrRiDetn96RdrDetnRng 10050;
BA_ "GenSigSendType" SG_ 335 ReSideRdrRiDetn96RdrDetnRng 0;
BA_ "GenSigStartValue" SG_ 335 ReSideRdrRiDetn96RdrDetnRngV 4000;
BA_ "GenSigSendType" SG_ 335 ReSideRdrRiDetn96RdrDetnRngV 0;
BA_ "GenSigStartValue" SG_ 335 ReSideRdrRiDetn96RdrDetnSts 3;
BA_ "GenSigSendType" SG_ 335 ReSideRdrRiDetn96RdrDetnSts 0;
// Frame: SODRSafetyCANFD3Frame17
BA_ "VFrameFormat" BO_ 337 14;
BA_ "GenMsgSendType" BO_ 337 0;
BA_ "GenMsgCycleTime" BO_ 337 50.000;
BA_ "GenSigStartValue" SG_ 337 ReSideRdrRiDetn100RdrDetnAzi 900;
BA_ "GenSigSendType" SG_ 337 ReSideRdrRiDetn100RdrDetnAzi 0;
BA_ "GenSigSendType" SG_ 337 ReSideRdrRiDetn100RdrDetnChks 0;
BA_ "GenSigFuncType" SG_ 337 ReSideRdrRiDetn100RdrDetnChks 15;
BA_ "GenSigDataID" SG_ 337 ReSideRdrRiDetn100RdrDetnChks "0xAA4";
BA_ "GenSigSendType" SG_ 337 ReSideRdrRiDetn100RdrDetnCntr 0;
BA_ "GenSigFuncType" SG_ 337 ReSideRdrRiDetn100RdrDetnCntr 16;
BA_ "GenSigSendType" SG_ 337 ReSideRdrRiDetn100RdrDetnConf 0;
BA_ "GenSigStartValue" SG_ 337 ReSideRdrRiDetn100RdrDetnElevn 15;
BA_ "GenSigSendType" SG_ 337 ReSideRdrRiDetn100RdrDetnElevn 0;
BA_ "GenSigSendType" SG_ 337 ReSideRdrRiDetn100RdrDetnPwr 0;
BA_ "GenSigStartValue" SG_ 337 ReSideRdrRiDetn100RdrDetnRng 10050;
BA_ "GenSigSendType" SG_ 337 ReSideRdrRiDetn100RdrDetnRng 0;
BA_ "GenSigStartValue" SG_ 337 ReSideRdrRiDetn100RdrDetnRngV 4000;
BA_ "GenSigSendType" SG_ 337 ReSideRdrRiDetn100RdrDetnRngV 0;
BA_ "GenSigStartValue" SG_ 337 ReSideRdrRiDetn100RdrDetnSts 3;
BA_ "GenSigSendType" SG_ 337 ReSideRdrRiDetn100RdrDetnSts 0;
BA_ "GenSigStartValue" SG_ 337 ReSideRdrRiDetn101RdrDetnAzi 900;
BA_ "GenSigSendType" SG_ 337 ReSideRdrRiDetn101RdrDetnAzi 0;
BA_ "GenSigSendType" SG_ 337 ReSideRdrRiDetn101RdrDetnChks 0;
BA_ "GenSigFuncType" SG_ 337 ReSideRdrRiDetn101RdrDetnChks 15;
BA_ "GenSigDataID" SG_ 337 ReSideRdrRiDetn101RdrDetnChks "0xAA5";
BA_ "GenSigSendType" SG_ 337 ReSideRdrRiDetn101RdrDetnCntr 0;
BA_ "GenSigFuncType" SG_ 337 ReSideRdrRiDetn101RdrDetnCntr 16;
BA_ "GenSigSendType" SG_ 337 ReSideRdrRiDetn101RdrDetnConf 0;
BA_ "GenSigStartValue" SG_ 337 ReSideRdrRiDetn101RdrDetnElevn 15;
BA_ "GenSigSendType" SG_ 337 ReSideRdrRiDetn101RdrDetnElevn 0;
BA_ "GenSigSendType" SG_ 337 ReSideRdrRiDetn101RdrDetnPwr 0;
BA_ "GenSigStartValue" SG_ 337 ReSideRdrRiDetn101RdrDetnRng 10050;
BA_ "GenSigSendType" SG_ 337 ReSideRdrRiDetn101RdrDetnRng 0;
BA_ "GenSigStartValue" SG_ 337 ReSideRdrRiDetn101RdrDetnRngV 4000;
BA_ "GenSigSendType" SG_ 337 ReSideRdrRiDetn101RdrDetnRngV 0;
BA_ "GenSigStartValue" SG_ 337 ReSideRdrRiDetn101RdrDetnSts 3;
BA_ "GenSigSendType" SG_ 337 ReSideRdrRiDetn101RdrDetnSts 0;
BA_ "GenSigStartValue" SG_ 337 ReSideRdrRiDetn102RdrDetnAzi 900;
BA_ "GenSigSendType" SG_ 337 ReSideRdrRiDetn102RdrDetnAzi 0;
BA_ "GenSigSendType" SG_ 337 ReSideRdrRiDetn102RdrDetnChks 0;
BA_ "GenSigFuncType" SG_ 337 ReSideRdrRiDetn102RdrDetnChks 15;
BA_ "GenSigDataID" SG_ 337 ReSideRdrRiDetn102RdrDetnChks "0xAA6";
BA_ "GenSigSendType" SG_ 337 ReSideRdrRiDetn102RdrDetnCntr 0;
BA_ "GenSigFuncType" SG_ 337 ReSideRdrRiDetn102RdrDetnCntr 16;
BA_ "GenSigSendType" SG_ 337 ReSideRdrRiDetn102RdrDetnConf 0;
BA_ "GenSigStartValue" SG_ 337 ReSideRdrRiDetn102RdrDetnElevn 15;
BA_ "GenSigSendType" SG_ 337 ReSideRdrRiDetn102RdrDetnElevn 0;
BA_ "GenSigSendType" SG_ 337 ReSideRdrRiDetn102RdrDetnPwr 0;
BA_ "GenSigStartValue" SG_ 337 ReSideRdrRiDetn102RdrDetnRng 10050;
BA_ "GenSigSendType" SG_ 337 ReSideRdrRiDetn102RdrDetnRng 0;
BA_ "GenSigStartValue" SG_ 337 ReSideRdrRiDetn102RdrDetnRngV 4000;
BA_ "GenSigSendType" SG_ 337 ReSideRdrRiDetn102RdrDetnRngV 0;
BA_ "GenSigStartValue" SG_ 337 ReSideRdrRiDetn102RdrDetnSts 3;
BA_ "GenSigSendType" SG_ 337 ReSideRdrRiDetn102RdrDetnSts 0;
BA_ "GenSigStartValue" SG_ 337 ReSideRdrRiDetn97RdrDetnAzi 900;
BA_ "GenSigSendType" SG_ 337 ReSideRdrRiDetn97RdrDetnAzi 0;
BA_ "GenSigSendType" SG_ 337 ReSideRdrRiDetn97RdrDetnChks 0;
BA_ "GenSigFuncType" SG_ 337 ReSideRdrRiDetn97RdrDetnChks 15;
BA_ "GenSigDataID" SG_ 337 ReSideRdrRiDetn97RdrDetnChks "0xAA1";
BA_ "GenSigSendType" SG_ 337 ReSideRdrRiDetn97RdrDetnCntr 0;
BA_ "GenSigFuncType" SG_ 337 ReSideRdrRiDetn97RdrDetnCntr 16;
BA_ "GenSigSendType" SG_ 337 ReSideRdrRiDetn97RdrDetnConf 0;
BA_ "GenSigStartValue" SG_ 337 ReSideRdrRiDetn97RdrDetnElevn 15;
BA_ "GenSigSendType" SG_ 337 ReSideRdrRiDetn97RdrDetnElevn 0;
BA_ "GenSigSendType" SG_ 337 ReSideRdrRiDetn97RdrDetnPwr 0;
BA_ "GenSigStartValue" SG_ 337 ReSideRdrRiDetn97RdrDetnRng 10050;
BA_ "GenSigSendType" SG_ 337 ReSideRdrRiDetn97RdrDetnRng 0;
BA_ "GenSigStartValue" SG_ 337 ReSideRdrRiDetn97RdrDetnRngV 4000;
BA_ "GenSigSendType" SG_ 337 ReSideRdrRiDetn97RdrDetnRngV 0;
BA_ "GenSigStartValue" SG_ 337 ReSideRdrRiDetn97RdrDetnSts 3;
BA_ "GenSigSendType" SG_ 337 ReSideRdrRiDetn97RdrDetnSts 0;
BA_ "GenSigStartValue" SG_ 337 ReSideRdrRiDetn98RdrDetnAzi 900;
BA_ "GenSigSendType" SG_ 337 ReSideRdrRiDetn98RdrDetnAzi 0;
BA_ "GenSigSendType" SG_ 337 ReSideRdrRiDetn98RdrDetnChks 0;
BA_ "GenSigFuncType" SG_ 337 ReSideRdrRiDetn98RdrDetnChks 15;
BA_ "GenSigDataID" SG_ 337 ReSideRdrRiDetn98RdrDetnChks "0xAA2";
BA_ "GenSigSendType" SG_ 337 ReSideRdrRiDetn98RdrDetnCntr 0;
BA_ "GenSigFuncType" SG_ 337 ReSideRdrRiDetn98RdrDetnCntr 16;
BA_ "GenSigSendType" SG_ 337 ReSideRdrRiDetn98RdrDetnConf 0;
BA_ "GenSigStartValue" SG_ 337 ReSideRdrRiDetn98RdrDetnElevn 15;
BA_ "GenSigSendType" SG_ 337 ReSideRdrRiDetn98RdrDetnElevn 0;
BA_ "GenSigSendType" SG_ 337 ReSideRdrRiDetn98RdrDetnPwr 0;
BA_ "GenSigStartValue" SG_ 337 ReSideRdrRiDetn98RdrDetnRng 10050;
BA_ "GenSigSendType" SG_ 337 ReSideRdrRiDetn98RdrDetnRng 0;
BA_ "GenSigStartValue" SG_ 337 ReSideRdrRiDetn98RdrDetnRngV 4000;
BA_ "GenSigSendType" SG_ 337 ReSideRdrRiDetn98RdrDetnRngV 0;
BA_ "GenSigStartValue" SG_ 337 ReSideRdrRiDetn98RdrDetnSts 3;
BA_ "GenSigSendType" SG_ 337 ReSideRdrRiDetn98RdrDetnSts 0;
BA_ "GenSigStartValue" SG_ 337 ReSideRdrRiDetn99RdrDetnAzi 900;
BA_ "GenSigSendType" SG_ 337 ReSideRdrRiDetn99RdrDetnAzi 0;
BA_ "GenSigSendType" SG_ 337 ReSideRdrRiDetn99RdrDetnChks 0;
BA_ "GenSigFuncType" SG_ 337 ReSideRdrRiDetn99RdrDetnChks 15;
BA_ "GenSigDataID" SG_ 337 ReSideRdrRiDetn99RdrDetnChks "0xAA3";
BA_ "GenSigSendType" SG_ 337 ReSideRdrRiDetn99RdrDetnCntr 0;
BA_ "GenSigFuncType" SG_ 337 ReSideRdrRiDetn99RdrDetnCntr 16;
BA_ "GenSigSendType" SG_ 337 ReSideRdrRiDetn99RdrDetnConf 0;
BA_ "GenSigStartValue" SG_ 337 ReSideRdrRiDetn99RdrDetnElevn 15;
BA_ "GenSigSendType" SG_ 337 ReSideRdrRiDetn99RdrDetnElevn 0;
BA_ "GenSigSendType" SG_ 337 ReSideRdrRiDetn99RdrDetnPwr 0;
BA_ "GenSigStartValue" SG_ 337 ReSideRdrRiDetn99RdrDetnRng 10050;
BA_ "GenSigSendType" SG_ 337 ReSideRdrRiDetn99RdrDetnRng 0;
BA_ "GenSigStartValue" SG_ 337 ReSideRdrRiDetn99RdrDetnRngV 4000;
BA_ "GenSigSendType" SG_ 337 ReSideRdrRiDetn99RdrDetnRngV 0;
BA_ "GenSigStartValue" SG_ 337 ReSideRdrRiDetn99RdrDetnSts 3;
BA_ "GenSigSendType" SG_ 337 ReSideRdrRiDetn99RdrDetnSts 0;
// Frame: SODRSafetyCANFD3Frame18
BA_ "VFrameFormat" BO_ 339 14;
BA_ "GenMsgSendType" BO_ 339 0;
BA_ "GenMsgCycleTime" BO_ 339 50.000;
BA_ "GenSigStartValue" SG_ 339 ReSideRdrRiDetn103RdrDetnAzi 900;
BA_ "GenSigSendType" SG_ 339 ReSideRdrRiDetn103RdrDetnAzi 0;
BA_ "GenSigSendType" SG_ 339 ReSideRdrRiDetn103RdrDetnChks 0;
BA_ "GenSigFuncType" SG_ 339 ReSideRdrRiDetn103RdrDetnChks 15;
BA_ "GenSigDataID" SG_ 339 ReSideRdrRiDetn103RdrDetnChks "0xAA7";
BA_ "GenSigSendType" SG_ 339 ReSideRdrRiDetn103RdrDetnCntr 0;
BA_ "GenSigFuncType" SG_ 339 ReSideRdrRiDetn103RdrDetnCntr 16;
BA_ "GenSigSendType" SG_ 339 ReSideRdrRiDetn103RdrDetnConf 0;
BA_ "GenSigStartValue" SG_ 339 ReSideRdrRiDetn103RdrDetnElevn 15;
BA_ "GenSigSendType" SG_ 339 ReSideRdrRiDetn103RdrDetnElevn 0;
BA_ "GenSigSendType" SG_ 339 ReSideRdrRiDetn103RdrDetnPwr 0;
BA_ "GenSigStartValue" SG_ 339 ReSideRdrRiDetn103RdrDetnRng 10050;
BA_ "GenSigSendType" SG_ 339 ReSideRdrRiDetn103RdrDetnRng 0;
BA_ "GenSigStartValue" SG_ 339 ReSideRdrRiDetn103RdrDetnRngV 4000;
BA_ "GenSigSendType" SG_ 339 ReSideRdrRiDetn103RdrDetnRngV 0;
BA_ "GenSigStartValue" SG_ 339 ReSideRdrRiDetn103RdrDetnSts 3;
BA_ "GenSigSendType" SG_ 339 ReSideRdrRiDetn103RdrDetnSts 0;
BA_ "GenSigStartValue" SG_ 339 ReSideRdrRiDetn104RdrDetnAzi 900;
BA_ "GenSigSendType" SG_ 339 ReSideRdrRiDetn104RdrDetnAzi 0;
BA_ "GenSigSendType" SG_ 339 ReSideRdrRiDetn104RdrDetnChks 0;
BA_ "GenSigFuncType" SG_ 339 ReSideRdrRiDetn104RdrDetnChks 15;
BA_ "GenSigDataID" SG_ 339 ReSideRdrRiDetn104RdrDetnChks "0xAA8";
BA_ "GenSigSendType" SG_ 339 ReSideRdrRiDetn104RdrDetnCntr 0;
BA_ "GenSigFuncType" SG_ 339 ReSideRdrRiDetn104RdrDetnCntr 16;
BA_ "GenSigSendType" SG_ 339 ReSideRdrRiDetn104RdrDetnConf 0;
BA_ "GenSigStartValue" SG_ 339 ReSideRdrRiDetn104RdrDetnElevn 15;
BA_ "GenSigSendType" SG_ 339 ReSideRdrRiDetn104RdrDetnElevn 0;
BA_ "GenSigSendType" SG_ 339 ReSideRdrRiDetn104RdrDetnPwr 0;
BA_ "GenSigStartValue" SG_ 339 ReSideRdrRiDetn104RdrDetnRng 10050;
BA_ "GenSigSendType" SG_ 339 ReSideRdrRiDetn104RdrDetnRng 0;
BA_ "GenSigStartValue" SG_ 339 ReSideRdrRiDetn104RdrDetnRngV 4000;
BA_ "GenSigSendType" SG_ 339 ReSideRdrRiDetn104RdrDetnRngV 0;
BA_ "GenSigStartValue" SG_ 339 ReSideRdrRiDetn104RdrDetnSts 3;
BA_ "GenSigSendType" SG_ 339 ReSideRdrRiDetn104RdrDetnSts 0;
BA_ "GenSigStartValue" SG_ 339 ReSideRdrRiDetn105RdrDetnAzi 900;
BA_ "GenSigSendType" SG_ 339 ReSideRdrRiDetn105RdrDetnAzi 0;
BA_ "GenSigSendType" SG_ 339 ReSideRdrRiDetn105RdrDetnChks 0;
BA_ "GenSigFuncType" SG_ 339 ReSideRdrRiDetn105RdrDetnChks 15;
BA_ "GenSigDataID" SG_ 339 ReSideRdrRiDetn105RdrDetnChks "0xAA9";
BA_ "GenSigSendType" SG_ 339 ReSideRdrRiDetn105RdrDetnCntr 0;
BA_ "GenSigFuncType" SG_ 339 ReSideRdrRiDetn105RdrDetnCntr 16;
BA_ "GenSigSendType" SG_ 339 ReSideRdrRiDetn105RdrDetnConf 0;
BA_ "GenSigStartValue" SG_ 339 ReSideRdrRiDetn105RdrDetnElevn 15;
BA_ "GenSigSendType" SG_ 339 ReSideRdrRiDetn105RdrDetnElevn 0;
BA_ "GenSigSendType" SG_ 339 ReSideRdrRiDetn105RdrDetnPwr 0;
BA_ "GenSigStartValue" SG_ 339 ReSideRdrRiDetn105RdrDetnRng 10050;
BA_ "GenSigSendType" SG_ 339 ReSideRdrRiDetn105RdrDetnRng 0;
BA_ "GenSigStartValue" SG_ 339 ReSideRdrRiDetn105RdrDetnRngV 4000;
BA_ "GenSigSendType" SG_ 339 ReSideRdrRiDetn105RdrDetnRngV 0;
BA_ "GenSigStartValue" SG_ 339 ReSideRdrRiDetn105RdrDetnSts 3;
BA_ "GenSigSendType" SG_ 339 ReSideRdrRiDetn105RdrDetnSts 0;
BA_ "GenSigStartValue" SG_ 339 ReSideRdrRiDetn106RdrDetnAzi 900;
BA_ "GenSigSendType" SG_ 339 ReSideRdrRiDetn106RdrDetnAzi 0;
BA_ "GenSigSendType" SG_ 339 ReSideRdrRiDetn106RdrDetnChks 0;
BA_ "GenSigFuncType" SG_ 339 ReSideRdrRiDetn106RdrDetnChks 15;
BA_ "GenSigDataID" SG_ 339 ReSideRdrRiDetn106RdrDetnChks "0xAAA";
BA_ "GenSigSendType" SG_ 339 ReSideRdrRiDetn106RdrDetnCntr 0;
BA_ "GenSigFuncType" SG_ 339 ReSideRdrRiDetn106RdrDetnCntr 16;
BA_ "GenSigSendType" SG_ 339 ReSideRdrRiDetn106RdrDetnConf 0;
BA_ "GenSigStartValue" SG_ 339 ReSideRdrRiDetn106RdrDetnElevn 15;
BA_ "GenSigSendType" SG_ 339 ReSideRdrRiDetn106RdrDetnElevn 0;
BA_ "GenSigSendType" SG_ 339 ReSideRdrRiDetn106RdrDetnPwr 0;
BA_ "GenSigStartValue" SG_ 339 ReSideRdrRiDetn106RdrDetnRng 10050;
BA_ "GenSigSendType" SG_ 339 ReSideRdrRiDetn106RdrDetnRng 0;
BA_ "GenSigStartValue" SG_ 339 ReSideRdrRiDetn106RdrDetnRngV 4000;
BA_ "GenSigSendType" SG_ 339 ReSideRdrRiDetn106RdrDetnRngV 0;
BA_ "GenSigStartValue" SG_ 339 ReSideRdrRiDetn106RdrDetnSts 3;
BA_ "GenSigSendType" SG_ 339 ReSideRdrRiDetn106RdrDetnSts 0;
BA_ "GenSigStartValue" SG_ 339 ReSideRdrRiDetn107RdrDetnAzi 900;
BA_ "GenSigSendType" SG_ 339 ReSideRdrRiDetn107RdrDetnAzi 0;
BA_ "GenSigSendType" SG_ 339 ReSideRdrRiDetn107RdrDetnChks 0;
BA_ "GenSigFuncType" SG_ 339 ReSideRdrRiDetn107RdrDetnChks 15;
BA_ "GenSigDataID" SG_ 339 ReSideRdrRiDetn107RdrDetnChks "0xAAB";
BA_ "GenSigSendType" SG_ 339 ReSideRdrRiDetn107RdrDetnCntr 0;
BA_ "GenSigFuncType" SG_ 339 ReSideRdrRiDetn107RdrDetnCntr 16;
BA_ "GenSigSendType" SG_ 339 ReSideRdrRiDetn107RdrDetnConf 0;
BA_ "GenSigStartValue" SG_ 339 ReSideRdrRiDetn107RdrDetnElevn 15;
BA_ "GenSigSendType" SG_ 339 ReSideRdrRiDetn107RdrDetnElevn 0;
BA_ "GenSigSendType" SG_ 339 ReSideRdrRiDetn107RdrDetnPwr 0;
BA_ "GenSigStartValue" SG_ 339 ReSideRdrRiDetn107RdrDetnRng 10050;
BA_ "GenSigSendType" SG_ 339 ReSideRdrRiDetn107RdrDetnRng 0;
BA_ "GenSigStartValue" SG_ 339 ReSideRdrRiDetn107RdrDetnRngV 4000;
BA_ "GenSigSendType" SG_ 339 ReSideRdrRiDetn107RdrDetnRngV 0;
BA_ "GenSigStartValue" SG_ 339 ReSideRdrRiDetn107RdrDetnSts 3;
BA_ "GenSigSendType" SG_ 339 ReSideRdrRiDetn107RdrDetnSts 0;
BA_ "GenSigStartValue" SG_ 339 ReSideRdrRiDetn108RdrDetnAzi 900;
BA_ "GenSigSendType" SG_ 339 ReSideRdrRiDetn108RdrDetnAzi 0;
BA_ "GenSigSendType" SG_ 339 ReSideRdrRiDetn108RdrDetnChks 0;
BA_ "GenSigFuncType" SG_ 339 ReSideRdrRiDetn108RdrDetnChks 15;
BA_ "GenSigDataID" SG_ 339 ReSideRdrRiDetn108RdrDetnChks "0xAAC";
BA_ "GenSigSendType" SG_ 339 ReSideRdrRiDetn108RdrDetnCntr 0;
BA_ "GenSigFuncType" SG_ 339 ReSideRdrRiDetn108RdrDetnCntr 16;
BA_ "GenSigSendType" SG_ 339 ReSideRdrRiDetn108RdrDetnConf 0;
BA_ "GenSigStartValue" SG_ 339 ReSideRdrRiDetn108RdrDetnElevn 15;
BA_ "GenSigSendType" SG_ 339 ReSideRdrRiDetn108RdrDetnElevn 0;
BA_ "GenSigSendType" SG_ 339 ReSideRdrRiDetn108RdrDetnPwr 0;
BA_ "GenSigStartValue" SG_ 339 ReSideRdrRiDetn108RdrDetnRng 10050;
BA_ "GenSigSendType" SG_ 339 ReSideRdrRiDetn108RdrDetnRng 0;
BA_ "GenSigStartValue" SG_ 339 ReSideRdrRiDetn108RdrDetnRngV 4000;
BA_ "GenSigSendType" SG_ 339 ReSideRdrRiDetn108RdrDetnRngV 0;
BA_ "GenSigStartValue" SG_ 339 ReSideRdrRiDetn108RdrDetnSts 3;
BA_ "GenSigSendType" SG_ 339 ReSideRdrRiDetn108RdrDetnSts 0;
// Frame: SODRSafetyCANFD3Frame19
BA_ "VFrameFormat" BO_ 341 14;
BA_ "GenMsgSendType" BO_ 341 0;
BA_ "GenMsgCycleTime" BO_ 341 50.000;
BA_ "GenSigStartValue" SG_ 341 ReSideRdrRiDetn109RdrDetnAzi 900;
BA_ "GenSigSendType" SG_ 341 ReSideRdrRiDetn109RdrDetnAzi 0;
BA_ "GenSigSendType" SG_ 341 ReSideRdrRiDetn109RdrDetnChks 0;
BA_ "GenSigFuncType" SG_ 341 ReSideRdrRiDetn109RdrDetnChks 15;
BA_ "GenSigDataID" SG_ 341 ReSideRdrRiDetn109RdrDetnChks "0xAAD";
BA_ "GenSigSendType" SG_ 341 ReSideRdrRiDetn109RdrDetnCntr 0;
BA_ "GenSigFuncType" SG_ 341 ReSideRdrRiDetn109RdrDetnCntr 16;
BA_ "GenSigSendType" SG_ 341 ReSideRdrRiDetn109RdrDetnConf 0;
BA_ "GenSigStartValue" SG_ 341 ReSideRdrRiDetn109RdrDetnElevn 15;
BA_ "GenSigSendType" SG_ 341 ReSideRdrRiDetn109RdrDetnElevn 0;
BA_ "GenSigSendType" SG_ 341 ReSideRdrRiDetn109RdrDetnPwr 0;
BA_ "GenSigStartValue" SG_ 341 ReSideRdrRiDetn109RdrDetnRng 10050;
BA_ "GenSigSendType" SG_ 341 ReSideRdrRiDetn109RdrDetnRng 0;
BA_ "GenSigStartValue" SG_ 341 ReSideRdrRiDetn109RdrDetnRngV 4000;
BA_ "GenSigSendType" SG_ 341 ReSideRdrRiDetn109RdrDetnRngV 0;
BA_ "GenSigStartValue" SG_ 341 ReSideRdrRiDetn109RdrDetnSts 3;
BA_ "GenSigSendType" SG_ 341 ReSideRdrRiDetn109RdrDetnSts 0;
BA_ "GenSigStartValue" SG_ 341 ReSideRdrRiDetn110RdrDetnAzi 900;
BA_ "GenSigSendType" SG_ 341 ReSideRdrRiDetn110RdrDetnAzi 0;
BA_ "GenSigSendType" SG_ 341 ReSideRdrRiDetn110RdrDetnChks 0;
BA_ "GenSigFuncType" SG_ 341 ReSideRdrRiDetn110RdrDetnChks 15;
BA_ "GenSigDataID" SG_ 341 ReSideRdrRiDetn110RdrDetnChks "0xAAE";
BA_ "GenSigSendType" SG_ 341 ReSideRdrRiDetn110RdrDetnCntr 0;
BA_ "GenSigFuncType" SG_ 341 ReSideRdrRiDetn110RdrDetnCntr 16;
BA_ "GenSigSendType" SG_ 341 ReSideRdrRiDetn110RdrDetnConf 0;
BA_ "GenSigStartValue" SG_ 341 ReSideRdrRiDetn110RdrDetnElevn 15;
BA_ "GenSigSendType" SG_ 341 ReSideRdrRiDetn110RdrDetnElevn 0;
BA_ "GenSigSendType" SG_ 341 ReSideRdrRiDetn110RdrDetnPwr 0;
BA_ "GenSigStartValue" SG_ 341 ReSideRdrRiDetn110RdrDetnRng 10050;
BA_ "GenSigSendType" SG_ 341 ReSideRdrRiDetn110RdrDetnRng 0;
BA_ "GenSigStartValue" SG_ 341 ReSideRdrRiDetn110RdrDetnRngV 4000;
BA_ "GenSigSendType" SG_ 341 ReSideRdrRiDetn110RdrDetnRngV 0;
BA_ "GenSigStartValue" SG_ 341 ReSideRdrRiDetn110RdrDetnSts 3;
BA_ "GenSigSendType" SG_ 341 ReSideRdrRiDetn110RdrDetnSts 0;
BA_ "GenSigStartValue" SG_ 341 ReSideRdrRiDetn111RdrDetnAzi 900;
BA_ "GenSigSendType" SG_ 341 ReSideRdrRiDetn111RdrDetnAzi 0;
BA_ "GenSigSendType" SG_ 341 ReSideRdrRiDetn111RdrDetnChks 0;
BA_ "GenSigFuncType" SG_ 341 ReSideRdrRiDetn111RdrDetnChks 15;
BA_ "GenSigDataID" SG_ 341 ReSideRdrRiDetn111RdrDetnChks "0xAAF";
BA_ "GenSigSendType" SG_ 341 ReSideRdrRiDetn111RdrDetnCntr 0;
BA_ "GenSigFuncType" SG_ 341 ReSideRdrRiDetn111RdrDetnCntr 16;
BA_ "GenSigSendType" SG_ 341 ReSideRdrRiDetn111RdrDetnConf 0;
BA_ "GenSigStartValue" SG_ 341 ReSideRdrRiDetn111RdrDetnElevn 15;
BA_ "GenSigSendType" SG_ 341 ReSideRdrRiDetn111RdrDetnElevn 0;
BA_ "GenSigSendType" SG_ 341 ReSideRdrRiDetn111RdrDetnPwr 0;
BA_ "GenSigStartValue" SG_ 341 ReSideRdrRiDetn111RdrDetnRng 10050;
BA_ "GenSigSendType" SG_ 341 ReSideRdrRiDetn111RdrDetnRng 0;
BA_ "GenSigStartValue" SG_ 341 ReSideRdrRiDetn111RdrDetnRngV 4000;
BA_ "GenSigSendType" SG_ 341 ReSideRdrRiDetn111RdrDetnRngV 0;
BA_ "GenSigStartValue" SG_ 341 ReSideRdrRiDetn111RdrDetnSts 3;
BA_ "GenSigSendType" SG_ 341 ReSideRdrRiDetn111RdrDetnSts 0;
BA_ "GenSigStartValue" SG_ 341 ReSideRdrRiDetn112RdrDetnAzi 900;
BA_ "GenSigSendType" SG_ 341 ReSideRdrRiDetn112RdrDetnAzi 0;
BA_ "GenSigSendType" SG_ 341 ReSideRdrRiDetn112RdrDetnChks 0;
BA_ "GenSigFuncType" SG_ 341 ReSideRdrRiDetn112RdrDetnChks 15;
BA_ "GenSigDataID" SG_ 341 ReSideRdrRiDetn112RdrDetnChks "0xAB0";
BA_ "GenSigSendType" SG_ 341 ReSideRdrRiDetn112RdrDetnCntr 0;
BA_ "GenSigFuncType" SG_ 341 ReSideRdrRiDetn112RdrDetnCntr 16;
BA_ "GenSigSendType" SG_ 341 ReSideRdrRiDetn112RdrDetnConf 0;
BA_ "GenSigStartValue" SG_ 341 ReSideRdrRiDetn112RdrDetnElevn 15;
BA_ "GenSigSendType" SG_ 341 ReSideRdrRiDetn112RdrDetnElevn 0;
BA_ "GenSigSendType" SG_ 341 ReSideRdrRiDetn112RdrDetnPwr 0;
BA_ "GenSigStartValue" SG_ 341 ReSideRdrRiDetn112RdrDetnRng 10050;
BA_ "GenSigSendType" SG_ 341 ReSideRdrRiDetn112RdrDetnRng 0;
BA_ "GenSigStartValue" SG_ 341 ReSideRdrRiDetn112RdrDetnRngV 4000;
BA_ "GenSigSendType" SG_ 341 ReSideRdrRiDetn112RdrDetnRngV 0;
BA_ "GenSigStartValue" SG_ 341 ReSideRdrRiDetn112RdrDetnSts 3;
BA_ "GenSigSendType" SG_ 341 ReSideRdrRiDetn112RdrDetnSts 0;
BA_ "GenSigStartValue" SG_ 341 ReSideRdrRiDetn113RdrDetnAzi 900;
BA_ "GenSigSendType" SG_ 341 ReSideRdrRiDetn113RdrDetnAzi 0;
BA_ "GenSigSendType" SG_ 341 ReSideRdrRiDetn113RdrDetnChks 0;
BA_ "GenSigFuncType" SG_ 341 ReSideRdrRiDetn113RdrDetnChks 15;
BA_ "GenSigDataID" SG_ 341 ReSideRdrRiDetn113RdrDetnChks "0xAB1";
BA_ "GenSigSendType" SG_ 341 ReSideRdrRiDetn113RdrDetnCntr 0;
BA_ "GenSigFuncType" SG_ 341 ReSideRdrRiDetn113RdrDetnCntr 16;
BA_ "GenSigSendType" SG_ 341 ReSideRdrRiDetn113RdrDetnConf 0;
BA_ "GenSigStartValue" SG_ 341 ReSideRdrRiDetn113RdrDetnElevn 15;
BA_ "GenSigSendType" SG_ 341 ReSideRdrRiDetn113RdrDetnElevn 0;
BA_ "GenSigSendType" SG_ 341 ReSideRdrRiDetn113RdrDetnPwr 0;
BA_ "GenSigStartValue" SG_ 341 ReSideRdrRiDetn113RdrDetnRng 10050;
BA_ "GenSigSendType" SG_ 341 ReSideRdrRiDetn113RdrDetnRng 0;
BA_ "GenSigStartValue" SG_ 341 ReSideRdrRiDetn113RdrDetnRngV 4000;
BA_ "GenSigSendType" SG_ 341 ReSideRdrRiDetn113RdrDetnRngV 0;
BA_ "GenSigStartValue" SG_ 341 ReSideRdrRiDetn113RdrDetnSts 3;
BA_ "GenSigSendType" SG_ 341 ReSideRdrRiDetn113RdrDetnSts 0;
BA_ "GenSigStartValue" SG_ 341 ReSideRdrRiDetn114RdrDetnAzi 900;
BA_ "GenSigSendType" SG_ 341 ReSideRdrRiDetn114RdrDetnAzi 0;
BA_ "GenSigSendType" SG_ 341 ReSideRdrRiDetn114RdrDetnChks 0;
BA_ "GenSigFuncType" SG_ 341 ReSideRdrRiDetn114RdrDetnChks 15;
BA_ "GenSigDataID" SG_ 341 ReSideRdrRiDetn114RdrDetnChks "0xAB2";
BA_ "GenSigSendType" SG_ 341 ReSideRdrRiDetn114RdrDetnCntr 0;
BA_ "GenSigFuncType" SG_ 341 ReSideRdrRiDetn114RdrDetnCntr 16;
BA_ "GenSigSendType" SG_ 341 ReSideRdrRiDetn114RdrDetnConf 0;
BA_ "GenSigStartValue" SG_ 341 ReSideRdrRiDetn114RdrDetnElevn 15;
BA_ "GenSigSendType" SG_ 341 ReSideRdrRiDetn114RdrDetnElevn 0;
BA_ "GenSigSendType" SG_ 341 ReSideRdrRiDetn114RdrDetnPwr 0;
BA_ "GenSigStartValue" SG_ 341 ReSideRdrRiDetn114RdrDetnRng 10050;
BA_ "GenSigSendType" SG_ 341 ReSideRdrRiDetn114RdrDetnRng 0;
BA_ "GenSigStartValue" SG_ 341 ReSideRdrRiDetn114RdrDetnRngV 4000;
BA_ "GenSigSendType" SG_ 341 ReSideRdrRiDetn114RdrDetnRngV 0;
BA_ "GenSigStartValue" SG_ 341 ReSideRdrRiDetn114RdrDetnSts 3;
BA_ "GenSigSendType" SG_ 341 ReSideRdrRiDetn114RdrDetnSts 0;
// Frame: SODRSafetyCANFD3Frame20
BA_ "VFrameFormat" BO_ 343 14;
BA_ "GenMsgSendType" BO_ 343 0;
BA_ "GenMsgCycleTime" BO_ 343 50.000;
BA_ "GenSigStartValue" SG_ 343 ReSideRdrRiDetn115RdrDetnAzi 900;
BA_ "GenSigSendType" SG_ 343 ReSideRdrRiDetn115RdrDetnAzi 0;
BA_ "GenSigSendType" SG_ 343 ReSideRdrRiDetn115RdrDetnChks 0;
BA_ "GenSigFuncType" SG_ 343 ReSideRdrRiDetn115RdrDetnChks 15;
BA_ "GenSigDataID" SG_ 343 ReSideRdrRiDetn115RdrDetnChks "0xAB3";
BA_ "GenSigSendType" SG_ 343 ReSideRdrRiDetn115RdrDetnCntr 0;
BA_ "GenSigFuncType" SG_ 343 ReSideRdrRiDetn115RdrDetnCntr 16;
BA_ "GenSigSendType" SG_ 343 ReSideRdrRiDetn115RdrDetnConf 0;
BA_ "GenSigStartValue" SG_ 343 ReSideRdrRiDetn115RdrDetnElevn 15;
BA_ "GenSigSendType" SG_ 343 ReSideRdrRiDetn115RdrDetnElevn 0;
BA_ "GenSigSendType" SG_ 343 ReSideRdrRiDetn115RdrDetnPwr 0;
BA_ "GenSigStartValue" SG_ 343 ReSideRdrRiDetn115RdrDetnRng 10050;
BA_ "GenSigSendType" SG_ 343 ReSideRdrRiDetn115RdrDetnRng 0;
BA_ "GenSigStartValue" SG_ 343 ReSideRdrRiDetn115RdrDetnRngV 4000;
BA_ "GenSigSendType" SG_ 343 ReSideRdrRiDetn115RdrDetnRngV 0;
BA_ "GenSigStartValue" SG_ 343 ReSideRdrRiDetn115RdrDetnSts 3;
BA_ "GenSigSendType" SG_ 343 ReSideRdrRiDetn115RdrDetnSts 0;
BA_ "GenSigStartValue" SG_ 343 ReSideRdrRiDetn116RdrDetnAzi 900;
BA_ "GenSigSendType" SG_ 343 ReSideRdrRiDetn116RdrDetnAzi 0;
BA_ "GenSigSendType" SG_ 343 ReSideRdrRiDetn116RdrDetnChks 0;
BA_ "GenSigFuncType" SG_ 343 ReSideRdrRiDetn116RdrDetnChks 15;
BA_ "GenSigDataID" SG_ 343 ReSideRdrRiDetn116RdrDetnChks "0xAB4";
BA_ "GenSigSendType" SG_ 343 ReSideRdrRiDetn116RdrDetnCntr 0;
BA_ "GenSigFuncType" SG_ 343 ReSideRdrRiDetn116RdrDetnCntr 16;
BA_ "GenSigSendType" SG_ 343 ReSideRdrRiDetn116RdrDetnConf 0;
BA_ "GenSigStartValue" SG_ 343 ReSideRdrRiDetn116RdrDetnElevn 15;
BA_ "GenSigSendType" SG_ 343 ReSideRdrRiDetn116RdrDetnElevn 0;
BA_ "GenSigSendType" SG_ 343 ReSideRdrRiDetn116RdrDetnPwr 0;
BA_ "GenSigStartValue" SG_ 343 ReSideRdrRiDetn116RdrDetnRng 10050;
BA_ "GenSigSendType" SG_ 343 ReSideRdrRiDetn116RdrDetnRng 0;
BA_ "GenSigStartValue" SG_ 343 ReSideRdrRiDetn116RdrDetnRngV 4000;
BA_ "GenSigSendType" SG_ 343 ReSideRdrRiDetn116RdrDetnRngV 0;
BA_ "GenSigStartValue" SG_ 343 ReSideRdrRiDetn116RdrDetnSts 3;
BA_ "GenSigSendType" SG_ 343 ReSideRdrRiDetn116RdrDetnSts 0;
BA_ "GenSigStartValue" SG_ 343 ReSideRdrRiDetn117RdrDetnAzi 900;
BA_ "GenSigSendType" SG_ 343 ReSideRdrRiDetn117RdrDetnAzi 0;
BA_ "GenSigSendType" SG_ 343 ReSideRdrRiDetn117RdrDetnChks 0;
BA_ "GenSigFuncType" SG_ 343 ReSideRdrRiDetn117RdrDetnChks 15;
BA_ "GenSigDataID" SG_ 343 ReSideRdrRiDetn117RdrDetnChks "0xAB5";
BA_ "GenSigSendType" SG_ 343 ReSideRdrRiDetn117RdrDetnCntr 0;
BA_ "GenSigFuncType" SG_ 343 ReSideRdrRiDetn117RdrDetnCntr 16;
BA_ "GenSigSendType" SG_ 343 ReSideRdrRiDetn117RdrDetnConf 0;
BA_ "GenSigStartValue" SG_ 343 ReSideRdrRiDetn117RdrDetnElevn 15;
BA_ "GenSigSendType" SG_ 343 ReSideRdrRiDetn117RdrDetnElevn 0;
BA_ "GenSigSendType" SG_ 343 ReSideRdrRiDetn117RdrDetnPwr 0;
BA_ "GenSigStartValue" SG_ 343 ReSideRdrRiDetn117RdrDetnRng 10050;
BA_ "GenSigSendType" SG_ 343 ReSideRdrRiDetn117RdrDetnRng 0;
BA_ "GenSigStartValue" SG_ 343 ReSideRdrRiDetn117RdrDetnRngV 4000;
BA_ "GenSigSendType" SG_ 343 ReSideRdrRiDetn117RdrDetnRngV 0;
BA_ "GenSigStartValue" SG_ 343 ReSideRdrRiDetn117RdrDetnSts 3;
BA_ "GenSigSendType" SG_ 343 ReSideRdrRiDetn117RdrDetnSts 0;
BA_ "GenSigStartValue" SG_ 343 ReSideRdrRiDetn118RdrDetnAzi 900;
BA_ "GenSigSendType" SG_ 343 ReSideRdrRiDetn118RdrDetnAzi 0;
BA_ "GenSigSendType" SG_ 343 ReSideRdrRiDetn118RdrDetnChks 0;
BA_ "GenSigFuncType" SG_ 343 ReSideRdrRiDetn118RdrDetnChks 15;
BA_ "GenSigDataID" SG_ 343 ReSideRdrRiDetn118RdrDetnChks "0xAB6";
BA_ "GenSigSendType" SG_ 343 ReSideRdrRiDetn118RdrDetnCntr 0;
BA_ "GenSigFuncType" SG_ 343 ReSideRdrRiDetn118RdrDetnCntr 16;
BA_ "GenSigSendType" SG_ 343 ReSideRdrRiDetn118RdrDetnConf 0;
BA_ "GenSigStartValue" SG_ 343 ReSideRdrRiDetn118RdrDetnElevn 15;
BA_ "GenSigSendType" SG_ 343 ReSideRdrRiDetn118RdrDetnElevn 0;
BA_ "GenSigSendType" SG_ 343 ReSideRdrRiDetn118RdrDetnPwr 0;
BA_ "GenSigStartValue" SG_ 343 ReSideRdrRiDetn118RdrDetnRng 10050;
BA_ "GenSigSendType" SG_ 343 ReSideRdrRiDetn118RdrDetnRng 0;
BA_ "GenSigStartValue" SG_ 343 ReSideRdrRiDetn118RdrDetnRngV 4000;
BA_ "GenSigSendType" SG_ 343 ReSideRdrRiDetn118RdrDetnRngV 0;
BA_ "GenSigStartValue" SG_ 343 ReSideRdrRiDetn118RdrDetnSts 3;
BA_ "GenSigSendType" SG_ 343 ReSideRdrRiDetn118RdrDetnSts 0;
BA_ "GenSigStartValue" SG_ 343 ReSideRdrRiDetn119RdrDetnAzi 900;
BA_ "GenSigSendType" SG_ 343 ReSideRdrRiDetn119RdrDetnAzi 0;
BA_ "GenSigSendType" SG_ 343 ReSideRdrRiDetn119RdrDetnChks 0;
BA_ "GenSigFuncType" SG_ 343 ReSideRdrRiDetn119RdrDetnChks 15;
BA_ "GenSigDataID" SG_ 343 ReSideRdrRiDetn119RdrDetnChks "0xAB7";
BA_ "GenSigSendType" SG_ 343 ReSideRdrRiDetn119RdrDetnCntr 0;
BA_ "GenSigFuncType" SG_ 343 ReSideRdrRiDetn119RdrDetnCntr 16;
BA_ "GenSigSendType" SG_ 343 ReSideRdrRiDetn119RdrDetnConf 0;
BA_ "GenSigStartValue" SG_ 343 ReSideRdrRiDetn119RdrDetnElevn 15;
BA_ "GenSigSendType" SG_ 343 ReSideRdrRiDetn119RdrDetnElevn 0;
BA_ "GenSigSendType" SG_ 343 ReSideRdrRiDetn119RdrDetnPwr 0;
BA_ "GenSigStartValue" SG_ 343 ReSideRdrRiDetn119RdrDetnRng 10050;
BA_ "GenSigSendType" SG_ 343 ReSideRdrRiDetn119RdrDetnRng 0;
BA_ "GenSigStartValue" SG_ 343 ReSideRdrRiDetn119RdrDetnRngV 4000;
BA_ "GenSigSendType" SG_ 343 ReSideRdrRiDetn119RdrDetnRngV 0;
BA_ "GenSigStartValue" SG_ 343 ReSideRdrRiDetn119RdrDetnSts 3;
BA_ "GenSigSendType" SG_ 343 ReSideRdrRiDetn119RdrDetnSts 0;
BA_ "GenSigStartValue" SG_ 343 ReSideRdrRiDetn120RdrDetnAzi 900;
BA_ "GenSigSendType" SG_ 343 ReSideRdrRiDetn120RdrDetnAzi 0;
BA_ "GenSigSendType" SG_ 343 ReSideRdrRiDetn120RdrDetnChks 0;
BA_ "GenSigFuncType" SG_ 343 ReSideRdrRiDetn120RdrDetnChks 15;
BA_ "GenSigDataID" SG_ 343 ReSideRdrRiDetn120RdrDetnChks "0xAB8";
BA_ "GenSigSendType" SG_ 343 ReSideRdrRiDetn120RdrDetnCntr 0;
BA_ "GenSigFuncType" SG_ 343 ReSideRdrRiDetn120RdrDetnCntr 16;
BA_ "GenSigSendType" SG_ 343 ReSideRdrRiDetn120RdrDetnConf 0;
BA_ "GenSigStartValue" SG_ 343 ReSideRdrRiDetn120RdrDetnElevn 15;
BA_ "GenSigSendType" SG_ 343 ReSideRdrRiDetn120RdrDetnElevn 0;
BA_ "GenSigSendType" SG_ 343 ReSideRdrRiDetn120RdrDetnPwr 0;
BA_ "GenSigStartValue" SG_ 343 ReSideRdrRiDetn120RdrDetnRng 10050;
BA_ "GenSigSendType" SG_ 343 ReSideRdrRiDetn120RdrDetnRng 0;
BA_ "GenSigStartValue" SG_ 343 ReSideRdrRiDetn120RdrDetnRngV 4000;
BA_ "GenSigSendType" SG_ 343 ReSideRdrRiDetn120RdrDetnRngV 0;
BA_ "GenSigStartValue" SG_ 343 ReSideRdrRiDetn120RdrDetnSts 3;
BA_ "GenSigSendType" SG_ 343 ReSideRdrRiDetn120RdrDetnSts 0;
// Frame: SODRSafetyCANFD3Frame21
BA_ "VFrameFormat" BO_ 345 14;
BA_ "GenMsgSendType" BO_ 345 0;
BA_ "GenMsgCycleTime" BO_ 345 50.000;
BA_ "GenSigStartValue" SG_ 345 ReSideRdrRiDetn121RdrDetnAzi 900;
BA_ "GenSigSendType" SG_ 345 ReSideRdrRiDetn121RdrDetnAzi 0;
BA_ "GenSigSendType" SG_ 345 ReSideRdrRiDetn121RdrDetnChks 0;
BA_ "GenSigFuncType" SG_ 345 ReSideRdrRiDetn121RdrDetnChks 15;
BA_ "GenSigDataID" SG_ 345 ReSideRdrRiDetn121RdrDetnChks "0xAB9";
BA_ "GenSigSendType" SG_ 345 ReSideRdrRiDetn121RdrDetnCntr 0;
BA_ "GenSigFuncType" SG_ 345 ReSideRdrRiDetn121RdrDetnCntr 16;
BA_ "GenSigSendType" SG_ 345 ReSideRdrRiDetn121RdrDetnConf 0;
BA_ "GenSigStartValue" SG_ 345 ReSideRdrRiDetn121RdrDetnElevn 15;
BA_ "GenSigSendType" SG_ 345 ReSideRdrRiDetn121RdrDetnElevn 0;
BA_ "GenSigSendType" SG_ 345 ReSideRdrRiDetn121RdrDetnPwr 0;
BA_ "GenSigStartValue" SG_ 345 ReSideRdrRiDetn121RdrDetnRng 10050;
BA_ "GenSigSendType" SG_ 345 ReSideRdrRiDetn121RdrDetnRng 0;
BA_ "GenSigStartValue" SG_ 345 ReSideRdrRiDetn121RdrDetnRngV 4000;
BA_ "GenSigSendType" SG_ 345 ReSideRdrRiDetn121RdrDetnRngV 0;
BA_ "GenSigStartValue" SG_ 345 ReSideRdrRiDetn121RdrDetnSts 3;
BA_ "GenSigSendType" SG_ 345 ReSideRdrRiDetn121RdrDetnSts 0;
BA_ "GenSigStartValue" SG_ 345 ReSideRdrRiDetn122RdrDetnAzi 900;
BA_ "GenSigSendType" SG_ 345 ReSideRdrRiDetn122RdrDetnAzi 0;
BA_ "GenSigSendType" SG_ 345 ReSideRdrRiDetn122RdrDetnChks 0;
BA_ "GenSigFuncType" SG_ 345 ReSideRdrRiDetn122RdrDetnChks 15;
BA_ "GenSigDataID" SG_ 345 ReSideRdrRiDetn122RdrDetnChks "0xABA";
BA_ "GenSigSendType" SG_ 345 ReSideRdrRiDetn122RdrDetnCntr 0;
BA_ "GenSigFuncType" SG_ 345 ReSideRdrRiDetn122RdrDetnCntr 16;
BA_ "GenSigSendType" SG_ 345 ReSideRdrRiDetn122RdrDetnConf 0;
BA_ "GenSigStartValue" SG_ 345 ReSideRdrRiDetn122RdrDetnElevn 15;
BA_ "GenSigSendType" SG_ 345 ReSideRdrRiDetn122RdrDetnElevn 0;
BA_ "GenSigSendType" SG_ 345 ReSideRdrRiDetn122RdrDetnPwr 0;
BA_ "GenSigStartValue" SG_ 345 ReSideRdrRiDetn122RdrDetnRng 10050;
BA_ "GenSigSendType" SG_ 345 ReSideRdrRiDetn122RdrDetnRng 0;
BA_ "GenSigStartValue" SG_ 345 ReSideRdrRiDetn122RdrDetnRngV 4000;
BA_ "GenSigSendType" SG_ 345 ReSideRdrRiDetn122RdrDetnRngV 0;
BA_ "GenSigStartValue" SG_ 345 ReSideRdrRiDetn122RdrDetnSts 3;
BA_ "GenSigSendType" SG_ 345 ReSideRdrRiDetn122RdrDetnSts 0;
BA_ "GenSigStartValue" SG_ 345 ReSideRdrRiDetn123RdrDetnAzi 900;
BA_ "GenSigSendType" SG_ 345 ReSideRdrRiDetn123RdrDetnAzi 0;
BA_ "GenSigSendType" SG_ 345 ReSideRdrRiDetn123RdrDetnChks 0;
BA_ "GenSigFuncType" SG_ 345 ReSideRdrRiDetn123RdrDetnChks 15;
BA_ "GenSigDataID" SG_ 345 ReSideRdrRiDetn123RdrDetnChks "0xABB";
BA_ "GenSigSendType" SG_ 345 ReSideRdrRiDetn123RdrDetnCntr 0;
BA_ "GenSigFuncType" SG_ 345 ReSideRdrRiDetn123RdrDetnCntr 16;
BA_ "GenSigSendType" SG_ 345 ReSideRdrRiDetn123RdrDetnConf 0;
BA_ "GenSigStartValue" SG_ 345 ReSideRdrRiDetn123RdrDetnElevn 15;
BA_ "GenSigSendType" SG_ 345 ReSideRdrRiDetn123RdrDetnElevn 0;
BA_ "GenSigSendType" SG_ 345 ReSideRdrRiDetn123RdrDetnPwr 0;
BA_ "GenSigStartValue" SG_ 345 ReSideRdrRiDetn123RdrDetnRng 10050;
BA_ "GenSigSendType" SG_ 345 ReSideRdrRiDetn123RdrDetnRng 0;
BA_ "GenSigStartValue" SG_ 345 ReSideRdrRiDetn123RdrDetnRngV 4000;
BA_ "GenSigSendType" SG_ 345 ReSideRdrRiDetn123RdrDetnRngV 0;
BA_ "GenSigStartValue" SG_ 345 ReSideRdrRiDetn123RdrDetnSts 3;
BA_ "GenSigSendType" SG_ 345 ReSideRdrRiDetn123RdrDetnSts 0;
BA_ "GenSigStartValue" SG_ 345 ReSideRdrRiDetn124RdrDetnAzi 900;
BA_ "GenSigSendType" SG_ 345 ReSideRdrRiDetn124RdrDetnAzi 0;
BA_ "GenSigSendType" SG_ 345 ReSideRdrRiDetn124RdrDetnChks 0;
BA_ "GenSigFuncType" SG_ 345 ReSideRdrRiDetn124RdrDetnChks 15;
BA_ "GenSigDataID" SG_ 345 ReSideRdrRiDetn124RdrDetnChks "0xABC";
BA_ "GenSigSendType" SG_ 345 ReSideRdrRiDetn124RdrDetnCntr 0;
BA_ "GenSigFuncType" SG_ 345 ReSideRdrRiDetn124RdrDetnCntr 16;
BA_ "GenSigSendType" SG_ 345 ReSideRdrRiDetn124RdrDetnConf 0;
BA_ "GenSigStartValue" SG_ 345 ReSideRdrRiDetn124RdrDetnElevn 15;
BA_ "GenSigSendType" SG_ 345 ReSideRdrRiDetn124RdrDetnElevn 0;
BA_ "GenSigSendType" SG_ 345 ReSideRdrRiDetn124RdrDetnPwr 0;
BA_ "GenSigStartValue" SG_ 345 ReSideRdrRiDetn124RdrDetnRng 10050;
BA_ "GenSigSendType" SG_ 345 ReSideRdrRiDetn124RdrDetnRng 0;
BA_ "GenSigStartValue" SG_ 345 ReSideRdrRiDetn124RdrDetnRngV 4000;
BA_ "GenSigSendType" SG_ 345 ReSideRdrRiDetn124RdrDetnRngV 0;
BA_ "GenSigStartValue" SG_ 345 ReSideRdrRiDetn124RdrDetnSts 3;
BA_ "GenSigSendType" SG_ 345 ReSideRdrRiDetn124RdrDetnSts 0;
BA_ "GenSigStartValue" SG_ 345 ReSideRdrRiDetn125RdrDetnAzi 900;
BA_ "GenSigSendType" SG_ 345 ReSideRdrRiDetn125RdrDetnAzi 0;
BA_ "GenSigSendType" SG_ 345 ReSideRdrRiDetn125RdrDetnChks 0;
BA_ "GenSigFuncType" SG_ 345 ReSideRdrRiDetn125RdrDetnChks 15;
BA_ "GenSigDataID" SG_ 345 ReSideRdrRiDetn125RdrDetnChks "0xABD";
BA_ "GenSigSendType" SG_ 345 ReSideRdrRiDetn125RdrDetnCntr 0;
BA_ "GenSigFuncType" SG_ 345 ReSideRdrRiDetn125RdrDetnCntr 16;
BA_ "GenSigSendType" SG_ 345 ReSideRdrRiDetn125RdrDetnConf 0;
BA_ "GenSigStartValue" SG_ 345 ReSideRdrRiDetn125RdrDetnElevn 15;
BA_ "GenSigSendType" SG_ 345 ReSideRdrRiDetn125RdrDetnElevn 0;
BA_ "GenSigSendType" SG_ 345 ReSideRdrRiDetn125RdrDetnPwr 0;
BA_ "GenSigStartValue" SG_ 345 ReSideRdrRiDetn125RdrDetnRng 10050;
BA_ "GenSigSendType" SG_ 345 ReSideRdrRiDetn125RdrDetnRng 0;
BA_ "GenSigStartValue" SG_ 345 ReSideRdrRiDetn125RdrDetnRngV 4000;
BA_ "GenSigSendType" SG_ 345 ReSideRdrRiDetn125RdrDetnRngV 0;
BA_ "GenSigStartValue" SG_ 345 ReSideRdrRiDetn125RdrDetnSts 3;
BA_ "GenSigSendType" SG_ 345 ReSideRdrRiDetn125RdrDetnSts 0;
BA_ "GenSigStartValue" SG_ 345 ReSideRdrRiDetn126RdrDetnAzi 900;
BA_ "GenSigSendType" SG_ 345 ReSideRdrRiDetn126RdrDetnAzi 0;
BA_ "GenSigSendType" SG_ 345 ReSideRdrRiDetn126RdrDetnChks 0;
BA_ "GenSigFuncType" SG_ 345 ReSideRdrRiDetn126RdrDetnChks 15;
BA_ "GenSigDataID" SG_ 345 ReSideRdrRiDetn126RdrDetnChks "0xABE";
BA_ "GenSigSendType" SG_ 345 ReSideRdrRiDetn126RdrDetnCntr 0;
BA_ "GenSigFuncType" SG_ 345 ReSideRdrRiDetn126RdrDetnCntr 16;
BA_ "GenSigSendType" SG_ 345 ReSideRdrRiDetn126RdrDetnConf 0;
BA_ "GenSigStartValue" SG_ 345 ReSideRdrRiDetn126RdrDetnElevn 15;
BA_ "GenSigSendType" SG_ 345 ReSideRdrRiDetn126RdrDetnElevn 0;
BA_ "GenSigSendType" SG_ 345 ReSideRdrRiDetn126RdrDetnPwr 0;
BA_ "GenSigStartValue" SG_ 345 ReSideRdrRiDetn126RdrDetnRng 10050;
BA_ "GenSigSendType" SG_ 345 ReSideRdrRiDetn126RdrDetnRng 0;
BA_ "GenSigStartValue" SG_ 345 ReSideRdrRiDetn126RdrDetnRngV 4000;
BA_ "GenSigSendType" SG_ 345 ReSideRdrRiDetn126RdrDetnRngV 0;
BA_ "GenSigStartValue" SG_ 345 ReSideRdrRiDetn126RdrDetnSts 3;
BA_ "GenSigSendType" SG_ 345 ReSideRdrRiDetn126RdrDetnSts 0;
// Frame: SODRSafetyCANFD3Frame22
BA_ "VFrameFormat" BO_ 347 14;
BA_ "GenMsgSendType" BO_ 347 0;
BA_ "GenMsgCycleTime" BO_ 347 50.000;
BA_ "GenSigStartValue" SG_ 347 ReSideRdrRiDetn127RdrDetnAzi 900;
BA_ "GenSigSendType" SG_ 347 ReSideRdrRiDetn127RdrDetnAzi 0;
BA_ "GenSigSendType" SG_ 347 ReSideRdrRiDetn127RdrDetnChks 0;
BA_ "GenSigFuncType" SG_ 347 ReSideRdrRiDetn127RdrDetnChks 15;
BA_ "GenSigDataID" SG_ 347 ReSideRdrRiDetn127RdrDetnChks "0xABF";
BA_ "GenSigSendType" SG_ 347 ReSideRdrRiDetn127RdrDetnCntr 0;
BA_ "GenSigFuncType" SG_ 347 ReSideRdrRiDetn127RdrDetnCntr 16;
BA_ "GenSigSendType" SG_ 347 ReSideRdrRiDetn127RdrDetnConf 0;
BA_ "GenSigStartValue" SG_ 347 ReSideRdrRiDetn127RdrDetnElevn 15;
BA_ "GenSigSendType" SG_ 347 ReSideRdrRiDetn127RdrDetnElevn 0;
BA_ "GenSigSendType" SG_ 347 ReSideRdrRiDetn127RdrDetnPwr 0;
BA_ "GenSigStartValue" SG_ 347 ReSideRdrRiDetn127RdrDetnRng 10050;
BA_ "GenSigSendType" SG_ 347 ReSideRdrRiDetn127RdrDetnRng 0;
BA_ "GenSigStartValue" SG_ 347 ReSideRdrRiDetn127RdrDetnRngV 4000;
BA_ "GenSigSendType" SG_ 347 ReSideRdrRiDetn127RdrDetnRngV 0;
BA_ "GenSigStartValue" SG_ 347 ReSideRdrRiDetn127RdrDetnSts 3;
BA_ "GenSigSendType" SG_ 347 ReSideRdrRiDetn127RdrDetnSts 0;
BA_ "GenSigStartValue" SG_ 347 ReSideRdrRiDetn128RdrDetnAzi 900;
BA_ "GenSigSendType" SG_ 347 ReSideRdrRiDetn128RdrDetnAzi 0;
BA_ "GenSigSendType" SG_ 347 ReSideRdrRiDetn128RdrDetnChks 0;
BA_ "GenSigFuncType" SG_ 347 ReSideRdrRiDetn128RdrDetnChks 15;
BA_ "GenSigDataID" SG_ 347 ReSideRdrRiDetn128RdrDetnChks "0xAC0";
BA_ "GenSigSendType" SG_ 347 ReSideRdrRiDetn128RdrDetnCntr 0;
BA_ "GenSigFuncType" SG_ 347 ReSideRdrRiDetn128RdrDetnCntr 16;
BA_ "GenSigSendType" SG_ 347 ReSideRdrRiDetn128RdrDetnConf 0;
BA_ "GenSigStartValue" SG_ 347 ReSideRdrRiDetn128RdrDetnElevn 15;
BA_ "GenSigSendType" SG_ 347 ReSideRdrRiDetn128RdrDetnElevn 0;
BA_ "GenSigSendType" SG_ 347 ReSideRdrRiDetn128RdrDetnPwr 0;
BA_ "GenSigStartValue" SG_ 347 ReSideRdrRiDetn128RdrDetnRng 10050;
BA_ "GenSigSendType" SG_ 347 ReSideRdrRiDetn128RdrDetnRng 0;
BA_ "GenSigStartValue" SG_ 347 ReSideRdrRiDetn128RdrDetnRngV 4000;
BA_ "GenSigSendType" SG_ 347 ReSideRdrRiDetn128RdrDetnRngV 0;
BA_ "GenSigStartValue" SG_ 347 ReSideRdrRiDetn128RdrDetnSts 3;
BA_ "GenSigSendType" SG_ 347 ReSideRdrRiDetn128RdrDetnSts 0;
// Frame: SODRSafetyCANFD3Frame23
BA_ "VFrameFormat" BO_ 349 14;
BA_ "GenMsgSendType" BO_ 349 0;
BA_ "GenMsgCycleTime" BO_ 349 50.000;
BA_ "GenSigStartValue" SG_ 349 ReSideRdrRiObj1Heading 1800;
BA_ "GenSigSendType" SG_ 349 ReSideRdrRiObj1Heading 0;
BA_ "GenSigStartValue" SG_ 349 ReSideRdrRiObj1ObjBoxCenterLat 250;
BA_ "GenSigSendType" SG_ 349 ReSideRdrRiObj1ObjBoxCenterLat 0;
BA_ "GenSigStartValue" SG_ 349 ReSideRdrRiObj1ObjBoxCenterLgt 250;
BA_ "GenSigSendType" SG_ 349 ReSideRdrRiObj1ObjBoxCenterLgt 0;
BA_ "GenSigSendType" SG_ 349 ReSideRdrRiObj1ObservationHist 0;
BA_ "GenSigSendType" SG_ 349 ReSideRdrRiObj1RdrObjAx 0;
BA_ "GenSigSendType" SG_ 349 ReSideRdrRiObj1RdrObjAy 0;
BA_ "GenSigSendType" SG_ 349 ReSideRdrRiObj1RdrObjBoxLength 0;
BA_ "GenSigSendType" SG_ 349 ReSideRdrRiObj1RdrObjBoxWidth 0;
BA_ "GenSigSendType" SG_ 349 ReSideRdrRiObj1RdrObjChks 0;
BA_ "GenSigFuncType" SG_ 349 ReSideRdrRiObj1RdrObjChks 15;
BA_ "GenSigDataID" SG_ 349 ReSideRdrRiObj1RdrObjChks "0xAC1";
BA_ "GenSigSendType" SG_ 349 ReSideRdrRiObj1RdrObjCntr 0;
BA_ "GenSigFuncType" SG_ 349 ReSideRdrRiObj1RdrObjCntr 16;
BA_ "GenSigStartValue" SG_ 349 ReSideRdrRiObj1RdrObjCoastCnt 31;
BA_ "GenSigSendType" SG_ 349 ReSideRdrRiObj1RdrObjCoastCnt 0;
BA_ "GenSigSendType" SG_ 349 ReSideRdrRiObj1RdrObjConf 0;
BA_ "GenSigSendType" SG_ 349 ReSideRdrRiObj1RdrObjDx 0;
BA_ "GenSigSendType" SG_ 349 ReSideRdrRiObj1RdrObjDxStdDe 0;
BA_ "GenSigStartValue" SG_ 349 ReSideRdrRiObj1RdrObjDy 4000;
BA_ "GenSigSendType" SG_ 349 ReSideRdrRiObj1RdrObjDy 0;
BA_ "GenSigSendType" SG_ 349 ReSideRdrRiObj1RdrObjDyStdDe 0;
BA_ "GenSigSendType" SG_ 349 ReSideRdrRiObj1RdrObjElevnConf 0;
BA_ "GenSigSendType" SG_ 349 ReSideRdrRiObj1RdrObjElevnSts 0;
BA_ "GenSigSendType" SG_ 349 ReSideRdrRiObj1RdrObjID 0;
BA_ "GenSigStartValue" SG_ 349 ReSideRdrRiObj1RdrObjIsInFreeSpace 1;
BA_ "GenSigSendType" SG_ 349 ReSideRdrRiObj1RdrObjIsInFreeSpace 0;
BA_ "GenSigSendType" SG_ 349 ReSideRdrRiObj1RdrObjMirrProblty 0;
BA_ "GenSigStartValue" SG_ 349 ReSideRdrRiObj1RdrObjMtnPat 3;
BA_ "GenSigSendType" SG_ 349 ReSideRdrRiObj1RdrObjMtnPat 0;
BA_ "GenSigSendType" SG_ 349 ReSideRdrRiObj1RdrObjNotRealProblty 0;
BA_ "GenSigSendType" SG_ 349 ReSideRdrRiObj1RdrObjStatyCnt 0;
BA_ "GenSigSendType" SG_ 349 ReSideRdrRiObj1RdrObjTiAlv 0;
BA_ "GenSigSendType" SG_ 349 ReSideRdrRiObj1RdrObjTrackSts 0;
BA_ "GenSigSendType" SG_ 349 ReSideRdrRiObj1RdrObjTyp 0;
BA_ "GenSigSendType" SG_ 349 ReSideRdrRiObj1RdrObjTypConfBike 0;
BA_ "GenSigSendType" SG_ 349 ReSideRdrRiObj1RdrObjTypConfPed 0;
BA_ "GenSigSendType" SG_ 349 ReSideRdrRiObj1RdrObjTypConfVeh 0;
BA_ "GenSigStartValue" SG_ 349 ReSideRdrRiObj1RdrObjVx 6400;
BA_ "GenSigSendType" SG_ 349 ReSideRdrRiObj1RdrObjVx 0;
BA_ "GenSigSendType" SG_ 349 ReSideRdrRiObj1RdrObjVxStdDe 0;
BA_ "GenSigStartValue" SG_ 349 ReSideRdrRiObj1RdrObjVy 6400;
BA_ "GenSigSendType" SG_ 349 ReSideRdrRiObj1RdrObjVy 0;
BA_ "GenSigSendType" SG_ 349 ReSideRdrRiObj1RdrObjVyStdDe 0;
BA_ "GenSigStartValue" SG_ 349 ReSideRdrRiObj1RelVx 1780;
BA_ "GenSigSendType" SG_ 349 ReSideRdrRiObj1RelVx 0;
BA_ "GenSigStartValue" SG_ 349 ReSideRdrRiObj1RelVy 1780;
BA_ "GenSigSendType" SG_ 349 ReSideRdrRiObj1RelVy 0;
// Frame: SODRSafetyCANFD3Frame24
BA_ "VFrameFormat" BO_ 351 14;
BA_ "GenMsgSendType" BO_ 351 0;
BA_ "GenMsgCycleTime" BO_ 351 50.000;
BA_ "GenSigStartValue" SG_ 351 ReSideRdrRiObj2Heading 1800;
BA_ "GenSigSendType" SG_ 351 ReSideRdrRiObj2Heading 0;
BA_ "GenSigStartValue" SG_ 351 ReSideRdrRiObj2ObjBoxCenterLat 250;
BA_ "GenSigSendType" SG_ 351 ReSideRdrRiObj2ObjBoxCenterLat 0;
BA_ "GenSigStartValue" SG_ 351 ReSideRdrRiObj2ObjBoxCenterLgt 250;
BA_ "GenSigSendType" SG_ 351 ReSideRdrRiObj2ObjBoxCenterLgt 0;
BA_ "GenSigSendType" SG_ 351 ReSideRdrRiObj2ObservationHist 0;
BA_ "GenSigSendType" SG_ 351 ReSideRdrRiObj2RdrObjAx 0;
BA_ "GenSigSendType" SG_ 351 ReSideRdrRiObj2RdrObjAy 0;
BA_ "GenSigSendType" SG_ 351 ReSideRdrRiObj2RdrObjBoxLength 0;
BA_ "GenSigSendType" SG_ 351 ReSideRdrRiObj2RdrObjBoxWidth 0;
BA_ "GenSigSendType" SG_ 351 ReSideRdrRiObj2RdrObjChks 0;
BA_ "GenSigFuncType" SG_ 351 ReSideRdrRiObj2RdrObjChks 15;
BA_ "GenSigDataID" SG_ 351 ReSideRdrRiObj2RdrObjChks "0xAC2";
BA_ "GenSigSendType" SG_ 351 ReSideRdrRiObj2RdrObjCntr 0;
BA_ "GenSigFuncType" SG_ 351 ReSideRdrRiObj2RdrObjCntr 16;
BA_ "GenSigStartValue" SG_ 351 ReSideRdrRiObj2RdrObjCoastCnt 31;
BA_ "GenSigSendType" SG_ 351 ReSideRdrRiObj2RdrObjCoastCnt 0;
BA_ "GenSigSendType" SG_ 351 ReSideRdrRiObj2RdrObjConf 0;
BA_ "GenSigSendType" SG_ 351 ReSideRdrRiObj2RdrObjDx 0;
BA_ "GenSigSendType" SG_ 351 ReSideRdrRiObj2RdrObjDxStdDe 0;
BA_ "GenSigStartValue" SG_ 351 ReSideRdrRiObj2RdrObjDy 4000;
BA_ "GenSigSendType" SG_ 351 ReSideRdrRiObj2RdrObjDy 0;
BA_ "GenSigSendType" SG_ 351 ReSideRdrRiObj2RdrObjDyStdDe 0;
BA_ "GenSigSendType" SG_ 351 ReSideRdrRiObj2RdrObjElevnConf 0;
BA_ "GenSigSendType" SG_ 351 ReSideRdrRiObj2RdrObjElevnSts 0;
BA_ "GenSigSendType" SG_ 351 ReSideRdrRiObj2RdrObjID 0;
BA_ "GenSigStartValue" SG_ 351 ReSideRdrRiObj2RdrObjIsInFreeSpace 1;
BA_ "GenSigSendType" SG_ 351 ReSideRdrRiObj2RdrObjIsInFreeSpace 0;
BA_ "GenSigSendType" SG_ 351 ReSideRdrRiObj2RdrObjMirrProblty 0;
BA_ "GenSigStartValue" SG_ 351 ReSideRdrRiObj2RdrObjMtnPat 3;
BA_ "GenSigSendType" SG_ 351 ReSideRdrRiObj2RdrObjMtnPat 0;
BA_ "GenSigSendType" SG_ 351 ReSideRdrRiObj2RdrObjNotRealProblty 0;
BA_ "GenSigSendType" SG_ 351 ReSideRdrRiObj2RdrObjStatyCnt 0;
BA_ "GenSigSendType" SG_ 351 ReSideRdrRiObj2RdrObjTiAlv 0;
BA_ "GenSigSendType" SG_ 351 ReSideRdrRiObj2RdrObjTrackSts 0;
BA_ "GenSigSendType" SG_ 351 ReSideRdrRiObj2RdrObjTyp 0;
BA_ "GenSigSendType" SG_ 351 ReSideRdrRiObj2RdrObjTypConfBike 0;
BA_ "GenSigSendType" SG_ 351 ReSideRdrRiObj2RdrObjTypConfPed 0;
BA_ "GenSigSendType" SG_ 351 ReSideRdrRiObj2RdrObjTypConfVeh 0;
BA_ "GenSigStartValue" SG_ 351 ReSideRdrRiObj2RdrObjVx 6400;
BA_ "GenSigSendType" SG_ 351 ReSideRdrRiObj2RdrObjVx 0;
BA_ "GenSigSendType" SG_ 351 ReSideRdrRiObj2RdrObjVxStdDe 0;
BA_ "GenSigStartValue" SG_ 351 ReSideRdrRiObj2RdrObjVy 6400;
BA_ "GenSigSendType" SG_ 351 ReSideRdrRiObj2RdrObjVy 0;
BA_ "GenSigSendType" SG_ 351 ReSideRdrRiObj2RdrObjVyStdDe 0;
BA_ "GenSigStartValue" SG_ 351 ReSideRdrRiObj2RelVx 1780;
BA_ "GenSigSendType" SG_ 351 ReSideRdrRiObj2RelVx 0;
BA_ "GenSigStartValue" SG_ 351 ReSideRdrRiObj2RelVy 1780;
BA_ "GenSigSendType" SG_ 351 ReSideRdrRiObj2RelVy 0;
// Frame: SODRSafetyCANFD3Frame25
BA_ "VFrameFormat" BO_ 353 14;
BA_ "GenMsgSendType" BO_ 353 0;
BA_ "GenMsgCycleTime" BO_ 353 50.000;
BA_ "GenSigStartValue" SG_ 353 ReSideRdrRiObj3Heading 1800;
BA_ "GenSigSendType" SG_ 353 ReSideRdrRiObj3Heading 0;
BA_ "GenSigStartValue" SG_ 353 ReSideRdrRiObj3ObjBoxCenterLat 250;
BA_ "GenSigSendType" SG_ 353 ReSideRdrRiObj3ObjBoxCenterLat 0;
BA_ "GenSigStartValue" SG_ 353 ReSideRdrRiObj3ObjBoxCenterLgt 250;
BA_ "GenSigSendType" SG_ 353 ReSideRdrRiObj3ObjBoxCenterLgt 0;
BA_ "GenSigSendType" SG_ 353 ReSideRdrRiObj3ObservationHist 0;
BA_ "GenSigSendType" SG_ 353 ReSideRdrRiObj3RdrObjAx 0;
BA_ "GenSigSendType" SG_ 353 ReSideRdrRiObj3RdrObjAy 0;
BA_ "GenSigSendType" SG_ 353 ReSideRdrRiObj3RdrObjBoxLength 0;
BA_ "GenSigSendType" SG_ 353 ReSideRdrRiObj3RdrObjBoxWidth 0;
BA_ "GenSigSendType" SG_ 353 ReSideRdrRiObj3RdrObjChks 0;
BA_ "GenSigFuncType" SG_ 353 ReSideRdrRiObj3RdrObjChks 15;
BA_ "GenSigDataID" SG_ 353 ReSideRdrRiObj3RdrObjChks "0xAC3";
BA_ "GenSigSendType" SG_ 353 ReSideRdrRiObj3RdrObjCntr 0;
BA_ "GenSigFuncType" SG_ 353 ReSideRdrRiObj3RdrObjCntr 16;
BA_ "GenSigStartValue" SG_ 353 ReSideRdrRiObj3RdrObjCoastCnt 31;
BA_ "GenSigSendType" SG_ 353 ReSideRdrRiObj3RdrObjCoastCnt 0;
BA_ "GenSigSendType" SG_ 353 ReSideRdrRiObj3RdrObjConf 0;
BA_ "GenSigSendType" SG_ 353 ReSideRdrRiObj3RdrObjDx 0;
BA_ "GenSigSendType" SG_ 353 ReSideRdrRiObj3RdrObjDxStdDe 0;
BA_ "GenSigStartValue" SG_ 353 ReSideRdrRiObj3RdrObjDy 4000;
BA_ "GenSigSendType" SG_ 353 ReSideRdrRiObj3RdrObjDy 0;
BA_ "GenSigSendType" SG_ 353 ReSideRdrRiObj3RdrObjDyStdDe 0;
BA_ "GenSigSendType" SG_ 353 ReSideRdrRiObj3RdrObjElevnConf 0;
BA_ "GenSigSendType" SG_ 353 ReSideRdrRiObj3RdrObjElevnSts 0;
BA_ "GenSigSendType" SG_ 353 ReSideRdrRiObj3RdrObjID 0;
BA_ "GenSigStartValue" SG_ 353 ReSideRdrRiObj3RdrObjIsInFreeSpace 1;
BA_ "GenSigSendType" SG_ 353 ReSideRdrRiObj3RdrObjIsInFreeSpace 0;
BA_ "GenSigSendType" SG_ 353 ReSideRdrRiObj3RdrObjMirrProblty 0;
BA_ "GenSigStartValue" SG_ 353 ReSideRdrRiObj3RdrObjMtnPat 3;
BA_ "GenSigSendType" SG_ 353 ReSideRdrRiObj3RdrObjMtnPat 0;
BA_ "GenSigSendType" SG_ 353 ReSideRdrRiObj3RdrObjNotRealProblty 0;
BA_ "GenSigSendType" SG_ 353 ReSideRdrRiObj3RdrObjStatyCnt 0;
BA_ "GenSigSendType" SG_ 353 ReSideRdrRiObj3RdrObjTiAlv 0;
BA_ "GenSigSendType" SG_ 353 ReSideRdrRiObj3RdrObjTrackSts 0;
BA_ "GenSigSendType" SG_ 353 ReSideRdrRiObj3RdrObjTyp 0;
BA_ "GenSigSendType" SG_ 353 ReSideRdrRiObj3RdrObjTypConfBike 0;
BA_ "GenSigSendType" SG_ 353 ReSideRdrRiObj3RdrObjTypConfPed 0;
BA_ "GenSigSendType" SG_ 353 ReSideRdrRiObj3RdrObjTypConfVeh 0;
BA_ "GenSigStartValue" SG_ 353 ReSideRdrRiObj3RdrObjVx 6400;
BA_ "GenSigSendType" SG_ 353 ReSideRdrRiObj3RdrObjVx 0;
BA_ "GenSigSendType" SG_ 353 ReSideRdrRiObj3RdrObjVxStdDe 0;
BA_ "GenSigStartValue" SG_ 353 ReSideRdrRiObj3RdrObjVy 6400;
BA_ "GenSigSendType" SG_ 353 ReSideRdrRiObj3RdrObjVy 0;
BA_ "GenSigSendType" SG_ 353 ReSideRdrRiObj3RdrObjVyStdDe 0;
BA_ "GenSigStartValue" SG_ 353 ReSideRdrRiObj3RelVx 1780;
BA_ "GenSigSendType" SG_ 353 ReSideRdrRiObj3RelVx 0;
BA_ "GenSigStartValue" SG_ 353 ReSideRdrRiObj3RelVy 1780;
BA_ "GenSigSendType" SG_ 353 ReSideRdrRiObj3RelVy 0;
VAL_ 335 ReSideRdrRiDetn91RdrDetnSts 0 "RdrDetnSts_Ukwn" 1 "RdrDetnSts_Movg" 2 "RdrDetnSts_Staty" 3 "RdrDetnSts_Invalid";
VAL_ 335 ReSideRdrRiDetn92RdrDetnSts 0 "RdrDetnSts_Ukwn" 1 "RdrDetnSts_Movg" 2 "RdrDetnSts_Staty" 3 "RdrDetnSts_Invalid";
VAL_ 335 ReSideRdrRiDetn93RdrDetnSts 0 "RdrDetnSts_Ukwn" 1 "RdrDetnSts_Movg" 2 "RdrDetnSts_Staty" 3 "RdrDetnSts_Invalid";
VAL_ 335 ReSideRdrRiDetn94RdrDetnSts 0 "RdrDetnSts_Ukwn" 1 "RdrDetnSts_Movg" 2 "RdrDetnSts_Staty" 3 "RdrDetnSts_Invalid";
VAL_ 335 ReSideRdrRiDetn95RdrDetnSts 0 "RdrDetnSts_Ukwn" 1 "RdrDetnSts_Movg" 2 "RdrDetnSts_Staty" 3 "RdrDetnSts_Invalid";
VAL_ 335 ReSideRdrRiDetn96RdrDetnSts 0 "RdrDetnSts_Ukwn" 1 "RdrDetnSts_Movg" 2 "RdrDetnSts_Staty" 3 "RdrDetnSts_Invalid";
VAL_ 337 ReSideRdrRiDetn100RdrDetnSts 0 "RdrDetnSts_Ukwn" 1 "RdrDetnSts_Movg" 2 "RdrDetnSts_Staty" 3 "RdrDetnSts_Invalid";
VAL_ 337 ReSideRdrRiDetn101RdrDetnSts 0 "RdrDetnSts_Ukwn" 1 "RdrDetnSts_Movg" 2 "RdrDetnSts_Staty" 3 "RdrDetnSts_Invalid";
VAL_ 337 ReSideRdrRiDetn102RdrDetnSts 0 "RdrDetnSts_Ukwn" 1 "RdrDetnSts_Movg" 2 "RdrDetnSts_Staty" 3 "RdrDetnSts_Invalid";
VAL_ 337 ReSideRdrRiDetn97RdrDetnSts 0 "RdrDetnSts_Ukwn" 1 "RdrDetnSts_Movg" 2 "RdrDetnSts_Staty" 3 "RdrDetnSts_Invalid";
VAL_ 337 ReSideRdrRiDetn98RdrDetnSts 0 "RdrDetnSts_Ukwn" 1 "RdrDetnSts_Movg" 2 "RdrDetnSts_Staty" 3 "RdrDetnSts_Invalid";
VAL_ 337 ReSideRdrRiDetn99RdrDetnSts 0 "RdrDetnSts_Ukwn" 1 "RdrDetnSts_Movg" 2 "RdrDetnSts_Staty" 3 "RdrDetnSts_Invalid";
VAL_ 339 ReSideRdrRiDetn103RdrDetnSts 0 "RdrDetnSts_Ukwn" 1 "RdrDetnSts_Movg" 2 "RdrDetnSts_Staty" 3 "RdrDetnSts_Invalid";
VAL_ 339 ReSideRdrRiDetn104RdrDetnSts 0 "RdrDetnSts_Ukwn" 1 "RdrDetnSts_Movg" 2 "RdrDetnSts_Staty" 3 "RdrDetnSts_Invalid";
VAL_ 339 ReSideRdrRiDetn105RdrDetnSts 0 "RdrDetnSts_Ukwn" 1 "RdrDetnSts_Movg" 2 "RdrDetnSts_Staty" 3 "RdrDetnSts_Invalid";
VAL_ 339 ReSideRdrRiDetn106RdrDetnSts 0 "RdrDetnSts_Ukwn" 1 "RdrDetnSts_Movg" 2 "RdrDetnSts_Staty" 3 "RdrDetnSts_Invalid";
VAL_ 339 ReSideRdrRiDetn107RdrDetnSts 0 "RdrDetnSts_Ukwn" 1 "RdrDetnSts_Movg" 2 "RdrDetnSts_Staty" 3 "RdrDetnSts_Invalid";
VAL_ 339 ReSideRdrRiDetn108RdrDetnSts 0 "RdrDetnSts_Ukwn" 1 "RdrDetnSts_Movg" 2 "RdrDetnSts_Staty" 3 "RdrDetnSts_Invalid";
VAL_ 341 ReSideRdrRiDetn109RdrDetnSts 0 "RdrDetnSts_Ukwn" 1 "RdrDetnSts_Movg" 2 "RdrDetnSts_Staty" 3 "RdrDetnSts_Invalid";
VAL_ 341 ReSideRdrRiDetn110RdrDetnSts 0 "RdrDetnSts_Ukwn" 1 "RdrDetnSts_Movg" 2 "RdrDetnSts_Staty" 3 "RdrDetnSts_Invalid";
VAL_ 341 ReSideRdrRiDetn111RdrDetnSts 0 "RdrDetnSts_Ukwn" 1 "RdrDetnSts_Movg" 2 "RdrDetnSts_Staty" 3 "RdrDetnSts_Invalid";
VAL_ 341 ReSideRdrRiDetn112RdrDetnSts 0 "RdrDetnSts_Ukwn" 1 "RdrDetnSts_Movg" 2 "RdrDetnSts_Staty" 3 "RdrDetnSts_Invalid";
VAL_ 341 ReSideRdrRiDetn113RdrDetnSts 0 "RdrDetnSts_Ukwn" 1 "RdrDetnSts_Movg" 2 "RdrDetnSts_Staty" 3 "RdrDetnSts_Invalid";
VAL_ 341 ReSideRdrRiDetn114RdrDetnSts 0 "RdrDetnSts_Ukwn" 1 "RdrDetnSts_Movg" 2 "RdrDetnSts_Staty" 3 "RdrDetnSts_Invalid";
VAL_ 343 ReSideRdrRiDetn115RdrDetnSts 0 "RdrDetnSts_Ukwn" 1 "RdrDetnSts_Movg" 2 "RdrDetnSts_Staty" 3 "RdrDetnSts_Invalid";
VAL_ 343 ReSideRdrRiDetn116RdrDetnSts 0 "RdrDetnSts_Ukwn" 1 "RdrDetnSts_Movg" 2 "RdrDetnSts_Staty" 3 "RdrDetnSts_Invalid";
VAL_ 343 ReSideRdrRiDetn117RdrDetnSts 0 "RdrDetnSts_Ukwn" 1 "RdrDetnSts_Movg" 2 "RdrDetnSts_Staty" 3 "RdrDetnSts_Invalid";
VAL_ 343 ReSideRdrRiDetn118RdrDetnSts 0 "RdrDetnSts_Ukwn" 1 "RdrDetnSts_Movg" 2 "RdrDetnSts_Staty" 3 "RdrDetnSts_Invalid";
VAL_ 343 ReSideRdrRiDetn119RdrDetnSts 0 "RdrDetnSts_Ukwn" 1 "RdrDetnSts_Movg" 2 "RdrDetnSts_Staty" 3 "RdrDetnSts_Invalid";
VAL_ 343 ReSideRdrRiDetn120RdrDetnSts 0 "RdrDetnSts_Ukwn" 1 "RdrDetnSts_Movg" 2 "RdrDetnSts_Staty" 3 "RdrDetnSts_Invalid";
VAL_ 345 ReSideRdrRiDetn121RdrDetnSts 0 "RdrDetnSts_Ukwn" 1 "RdrDetnSts_Movg" 2 "RdrDetnSts_Staty" 3 "RdrDetnSts_Invalid";
VAL_ 345 ReSideRdrRiDetn122RdrDetnSts 0 "RdrDetnSts_Ukwn" 1 "RdrDetnSts_Movg" 2 "RdrDetnSts_Staty" 3 "RdrDetnSts_Invalid";
VAL_ 345 ReSideRdrRiDetn123RdrDetnSts 0 "RdrDetnSts_Ukwn" 1 "RdrDetnSts_Movg" 2 "RdrDetnSts_Staty" 3 "RdrDetnSts_Invalid";
VAL_ 345 ReSideRdrRiDetn124RdrDetnSts 0 "RdrDetnSts_Ukwn" 1 "RdrDetnSts_Movg" 2 "RdrDetnSts_Staty" 3 "RdrDetnSts_Invalid";
VAL_ 345 ReSideRdrRiDetn125RdrDetnSts 0 "RdrDetnSts_Ukwn" 1 "RdrDetnSts_Movg" 2 "RdrDetnSts_Staty" 3 "RdrDetnSts_Invalid";
VAL_ 345 ReSideRdrRiDetn126RdrDetnSts 0 "RdrDetnSts_Ukwn" 1 "RdrDetnSts_Movg" 2 "RdrDetnSts_Staty" 3 "RdrDetnSts_Invalid";
VAL_ 347 ReSideRdrRiDetn127RdrDetnSts 0 "RdrDetnSts_Ukwn" 1 "RdrDetnSts_Movg" 2 "RdrDetnSts_Staty" 3 "RdrDetnSts_Invalid";
VAL_ 347 ReSideRdrRiDetn128RdrDetnSts 0 "RdrDetnSts_Ukwn" 1 "RdrDetnSts_Movg" 2 "RdrDetnSts_Staty" 3 "RdrDetnSts_Invalid";
VAL_ 349 ReSideRdrRiObj1RdrObjElevnSts 0 "RdrObjElevnSts_Unknown" 1 "RdrObjElevnSts_OverRidable" 2 "RdrObjElevnSts_Rlv" 3 "RdrObjElevnSts_UnderRidable";
VAL_ 349 ReSideRdrRiObj1RdrObjIsInFreeSpace 0 "YesNo2_No" 1 "YesNo2_Yes";
VAL_ 349 ReSideRdrRiObj1RdrObjMtnPat 0 "RdrObjMtnPat_Ukwn" 1 "RdrObjMtnPat_Staty" 2 "RdrObjMtnPat_StatyFromMovg" 3 "RdrObjMtnPat_Movg" 4 "RdrObjMtnPat_Receding" 5 "RdrObjMtnPat_Oncoming" 6 "RdrObjMtnPat_CrossingFromLe" 7 "RdrObjMtnPat_CrossingFromRi";
VAL_ 349 ReSideRdrRiObj1RdrObjTrackSts 0 "RdrObjTrackSts_Invld" 1 "RdrObjTrackSts_Updated" 2 "RdrObjTrackSts_New" 3 "RdrObjTrackSts_Coasted";
VAL_ 349 ReSideRdrRiObj1RdrObjTyp 0 "RdrObjTyp_Ukwn" 1 "RdrObjTyp_Car" 2 "RdrObjTyp_MotorCycle" 3 "RdrObjTyp_Truck" 4 "RdrObjTyp_Ped" 5 "RdrObjTyp_ObstdVert1" 6 "RdrObjTyp_ObstdVert2" 7 "RdrObjTyp_Anim" 8 "RdrObjTyp_ObjGen" 9 "RdrObjTyp_Bicycle" 10 "RdrObjTyp_VehofUkwnClass" 11 "RdrObjTyp_Reserved";
VAL_ 351 ReSideRdrRiObj2RdrObjElevnSts 0 "RdrObjElevnSts_Unknown" 1 "RdrObjElevnSts_OverRidable" 2 "RdrObjElevnSts_Rlv" 3 "RdrObjElevnSts_UnderRidable";
VAL_ 351 ReSideRdrRiObj2RdrObjIsInFreeSpace 0 "YesNo2_No" 1 "YesNo2_Yes";
VAL_ 351 ReSideRdrRiObj2RdrObjMtnPat 0 "RdrObjMtnPat_Ukwn" 1 "RdrObjMtnPat_Staty" 2 "RdrObjMtnPat_StatyFromMovg" 3 "RdrObjMtnPat_Movg" 4 "RdrObjMtnPat_Receding" 5 "RdrObjMtnPat_Oncoming" 6 "RdrObjMtnPat_CrossingFromLe" 7 "RdrObjMtnPat_CrossingFromRi";
VAL_ 351 ReSideRdrRiObj2RdrObjTrackSts 0 "RdrObjTrackSts_Invld" 1 "RdrObjTrackSts_Updated" 2 "RdrObjTrackSts_New" 3 "RdrObjTrackSts_Coasted";
VAL_ 351 ReSideRdrRiObj2RdrObjTyp 0 "RdrObjTyp_Ukwn" 1 "RdrObjTyp_Car" 2 "RdrObjTyp_MotorCycle" 3 "RdrObjTyp_Truck" 4 "RdrObjTyp_Ped" 5 "RdrObjTyp_ObstdVert1" 6 "RdrObjTyp_ObstdVert2" 7 "RdrObjTyp_Anim" 8 "RdrObjTyp_ObjGen" 9 "RdrObjTyp_Bicycle" 10 "RdrObjTyp_VehofUkwnClass" 11 "RdrObjTyp_Reserved";
VAL_ 353 ReSideRdrRiObj3RdrObjElevnSts 0 "RdrObjElevnSts_Unknown" 1 "RdrObjElevnSts_OverRidable" 2 "RdrObjElevnSts_Rlv" 3 "RdrObjElevnSts_UnderRidable";
VAL_ 353 ReSideRdrRiObj3RdrObjIsInFreeSpace 0 "YesNo2_No" 1 "YesNo2_Yes";
VAL_ 353 ReSideRdrRiObj3RdrObjMtnPat 0 "RdrObjMtnPat_Ukwn" 1 "RdrObjMtnPat_Staty" 2 "RdrObjMtnPat_StatyFromMovg" 3 "RdrObjMtnPat_Movg" 4 "RdrObjMtnPat_Receding" 5 "RdrObjMtnPat_Oncoming" 6 "RdrObjMtnPat_CrossingFromLe" 7 "RdrObjMtnPat_CrossingFromRi";
VAL_ 353 ReSideRdrRiObj3RdrObjTrackSts 0 "RdrObjTrackSts_Invld" 1 "RdrObjTrackSts_Updated" 2 "RdrObjTrackSts_New" 3 "RdrObjTrackSts_Coasted";
VAL_ 353 ReSideRdrRiObj3RdrObjTyp 0 "RdrObjTyp_Ukwn" 1 "RdrObjTyp_Car" 2 "RdrObjTyp_MotorCycle" 3 "RdrObjTyp_Truck" 4 "RdrObjTyp_Ped" 5 "RdrObjTyp_ObstdVert1" 6 "RdrObjTyp_ObstdVert2" 7 "RdrObjTyp_Anim" 8 "RdrObjTyp_ObjGen" 9 "RdrObjTyp_Bicycle" 10 "RdrObjTyp_VehofUkwnClass" 11 "RdrObjTyp_Reserved";
SIG_GROUP_ 337 ReSideRdrRiDetn100 1 : ReSideRdrRiDetn100RdrDetnAzi ReSideRdrRiDetn100RdrDetnChks ReSideRdrRiDetn100RdrDetnCntr ReSideRdrRiDetn100RdrDetnConf ReSideRdrRiDetn100RdrDetnElevn ReSideRdrRiDetn100RdrDetnPwr ReSideRdrRiDetn100RdrDetnRng ReSideRdrRiDetn100RdrDetnRngV ReSideRdrRiDetn100RdrDetnSts;
SIG_GROUP_ 337 ReSideRdrRiDetn101 1 : ReSideRdrRiDetn101RdrDetnAzi ReSideRdrRiDetn101RdrDetnChks ReSideRdrRiDetn101RdrDetnCntr ReSideRdrRiDetn101RdrDetnConf ReSideRdrRiDetn101RdrDetnElevn ReSideRdrRiDetn101RdrDetnPwr ReSideRdrRiDetn101RdrDetnRng ReSideRdrRiDetn101RdrDetnRngV ReSideRdrRiDetn101RdrDetnSts;
SIG_GROUP_ 337 ReSideRdrRiDetn102 1 : ReSideRdrRiDetn102RdrDetnAzi ReSideRdrRiDetn102RdrDetnChks ReSideRdrRiDetn102RdrDetnCntr ReSideRdrRiDetn102RdrDetnConf ReSideRdrRiDetn102RdrDetnElevn ReSideRdrRiDetn102RdrDetnPwr ReSideRdrRiDetn102RdrDetnRng ReSideRdrRiDetn102RdrDetnRngV ReSideRdrRiDetn102RdrDetnSts;
SIG_GROUP_ 339 ReSideRdrRiDetn103 1 : ReSideRdrRiDetn103RdrDetnAzi ReSideRdrRiDetn103RdrDetnChks ReSideRdrRiDetn103RdrDetnCntr ReSideRdrRiDetn103RdrDetnConf ReSideRdrRiDetn103RdrDetnElevn ReSideRdrRiDetn103RdrDetnPwr ReSideRdrRiDetn103RdrDetnRng ReSideRdrRiDetn103RdrDetnRngV ReSideRdrRiDetn103RdrDetnSts;
SIG_GROUP_ 339 ReSideRdrRiDetn104 1 : ReSideRdrRiDetn104RdrDetnAzi ReSideRdrRiDetn104RdrDetnChks ReSideRdrRiDetn104RdrDetnCntr ReSideRdrRiDetn104RdrDetnConf ReSideRdrRiDetn104RdrDetnElevn ReSideRdrRiDetn104RdrDetnPwr ReSideRdrRiDetn104RdrDetnRng ReSideRdrRiDetn104RdrDetnRngV ReSideRdrRiDetn104RdrDetnSts;
SIG_GROUP_ 339 ReSideRdrRiDetn105 1 : ReSideRdrRiDetn105RdrDetnAzi ReSideRdrRiDetn105RdrDetnChks ReSideRdrRiDetn105RdrDetnCntr ReSideRdrRiDetn105RdrDetnConf ReSideRdrRiDetn105RdrDetnElevn ReSideRdrRiDetn105RdrDetnPwr ReSideRdrRiDetn105RdrDetnRng ReSideRdrRiDetn105RdrDetnRngV ReSideRdrRiDetn105RdrDetnSts;
SIG_GROUP_ 339 ReSideRdrRiDetn106 1 : ReSideRdrRiDetn106RdrDetnAzi ReSideRdrRiDetn106RdrDetnChks ReSideRdrRiDetn106RdrDetnCntr ReSideRdrRiDetn106RdrDetnConf ReSideRdrRiDetn106RdrDetnElevn ReSideRdrRiDetn106RdrDetnPwr ReSideRdrRiDetn106RdrDetnRng ReSideRdrRiDetn106RdrDetnRngV ReSideRdrRiDetn106RdrDetnSts;
SIG_GROUP_ 339 ReSideRdrRiDetn107 1 : ReSideRdrRiDetn107RdrDetnAzi ReSideRdrRiDetn107RdrDetnChks ReSideRdrRiDetn107RdrDetnCntr ReSideRdrRiDetn107RdrDetnConf ReSideRdrRiDetn107RdrDetnElevn ReSideRdrRiDetn107RdrDetnPwr ReSideRdrRiDetn107RdrDetnRng ReSideRdrRiDetn107RdrDetnRngV ReSideRdrRiDetn107RdrDetnSts;
SIG_GROUP_ 339 ReSideRdrRiDetn108 1 : ReSideRdrRiDetn108RdrDetnAzi ReSideRdrRiDetn108RdrDetnChks ReSideRdrRiDetn108RdrDetnCntr ReSideRdrRiDetn108RdrDetnConf ReSideRdrRiDetn108RdrDetnElevn ReSideRdrRiDetn108RdrDetnPwr ReSideRdrRiDetn108RdrDetnRng ReSideRdrRiDetn108RdrDetnRngV ReSideRdrRiDetn108RdrDetnSts;
SIG_GROUP_ 341 ReSideRdrRiDetn109 1 : ReSideRdrRiDetn109RdrDetnAzi ReSideRdrRiDetn109RdrDetnChks ReSideRdrRiDetn109RdrDetnCntr ReSideRdrRiDetn109RdrDetnConf ReSideRdrRiDetn109RdrDetnElevn ReSideRdrRiDetn109RdrDetnPwr ReSideRdrRiDetn109RdrDetnRng ReSideRdrRiDetn109RdrDetnRngV ReSideRdrRiDetn109RdrDetnSts;
SIG_GROUP_ 341 ReSideRdrRiDetn110 1 : ReSideRdrRiDetn110RdrDetnAzi ReSideRdrRiDetn110RdrDetnChks ReSideRdrRiDetn110RdrDetnCntr ReSideRdrRiDetn110RdrDetnConf ReSideRdrRiDetn110RdrDetnElevn ReSideRdrRiDetn110RdrDetnPwr ReSideRdrRiDetn110RdrDetnRng ReSideRdrRiDetn110RdrDetnRngV ReSideRdrRiDetn110RdrDetnSts;
SIG_GROUP_ 341 ReSideRdrRiDetn111 1 : ReSideRdrRiDetn111RdrDetnAzi ReSideRdrRiDetn111RdrDetnChks ReSideRdrRiDetn111RdrDetnCntr ReSideRdrRiDetn111RdrDetnConf ReSideRdrRiDetn111RdrDetnElevn ReSideRdrRiDetn111RdrDetnPwr ReSideRdrRiDetn111RdrDetnRng ReSideRdrRiDetn111RdrDetnRngV ReSideRdrRiDetn111RdrDetnSts;
SIG_GROUP_ 341 ReSideRdrRiDetn112 1 : ReSideRdrRiDetn112RdrDetnAzi ReSideRdrRiDetn112RdrDetnChks ReSideRdrRiDetn112RdrDetnCntr ReSideRdrRiDetn112RdrDetnConf ReSideRdrRiDetn112RdrDetnElevn ReSideRdrRiDetn112RdrDetnPwr ReSideRdrRiDetn112RdrDetnRng ReSideRdrRiDetn112RdrDetnRngV ReSideRdrRiDetn112RdrDetnSts;
SIG_GROUP_ 341 ReSideRdrRiDetn113 1 : ReSideRdrRiDetn113RdrDetnAzi ReSideRdrRiDetn113RdrDetnChks ReSideRdrRiDetn113RdrDetnCntr ReSideRdrRiDetn113RdrDetnConf ReSideRdrRiDetn113RdrDetnElevn ReSideRdrRiDetn113RdrDetnPwr ReSideRdrRiDetn113RdrDetnRng ReSideRdrRiDetn113RdrDetnRngV ReSideRdrRiDetn113RdrDetnSts;
SIG_GROUP_ 341 ReSideRdrRiDetn114 1 : ReSideRdrRiDetn114RdrDetnAzi ReSideRdrRiDetn114RdrDetnChks ReSideRdrRiDetn114RdrDetnCntr ReSideRdrRiDetn114RdrDetnConf ReSideRdrRiDetn114RdrDetnElevn ReSideRdrRiDetn114RdrDetnPwr ReSideRdrRiDetn114RdrDetnRng ReSideRdrRiDetn114RdrDetnRngV ReSideRdrRiDetn114RdrDetnSts;
SIG_GROUP_ 343 ReSideRdrRiDetn115 1 : ReSideRdrRiDetn115RdrDetnAzi ReSideRdrRiDetn115RdrDetnChks ReSideRdrRiDetn115RdrDetnCntr ReSideRdrRiDetn115RdrDetnConf ReSideRdrRiDetn115RdrDetnElevn ReSideRdrRiDetn115RdrDetnPwr ReSideRdrRiDetn115RdrDetnRng ReSideRdrRiDetn115RdrDetnRngV ReSideRdrRiDetn115RdrDetnSts;
SIG_GROUP_ 343 ReSideRdrRiDetn116 1 : ReSideRdrRiDetn116RdrDetnAzi ReSideRdrRiDetn116RdrDetnChks ReSideRdrRiDetn116RdrDetnCntr ReSideRdrRiDetn116RdrDetnConf ReSideRdrRiDetn116RdrDetnElevn ReSideRdrRiDetn116RdrDetnPwr ReSideRdrRiDetn116RdrDetnRng ReSideRdrRiDetn116RdrDetnRngV ReSideRdrRiDetn116RdrDetnSts;
SIG_GROUP_ 343 ReSideRdrRiDetn117 1 : ReSideRdrRiDetn117RdrDetnAzi ReSideRdrRiDetn117RdrDetnChks ReSideRdrRiDetn117RdrDetnCntr ReSideRdrRiDetn117RdrDetnConf ReSideRdrRiDetn117RdrDetnElevn ReSideRdrRiDetn117RdrDetnPwr ReSideRdrRiDetn117RdrDetnRng ReSideRdrRiDetn117RdrDetnRngV ReSideRdrRiDetn117RdrDetnSts;
SIG_GROUP_ 343 ReSideRdrRiDetn118 1 : ReSideRdrRiDetn118RdrDetnAzi ReSideRdrRiDetn118RdrDetnChks ReSideRdrRiDetn118RdrDetnCntr ReSideRdrRiDetn118RdrDetnConf ReSideRdrRiDetn118RdrDetnElevn ReSideRdrRiDetn118RdrDetnPwr ReSideRdrRiDetn118RdrDetnRng ReSideRdrRiDetn118RdrDetnRngV ReSideRdrRiDetn118RdrDetnSts;
SIG_GROUP_ 343 ReSideRdrRiDetn119 1 : ReSideRdrRiDetn119RdrDetnAzi ReSideRdrRiDetn119RdrDetnChks ReSideRdrRiDetn119RdrDetnCntr ReSideRdrRiDetn119RdrDetnConf ReSideRdrRiDetn119RdrDetnElevn ReSideRdrRiDetn119RdrDetnPwr ReSideRdrRiDetn119RdrDetnRng ReSideRdrRiDetn119RdrDetnRngV ReSideRdrRiDetn119RdrDetnSts;
SIG_GROUP_ 343 ReSideRdrRiDetn120 1 : ReSideRdrRiDetn120RdrDetnAzi ReSideRdrRiDetn120RdrDetnChks ReSideRdrRiDetn120RdrDetnCntr ReSideRdrRiDetn120RdrDetnConf ReSideRdrRiDetn120RdrDetnElevn ReSideRdrRiDetn120RdrDetnPwr ReSideRdrRiDetn120RdrDetnRng ReSideRdrRiDetn120RdrDetnRngV ReSideRdrRiDetn120RdrDetnSts;
SIG_GROUP_ 345 ReSideRdrRiDetn121 1 : ReSideRdrRiDetn121RdrDetnAzi ReSideRdrRiDetn121RdrDetnChks ReSideRdrRiDetn121RdrDetnCntr ReSideRdrRiDetn121RdrDetnConf ReSideRdrRiDetn121RdrDetnElevn ReSideRdrRiDetn121RdrDetnPwr ReSideRdrRiDetn121RdrDetnRng ReSideRdrRiDetn121RdrDetnRngV ReSideRdrRiDetn121RdrDetnSts;
SIG_GROUP_ 345 ReSideRdrRiDetn122 1 : ReSideRdrRiDetn122RdrDetnAzi ReSideRdrRiDetn122RdrDetnChks ReSideRdrRiDetn122RdrDetnCntr ReSideRdrRiDetn122RdrDetnConf ReSideRdrRiDetn122RdrDetnElevn ReSideRdrRiDetn122RdrDetnPwr ReSideRdrRiDetn122RdrDetnRng ReSideRdrRiDetn122RdrDetnRngV ReSideRdrRiDetn122RdrDetnSts;
SIG_GROUP_ 345 ReSideRdrRiDetn123 1 : ReSideRdrRiDetn123RdrDetnAzi ReSideRdrRiDetn123RdrDetnChks ReSideRdrRiDetn123RdrDetnCntr ReSideRdrRiDetn123RdrDetnConf ReSideRdrRiDetn123RdrDetnElevn ReSideRdrRiDetn123RdrDetnPwr ReSideRdrRiDetn123RdrDetnRng ReSideRdrRiDetn123RdrDetnRngV ReSideRdrRiDetn123RdrDetnSts;
SIG_GROUP_ 345 ReSideRdrRiDetn124 1 : ReSideRdrRiDetn124RdrDetnAzi ReSideRdrRiDetn124RdrDetnChks ReSideRdrRiDetn124RdrDetnCntr ReSideRdrRiDetn124RdrDetnConf ReSideRdrRiDetn124RdrDetnElevn ReSideRdrRiDetn124RdrDetnPwr ReSideRdrRiDetn124RdrDetnRng ReSideRdrRiDetn124RdrDetnRngV ReSideRdrRiDetn124RdrDetnSts;
SIG_GROUP_ 345 ReSideRdrRiDetn125 1 : ReSideRdrRiDetn125RdrDetnAzi ReSideRdrRiDetn125RdrDetnChks ReSideRdrRiDetn125RdrDetnCntr ReSideRdrRiDetn125RdrDetnConf ReSideRdrRiDetn125RdrDetnElevn ReSideRdrRiDetn125RdrDetnPwr ReSideRdrRiDetn125RdrDetnRng ReSideRdrRiDetn125RdrDetnRngV ReSideRdrRiDetn125RdrDetnSts;
SIG_GROUP_ 345 ReSideRdrRiDetn126 1 : ReSideRdrRiDetn126RdrDetnAzi ReSideRdrRiDetn126RdrDetnChks ReSideRdrRiDetn126RdrDetnCntr ReSideRdrRiDetn126RdrDetnConf ReSideRdrRiDetn126RdrDetnElevn ReSideRdrRiDetn126RdrDetnPwr ReSideRdrRiDetn126RdrDetnRng ReSideRdrRiDetn126RdrDetnRngV ReSideRdrRiDetn126RdrDetnSts;
SIG_GROUP_ 347 ReSideRdrRiDetn127 1 : ReSideRdrRiDetn127RdrDetnAzi ReSideRdrRiDetn127RdrDetnChks ReSideRdrRiDetn127RdrDetnCntr ReSideRdrRiDetn127RdrDetnConf ReSideRdrRiDetn127RdrDetnElevn ReSideRdrRiDetn127RdrDetnPwr ReSideRdrRiDetn127RdrDetnRng ReSideRdrRiDetn127RdrDetnRngV ReSideRdrRiDetn127RdrDetnSts;
SIG_GROUP_ 347 ReSideRdrRiDetn128 1 : ReSideRdrRiDetn128RdrDetnAzi ReSideRdrRiDetn128RdrDetnChks ReSideRdrRiDetn128RdrDetnCntr ReSideRdrRiDetn128RdrDetnConf ReSideRdrRiDetn128RdrDetnElevn ReSideRdrRiDetn128RdrDetnPwr ReSideRdrRiDetn128RdrDetnRng ReSideRdrRiDetn128RdrDetnRngV ReSideRdrRiDetn128RdrDetnSts;
SIG_GROUP_ 335 ReSideRdrRiDetn91 1 : ReSideRdrRiDetn91RdrDetnAzi ReSideRdrRiDetn91RdrDetnChks ReSideRdrRiDetn91RdrDetnCntr ReSideRdrRiDetn91RdrDetnConf ReSideRdrRiDetn91RdrDetnElevn ReSideRdrRiDetn91RdrDetnPwr ReSideRdrRiDetn91RdrDetnRng ReSideRdrRiDetn91RdrDetnRngV ReSideRdrRiDetn91RdrDetnSts;
SIG_GROUP_ 335 ReSideRdrRiDetn92 1 : ReSideRdrRiDetn92RdrDetnAzi ReSideRdrRiDetn92RdrDetnChks ReSideRdrRiDetn92RdrDetnCntr ReSideRdrRiDetn92RdrDetnConf ReSideRdrRiDetn92RdrDetnElevn ReSideRdrRiDetn92RdrDetnPwr ReSideRdrRiDetn92RdrDetnRng ReSideRdrRiDetn92RdrDetnRngV ReSideRdrRiDetn92RdrDetnSts;
SIG_GROUP_ 335 ReSideRdrRiDetn93 1 : ReSideRdrRiDetn93RdrDetnAzi ReSideRdrRiDetn93RdrDetnChks ReSideRdrRiDetn93RdrDetnCntr ReSideRdrRiDetn93RdrDetnConf ReSideRdrRiDetn93RdrDetnElevn ReSideRdrRiDetn93RdrDetnPwr ReSideRdrRiDetn93RdrDetnRng ReSideRdrRiDetn93RdrDetnRngV ReSideRdrRiDetn93RdrDetnSts;
SIG_GROUP_ 335 ReSideRdrRiDetn94 1 : ReSideRdrRiDetn94RdrDetnAzi ReSideRdrRiDetn94RdrDetnChks ReSideRdrRiDetn94RdrDetnCntr ReSideRdrRiDetn94RdrDetnConf ReSideRdrRiDetn94RdrDetnElevn ReSideRdrRiDetn94RdrDetnPwr ReSideRdrRiDetn94RdrDetnRng ReSideRdrRiDetn94RdrDetnRngV ReSideRdrRiDetn94RdrDetnSts;
SIG_GROUP_ 335 ReSideRdrRiDetn95 1 : ReSideRdrRiDetn95RdrDetnAzi ReSideRdrRiDetn95RdrDetnChks ReSideRdrRiDetn95RdrDetnCntr ReSideRdrRiDetn95RdrDetnConf ReSideRdrRiDetn95RdrDetnElevn ReSideRdrRiDetn95RdrDetnPwr ReSideRdrRiDetn95RdrDetnRng ReSideRdrRiDetn95RdrDetnRngV ReSideRdrRiDetn95RdrDetnSts;
SIG_GROUP_ 335 ReSideRdrRiDetn96 1 : ReSideRdrRiDetn96RdrDetnAzi ReSideRdrRiDetn96RdrDetnChks ReSideRdrRiDetn96RdrDetnCntr ReSideRdrRiDetn96RdrDetnConf ReSideRdrRiDetn96RdrDetnElevn ReSideRdrRiDetn96RdrDetnPwr ReSideRdrRiDetn96RdrDetnRng ReSideRdrRiDetn96RdrDetnRngV ReSideRdrRiDetn96RdrDetnSts;
SIG_GROUP_ 337 ReSideRdrRiDetn97 1 : ReSideRdrRiDetn97RdrDetnAzi ReSideRdrRiDetn97RdrDetnChks ReSideRdrRiDetn97RdrDetnCntr ReSideRdrRiDetn97RdrDetnConf ReSideRdrRiDetn97RdrDetnElevn ReSideRdrRiDetn97RdrDetnPwr ReSideRdrRiDetn97RdrDetnRng ReSideRdrRiDetn97RdrDetnRngV ReSideRdrRiDetn97RdrDetnSts;
SIG_GROUP_ 337 ReSideRdrRiDetn98 1 : ReSideRdrRiDetn98RdrDetnAzi ReSideRdrRiDetn98RdrDetnChks ReSideRdrRiDetn98RdrDetnCntr ReSideRdrRiDetn98RdrDetnConf ReSideRdrRiDetn98RdrDetnElevn ReSideRdrRiDetn98RdrDetnPwr ReSideRdrRiDetn98RdrDetnRng ReSideRdrRiDetn98RdrDetnRngV ReSideRdrRiDetn98RdrDetnSts;
SIG_GROUP_ 337 ReSideRdrRiDetn99 1 : ReSideRdrRiDetn99RdrDetnAzi ReSideRdrRiDetn99RdrDetnChks ReSideRdrRiDetn99RdrDetnCntr ReSideRdrRiDetn99RdrDetnConf ReSideRdrRiDetn99RdrDetnElevn ReSideRdrRiDetn99RdrDetnPwr ReSideRdrRiDetn99RdrDetnRng ReSideRdrRiDetn99RdrDetnRngV ReSideRdrRiDetn99RdrDetnSts;
SIG_GROUP_ 349 ReSideRdrRiObj1 1 : ReSideRdrRiObj1Heading ReSideRdrRiObj1ObjBoxCenterLat ReSideRdrRiObj1ObjBoxCenterLgt ReSideRdrRiObj1ObservationHist ReSideRdrRiObj1RdrObjAx ReSideRdrRiObj1RdrObjAy ReSideRdrRiObj1RdrObjBoxLength ReSideRdrRiObj1RdrObjBoxWidth ReSideRdrRiObj1RdrObjChks ReSideRdrRiObj1RdrObjCntr ReSideRdrRiObj1RdrObjCoastCnt ReSideRdrRiObj1RdrObjConf ReSideRdrRiObj1RdrObjDx ReSideRdrRiObj1RdrObjDxStdDe ReSideRdrRiObj1RdrObjDy ReSideRdrRiObj1RdrObjDyStdDe ReSideRdrRiObj1RdrObjElevnConf ReSideRdrRiObj1RdrObjElevnSts ReSideRdrRiObj1RdrObjID ReSideRdrRiObj1RdrObjIsInFreeSpace ReSideRdrRiObj1RdrObjMirrProblty ReSideRdrRiObj1RdrObjMtnPat ReSideRdrRiObj1RdrObjNotRealProblty ReSideRdrRiObj1RdrObjStatyCnt ReSideRdrRiObj1RdrObjTiAlv ReSideRdrRiObj1RdrObjTrackSts ReSideRdrRiObj1RdrObjTyp ReSideRdrRiObj1RdrObjTypConfBike ReSideRdrRiObj1RdrObjTypConfPed ReSideRdrRiObj1RdrObjTypConfVeh ReSideRdrRiObj1RdrObjVx ReSideRdrRiObj1RdrObjVxStdDe ReSideRdrRiObj1RdrObjVy ReSideRdrRiObj1RdrObjVyStdDe ReSideRdrRiObj1RelVx ReSideRdrRiObj1RelVy;
SIG_GROUP_ 351 ReSideRdrRiObj2 1 : ReSideRdrRiObj2Heading ReSideRdrRiObj2ObjBoxCenterLat ReSideRdrRiObj2ObjBoxCenterLgt ReSideRdrRiObj2ObservationHist ReSideRdrRiObj2RdrObjAx ReSideRdrRiObj2RdrObjAy ReSideRdrRiObj2RdrObjBoxLength ReSideRdrRiObj2RdrObjBoxWidth ReSideRdrRiObj2RdrObjChks ReSideRdrRiObj2RdrObjCntr ReSideRdrRiObj2RdrObjCoastCnt ReSideRdrRiObj2RdrObjConf ReSideRdrRiObj2RdrObjDx ReSideRdrRiObj2RdrObjDxStdDe ReSideRdrRiObj2RdrObjDy ReSideRdrRiObj2RdrObjDyStdDe ReSideRdrRiObj2RdrObjElevnConf ReSideRdrRiObj2RdrObjElevnSts ReSideRdrRiObj2RdrObjID ReSideRdrRiObj2RdrObjIsInFreeSpace ReSideRdrRiObj2RdrObjMirrProblty ReSideRdrRiObj2RdrObjMtnPat ReSideRdrRiObj2RdrObjNotRealProblty ReSideRdrRiObj2RdrObjStatyCnt ReSideRdrRiObj2RdrObjTiAlv ReSideRdrRiObj2RdrObjTrackSts ReSideRdrRiObj2RdrObjTyp ReSideRdrRiObj2RdrObjTypConfBike ReSideRdrRiObj2RdrObjTypConfPed ReSideRdrRiObj2RdrObjTypConfVeh ReSideRdrRiObj2RdrObjVx ReSideRdrRiObj2RdrObjVxStdDe ReSideRdrRiObj2RdrObjVy ReSideRdrRiObj2RdrObjVyStdDe ReSideRdrRiObj2RelVx ReSideRdrRiObj2RelVy;
SIG_GROUP_ 353 ReSideRdrRiObj3 1 : ReSideRdrRiObj3Heading ReSideRdrRiObj3ObjBoxCenterLat ReSideRdrRiObj3ObjBoxCenterLgt ReSideRdrRiObj3ObservationHist ReSideRdrRiObj3RdrObjAx ReSideRdrRiObj3RdrObjAy ReSideRdrRiObj3RdrObjBoxLength ReSideRdrRiObj3RdrObjBoxWidth ReSideRdrRiObj3RdrObjChks ReSideRdrRiObj3RdrObjCntr ReSideRdrRiObj3RdrObjCoastCnt ReSideRdrRiObj3RdrObjConf ReSideRdrRiObj3RdrObjDx ReSideRdrRiObj3RdrObjDxStdDe ReSideRdrRiObj3RdrObjDy ReSideRdrRiObj3RdrObjDyStdDe ReSideRdrRiObj3RdrObjElevnConf ReSideRdrRiObj3RdrObjElevnSts ReSideRdrRiObj3RdrObjID ReSideRdrRiObj3RdrObjIsInFreeSpace ReSideRdrRiObj3RdrObjMirrProblty ReSideRdrRiObj3RdrObjMtnPat ReSideRdrRiObj3RdrObjNotRealProblty ReSideRdrRiObj3RdrObjStatyCnt ReSideRdrRiObj3RdrObjTiAlv ReSideRdrRiObj3RdrObjTrackSts ReSideRdrRiObj3RdrObjTyp ReSideRdrRiObj3RdrObjTypConfBike ReSideRdrRiObj3RdrObjTypConfPed ReSideRdrRiObj3RdrObjTypConfVeh ReSideRdrRiObj3RdrObjVx ReSideRdrRiObj3RdrObjVxStdDe ReSideRdrRiObj3RdrObjVy ReSideRdrRiObj3RdrObjVyStdDe ReSideRdrRiObj3RelVx ReSideRdrRiObj3RelVy;
