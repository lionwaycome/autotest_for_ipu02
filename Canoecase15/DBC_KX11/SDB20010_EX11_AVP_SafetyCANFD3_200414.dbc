// *************************************************************************** *
// *                                                                           *
// *                      Mentor Graphics Corporation                          *
// *                          All rights reserved                              *
// *                                                                           *
// *************************************************************************** *
// *                                                                           *
// * Description:         CANDB File                                           *
// * Generated at:        2020-04-14 13:14:03                                  *
// * System:              SDB20010                                             *
// * Variant:             EX11_AVP                                             *
// * Network:             SafetyCANFD3                                         *
// *                                                                           *
// *************************************************************************** *
// *                                                                           *
// *             THIS CONFIGURATION MIGHT CONTAIN SOME ERRORS                  *
// *              IF THE INPUT MODEL WAS NOT PROPERLY FORMED!                  *
// *                    Do Not Use this File directly!                         *
// *                                                                           *
// *************************************************************************** *
VERSION "SafetyCANFD3"

NS_ :

BS_:

BU_:  ASDM ETC PAS SODL SODR

BO_ 316 SODLSafetyCANFD3Frame07: 64 SODL
 SG_ ReSideRdrLeDetn37_UB : 74|1@0+ (1,0) [0|1] "" ASDM,PAS
 SG_ ReSideRdrLeDetn37RdrDetnAzi : 31|11@0+ (0.1,-90.0) [-90.0|90.0] "Deg" ASDM,PAS
 SG_ ReSideRdrLeDetn37RdrDetnChks : 7|8@0+ (1.0,0.0) [0.0|255.0] "Unitless" ASDM,PAS
 SG_ ReSideRdrLeDetn37RdrDetnCntr : 15|4@0+ (1.0,0.0) [0.0|15.0] "Unitless" ASDM,PAS
 SG_ ReSideRdrLeDetn37RdrDetnConf : 71|7@0+ (1.0,0.0) [0.0|100.0] "%" ASDM,PAS
 SG_ ReSideRdrLeDetn37RdrDetnElevn : 79|5@0+ (1.0,-15.0) [-15.0|15.0] "Deg" ASDM,PAS
 SG_ ReSideRdrLeDetn37RdrDetnPwr : 8|9@0+ (0.1,0.0) [0.0|51.1] "dB" ASDM,PAS
 SG_ ReSideRdrLeDetn37RdrDetnRng : 55|14@0+ (0.02,-1.0) [-1.0|200.0] "m" ASDM,PAS
 SG_ ReSideRdrLeDetn37RdrDetnRngV : 36|13@0+ (0.02,-80.0) [-80.0|80.0] "m/s" ASDM,PAS
 SG_ ReSideRdrLeDetn37RdrDetnSts : 11|2@0+ (1,0) [0|3] "" ASDM,PAS
 SG_ ReSideRdrLeDetn38_UB : 154|1@0+ (1,0) [0|1] "" ASDM,PAS
 SG_ ReSideRdrLeDetn38RdrDetnAzi : 119|11@0+ (0.1,-90.0) [-90.0|90.0] "Deg" ASDM,PAS
 SG_ ReSideRdrLeDetn38RdrDetnChks : 87|8@0+ (1.0,0.0) [0.0|255.0] "Unitless" ASDM,PAS
 SG_ ReSideRdrLeDetn38RdrDetnCntr : 95|4@0+ (1.0,0.0) [0.0|15.0] "Unitless" ASDM,PAS
 SG_ ReSideRdrLeDetn38RdrDetnConf : 111|7@0+ (1.0,0.0) [0.0|100.0] "%" ASDM,PAS
 SG_ ReSideRdrLeDetn38RdrDetnElevn : 159|5@0+ (1.0,-15.0) [-15.0|15.0] "Deg" ASDM,PAS
 SG_ ReSideRdrLeDetn38RdrDetnPwr : 89|9@0+ (0.1,0.0) [0.0|51.1] "dB" ASDM,PAS
 SG_ ReSideRdrLeDetn38RdrDetnRng : 143|14@0+ (0.02,-1.0) [-1.0|200.0] "m" ASDM,PAS
 SG_ ReSideRdrLeDetn38RdrDetnRngV : 124|13@0+ (0.02,-80.0) [-80.0|80.0] "m/s" ASDM,PAS
 SG_ ReSideRdrLeDetn38RdrDetnSts : 91|2@0+ (1,0) [0|3] "" ASDM,PAS
 SG_ ReSideRdrLeDetn39_UB : 234|1@0+ (1,0) [0|1] "" ASDM,PAS
 SG_ ReSideRdrLeDetn39RdrDetnAzi : 199|11@0+ (0.1,-90.0) [-90.0|90.0] "Deg" ASDM,PAS
 SG_ ReSideRdrLeDetn39RdrDetnChks : 167|8@0+ (1.0,0.0) [0.0|255.0] "Unitless" ASDM,PAS
 SG_ ReSideRdrLeDetn39RdrDetnCntr : 175|4@0+ (1.0,0.0) [0.0|15.0] "Unitless" ASDM,PAS
 SG_ ReSideRdrLeDetn39RdrDetnConf : 191|7@0+ (1.0,0.0) [0.0|100.0] "%" ASDM,PAS
 SG_ ReSideRdrLeDetn39RdrDetnElevn : 239|5@0+ (1.0,-15.0) [-15.0|15.0] "Deg" ASDM,PAS
 SG_ ReSideRdrLeDetn39RdrDetnPwr : 169|9@0+ (0.1,0.0) [0.0|51.1] "dB" ASDM,PAS
 SG_ ReSideRdrLeDetn39RdrDetnRng : 223|14@0+ (0.02,-1.0) [-1.0|200.0] "m" ASDM,PAS
 SG_ ReSideRdrLeDetn39RdrDetnRngV : 204|13@0+ (0.02,-80.0) [-80.0|80.0] "m/s" ASDM,PAS
 SG_ ReSideRdrLeDetn39RdrDetnSts : 171|2@0+ (1,0) [0|3] "" ASDM,PAS
 SG_ ReSideRdrLeDetn40_UB : 314|1@0+ (1,0) [0|1] "" ASDM,PAS
 SG_ ReSideRdrLeDetn40RdrDetnAzi : 287|11@0+ (0.1,-90.0) [-90.0|90.0] "Deg" ASDM,PAS
 SG_ ReSideRdrLeDetn40RdrDetnChks : 247|8@0+ (1.0,0.0) [0.0|255.0] "Unitless" ASDM,PAS
 SG_ ReSideRdrLeDetn40RdrDetnCntr : 255|4@0+ (1.0,0.0) [0.0|15.0] "Unitless" ASDM,PAS
 SG_ ReSideRdrLeDetn40RdrDetnConf : 311|7@0+ (1.0,0.0) [0.0|100.0] "%" ASDM,PAS
 SG_ ReSideRdrLeDetn40RdrDetnElevn : 319|5@0+ (1.0,-15.0) [-15.0|15.0] "Deg" ASDM,PAS
 SG_ ReSideRdrLeDetn40RdrDetnPwr : 249|9@0+ (0.1,0.0) [0.0|51.1] "dB" ASDM,PAS
 SG_ ReSideRdrLeDetn40RdrDetnRng : 271|14@0+ (0.02,-1.0) [-1.0|200.0] "m" ASDM,PAS
 SG_ ReSideRdrLeDetn40RdrDetnRngV : 292|13@0+ (0.02,-80.0) [-80.0|80.0] "m/s" ASDM,PAS
 SG_ ReSideRdrLeDetn40RdrDetnSts : 251|2@0+ (1,0) [0|3] "" ASDM,PAS
 SG_ ReSideRdrLeDetn41_UB : 394|1@0+ (1,0) [0|1] "" ASDM,PAS
 SG_ ReSideRdrLeDetn41RdrDetnAzi : 351|11@0+ (0.1,-90.0) [-90.0|90.0] "Deg" ASDM,PAS
 SG_ ReSideRdrLeDetn41RdrDetnChks : 327|8@0+ (1.0,0.0) [0.0|255.0] "Unitless" ASDM,PAS
 SG_ ReSideRdrLeDetn41RdrDetnCntr : 335|4@0+ (1.0,0.0) [0.0|15.0] "Unitless" ASDM,PAS
 SG_ ReSideRdrLeDetn41RdrDetnConf : 391|7@0+ (1.0,0.0) [0.0|100.0] "%" ASDM,PAS
 SG_ ReSideRdrLeDetn41RdrDetnElevn : 399|5@0+ (1.0,-15.0) [-15.0|15.0] "Deg" ASDM,PAS
 SG_ ReSideRdrLeDetn41RdrDetnPwr : 329|9@0+ (0.1,0.0) [0.0|51.1] "dB" ASDM,PAS
 SG_ ReSideRdrLeDetn41RdrDetnRng : 375|14@0+ (0.02,-1.0) [-1.0|200.0] "m" ASDM,PAS
 SG_ ReSideRdrLeDetn41RdrDetnRngV : 356|13@0+ (0.02,-80.0) [-80.0|80.0] "m/s" ASDM,PAS
 SG_ ReSideRdrLeDetn41RdrDetnSts : 331|2@0+ (1,0) [0|3] "" ASDM,PAS
 SG_ ReSideRdrLeDetn42_UB : 474|1@0+ (1,0) [0|1] "" ASDM,PAS
 SG_ ReSideRdrLeDetn42RdrDetnAzi : 447|11@0+ (0.1,-90.0) [-90.0|90.0] "Deg" ASDM,PAS
 SG_ ReSideRdrLeDetn42RdrDetnChks : 407|8@0+ (1.0,0.0) [0.0|255.0] "Unitless" ASDM,PAS
 SG_ ReSideRdrLeDetn42RdrDetnCntr : 415|4@0+ (1.0,0.0) [0.0|15.0] "Unitless" ASDM,PAS
 SG_ ReSideRdrLeDetn42RdrDetnConf : 471|7@0+ (1.0,0.0) [0.0|100.0] "%" ASDM,PAS
 SG_ ReSideRdrLeDetn42RdrDetnElevn : 479|5@0+ (1.0,-15.0) [-15.0|15.0] "Deg" ASDM,PAS
 SG_ ReSideRdrLeDetn42RdrDetnPwr : 409|9@0+ (0.1,0.0) [0.0|51.1] "dB" ASDM,PAS
 SG_ ReSideRdrLeDetn42RdrDetnRng : 431|14@0+ (0.02,-1.0) [-1.0|200.0] "m" ASDM,PAS
 SG_ ReSideRdrLeDetn42RdrDetnRngV : 452|13@0+ (0.02,-80.0) [-80.0|80.0] "m/s" ASDM,PAS
 SG_ ReSideRdrLeDetn42RdrDetnSts : 411|2@0+ (1,0) [0|3] "" ASDM,PAS

BO_ 318 SODLSafetyCANFD3Frame08: 64 SODL
 SG_ ReSideRdrLeDetn43_UB : 74|1@0+ (1,0) [0|1] "" ASDM,PAS
 SG_ ReSideRdrLeDetn43RdrDetnAzi : 31|11@0+ (0.1,-90.0) [-90.0|90.0] "Deg" ASDM,PAS
 SG_ ReSideRdrLeDetn43RdrDetnChks : 7|8@0+ (1.0,0.0) [0.0|255.0] "Unitless" ASDM,PAS
 SG_ ReSideRdrLeDetn43RdrDetnCntr : 15|4@0+ (1.0,0.0) [0.0|15.0] "Unitless" ASDM,PAS
 SG_ ReSideRdrLeDetn43RdrDetnConf : 71|7@0+ (1.0,0.0) [0.0|100.0] "%" ASDM,PAS
 SG_ ReSideRdrLeDetn43RdrDetnElevn : 79|5@0+ (1.0,-15.0) [-15.0|15.0] "Deg" ASDM,PAS
 SG_ ReSideRdrLeDetn43RdrDetnPwr : 8|9@0+ (0.1,0.0) [0.0|51.1] "dB" ASDM,PAS
 SG_ ReSideRdrLeDetn43RdrDetnRng : 55|14@0+ (0.02,-1.0) [-1.0|200.0] "m" ASDM,PAS
 SG_ ReSideRdrLeDetn43RdrDetnRngV : 36|13@0+ (0.02,-80.0) [-80.0|80.0] "m/s" ASDM,PAS
 SG_ ReSideRdrLeDetn43RdrDetnSts : 11|2@0+ (1,0) [0|3] "" ASDM,PAS
 SG_ ReSideRdrLeDetn44_UB : 154|1@0+ (1,0) [0|1] "" ASDM,PAS
 SG_ ReSideRdrLeDetn44RdrDetnAzi : 119|11@0+ (0.1,-90.0) [-90.0|90.0] "Deg" ASDM,PAS
 SG_ ReSideRdrLeDetn44RdrDetnChks : 87|8@0+ (1.0,0.0) [0.0|255.0] "Unitless" ASDM,PAS
 SG_ ReSideRdrLeDetn44RdrDetnCntr : 95|4@0+ (1.0,0.0) [0.0|15.0] "Unitless" ASDM,PAS
 SG_ ReSideRdrLeDetn44RdrDetnConf : 111|7@0+ (1.0,0.0) [0.0|100.0] "%" ASDM,PAS
 SG_ ReSideRdrLeDetn44RdrDetnElevn : 159|5@0+ (1.0,-15.0) [-15.0|15.0] "Deg" ASDM,PAS
 SG_ ReSideRdrLeDetn44RdrDetnPwr : 89|9@0+ (0.1,0.0) [0.0|51.1] "dB" ASDM,PAS
 SG_ ReSideRdrLeDetn44RdrDetnRng : 143|14@0+ (0.02,-1.0) [-1.0|200.0] "m" ASDM,PAS
 SG_ ReSideRdrLeDetn44RdrDetnRngV : 124|13@0+ (0.02,-80.0) [-80.0|80.0] "m/s" ASDM,PAS
 SG_ ReSideRdrLeDetn44RdrDetnSts : 91|2@0+ (1,0) [0|3] "" ASDM,PAS
 SG_ ReSideRdrLeDetn45_UB : 234|1@0+ (1,0) [0|1] "" ASDM,PAS
 SG_ ReSideRdrLeDetn45RdrDetnAzi : 199|11@0+ (0.1,-90.0) [-90.0|90.0] "Deg" ASDM,PAS
 SG_ ReSideRdrLeDetn45RdrDetnChks : 167|8@0+ (1.0,0.0) [0.0|255.0] "Unitless" ASDM,PAS
 SG_ ReSideRdrLeDetn45RdrDetnCntr : 175|4@0+ (1.0,0.0) [0.0|15.0] "Unitless" ASDM,PAS
 SG_ ReSideRdrLeDetn45RdrDetnConf : 191|7@0+ (1.0,0.0) [0.0|100.0] "%" ASDM,PAS
 SG_ ReSideRdrLeDetn45RdrDetnElevn : 239|5@0+ (1.0,-15.0) [-15.0|15.0] "Deg" ASDM,PAS
 SG_ ReSideRdrLeDetn45RdrDetnPwr : 169|9@0+ (0.1,0.0) [0.0|51.1] "dB" ASDM,PAS
 SG_ ReSideRdrLeDetn45RdrDetnRng : 223|14@0+ (0.02,-1.0) [-1.0|200.0] "m" ASDM,PAS
 SG_ ReSideRdrLeDetn45RdrDetnRngV : 204|13@0+ (0.02,-80.0) [-80.0|80.0] "m/s" ASDM,PAS
 SG_ ReSideRdrLeDetn45RdrDetnSts : 171|2@0+ (1,0) [0|3] "" ASDM,PAS
 SG_ ReSideRdrLeDetn46_UB : 314|1@0+ (1,0) [0|1] "" ASDM,PAS
 SG_ ReSideRdrLeDetn46RdrDetnAzi : 287|11@0+ (0.1,-90.0) [-90.0|90.0] "Deg" ASDM,PAS
 SG_ ReSideRdrLeDetn46RdrDetnChks : 247|8@0+ (1.0,0.0) [0.0|255.0] "Unitless" ASDM,PAS
 SG_ ReSideRdrLeDetn46RdrDetnCntr : 255|4@0+ (1.0,0.0) [0.0|15.0] "Unitless" ASDM,PAS
 SG_ ReSideRdrLeDetn46RdrDetnConf : 311|7@0+ (1.0,0.0) [0.0|100.0] "%" ASDM,PAS
 SG_ ReSideRdrLeDetn46RdrDetnElevn : 319|5@0+ (1.0,-15.0) [-15.0|15.0] "Deg" ASDM,PAS
 SG_ ReSideRdrLeDetn46RdrDetnPwr : 249|9@0+ (0.1,0.0) [0.0|51.1] "dB" ASDM,PAS
 SG_ ReSideRdrLeDetn46RdrDetnRng : 271|14@0+ (0.02,-1.0) [-1.0|200.0] "m" ASDM,PAS
 SG_ ReSideRdrLeDetn46RdrDetnRngV : 292|13@0+ (0.02,-80.0) [-80.0|80.0] "m/s" ASDM,PAS
 SG_ ReSideRdrLeDetn46RdrDetnSts : 251|2@0+ (1,0) [0|3] "" ASDM,PAS
 SG_ ReSideRdrLeDetn47_UB : 394|1@0+ (1,0) [0|1] "" ASDM,PAS
 SG_ ReSideRdrLeDetn47RdrDetnAzi : 351|11@0+ (0.1,-90.0) [-90.0|90.0] "Deg" ASDM,PAS
 SG_ ReSideRdrLeDetn47RdrDetnChks : 327|8@0+ (1.0,0.0) [0.0|255.0] "Unitless" ASDM,PAS
 SG_ ReSideRdrLeDetn47RdrDetnCntr : 335|4@0+ (1.0,0.0) [0.0|15.0] "Unitless" ASDM,PAS
 SG_ ReSideRdrLeDetn47RdrDetnConf : 391|7@0+ (1.0,0.0) [0.0|100.0] "%" ASDM,PAS
 SG_ ReSideRdrLeDetn47RdrDetnElevn : 399|5@0+ (1.0,-15.0) [-15.0|15.0] "Deg" ASDM,PAS
 SG_ ReSideRdrLeDetn47RdrDetnPwr : 329|9@0+ (0.1,0.0) [0.0|51.1] "dB" ASDM,PAS
 SG_ ReSideRdrLeDetn47RdrDetnRng : 375|14@0+ (0.02,-1.0) [-1.0|200.0] "m" ASDM,PAS
 SG_ ReSideRdrLeDetn47RdrDetnRngV : 356|13@0+ (0.02,-80.0) [-80.0|80.0] "m/s" ASDM,PAS
 SG_ ReSideRdrLeDetn47RdrDetnSts : 331|2@0+ (1,0) [0|3] "" ASDM,PAS
 SG_ ReSideRdrLeDetn48_UB : 474|1@0+ (1,0) [0|1] "" ASDM,PAS
 SG_ ReSideRdrLeDetn48RdrDetnAzi : 447|11@0+ (0.1,-90.0) [-90.0|90.0] "Deg" ASDM,PAS
 SG_ ReSideRdrLeDetn48RdrDetnChks : 407|8@0+ (1.0,0.0) [0.0|255.0] "Unitless" ASDM,PAS
 SG_ ReSideRdrLeDetn48RdrDetnCntr : 415|4@0+ (1.0,0.0) [0.0|15.0] "Unitless" ASDM,PAS
 SG_ ReSideRdrLeDetn48RdrDetnConf : 471|7@0+ (1.0,0.0) [0.0|100.0] "%" ASDM,PAS
 SG_ ReSideRdrLeDetn48RdrDetnElevn : 479|5@0+ (1.0,-15.0) [-15.0|15.0] "Deg" ASDM,PAS
 SG_ ReSideRdrLeDetn48RdrDetnPwr : 409|9@0+ (0.1,0.0) [0.0|51.1] "dB" ASDM,PAS
 SG_ ReSideRdrLeDetn48RdrDetnRng : 431|14@0+ (0.02,-1.0) [-1.0|200.0] "m" ASDM,PAS
 SG_ ReSideRdrLeDetn48RdrDetnRngV : 452|13@0+ (0.02,-80.0) [-80.0|80.0] "m/s" ASDM,PAS
 SG_ ReSideRdrLeDetn48RdrDetnSts : 411|2@0+ (1,0) [0|3] "" ASDM,PAS

BO_ 320 SODLSafetyCANFD3Frame09: 64 SODL
 SG_ ReSideRdrLeDetn49_UB : 74|1@0+ (1,0) [0|1] "" ASDM,PAS
 SG_ ReSideRdrLeDetn49RdrDetnAzi : 31|11@0+ (0.1,-90.0) [-90.0|90.0] "Deg" ASDM,PAS
 SG_ ReSideRdrLeDetn49RdrDetnChks : 7|8@0+ (1.0,0.0) [0.0|255.0] "Unitless" ASDM,PAS
 SG_ ReSideRdrLeDetn49RdrDetnCntr : 15|4@0+ (1.0,0.0) [0.0|15.0] "Unitless" ASDM,PAS
 SG_ ReSideRdrLeDetn49RdrDetnConf : 71|7@0+ (1.0,0.0) [0.0|100.0] "%" ASDM,PAS
 SG_ ReSideRdrLeDetn49RdrDetnElevn : 79|5@0+ (1.0,-15.0) [-15.0|15.0] "Deg" ASDM,PAS
 SG_ ReSideRdrLeDetn49RdrDetnPwr : 8|9@0+ (0.1,0.0) [0.0|51.1] "dB" ASDM,PAS
 SG_ ReSideRdrLeDetn49RdrDetnRng : 55|14@0+ (0.02,-1.0) [-1.0|200.0] "m" ASDM,PAS
 SG_ ReSideRdrLeDetn49RdrDetnRngV : 36|13@0+ (0.02,-80.0) [-80.0|80.0] "m/s" ASDM,PAS
 SG_ ReSideRdrLeDetn49RdrDetnSts : 11|2@0+ (1,0) [0|3] "" ASDM,PAS
 SG_ ReSideRdrLeDetn50_UB : 154|1@0+ (1,0) [0|1] "" ASDM,PAS
 SG_ ReSideRdrLeDetn50RdrDetnAzi : 119|11@0+ (0.1,-90.0) [-90.0|90.0] "Deg" ASDM,PAS
 SG_ ReSideRdrLeDetn50RdrDetnChks : 87|8@0+ (1.0,0.0) [0.0|255.0] "Unitless" ASDM,PAS
 SG_ ReSideRdrLeDetn50RdrDetnCntr : 95|4@0+ (1.0,0.0) [0.0|15.0] "Unitless" ASDM,PAS
 SG_ ReSideRdrLeDetn50RdrDetnConf : 111|7@0+ (1.0,0.0) [0.0|100.0] "%" ASDM,PAS
 SG_ ReSideRdrLeDetn50RdrDetnElevn : 159|5@0+ (1.0,-15.0) [-15.0|15.0] "Deg" ASDM,PAS
 SG_ ReSideRdrLeDetn50RdrDetnPwr : 89|9@0+ (0.1,0.0) [0.0|51.1] "dB" ASDM,PAS
 SG_ ReSideRdrLeDetn50RdrDetnRng : 143|14@0+ (0.02,-1.0) [-1.0|200.0] "m" ASDM,PAS
 SG_ ReSideRdrLeDetn50RdrDetnRngV : 124|13@0+ (0.02,-80.0) [-80.0|80.0] "m/s" ASDM,PAS
 SG_ ReSideRdrLeDetn50RdrDetnSts : 91|2@0+ (1,0) [0|3] "" ASDM,PAS
 SG_ ReSideRdrLeDetn51_UB : 234|1@0+ (1,0) [0|1] "" ASDM,PAS
 SG_ ReSideRdrLeDetn51RdrDetnAzi : 199|11@0+ (0.1,-90.0) [-90.0|90.0] "Deg" ASDM,PAS
 SG_ ReSideRdrLeDetn51RdrDetnChks : 167|8@0+ (1.0,0.0) [0.0|255.0] "Unitless" ASDM,PAS
 SG_ ReSideRdrLeDetn51RdrDetnCntr : 175|4@0+ (1.0,0.0) [0.0|15.0] "Unitless" ASDM,PAS
 SG_ ReSideRdrLeDetn51RdrDetnConf : 191|7@0+ (1.0,0.0) [0.0|100.0] "%" ASDM,PAS
 SG_ ReSideRdrLeDetn51RdrDetnElevn : 239|5@0+ (1.0,-15.0) [-15.0|15.0] "Deg" ASDM,PAS
 SG_ ReSideRdrLeDetn51RdrDetnPwr : 169|9@0+ (0.1,0.0) [0.0|51.1] "dB" ASDM,PAS
 SG_ ReSideRdrLeDetn51RdrDetnRng : 223|14@0+ (0.02,-1.0) [-1.0|200.0] "m" ASDM,PAS
 SG_ ReSideRdrLeDetn51RdrDetnRngV : 204|13@0+ (0.02,-80.0) [-80.0|80.0] "m/s" ASDM,PAS
 SG_ ReSideRdrLeDetn51RdrDetnSts : 171|2@0+ (1,0) [0|3] "" ASDM,PAS
 SG_ ReSideRdrLeDetn52_UB : 314|1@0+ (1,0) [0|1] "" ASDM,PAS
 SG_ ReSideRdrLeDetn52RdrDetnAzi : 287|11@0+ (0.1,-90.0) [-90.0|90.0] "Deg" ASDM,PAS
 SG_ ReSideRdrLeDetn52RdrDetnChks : 247|8@0+ (1.0,0.0) [0.0|255.0] "Unitless" ASDM,PAS
 SG_ ReSideRdrLeDetn52RdrDetnCntr : 255|4@0+ (1.0,0.0) [0.0|15.0] "Unitless" ASDM,PAS
 SG_ ReSideRdrLeDetn52RdrDetnConf : 311|7@0+ (1.0,0.0) [0.0|100.0] "%" ASDM,PAS
 SG_ ReSideRdrLeDetn52RdrDetnElevn : 319|5@0+ (1.0,-15.0) [-15.0|15.0] "Deg" ASDM,PAS
 SG_ ReSideRdrLeDetn52RdrDetnPwr : 249|9@0+ (0.1,0.0) [0.0|51.1] "dB" ASDM,PAS
 SG_ ReSideRdrLeDetn52RdrDetnRng : 271|14@0+ (0.02,-1.0) [-1.0|200.0] "m" ASDM,PAS
 SG_ ReSideRdrLeDetn52RdrDetnRngV : 292|13@0+ (0.02,-80.0) [-80.0|80.0] "m/s" ASDM,PAS
 SG_ ReSideRdrLeDetn52RdrDetnSts : 251|2@0+ (1,0) [0|3] "" ASDM,PAS
 SG_ ReSideRdrLeDetn53_UB : 394|1@0+ (1,0) [0|1] "" ASDM,PAS
 SG_ ReSideRdrLeDetn53RdrDetnAzi : 351|11@0+ (0.1,-90.0) [-90.0|90.0] "Deg" ASDM,PAS
 SG_ ReSideRdrLeDetn53RdrDetnChks : 327|8@0+ (1.0,0.0) [0.0|255.0] "Unitless" ASDM,PAS
 SG_ ReSideRdrLeDetn53RdrDetnCntr : 335|4@0+ (1.0,0.0) [0.0|15.0] "Unitless" ASDM,PAS
 SG_ ReSideRdrLeDetn53RdrDetnConf : 391|7@0+ (1.0,0.0) [0.0|100.0] "%" ASDM,PAS
 SG_ ReSideRdrLeDetn53RdrDetnElevn : 399|5@0+ (1.0,-15.0) [-15.0|15.0] "Deg" ASDM,PAS
 SG_ ReSideRdrLeDetn53RdrDetnPwr : 329|9@0+ (0.1,0.0) [0.0|51.1] "dB" ASDM,PAS
 SG_ ReSideRdrLeDetn53RdrDetnRng : 375|14@0+ (0.02,-1.0) [-1.0|200.0] "m" ASDM,PAS
 SG_ ReSideRdrLeDetn53RdrDetnRngV : 356|13@0+ (0.02,-80.0) [-80.0|80.0] "m/s" ASDM,PAS
 SG_ ReSideRdrLeDetn53RdrDetnSts : 331|2@0+ (1,0) [0|3] "" ASDM,PAS
 SG_ ReSideRdrLeDetn54_UB : 474|1@0+ (1,0) [0|1] "" ASDM,PAS
 SG_ ReSideRdrLeDetn54RdrDetnAzi : 447|11@0+ (0.1,-90.0) [-90.0|90.0] "Deg" ASDM,PAS
 SG_ ReSideRdrLeDetn54RdrDetnChks : 407|8@0+ (1.0,0.0) [0.0|255.0] "Unitless" ASDM,PAS
 SG_ ReSideRdrLeDetn54RdrDetnCntr : 415|4@0+ (1.0,0.0) [0.0|15.0] "Unitless" ASDM,PAS
 SG_ ReSideRdrLeDetn54RdrDetnConf : 471|7@0+ (1.0,0.0) [0.0|100.0] "%" ASDM,PAS
 SG_ ReSideRdrLeDetn54RdrDetnElevn : 479|5@0+ (1.0,-15.0) [-15.0|15.0] "Deg" ASDM,PAS
 SG_ ReSideRdrLeDetn54RdrDetnPwr : 409|9@0+ (0.1,0.0) [0.0|51.1] "dB" ASDM,PAS
 SG_ ReSideRdrLeDetn54RdrDetnRng : 431|14@0+ (0.02,-1.0) [-1.0|200.0] "m" ASDM,PAS
 SG_ ReSideRdrLeDetn54RdrDetnRngV : 452|13@0+ (0.02,-80.0) [-80.0|80.0] "m/s" ASDM,PAS
 SG_ ReSideRdrLeDetn54RdrDetnSts : 411|2@0+ (1,0) [0|3] "" ASDM,PAS

BO_ 322 SODLSafetyCANFD3Frame10: 64 SODL
 SG_ ReSideRdrLeDetn55_UB : 74|1@0+ (1,0) [0|1] "" ASDM,PAS
 SG_ ReSideRdrLeDetn55RdrDetnAzi : 31|11@0+ (0.1,-90.0) [-90.0|90.0] "Deg" ASDM,PAS
 SG_ ReSideRdrLeDetn55RdrDetnChks : 7|8@0+ (1.0,0.0) [0.0|255.0] "Unitless" ASDM,PAS
 SG_ ReSideRdrLeDetn55RdrDetnCntr : 15|4@0+ (1.0,0.0) [0.0|15.0] "Unitless" ASDM,PAS
 SG_ ReSideRdrLeDetn55RdrDetnConf : 71|7@0+ (1.0,0.0) [0.0|100.0] "%" ASDM,PAS
 SG_ ReSideRdrLeDetn55RdrDetnElevn : 79|5@0+ (1.0,-15.0) [-15.0|15.0] "Deg" ASDM,PAS
 SG_ ReSideRdrLeDetn55RdrDetnPwr : 8|9@0+ (0.1,0.0) [0.0|51.1] "dB" ASDM,PAS
 SG_ ReSideRdrLeDetn55RdrDetnRng : 55|14@0+ (0.02,-1.0) [-1.0|200.0] "m" ASDM,PAS
 SG_ ReSideRdrLeDetn55RdrDetnRngV : 36|13@0+ (0.02,-80.0) [-80.0|80.0] "m/s" ASDM,PAS
 SG_ ReSideRdrLeDetn55RdrDetnSts : 11|2@0+ (1,0) [0|3] "" ASDM,PAS
 SG_ ReSideRdrLeDetn56_UB : 154|1@0+ (1,0) [0|1] "" ASDM,PAS
 SG_ ReSideRdrLeDetn56RdrDetnAzi : 119|11@0+ (0.1,-90.0) [-90.0|90.0] "Deg" ASDM,PAS
 SG_ ReSideRdrLeDetn56RdrDetnChks : 87|8@0+ (1.0,0.0) [0.0|255.0] "Unitless" ASDM,PAS
 SG_ ReSideRdrLeDetn56RdrDetnCntr : 95|4@0+ (1.0,0.0) [0.0|15.0] "Unitless" ASDM,PAS
 SG_ ReSideRdrLeDetn56RdrDetnConf : 111|7@0+ (1.0,0.0) [0.0|100.0] "%" ASDM,PAS
 SG_ ReSideRdrLeDetn56RdrDetnElevn : 159|5@0+ (1.0,-15.0) [-15.0|15.0] "Deg" ASDM,PAS
 SG_ ReSideRdrLeDetn56RdrDetnPwr : 89|9@0+ (0.1,0.0) [0.0|51.1] "dB" ASDM,PAS
 SG_ ReSideRdrLeDetn56RdrDetnRng : 143|14@0+ (0.02,-1.0) [-1.0|200.0] "m" ASDM,PAS
 SG_ ReSideRdrLeDetn56RdrDetnRngV : 124|13@0+ (0.02,-80.0) [-80.0|80.0] "m/s" ASDM,PAS
 SG_ ReSideRdrLeDetn56RdrDetnSts : 91|2@0+ (1,0) [0|3] "" ASDM,PAS
 SG_ ReSideRdrLeDetn57_UB : 234|1@0+ (1,0) [0|1] "" ASDM,PAS
 SG_ ReSideRdrLeDetn57RdrDetnAzi : 199|11@0+ (0.1,-90.0) [-90.0|90.0] "Deg" ASDM,PAS
 SG_ ReSideRdrLeDetn57RdrDetnChks : 167|8@0+ (1.0,0.0) [0.0|255.0] "Unitless" ASDM,PAS
 SG_ ReSideRdrLeDetn57RdrDetnCntr : 175|4@0+ (1.0,0.0) [0.0|15.0] "Unitless" ASDM,PAS
 SG_ ReSideRdrLeDetn57RdrDetnConf : 191|7@0+ (1.0,0.0) [0.0|100.0] "%" ASDM,PAS
 SG_ ReSideRdrLeDetn57RdrDetnElevn : 239|5@0+ (1.0,-15.0) [-15.0|15.0] "Deg" ASDM,PAS
 SG_ ReSideRdrLeDetn57RdrDetnPwr : 169|9@0+ (0.1,0.0) [0.0|51.1] "dB" ASDM,PAS
 SG_ ReSideRdrLeDetn57RdrDetnRng : 223|14@0+ (0.02,-1.0) [-1.0|200.0] "m" ASDM,PAS
 SG_ ReSideRdrLeDetn57RdrDetnRngV : 204|13@0+ (0.02,-80.0) [-80.0|80.0] "m/s" ASDM,PAS
 SG_ ReSideRdrLeDetn57RdrDetnSts : 171|2@0+ (1,0) [0|3] "" ASDM,PAS
 SG_ ReSideRdrLeDetn58_UB : 314|1@0+ (1,0) [0|1] "" ASDM,PAS
 SG_ ReSideRdrLeDetn58RdrDetnAzi : 287|11@0+ (0.1,-90.0) [-90.0|90.0] "Deg" ASDM,PAS
 SG_ ReSideRdrLeDetn58RdrDetnChks : 247|8@0+ (1.0,0.0) [0.0|255.0] "Unitless" ASDM,PAS
 SG_ ReSideRdrLeDetn58RdrDetnCntr : 255|4@0+ (1.0,0.0) [0.0|15.0] "Unitless" ASDM,PAS
 SG_ ReSideRdrLeDetn58RdrDetnConf : 311|7@0+ (1.0,0.0) [0.0|100.0] "%" ASDM,PAS
 SG_ ReSideRdrLeDetn58RdrDetnElevn : 319|5@0+ (1.0,-15.0) [-15.0|15.0] "Deg" ASDM,PAS
 SG_ ReSideRdrLeDetn58RdrDetnPwr : 249|9@0+ (0.1,0.0) [0.0|51.1] "dB" ASDM,PAS
 SG_ ReSideRdrLeDetn58RdrDetnRng : 271|14@0+ (0.02,-1.0) [-1.0|200.0] "m" ASDM,PAS
 SG_ ReSideRdrLeDetn58RdrDetnRngV : 292|13@0+ (0.02,-80.0) [-80.0|80.0] "m/s" ASDM,PAS
 SG_ ReSideRdrLeDetn58RdrDetnSts : 251|2@0+ (1,0) [0|3] "" ASDM,PAS
 SG_ ReSideRdrLeDetn59_UB : 394|1@0+ (1,0) [0|1] "" ASDM,PAS
 SG_ ReSideRdrLeDetn59RdrDetnAzi : 351|11@0+ (0.1,-90.0) [-90.0|90.0] "Deg" ASDM,PAS
 SG_ ReSideRdrLeDetn59RdrDetnChks : 327|8@0+ (1.0,0.0) [0.0|255.0] "Unitless" ASDM,PAS
 SG_ ReSideRdrLeDetn59RdrDetnCntr : 335|4@0+ (1.0,0.0) [0.0|15.0] "Unitless" ASDM,PAS
 SG_ ReSideRdrLeDetn59RdrDetnConf : 391|7@0+ (1.0,0.0) [0.0|100.0] "%" ASDM,PAS
 SG_ ReSideRdrLeDetn59RdrDetnElevn : 399|5@0+ (1.0,-15.0) [-15.0|15.0] "Deg" ASDM,PAS
 SG_ ReSideRdrLeDetn59RdrDetnPwr : 329|9@0+ (0.1,0.0) [0.0|51.1] "dB" ASDM,PAS
 SG_ ReSideRdrLeDetn59RdrDetnRng : 375|14@0+ (0.02,-1.0) [-1.0|200.0] "m" ASDM,PAS
 SG_ ReSideRdrLeDetn59RdrDetnRngV : 356|13@0+ (0.02,-80.0) [-80.0|80.0] "m/s" ASDM,PAS
 SG_ ReSideRdrLeDetn59RdrDetnSts : 331|2@0+ (1,0) [0|3] "" ASDM,PAS
 SG_ ReSideRdrLeDetn60_UB : 474|1@0+ (1,0) [0|1] "" ASDM,PAS
 SG_ ReSideRdrLeDetn60RdrDetnAzi : 447|11@0+ (0.1,-90.0) [-90.0|90.0] "Deg" ASDM,PAS
 SG_ ReSideRdrLeDetn60RdrDetnChks : 407|8@0+ (1.0,0.0) [0.0|255.0] "Unitless" ASDM,PAS
 SG_ ReSideRdrLeDetn60RdrDetnCntr : 415|4@0+ (1.0,0.0) [0.0|15.0] "Unitless" ASDM,PAS
 SG_ ReSideRdrLeDetn60RdrDetnConf : 471|7@0+ (1.0,0.0) [0.0|100.0] "%" ASDM,PAS
 SG_ ReSideRdrLeDetn60RdrDetnElevn : 479|5@0+ (1.0,-15.0) [-15.0|15.0] "Deg" ASDM,PAS
 SG_ ReSideRdrLeDetn60RdrDetnPwr : 409|9@0+ (0.1,0.0) [0.0|51.1] "dB" ASDM,PAS
 SG_ ReSideRdrLeDetn60RdrDetnRng : 431|14@0+ (0.02,-1.0) [-1.0|200.0] "m" ASDM,PAS
 SG_ ReSideRdrLeDetn60RdrDetnRngV : 452|13@0+ (0.02,-80.0) [-80.0|80.0] "m/s" ASDM,PAS
 SG_ ReSideRdrLeDetn60RdrDetnSts : 411|2@0+ (1,0) [0|3] "" ASDM,PAS

BO_ 324 SODLSafetyCANFD3Frame11: 64 SODL
 SG_ ReSideRdrLeDetn61_UB : 74|1@0+ (1,0) [0|1] "" ASDM,PAS
 SG_ ReSideRdrLeDetn61RdrDetnAzi : 31|11@0+ (0.1,-90.0) [-90.0|90.0] "Deg" ASDM,PAS
 SG_ ReSideRdrLeDetn61RdrDetnChks : 7|8@0+ (1.0,0.0) [0.0|255.0] "Unitless" ASDM,PAS
 SG_ ReSideRdrLeDetn61RdrDetnCntr : 15|4@0+ (1.0,0.0) [0.0|15.0] "Unitless" ASDM,PAS
 SG_ ReSideRdrLeDetn61RdrDetnConf : 71|7@0+ (1.0,0.0) [0.0|100.0] "%" ASDM,PAS
 SG_ ReSideRdrLeDetn61RdrDetnElevn : 79|5@0+ (1.0,-15.0) [-15.0|15.0] "Deg" ASDM,PAS
 SG_ ReSideRdrLeDetn61RdrDetnPwr : 8|9@0+ (0.1,0.0) [0.0|51.1] "dB" ASDM,PAS
 SG_ ReSideRdrLeDetn61RdrDetnRng : 55|14@0+ (0.02,-1.0) [-1.0|200.0] "m" ASDM,PAS
 SG_ ReSideRdrLeDetn61RdrDetnRngV : 36|13@0+ (0.02,-80.0) [-80.0|80.0] "m/s" ASDM,PAS
 SG_ ReSideRdrLeDetn61RdrDetnSts : 11|2@0+ (1,0) [0|3] "" ASDM,PAS
 SG_ ReSideRdrLeDetn62_UB : 154|1@0+ (1,0) [0|1] "" ASDM,PAS
 SG_ ReSideRdrLeDetn62RdrDetnAzi : 119|11@0+ (0.1,-90.0) [-90.0|90.0] "Deg" ASDM,PAS
 SG_ ReSideRdrLeDetn62RdrDetnChks : 87|8@0+ (1.0,0.0) [0.0|255.0] "Unitless" ASDM,PAS
 SG_ ReSideRdrLeDetn62RdrDetnCntr : 95|4@0+ (1.0,0.0) [0.0|15.0] "Unitless" ASDM,PAS
 SG_ ReSideRdrLeDetn62RdrDetnConf : 111|7@0+ (1.0,0.0) [0.0|100.0] "%" ASDM,PAS
 SG_ ReSideRdrLeDetn62RdrDetnElevn : 159|5@0+ (1.0,-15.0) [-15.0|15.0] "Deg" ASDM,PAS
 SG_ ReSideRdrLeDetn62RdrDetnPwr : 89|9@0+ (0.1,0.0) [0.0|51.1] "dB" ASDM,PAS
 SG_ ReSideRdrLeDetn62RdrDetnRng : 143|14@0+ (0.02,-1.0) [-1.0|200.0] "m" ASDM,PAS
 SG_ ReSideRdrLeDetn62RdrDetnRngV : 124|13@0+ (0.02,-80.0) [-80.0|80.0] "m/s" ASDM,PAS
 SG_ ReSideRdrLeDetn62RdrDetnSts : 91|2@0+ (1,0) [0|3] "" ASDM,PAS
 SG_ ReSideRdrLeDetn63_UB : 234|1@0+ (1,0) [0|1] "" ASDM,PAS
 SG_ ReSideRdrLeDetn63RdrDetnAzi : 199|11@0+ (0.1,-90.0) [-90.0|90.0] "Deg" ASDM,PAS
 SG_ ReSideRdrLeDetn63RdrDetnChks : 167|8@0+ (1.0,0.0) [0.0|255.0] "Unitless" ASDM,PAS
 SG_ ReSideRdrLeDetn63RdrDetnCntr : 175|4@0+ (1.0,0.0) [0.0|15.0] "Unitless" ASDM,PAS
 SG_ ReSideRdrLeDetn63RdrDetnConf : 191|7@0+ (1.0,0.0) [0.0|100.0] "%" ASDM,PAS
 SG_ ReSideRdrLeDetn63RdrDetnElevn : 239|5@0+ (1.0,-15.0) [-15.0|15.0] "Deg" ASDM,PAS
 SG_ ReSideRdrLeDetn63RdrDetnPwr : 169|9@0+ (0.1,0.0) [0.0|51.1] "dB" ASDM,PAS
 SG_ ReSideRdrLeDetn63RdrDetnRng : 223|14@0+ (0.02,-1.0) [-1.0|200.0] "m" ASDM,PAS
 SG_ ReSideRdrLeDetn63RdrDetnRngV : 204|13@0+ (0.02,-80.0) [-80.0|80.0] "m/s" ASDM,PAS
 SG_ ReSideRdrLeDetn63RdrDetnSts : 171|2@0+ (1,0) [0|3] "" ASDM,PAS
 SG_ ReSideRdrLeDetn64_UB : 314|1@0+ (1,0) [0|1] "" ASDM,PAS
 SG_ ReSideRdrLeDetn64RdrDetnAzi : 287|11@0+ (0.1,-90.0) [-90.0|90.0] "Deg" ASDM,PAS
 SG_ ReSideRdrLeDetn64RdrDetnChks : 247|8@0+ (1.0,0.0) [0.0|255.0] "Unitless" ASDM,PAS
 SG_ ReSideRdrLeDetn64RdrDetnCntr : 255|4@0+ (1.0,0.0) [0.0|15.0] "Unitless" ASDM,PAS
 SG_ ReSideRdrLeDetn64RdrDetnConf : 311|7@0+ (1.0,0.0) [0.0|100.0] "%" ASDM,PAS
 SG_ ReSideRdrLeDetn64RdrDetnElevn : 319|5@0+ (1.0,-15.0) [-15.0|15.0] "Deg" ASDM,PAS
 SG_ ReSideRdrLeDetn64RdrDetnPwr : 249|9@0+ (0.1,0.0) [0.0|51.1] "dB" ASDM,PAS
 SG_ ReSideRdrLeDetn64RdrDetnRng : 271|14@0+ (0.02,-1.0) [-1.0|200.0] "m" ASDM,PAS
 SG_ ReSideRdrLeDetn64RdrDetnRngV : 292|13@0+ (0.02,-80.0) [-80.0|80.0] "m/s" ASDM,PAS
 SG_ ReSideRdrLeDetn64RdrDetnSts : 251|2@0+ (1,0) [0|3] "" ASDM,PAS
 SG_ ReSideRdrLeDetn65_UB : 394|1@0+ (1,0) [0|1] "" ASDM,PAS
 SG_ ReSideRdrLeDetn65RdrDetnAzi : 351|11@0+ (0.1,-90.0) [-90.0|90.0] "Deg" ASDM,PAS
 SG_ ReSideRdrLeDetn65RdrDetnChks : 327|8@0+ (1.0,0.0) [0.0|255.0] "Unitless" ASDM,PAS
 SG_ ReSideRdrLeDetn65RdrDetnCntr : 335|4@0+ (1.0,0.0) [0.0|15.0] "Unitless" ASDM,PAS
 SG_ ReSideRdrLeDetn65RdrDetnConf : 391|7@0+ (1.0,0.0) [0.0|100.0] "%" ASDM,PAS
 SG_ ReSideRdrLeDetn65RdrDetnElevn : 399|5@0+ (1.0,-15.0) [-15.0|15.0] "Deg" ASDM,PAS
 SG_ ReSideRdrLeDetn65RdrDetnPwr : 329|9@0+ (0.1,0.0) [0.0|51.1] "dB" ASDM,PAS
 SG_ ReSideRdrLeDetn65RdrDetnRng : 375|14@0+ (0.02,-1.0) [-1.0|200.0] "m" ASDM,PAS
 SG_ ReSideRdrLeDetn65RdrDetnRngV : 356|13@0+ (0.02,-80.0) [-80.0|80.0] "m/s" ASDM,PAS
 SG_ ReSideRdrLeDetn65RdrDetnSts : 331|2@0+ (1,0) [0|3] "" ASDM,PAS
 SG_ ReSideRdrLeDetn66_UB : 474|1@0+ (1,0) [0|1] "" ASDM,PAS
 SG_ ReSideRdrLeDetn66RdrDetnAzi : 447|11@0+ (0.1,-90.0) [-90.0|90.0] "Deg" ASDM,PAS
 SG_ ReSideRdrLeDetn66RdrDetnChks : 407|8@0+ (1.0,0.0) [0.0|255.0] "Unitless" ASDM,PAS
 SG_ ReSideRdrLeDetn66RdrDetnCntr : 415|4@0+ (1.0,0.0) [0.0|15.0] "Unitless" ASDM,PAS
 SG_ ReSideRdrLeDetn66RdrDetnConf : 471|7@0+ (1.0,0.0) [0.0|100.0] "%" ASDM,PAS
 SG_ ReSideRdrLeDetn66RdrDetnElevn : 479|5@0+ (1.0,-15.0) [-15.0|15.0] "Deg" ASDM,PAS
 SG_ ReSideRdrLeDetn66RdrDetnPwr : 409|9@0+ (0.1,0.0) [0.0|51.1] "dB" ASDM,PAS
 SG_ ReSideRdrLeDetn66RdrDetnRng : 431|14@0+ (0.02,-1.0) [-1.0|200.0] "m" ASDM,PAS
 SG_ ReSideRdrLeDetn66RdrDetnRngV : 452|13@0+ (0.02,-80.0) [-80.0|80.0] "m/s" ASDM,PAS
 SG_ ReSideRdrLeDetn66RdrDetnSts : 411|2@0+ (1,0) [0|3] "" ASDM,PAS

BO_ 326 SODLSafetyCANFD3Frame12: 64 SODL
 SG_ ReSideRdrLeDetn67_UB : 74|1@0+ (1,0) [0|1] "" ASDM,PAS
 SG_ ReSideRdrLeDetn67RdrDetnAzi : 31|11@0+ (0.1,-90.0) [-90.0|90.0] "Deg" ASDM,PAS
 SG_ ReSideRdrLeDetn67RdrDetnChks : 7|8@0+ (1.0,0.0) [0.0|255.0] "Unitless" ASDM,PAS
 SG_ ReSideRdrLeDetn67RdrDetnCntr : 15|4@0+ (1.0,0.0) [0.0|15.0] "Unitless" ASDM,PAS
 SG_ ReSideRdrLeDetn67RdrDetnConf : 71|7@0+ (1.0,0.0) [0.0|100.0] "%" ASDM,PAS
 SG_ ReSideRdrLeDetn67RdrDetnElevn : 79|5@0+ (1.0,-15.0) [-15.0|15.0] "Deg" ASDM,PAS
 SG_ ReSideRdrLeDetn67RdrDetnPwr : 8|9@0+ (0.1,0.0) [0.0|51.1] "dB" ASDM,PAS
 SG_ ReSideRdrLeDetn67RdrDetnRng : 55|14@0+ (0.02,-1.0) [-1.0|200.0] "m" ASDM,PAS
 SG_ ReSideRdrLeDetn67RdrDetnRngV : 36|13@0+ (0.02,-80.0) [-80.0|80.0] "m/s" ASDM,PAS
 SG_ ReSideRdrLeDetn67RdrDetnSts : 11|2@0+ (1,0) [0|3] "" ASDM,PAS
 SG_ ReSideRdrLeDetn68_UB : 154|1@0+ (1,0) [0|1] "" ASDM,PAS
 SG_ ReSideRdrLeDetn68RdrDetnAzi : 119|11@0+ (0.1,-90.0) [-90.0|90.0] "Deg" ASDM,PAS
 SG_ ReSideRdrLeDetn68RdrDetnChks : 87|8@0+ (1.0,0.0) [0.0|255.0] "Unitless" ASDM,PAS
 SG_ ReSideRdrLeDetn68RdrDetnCntr : 95|4@0+ (1.0,0.0) [0.0|15.0] "Unitless" ASDM,PAS
 SG_ ReSideRdrLeDetn68RdrDetnConf : 111|7@0+ (1.0,0.0) [0.0|100.0] "%" ASDM,PAS
 SG_ ReSideRdrLeDetn68RdrDetnElevn : 159|5@0+ (1.0,-15.0) [-15.0|15.0] "Deg" ASDM,PAS
 SG_ ReSideRdrLeDetn68RdrDetnPwr : 89|9@0+ (0.1,0.0) [0.0|51.1] "dB" ASDM,PAS
 SG_ ReSideRdrLeDetn68RdrDetnRng : 143|14@0+ (0.02,-1.0) [-1.0|200.0] "m" ASDM,PAS
 SG_ ReSideRdrLeDetn68RdrDetnRngV : 124|13@0+ (0.02,-80.0) [-80.0|80.0] "m/s" ASDM,PAS
 SG_ ReSideRdrLeDetn68RdrDetnSts : 91|2@0+ (1,0) [0|3] "" ASDM,PAS
 SG_ ReSideRdrLeDetn69_UB : 234|1@0+ (1,0) [0|1] "" ASDM,PAS
 SG_ ReSideRdrLeDetn69RdrDetnAzi : 199|11@0+ (0.1,-90.0) [-90.0|90.0] "Deg" ASDM,PAS
 SG_ ReSideRdrLeDetn69RdrDetnChks : 167|8@0+ (1.0,0.0) [0.0|255.0] "Unitless" ASDM,PAS
 SG_ ReSideRdrLeDetn69RdrDetnCntr : 175|4@0+ (1.0,0.0) [0.0|15.0] "Unitless" ASDM,PAS
 SG_ ReSideRdrLeDetn69RdrDetnConf : 191|7@0+ (1.0,0.0) [0.0|100.0] "%" ASDM,PAS
 SG_ ReSideRdrLeDetn69RdrDetnElevn : 239|5@0+ (1.0,-15.0) [-15.0|15.0] "Deg" ASDM,PAS
 SG_ ReSideRdrLeDetn69RdrDetnPwr : 169|9@0+ (0.1,0.0) [0.0|51.1] "dB" ASDM,PAS
 SG_ ReSideRdrLeDetn69RdrDetnRng : 223|14@0+ (0.02,-1.0) [-1.0|200.0] "m" ASDM,PAS
 SG_ ReSideRdrLeDetn69RdrDetnRngV : 204|13@0+ (0.02,-80.0) [-80.0|80.0] "m/s" ASDM,PAS
 SG_ ReSideRdrLeDetn69RdrDetnSts : 171|2@0+ (1,0) [0|3] "" ASDM,PAS
 SG_ ReSideRdrLeDetn70_UB : 314|1@0+ (1,0) [0|1] "" ASDM,PAS
 SG_ ReSideRdrLeDetn70RdrDetnAzi : 287|11@0+ (0.1,-90.0) [-90.0|90.0] "Deg" ASDM,PAS
 SG_ ReSideRdrLeDetn70RdrDetnChks : 247|8@0+ (1.0,0.0) [0.0|255.0] "Unitless" ASDM,PAS
 SG_ ReSideRdrLeDetn70RdrDetnCntr : 255|4@0+ (1.0,0.0) [0.0|15.0] "Unitless" ASDM,PAS
 SG_ ReSideRdrLeDetn70RdrDetnConf : 311|7@0+ (1.0,0.0) [0.0|100.0] "%" ASDM,PAS
 SG_ ReSideRdrLeDetn70RdrDetnElevn : 319|5@0+ (1.0,-15.0) [-15.0|15.0] "Deg" ASDM,PAS
 SG_ ReSideRdrLeDetn70RdrDetnPwr : 249|9@0+ (0.1,0.0) [0.0|51.1] "dB" ASDM,PAS
 SG_ ReSideRdrLeDetn70RdrDetnRng : 271|14@0+ (0.02,-1.0) [-1.0|200.0] "m" ASDM,PAS
 SG_ ReSideRdrLeDetn70RdrDetnRngV : 292|13@0+ (0.02,-80.0) [-80.0|80.0] "m/s" ASDM,PAS
 SG_ ReSideRdrLeDetn70RdrDetnSts : 251|2@0+ (1,0) [0|3] "" ASDM,PAS
 SG_ ReSideRdrLeDetn71_UB : 394|1@0+ (1,0) [0|1] "" ASDM,PAS
 SG_ ReSideRdrLeDetn71RdrDetnAzi : 351|11@0+ (0.1,-90.0) [-90.0|90.0] "Deg" ASDM,PAS
 SG_ ReSideRdrLeDetn71RdrDetnChks : 327|8@0+ (1.0,0.0) [0.0|255.0] "Unitless" ASDM,PAS
 SG_ ReSideRdrLeDetn71RdrDetnCntr : 335|4@0+ (1.0,0.0) [0.0|15.0] "Unitless" ASDM,PAS
 SG_ ReSideRdrLeDetn71RdrDetnConf : 391|7@0+ (1.0,0.0) [0.0|100.0] "%" ASDM,PAS
 SG_ ReSideRdrLeDetn71RdrDetnElevn : 399|5@0+ (1.0,-15.0) [-15.0|15.0] "Deg" ASDM,PAS
 SG_ ReSideRdrLeDetn71RdrDetnPwr : 329|9@0+ (0.1,0.0) [0.0|51.1] "dB" ASDM,PAS
 SG_ ReSideRdrLeDetn71RdrDetnRng : 375|14@0+ (0.02,-1.0) [-1.0|200.0] "m" ASDM,PAS
 SG_ ReSideRdrLeDetn71RdrDetnRngV : 356|13@0+ (0.02,-80.0) [-80.0|80.0] "m/s" ASDM,PAS
 SG_ ReSideRdrLeDetn71RdrDetnSts : 331|2@0+ (1,0) [0|3] "" ASDM,PAS
 SG_ ReSideRdrLeDetn72_UB : 474|1@0+ (1,0) [0|1] "" ASDM,PAS
 SG_ ReSideRdrLeDetn72RdrDetnAzi : 447|11@0+ (0.1,-90.0) [-90.0|90.0] "Deg" ASDM,PAS
 SG_ ReSideRdrLeDetn72RdrDetnChks : 407|8@0+ (1.0,0.0) [0.0|255.0] "Unitless" ASDM,PAS
 SG_ ReSideRdrLeDetn72RdrDetnCntr : 415|4@0+ (1.0,0.0) [0.0|15.0] "Unitless" ASDM,PAS
 SG_ ReSideRdrLeDetn72RdrDetnConf : 471|7@0+ (1.0,0.0) [0.0|100.0] "%" ASDM,PAS
 SG_ ReSideRdrLeDetn72RdrDetnElevn : 479|5@0+ (1.0,-15.0) [-15.0|15.0] "Deg" ASDM,PAS
 SG_ ReSideRdrLeDetn72RdrDetnPwr : 409|9@0+ (0.1,0.0) [0.0|51.1] "dB" ASDM,PAS
 SG_ ReSideRdrLeDetn72RdrDetnRng : 431|14@0+ (0.02,-1.0) [-1.0|200.0] "m" ASDM,PAS
 SG_ ReSideRdrLeDetn72RdrDetnRngV : 452|13@0+ (0.02,-80.0) [-80.0|80.0] "m/s" ASDM,PAS
 SG_ ReSideRdrLeDetn72RdrDetnSts : 411|2@0+ (1,0) [0|3] "" ASDM,PAS

BO_ 328 SODLSafetyCANFD3Frame13: 64 SODL
 SG_ ReSideRdrLeDetn73_UB : 74|1@0+ (1,0) [0|1] "" ASDM,PAS
 SG_ ReSideRdrLeDetn73RdrDetnAzi : 31|11@0+ (0.1,-90.0) [-90.0|90.0] "Deg" ASDM,PAS
 SG_ ReSideRdrLeDetn73RdrDetnChks : 7|8@0+ (1.0,0.0) [0.0|255.0] "Unitless" ASDM,PAS
 SG_ ReSideRdrLeDetn73RdrDetnCntr : 15|4@0+ (1.0,0.0) [0.0|15.0] "Unitless" ASDM,PAS
 SG_ ReSideRdrLeDetn73RdrDetnConf : 71|7@0+ (1.0,0.0) [0.0|100.0] "%" ASDM,PAS
 SG_ ReSideRdrLeDetn73RdrDetnElevn : 79|5@0+ (1.0,-15.0) [-15.0|15.0] "Deg" ASDM,PAS
 SG_ ReSideRdrLeDetn73RdrDetnPwr : 8|9@0+ (0.1,0.0) [0.0|51.1] "dB" ASDM,PAS
 SG_ ReSideRdrLeDetn73RdrDetnRng : 55|14@0+ (0.02,-1.0) [-1.0|200.0] "m" ASDM,PAS
 SG_ ReSideRdrLeDetn73RdrDetnRngV : 36|13@0+ (0.02,-80.0) [-80.0|80.0] "m/s" ASDM,PAS
 SG_ ReSideRdrLeDetn73RdrDetnSts : 11|2@0+ (1,0) [0|3] "" ASDM,PAS
 SG_ ReSideRdrLeDetn74_UB : 154|1@0+ (1,0) [0|1] "" ASDM,PAS
 SG_ ReSideRdrLeDetn74RdrDetnAzi : 119|11@0+ (0.1,-90.0) [-90.0|90.0] "Deg" ASDM,PAS
 SG_ ReSideRdrLeDetn74RdrDetnChks : 87|8@0+ (1.0,0.0) [0.0|255.0] "Unitless" ASDM,PAS
 SG_ ReSideRdrLeDetn74RdrDetnCntr : 95|4@0+ (1.0,0.0) [0.0|15.0] "Unitless" ASDM,PAS
 SG_ ReSideRdrLeDetn74RdrDetnConf : 111|7@0+ (1.0,0.0) [0.0|100.0] "%" ASDM,PAS
 SG_ ReSideRdrLeDetn74RdrDetnElevn : 159|5@0+ (1.0,-15.0) [-15.0|15.0] "Deg" ASDM,PAS
 SG_ ReSideRdrLeDetn74RdrDetnPwr : 89|9@0+ (0.1,0.0) [0.0|51.1] "dB" ASDM,PAS
 SG_ ReSideRdrLeDetn74RdrDetnRng : 143|14@0+ (0.02,-1.0) [-1.0|200.0] "m" ASDM,PAS
 SG_ ReSideRdrLeDetn74RdrDetnRngV : 124|13@0+ (0.02,-80.0) [-80.0|80.0] "m/s" ASDM,PAS
 SG_ ReSideRdrLeDetn74RdrDetnSts : 91|2@0+ (1,0) [0|3] "" ASDM,PAS
 SG_ ReSideRdrLeDetn75_UB : 234|1@0+ (1,0) [0|1] "" ASDM,PAS
 SG_ ReSideRdrLeDetn75RdrDetnAzi : 199|11@0+ (0.1,-90.0) [-90.0|90.0] "Deg" ASDM,PAS
 SG_ ReSideRdrLeDetn75RdrDetnChks : 167|8@0+ (1.0,0.0) [0.0|255.0] "Unitless" ASDM,PAS
 SG_ ReSideRdrLeDetn75RdrDetnCntr : 175|4@0+ (1.0,0.0) [0.0|15.0] "Unitless" ASDM,PAS
 SG_ ReSideRdrLeDetn75RdrDetnConf : 191|7@0+ (1.0,0.0) [0.0|100.0] "%" ASDM,PAS
 SG_ ReSideRdrLeDetn75RdrDetnElevn : 239|5@0+ (1.0,-15.0) [-15.0|15.0] "Deg" ASDM,PAS
 SG_ ReSideRdrLeDetn75RdrDetnPwr : 169|9@0+ (0.1,0.0) [0.0|51.1] "dB" ASDM,PAS
 SG_ ReSideRdrLeDetn75RdrDetnRng : 223|14@0+ (0.02,-1.0) [-1.0|200.0] "m" ASDM,PAS
 SG_ ReSideRdrLeDetn75RdrDetnRngV : 204|13@0+ (0.02,-80.0) [-80.0|80.0] "m/s" ASDM,PAS
 SG_ ReSideRdrLeDetn75RdrDetnSts : 171|2@0+ (1,0) [0|3] "" ASDM,PAS
 SG_ ReSideRdrLeDetn76_UB : 314|1@0+ (1,0) [0|1] "" ASDM,PAS
 SG_ ReSideRdrLeDetn76RdrDetnAzi : 287|11@0+ (0.1,-90.0) [-90.0|90.0] "Deg" ASDM,PAS
 SG_ ReSideRdrLeDetn76RdrDetnChks : 247|8@0+ (1.0,0.0) [0.0|255.0] "Unitless" ASDM,PAS
 SG_ ReSideRdrLeDetn76RdrDetnCntr : 255|4@0+ (1.0,0.0) [0.0|15.0] "Unitless" ASDM,PAS
 SG_ ReSideRdrLeDetn76RdrDetnConf : 311|7@0+ (1.0,0.0) [0.0|100.0] "%" ASDM,PAS
 SG_ ReSideRdrLeDetn76RdrDetnElevn : 319|5@0+ (1.0,-15.0) [-15.0|15.0] "Deg" ASDM,PAS
 SG_ ReSideRdrLeDetn76RdrDetnPwr : 249|9@0+ (0.1,0.0) [0.0|51.1] "dB" ASDM,PAS
 SG_ ReSideRdrLeDetn76RdrDetnRng : 271|14@0+ (0.02,-1.0) [-1.0|200.0] "m" ASDM,PAS
 SG_ ReSideRdrLeDetn76RdrDetnRngV : 292|13@0+ (0.02,-80.0) [-80.0|80.0] "m/s" ASDM,PAS
 SG_ ReSideRdrLeDetn76RdrDetnSts : 251|2@0+ (1,0) [0|3] "" ASDM,PAS
 SG_ ReSideRdrLeDetn77_UB : 394|1@0+ (1,0) [0|1] "" ASDM,PAS
 SG_ ReSideRdrLeDetn77RdrDetnAzi : 351|11@0+ (0.1,-90.0) [-90.0|90.0] "Deg" ASDM,PAS
 SG_ ReSideRdrLeDetn77RdrDetnChks : 327|8@0+ (1.0,0.0) [0.0|255.0] "Unitless" ASDM,PAS
 SG_ ReSideRdrLeDetn77RdrDetnCntr : 335|4@0+ (1.0,0.0) [0.0|15.0] "Unitless" ASDM,PAS
 SG_ ReSideRdrLeDetn77RdrDetnConf : 391|7@0+ (1.0,0.0) [0.0|100.0] "%" ASDM,PAS
 SG_ ReSideRdrLeDetn77RdrDetnElevn : 399|5@0+ (1.0,-15.0) [-15.0|15.0] "Deg" ASDM,PAS
 SG_ ReSideRdrLeDetn77RdrDetnPwr : 329|9@0+ (0.1,0.0) [0.0|51.1] "dB" ASDM,PAS
 SG_ ReSideRdrLeDetn77RdrDetnRng : 375|14@0+ (0.02,-1.0) [-1.0|200.0] "m" ASDM,PAS
 SG_ ReSideRdrLeDetn77RdrDetnRngV : 356|13@0+ (0.02,-80.0) [-80.0|80.0] "m/s" ASDM,PAS
 SG_ ReSideRdrLeDetn77RdrDetnSts : 331|2@0+ (1,0) [0|3] "" ASDM,PAS
 SG_ ReSideRdrLeDetn78_UB : 474|1@0+ (1,0) [0|1] "" ASDM,PAS
 SG_ ReSideRdrLeDetn78RdrDetnAzi : 447|11@0+ (0.1,-90.0) [-90.0|90.0] "Deg" ASDM,PAS
 SG_ ReSideRdrLeDetn78RdrDetnChks : 407|8@0+ (1.0,0.0) [0.0|255.0] "Unitless" ASDM,PAS
 SG_ ReSideRdrLeDetn78RdrDetnCntr : 415|4@0+ (1.0,0.0) [0.0|15.0] "Unitless" ASDM,PAS
 SG_ ReSideRdrLeDetn78RdrDetnConf : 471|7@0+ (1.0,0.0) [0.0|100.0] "%" ASDM,PAS
 SG_ ReSideRdrLeDetn78RdrDetnElevn : 479|5@0+ (1.0,-15.0) [-15.0|15.0] "Deg" ASDM,PAS
 SG_ ReSideRdrLeDetn78RdrDetnPwr : 409|9@0+ (0.1,0.0) [0.0|51.1] "dB" ASDM,PAS
 SG_ ReSideRdrLeDetn78RdrDetnRng : 431|14@0+ (0.02,-1.0) [-1.0|200.0] "m" ASDM,PAS
 SG_ ReSideRdrLeDetn78RdrDetnRngV : 452|13@0+ (0.02,-80.0) [-80.0|80.0] "m/s" ASDM,PAS
 SG_ ReSideRdrLeDetn78RdrDetnSts : 411|2@0+ (1,0) [0|3] "" ASDM,PAS

BO_ 330 SODLSafetyCANFD3Frame14: 64 SODL
 SG_ ReSideRdrLeDetn79_UB : 74|1@0+ (1,0) [0|1] "" ASDM,PAS
 SG_ ReSideRdrLeDetn79RdrDetnAzi : 31|11@0+ (0.1,-90.0) [-90.0|90.0] "Deg" ASDM,PAS
 SG_ ReSideRdrLeDetn79RdrDetnChks : 7|8@0+ (1.0,0.0) [0.0|255.0] "Unitless" ASDM,PAS
 SG_ ReSideRdrLeDetn79RdrDetnCntr : 15|4@0+ (1.0,0.0) [0.0|15.0] "Unitless" ASDM,PAS
 SG_ ReSideRdrLeDetn79RdrDetnConf : 71|7@0+ (1.0,0.0) [0.0|100.0] "%" ASDM,PAS
 SG_ ReSideRdrLeDetn79RdrDetnElevn : 79|5@0+ (1.0,-15.0) [-15.0|15.0] "Deg" ASDM,PAS
 SG_ ReSideRdrLeDetn79RdrDetnPwr : 8|9@0+ (0.1,0.0) [0.0|51.1] "dB" ASDM,PAS
 SG_ ReSideRdrLeDetn79RdrDetnRng : 55|14@0+ (0.02,-1.0) [-1.0|200.0] "m" ASDM,PAS
 SG_ ReSideRdrLeDetn79RdrDetnRngV : 36|13@0+ (0.02,-80.0) [-80.0|80.0] "m/s" ASDM,PAS
 SG_ ReSideRdrLeDetn79RdrDetnSts : 11|2@0+ (1,0) [0|3] "" ASDM,PAS
 SG_ ReSideRdrLeDetn80_UB : 154|1@0+ (1,0) [0|1] "" ASDM,PAS
 SG_ ReSideRdrLeDetn80RdrDetnAzi : 119|11@0+ (0.1,-90.0) [-90.0|90.0] "Deg" ASDM,PAS
 SG_ ReSideRdrLeDetn80RdrDetnChks : 87|8@0+ (1.0,0.0) [0.0|255.0] "Unitless" ASDM,PAS
 SG_ ReSideRdrLeDetn80RdrDetnCntr : 95|4@0+ (1.0,0.0) [0.0|15.0] "Unitless" ASDM,PAS
 SG_ ReSideRdrLeDetn80RdrDetnConf : 111|7@0+ (1.0,0.0) [0.0|100.0] "%" ASDM,PAS
 SG_ ReSideRdrLeDetn80RdrDetnElevn : 159|5@0+ (1.0,-15.0) [-15.0|15.0] "Deg" ASDM,PAS
 SG_ ReSideRdrLeDetn80RdrDetnPwr : 89|9@0+ (0.1,0.0) [0.0|51.1] "dB" ASDM,PAS
 SG_ ReSideRdrLeDetn80RdrDetnRng : 143|14@0+ (0.02,-1.0) [-1.0|200.0] "m" ASDM,PAS
 SG_ ReSideRdrLeDetn80RdrDetnRngV : 124|13@0+ (0.02,-80.0) [-80.0|80.0] "m/s" ASDM,PAS
 SG_ ReSideRdrLeDetn80RdrDetnSts : 91|2@0+ (1,0) [0|3] "" ASDM,PAS
 SG_ ReSideRdrLeDetn81_UB : 234|1@0+ (1,0) [0|1] "" ASDM,PAS
 SG_ ReSideRdrLeDetn81RdrDetnAzi : 199|11@0+ (0.1,-90.0) [-90.0|90.0] "Deg" ASDM,PAS
 SG_ ReSideRdrLeDetn81RdrDetnChks : 167|8@0+ (1.0,0.0) [0.0|255.0] "Unitless" ASDM,PAS
 SG_ ReSideRdrLeDetn81RdrDetnCntr : 175|4@0+ (1.0,0.0) [0.0|15.0] "Unitless" ASDM,PAS
 SG_ ReSideRdrLeDetn81RdrDetnConf : 191|7@0+ (1.0,0.0) [0.0|100.0] "%" ASDM,PAS
 SG_ ReSideRdrLeDetn81RdrDetnElevn : 239|5@0+ (1.0,-15.0) [-15.0|15.0] "Deg" ASDM,PAS
 SG_ ReSideRdrLeDetn81RdrDetnPwr : 169|9@0+ (0.1,0.0) [0.0|51.1] "dB" ASDM,PAS
 SG_ ReSideRdrLeDetn81RdrDetnRng : 223|14@0+ (0.02,-1.0) [-1.0|200.0] "m" ASDM,PAS
 SG_ ReSideRdrLeDetn81RdrDetnRngV : 204|13@0+ (0.02,-80.0) [-80.0|80.0] "m/s" ASDM,PAS
 SG_ ReSideRdrLeDetn81RdrDetnSts : 171|2@0+ (1,0) [0|3] "" ASDM,PAS
 SG_ ReSideRdrLeDetn82_UB : 314|1@0+ (1,0) [0|1] "" ASDM,PAS
 SG_ ReSideRdrLeDetn82RdrDetnAzi : 287|11@0+ (0.1,-90.0) [-90.0|90.0] "Deg" ASDM,PAS
 SG_ ReSideRdrLeDetn82RdrDetnChks : 247|8@0+ (1.0,0.0) [0.0|255.0] "Unitless" ASDM,PAS
 SG_ ReSideRdrLeDetn82RdrDetnCntr : 255|4@0+ (1.0,0.0) [0.0|15.0] "Unitless" ASDM,PAS
 SG_ ReSideRdrLeDetn82RdrDetnConf : 311|7@0+ (1.0,0.0) [0.0|100.0] "%" ASDM,PAS
 SG_ ReSideRdrLeDetn82RdrDetnElevn : 319|5@0+ (1.0,-15.0) [-15.0|15.0] "Deg" ASDM,PAS
 SG_ ReSideRdrLeDetn82RdrDetnPwr : 249|9@0+ (0.1,0.0) [0.0|51.1] "dB" ASDM,PAS
 SG_ ReSideRdrLeDetn82RdrDetnRng : 271|14@0+ (0.02,-1.0) [-1.0|200.0] "m" ASDM,PAS
 SG_ ReSideRdrLeDetn82RdrDetnRngV : 292|13@0+ (0.02,-80.0) [-80.0|80.0] "m/s" ASDM,PAS
 SG_ ReSideRdrLeDetn82RdrDetnSts : 251|2@0+ (1,0) [0|3] "" ASDM,PAS
 SG_ ReSideRdrLeDetn83_UB : 394|1@0+ (1,0) [0|1] "" ASDM,PAS
 SG_ ReSideRdrLeDetn83RdrDetnAzi : 351|11@0+ (0.1,-90.0) [-90.0|90.0] "Deg" ASDM,PAS
 SG_ ReSideRdrLeDetn83RdrDetnChks : 327|8@0+ (1.0,0.0) [0.0|255.0] "Unitless" ASDM,PAS
 SG_ ReSideRdrLeDetn83RdrDetnCntr : 335|4@0+ (1.0,0.0) [0.0|15.0] "Unitless" ASDM,PAS
 SG_ ReSideRdrLeDetn83RdrDetnConf : 391|7@0+ (1.0,0.0) [0.0|100.0] "%" ASDM,PAS
 SG_ ReSideRdrLeDetn83RdrDetnElevn : 399|5@0+ (1.0,-15.0) [-15.0|15.0] "Deg" ASDM,PAS
 SG_ ReSideRdrLeDetn83RdrDetnPwr : 329|9@0+ (0.1,0.0) [0.0|51.1] "dB" ASDM,PAS
 SG_ ReSideRdrLeDetn83RdrDetnRng : 375|14@0+ (0.02,-1.0) [-1.0|200.0] "m" ASDM,PAS
 SG_ ReSideRdrLeDetn83RdrDetnRngV : 356|13@0+ (0.02,-80.0) [-80.0|80.0] "m/s" ASDM,PAS
 SG_ ReSideRdrLeDetn83RdrDetnSts : 331|2@0+ (1,0) [0|3] "" ASDM,PAS
 SG_ ReSideRdrLeDetn84_UB : 474|1@0+ (1,0) [0|1] "" ASDM,PAS
 SG_ ReSideRdrLeDetn84RdrDetnAzi : 447|11@0+ (0.1,-90.0) [-90.0|90.0] "Deg" ASDM,PAS
 SG_ ReSideRdrLeDetn84RdrDetnChks : 407|8@0+ (1.0,0.0) [0.0|255.0] "Unitless" ASDM,PAS
 SG_ ReSideRdrLeDetn84RdrDetnCntr : 415|4@0+ (1.0,0.0) [0.0|15.0] "Unitless" ASDM,PAS
 SG_ ReSideRdrLeDetn84RdrDetnConf : 471|7@0+ (1.0,0.0) [0.0|100.0] "%" ASDM,PAS
 SG_ ReSideRdrLeDetn84RdrDetnElevn : 479|5@0+ (1.0,-15.0) [-15.0|15.0] "Deg" ASDM,PAS
 SG_ ReSideRdrLeDetn84RdrDetnPwr : 409|9@0+ (0.1,0.0) [0.0|51.1] "dB" ASDM,PAS
 SG_ ReSideRdrLeDetn84RdrDetnRng : 431|14@0+ (0.02,-1.0) [-1.0|200.0] "m" ASDM,PAS
 SG_ ReSideRdrLeDetn84RdrDetnRngV : 452|13@0+ (0.02,-80.0) [-80.0|80.0] "m/s" ASDM,PAS
 SG_ ReSideRdrLeDetn84RdrDetnSts : 411|2@0+ (1,0) [0|3] "" ASDM,PAS

CM_ SG_ 316 ReSideRdrLeDetn37RdrDetnAzi "Refer to the data element description in ReSideRdrLeDetn1 with the same data element name";
CM_ SG_ 316 ReSideRdrLeDetn37RdrDetnChks "Refer to the data element description in ReSideRdrLeDetn1 with the same data element name";
CM_ SG_ 316 ReSideRdrLeDetn37RdrDetnCntr "Refer to the data element description in ReSideRdrLeDetn1 with the same data element name";
CM_ SG_ 316 ReSideRdrLeDetn37RdrDetnConf "Refer to the data element description in ReSideRdrLeDetn1 with the same data element name";
CM_ SG_ 316 ReSideRdrLeDetn37RdrDetnElevn "Refer to the data element description in ReSideRdrLeDetn1 with the same data element name";
CM_ SG_ 316 ReSideRdrLeDetn37RdrDetnPwr "Refer to the data element description in ReSideRdrLeDetn1 with the same data element name";
CM_ SG_ 316 ReSideRdrLeDetn37RdrDetnRng "Refer to the data element description in ReSideRdrLeDetn1 with the same data element name";
CM_ SG_ 316 ReSideRdrLeDetn37RdrDetnRngV "Range Velocity";
CM_ SG_ 316 ReSideRdrLeDetn37RdrDetnSts "Refer to the data element description in ReSideRdrLeDetn1 with the same data element name";
CM_ SG_ 316 ReSideRdrLeDetn38RdrDetnAzi "Refer to the data element description in ReSideRdrLeDetn1 with the same data element name";
CM_ SG_ 316 ReSideRdrLeDetn38RdrDetnChks "Refer to the data element description in ReSideRdrLeDetn1 with the same data element name";
CM_ SG_ 316 ReSideRdrLeDetn38RdrDetnCntr "Refer to the data element description in ReSideRdrLeDetn1 with the same data element name";
CM_ SG_ 316 ReSideRdrLeDetn38RdrDetnConf "Refer to the data element description in ReSideRdrLeDetn1 with the same data element name";
CM_ SG_ 316 ReSideRdrLeDetn38RdrDetnElevn "Refer to the data element description in ReSideRdrLeDetn1 with the same data element name";
CM_ SG_ 316 ReSideRdrLeDetn38RdrDetnPwr "Refer to the data element description in ReSideRdrLeDetn1 with the same data element name";
CM_ SG_ 316 ReSideRdrLeDetn38RdrDetnRng "Refer to the data element description in ReSideRdrLeDetn1 with the same data element name";
CM_ SG_ 316 ReSideRdrLeDetn38RdrDetnRngV "Range Velocity";
CM_ SG_ 316 ReSideRdrLeDetn38RdrDetnSts "Refer to the data element description in ReSideRdrLeDetn1 with the same data element name";
CM_ SG_ 316 ReSideRdrLeDetn39RdrDetnAzi "Refer to the data element description in ReSideRdrLeDetn1 with the same data element name";
CM_ SG_ 316 ReSideRdrLeDetn39RdrDetnChks "Refer to the data element description in ReSideRdrLeDetn1 with the same data element name";
CM_ SG_ 316 ReSideRdrLeDetn39RdrDetnCntr "Refer to the data element description in ReSideRdrLeDetn1 with the same data element name";
CM_ SG_ 316 ReSideRdrLeDetn39RdrDetnConf "Refer to the data element description in ReSideRdrLeDetn1 with the same data element name";
CM_ SG_ 316 ReSideRdrLeDetn39RdrDetnElevn "Refer to the data element description in ReSideRdrLeDetn1 with the same data element name";
CM_ SG_ 316 ReSideRdrLeDetn39RdrDetnPwr "Refer to the data element description in ReSideRdrLeDetn1 with the same data element name";
CM_ SG_ 316 ReSideRdrLeDetn39RdrDetnRng "Refer to the data element description in ReSideRdrLeDetn1 with the same data element name";
CM_ SG_ 316 ReSideRdrLeDetn39RdrDetnRngV "Range Velocity";
CM_ SG_ 316 ReSideRdrLeDetn39RdrDetnSts "Refer to the data element description in ReSideRdrLeDetn1 with the same data element name";
CM_ SG_ 316 ReSideRdrLeDetn40RdrDetnAzi "Refer to the data element description in ReSideRdrLeDetn1 with the same data element name";
CM_ SG_ 316 ReSideRdrLeDetn40RdrDetnChks "Refer to the data element description in ReSideRdrLeDetn1 with the same data element name";
CM_ SG_ 316 ReSideRdrLeDetn40RdrDetnCntr "Refer to the data element description in ReSideRdrLeDetn1 with the same data element name";
CM_ SG_ 316 ReSideRdrLeDetn40RdrDetnConf "Refer to the data element description in ReSideRdrLeDetn1 with the same data element name";
CM_ SG_ 316 ReSideRdrLeDetn40RdrDetnElevn "Refer to the data element description in ReSideRdrLeDetn1 with the same data element name";
CM_ SG_ 316 ReSideRdrLeDetn40RdrDetnPwr "Refer to the data element description in ReSideRdrLeDetn1 with the same data element name";
CM_ SG_ 316 ReSideRdrLeDetn40RdrDetnRng "Refer to the data element description in ReSideRdrLeDetn1 with the same data element name";
CM_ SG_ 316 ReSideRdrLeDetn40RdrDetnRngV "Range Velocity";
CM_ SG_ 316 ReSideRdrLeDetn40RdrDetnSts "Refer to the data element description in ReSideRdrLeDetn1 with the same data element name";
CM_ SG_ 316 ReSideRdrLeDetn41RdrDetnAzi "Refer to the data element description in ReSideRdrLeDetn1 with the same data element name";
CM_ SG_ 316 ReSideRdrLeDetn41RdrDetnChks "Refer to the data element description in ReSideRdrLeDetn1 with the same data element name";
CM_ SG_ 316 ReSideRdrLeDetn41RdrDetnCntr "Refer to the data element description in ReSideRdrLeDetn1 with the same data element name";
CM_ SG_ 316 ReSideRdrLeDetn41RdrDetnConf "Refer to the data element description in ReSideRdrLeDetn1 with the same data element name";
CM_ SG_ 316 ReSideRdrLeDetn41RdrDetnElevn "Refer to the data element description in ReSideRdrLeDetn1 with the same data element name";
CM_ SG_ 316 ReSideRdrLeDetn41RdrDetnPwr "Refer to the data element description in ReSideRdrLeDetn1 with the same data element name";
CM_ SG_ 316 ReSideRdrLeDetn41RdrDetnRng "Refer to the data element description in ReSideRdrLeDetn1 with the same data element name";
CM_ SG_ 316 ReSideRdrLeDetn41RdrDetnRngV "Range Velocity";
CM_ SG_ 316 ReSideRdrLeDetn41RdrDetnSts "Refer to the data element description in ReSideRdrLeDetn1 with the same data element name";
CM_ SG_ 316 ReSideRdrLeDetn42RdrDetnAzi "Refer to the data element description in ReSideRdrLeDetn1 with the same data element name";
CM_ SG_ 316 ReSideRdrLeDetn42RdrDetnChks "Refer to the data element description in ReSideRdrLeDetn1 with the same data element name";
CM_ SG_ 316 ReSideRdrLeDetn42RdrDetnCntr "Refer to the data element description in ReSideRdrLeDetn1 with the same data element name";
CM_ SG_ 316 ReSideRdrLeDetn42RdrDetnConf "Refer to the data element description in ReSideRdrLeDetn1 with the same data element name";
CM_ SG_ 316 ReSideRdrLeDetn42RdrDetnElevn "Refer to the data element description in ReSideRdrLeDetn1 with the same data element name";
CM_ SG_ 316 ReSideRdrLeDetn42RdrDetnPwr "Refer to the data element description in ReSideRdrLeDetn1 with the same data element name";
CM_ SG_ 316 ReSideRdrLeDetn42RdrDetnRng "Refer to the data element description in ReSideRdrLeDetn1 with the same data element name";
CM_ SG_ 316 ReSideRdrLeDetn42RdrDetnRngV "Range Velocity";
CM_ SG_ 316 ReSideRdrLeDetn42RdrDetnSts "Refer to the data element description in ReSideRdrLeDetn1 with the same data element name";
CM_ SG_ 318 ReSideRdrLeDetn43RdrDetnAzi "Refer to the data element description in ReSideRdrLeDetn1 with the same data element name";
CM_ SG_ 318 ReSideRdrLeDetn43RdrDetnChks "Refer to the data element description in ReSideRdrLeDetn1 with the same data element name";
CM_ SG_ 318 ReSideRdrLeDetn43RdrDetnCntr "Refer to the data element description in ReSideRdrLeDetn1 with the same data element name";
CM_ SG_ 318 ReSideRdrLeDetn43RdrDetnConf "Refer to the data element description in ReSideRdrLeDetn1 with the same data element name";
CM_ SG_ 318 ReSideRdrLeDetn43RdrDetnElevn "Refer to the data element description in ReSideRdrLeDetn1 with the same data element name";
CM_ SG_ 318 ReSideRdrLeDetn43RdrDetnPwr "Refer to the data element description in ReSideRdrLeDetn1 with the same data element name";
CM_ SG_ 318 ReSideRdrLeDetn43RdrDetnRng "Refer to the data element description in ReSideRdrLeDetn1 with the same data element name";
CM_ SG_ 318 ReSideRdrLeDetn43RdrDetnRngV "Range Velocity";
CM_ SG_ 318 ReSideRdrLeDetn43RdrDetnSts "Refer to the data element description in ReSideRdrLeDetn1 with the same data element name";
CM_ SG_ 318 ReSideRdrLeDetn44RdrDetnAzi "Refer to the data element description in ReSideRdrLeDetn1 with the same data element name";
CM_ SG_ 318 ReSideRdrLeDetn44RdrDetnChks "Refer to the data element description in ReSideRdrLeDetn1 with the same data element name";
CM_ SG_ 318 ReSideRdrLeDetn44RdrDetnCntr "Refer to the data element description in ReSideRdrLeDetn1 with the same data element name";
CM_ SG_ 318 ReSideRdrLeDetn44RdrDetnConf "Refer to the data element description in ReSideRdrLeDetn1 with the same data element name";
CM_ SG_ 318 ReSideRdrLeDetn44RdrDetnElevn "Refer to the data element description in ReSideRdrLeDetn1 with the same data element name";
CM_ SG_ 318 ReSideRdrLeDetn44RdrDetnPwr "Refer to the data element description in ReSideRdrLeDetn1 with the same data element name";
CM_ SG_ 318 ReSideRdrLeDetn44RdrDetnRng "Refer to the data element description in ReSideRdrLeDetn1 with the same data element name";
CM_ SG_ 318 ReSideRdrLeDetn44RdrDetnRngV "Range Velocity";
CM_ SG_ 318 ReSideRdrLeDetn44RdrDetnSts "Refer to the data element description in ReSideRdrLeDetn1 with the same data element name";
CM_ SG_ 318 ReSideRdrLeDetn45RdrDetnAzi "Refer to the data element description in ReSideRdrLeDetn1 with the same data element name";
CM_ SG_ 318 ReSideRdrLeDetn45RdrDetnChks "Refer to the data element description in ReSideRdrLeDetn1 with the same data element name";
CM_ SG_ 318 ReSideRdrLeDetn45RdrDetnCntr "Refer to the data element description in ReSideRdrLeDetn1 with the same data element name";
CM_ SG_ 318 ReSideRdrLeDetn45RdrDetnConf "Refer to the data element description in ReSideRdrLeDetn1 with the same data element name";
CM_ SG_ 318 ReSideRdrLeDetn45RdrDetnElevn "Refer to the data element description in ReSideRdrLeDetn1 with the same data element name";
CM_ SG_ 318 ReSideRdrLeDetn45RdrDetnPwr "Refer to the data element description in ReSideRdrLeDetn1 with the same data element name";
CM_ SG_ 318 ReSideRdrLeDetn45RdrDetnRng "Refer to the data element description in ReSideRdrLeDetn1 with the same data element name";
CM_ SG_ 318 ReSideRdrLeDetn45RdrDetnRngV "Range Velocity";
CM_ SG_ 318 ReSideRdrLeDetn45RdrDetnSts "Refer to the data element description in ReSideRdrLeDetn1 with the same data element name";
CM_ SG_ 318 ReSideRdrLeDetn46RdrDetnAzi "Refer to the data element description in ReSideRdrLeDetn1 with the same data element name";
CM_ SG_ 318 ReSideRdrLeDetn46RdrDetnChks "Refer to the data element description in ReSideRdrLeDetn1 with the same data element name";
CM_ SG_ 318 ReSideRdrLeDetn46RdrDetnCntr "Refer to the data element description in ReSideRdrLeDetn1 with the same data element name";
CM_ SG_ 318 ReSideRdrLeDetn46RdrDetnConf "Refer to the data element description in ReSideRdrLeDetn1 with the same data element name";
CM_ SG_ 318 ReSideRdrLeDetn46RdrDetnElevn "Refer to the data element description in ReSideRdrLeDetn1 with the same data element name";
CM_ SG_ 318 ReSideRdrLeDetn46RdrDetnPwr "Refer to the data element description in ReSideRdrLeDetn1 with the same data element name";
CM_ SG_ 318 ReSideRdrLeDetn46RdrDetnRng "Refer to the data element description in ReSideRdrLeDetn1 with the same data element name";
CM_ SG_ 318 ReSideRdrLeDetn46RdrDetnRngV "Range Velocity";
CM_ SG_ 318 ReSideRdrLeDetn46RdrDetnSts "Refer to the data element description in ReSideRdrLeDetn1 with the same data element name";
CM_ SG_ 318 ReSideRdrLeDetn47RdrDetnAzi "Refer to the data element description in ReSideRdrLeDetn1 with the same data element name";
CM_ SG_ 318 ReSideRdrLeDetn47RdrDetnChks "Refer to the data element description in ReSideRdrLeDetn1 with the same data element name";
CM_ SG_ 318 ReSideRdrLeDetn47RdrDetnCntr "Refer to the data element description in ReSideRdrLeDetn1 with the same data element name";
CM_ SG_ 318 ReSideRdrLeDetn47RdrDetnConf "Refer to the data element description in ReSideRdrLeDetn1 with the same data element name";
CM_ SG_ 318 ReSideRdrLeDetn47RdrDetnElevn "Refer to the data element description in ReSideRdrLeDetn1 with the same data element name";
CM_ SG_ 318 ReSideRdrLeDetn47RdrDetnPwr "Refer to the data element description in ReSideRdrLeDetn1 with the same data element name";
CM_ SG_ 318 ReSideRdrLeDetn47RdrDetnRng "Refer to the data element description in ReSideRdrLeDetn1 with the same data element name";
CM_ SG_ 318 ReSideRdrLeDetn47RdrDetnRngV "Range Velocity";
CM_ SG_ 318 ReSideRdrLeDetn47RdrDetnSts "Refer to the data element description in ReSideRdrLeDetn1 with the same data element name";
CM_ SG_ 318 ReSideRdrLeDetn48RdrDetnAzi "Refer to the data element description in ReSideRdrLeDetn1 with the same data element name";
CM_ SG_ 318 ReSideRdrLeDetn48RdrDetnChks "Refer to the data element description in ReSideRdrLeDetn1 with the same data element name";
CM_ SG_ 318 ReSideRdrLeDetn48RdrDetnCntr "Refer to the data element description in ReSideRdrLeDetn1 with the same data element name";
CM_ SG_ 318 ReSideRdrLeDetn48RdrDetnConf "Refer to the data element description in ReSideRdrLeDetn1 with the same data element name";
CM_ SG_ 318 ReSideRdrLeDetn48RdrDetnElevn "Refer to the data element description in ReSideRdrLeDetn1 with the same data element name";
CM_ SG_ 318 ReSideRdrLeDetn48RdrDetnPwr "Refer to the data element description in ReSideRdrLeDetn1 with the same data element name";
CM_ SG_ 318 ReSideRdrLeDetn48RdrDetnRng "Refer to the data element description in ReSideRdrLeDetn1 with the same data element name";
CM_ SG_ 318 ReSideRdrLeDetn48RdrDetnRngV "Range Velocity";
CM_ SG_ 318 ReSideRdrLeDetn48RdrDetnSts "Refer to the data element description in ReSideRdrLeDetn1 with the same data element name";
CM_ SG_ 320 ReSideRdrLeDetn49RdrDetnAzi "Refer to the data element description in ReSideRdrLeDetn1 with the same data element name";
CM_ SG_ 320 ReSideRdrLeDetn49RdrDetnChks "Refer to the data element description in ReSideRdrLeDetn1 with the same data element name";
CM_ SG_ 320 ReSideRdrLeDetn49RdrDetnCntr "Refer to the data element description in ReSideRdrLeDetn1 with the same data element name";
CM_ SG_ 320 ReSideRdrLeDetn49RdrDetnConf "Refer to the data element description in ReSideRdrLeDetn1 with the same data element name";
CM_ SG_ 320 ReSideRdrLeDetn49RdrDetnElevn "Refer to the data element description in ReSideRdrLeDetn1 with the same data element name";
CM_ SG_ 320 ReSideRdrLeDetn49RdrDetnPwr "Refer to the data element description in ReSideRdrLeDetn1 with the same data element name";
CM_ SG_ 320 ReSideRdrLeDetn49RdrDetnRng "Refer to the data element description in ReSideRdrLeDetn1 with the same data element name";
CM_ SG_ 320 ReSideRdrLeDetn49RdrDetnRngV "Range Velocity";
CM_ SG_ 320 ReSideRdrLeDetn49RdrDetnSts "Refer to the data element description in ReSideRdrLeDetn1 with the same data element name";
CM_ SG_ 320 ReSideRdrLeDetn50RdrDetnAzi "Refer to the data element description in ReSideRdrLeDetn1 with the same data element name";
CM_ SG_ 320 ReSideRdrLeDetn50RdrDetnChks "Refer to the data element description in ReSideRdrLeDetn1 with the same data element name";
CM_ SG_ 320 ReSideRdrLeDetn50RdrDetnCntr "Refer to the data element description in ReSideRdrLeDetn1 with the same data element name";
CM_ SG_ 320 ReSideRdrLeDetn50RdrDetnConf "Refer to the data element description in ReSideRdrLeDetn1 with the same data element name";
CM_ SG_ 320 ReSideRdrLeDetn50RdrDetnElevn "Refer to the data element description in ReSideRdrLeDetn1 with the same data element name";
CM_ SG_ 320 ReSideRdrLeDetn50RdrDetnPwr "Refer to the data element description in ReSideRdrLeDetn1 with the same data element name";
CM_ SG_ 320 ReSideRdrLeDetn50RdrDetnRng "Refer to the data element description in ReSideRdrLeDetn1 with the same data element name";
CM_ SG_ 320 ReSideRdrLeDetn50RdrDetnRngV "Range Velocity";
CM_ SG_ 320 ReSideRdrLeDetn50RdrDetnSts "Refer to the data element description in ReSideRdrLeDetn1 with the same data element name";
CM_ SG_ 320 ReSideRdrLeDetn51RdrDetnAzi "Refer to the data element description in ReSideRdrLeDetn1 with the same data element name";
CM_ SG_ 320 ReSideRdrLeDetn51RdrDetnChks "Refer to the data element description in ReSideRdrLeDetn1 with the same data element name";
CM_ SG_ 320 ReSideRdrLeDetn51RdrDetnCntr "Refer to the data element description in ReSideRdrLeDetn1 with the same data element name";
CM_ SG_ 320 ReSideRdrLeDetn51RdrDetnConf "Refer to the data element description in ReSideRdrLeDetn1 with the same data element name";
CM_ SG_ 320 ReSideRdrLeDetn51RdrDetnElevn "Refer to the data element description in ReSideRdrLeDetn1 with the same data element name";
CM_ SG_ 320 ReSideRdrLeDetn51RdrDetnPwr "Refer to the data element description in ReSideRdrLeDetn1 with the same data element name";
CM_ SG_ 320 ReSideRdrLeDetn51RdrDetnRng "Refer to the data element description in ReSideRdrLeDetn1 with the same data element name";
CM_ SG_ 320 ReSideRdrLeDetn51RdrDetnRngV "Range Velocity";
CM_ SG_ 320 ReSideRdrLeDetn51RdrDetnSts "Refer to the data element description in ReSideRdrLeDetn1 with the same data element name";
CM_ SG_ 320 ReSideRdrLeDetn52RdrDetnAzi "Refer to the data element description in ReSideRdrLeDetn1 with the same data element name";
CM_ SG_ 320 ReSideRdrLeDetn52RdrDetnChks "Refer to the data element description in ReSideRdrLeDetn1 with the same data element name";
CM_ SG_ 320 ReSideRdrLeDetn52RdrDetnCntr "Refer to the data element description in ReSideRdrLeDetn1 with the same data element name";
CM_ SG_ 320 ReSideRdrLeDetn52RdrDetnConf "Refer to the data element description in ReSideRdrLeDetn1 with the same data element name";
CM_ SG_ 320 ReSideRdrLeDetn52RdrDetnElevn "Refer to the data element description in ReSideRdrLeDetn1 with the same data element name";
CM_ SG_ 320 ReSideRdrLeDetn52RdrDetnPwr "Refer to the data element description in ReSideRdrLeDetn1 with the same data element name";
CM_ SG_ 320 ReSideRdrLeDetn52RdrDetnRng "Refer to the data element description in ReSideRdrLeDetn1 with the same data element name";
CM_ SG_ 320 ReSideRdrLeDetn52RdrDetnRngV "Range Velocity";
CM_ SG_ 320 ReSideRdrLeDetn52RdrDetnSts "Refer to the data element description in ReSideRdrLeDetn1 with the same data element name";
CM_ SG_ 320 ReSideRdrLeDetn53RdrDetnAzi "Refer to the data element description in ReSideRdrLeDetn1 with the same data element name";
CM_ SG_ 320 ReSideRdrLeDetn53RdrDetnChks "Refer to the data element description in ReSideRdrLeDetn1 with the same data element name";
CM_ SG_ 320 ReSideRdrLeDetn53RdrDetnCntr "Refer to the data element description in ReSideRdrLeDetn1 with the same data element name";
CM_ SG_ 320 ReSideRdrLeDetn53RdrDetnConf "Refer to the data element description in ReSideRdrLeDetn1 with the same data element name";
CM_ SG_ 320 ReSideRdrLeDetn53RdrDetnElevn "Refer to the data element description in ReSideRdrLeDetn1 with the same data element name";
CM_ SG_ 320 ReSideRdrLeDetn53RdrDetnPwr "Refer to the data element description in ReSideRdrLeDetn1 with the same data element name";
CM_ SG_ 320 ReSideRdrLeDetn53RdrDetnRng "Refer to the data element description in ReSideRdrLeDetn1 with the same data element name";
CM_ SG_ 320 ReSideRdrLeDetn53RdrDetnRngV "Range Velocity";
CM_ SG_ 320 ReSideRdrLeDetn53RdrDetnSts "Refer to the data element description in ReSideRdrLeDetn1 with the same data element name";
CM_ SG_ 320 ReSideRdrLeDetn54RdrDetnAzi "Refer to the data element description in ReSideRdrLeDetn1 with the same data element name";
CM_ SG_ 320 ReSideRdrLeDetn54RdrDetnChks "Refer to the data element description in ReSideRdrLeDetn1 with the same data element name";
CM_ SG_ 320 ReSideRdrLeDetn54RdrDetnCntr "Refer to the data element description in ReSideRdrLeDetn1 with the same data element name";
CM_ SG_ 320 ReSideRdrLeDetn54RdrDetnConf "Refer to the data element description in ReSideRdrLeDetn1 with the same data element name";
CM_ SG_ 320 ReSideRdrLeDetn54RdrDetnElevn "Refer to the data element description in ReSideRdrLeDetn1 with the same data element name";
CM_ SG_ 320 ReSideRdrLeDetn54RdrDetnPwr "Refer to the data element description in ReSideRdrLeDetn1 with the same data element name";
CM_ SG_ 320 ReSideRdrLeDetn54RdrDetnRng "Refer to the data element description in ReSideRdrLeDetn1 with the same data element name";
CM_ SG_ 320 ReSideRdrLeDetn54RdrDetnRngV "Range Velocity";
CM_ SG_ 320 ReSideRdrLeDetn54RdrDetnSts "Refer to the data element description in ReSideRdrLeDetn1 with the same data element name";
CM_ SG_ 322 ReSideRdrLeDetn55RdrDetnAzi "Refer to the data element description in ReSideRdrLeDetn1 with the same data element name";
CM_ SG_ 322 ReSideRdrLeDetn55RdrDetnChks "Refer to the data element description in ReSideRdrLeDetn1 with the same data element name";
CM_ SG_ 322 ReSideRdrLeDetn55RdrDetnCntr "Refer to the data element description in ReSideRdrLeDetn1 with the same data element name";
CM_ SG_ 322 ReSideRdrLeDetn55RdrDetnConf "Refer to the data element description in ReSideRdrLeDetn1 with the same data element name";
CM_ SG_ 322 ReSideRdrLeDetn55RdrDetnElevn "Refer to the data element description in ReSideRdrLeDetn1 with the same data element name";
CM_ SG_ 322 ReSideRdrLeDetn55RdrDetnPwr "Refer to the data element description in ReSideRdrLeDetn1 with the same data element name";
CM_ SG_ 322 ReSideRdrLeDetn55RdrDetnRng "Refer to the data element description in ReSideRdrLeDetn1 with the same data element name";
CM_ SG_ 322 ReSideRdrLeDetn55RdrDetnRngV "Range Velocity";
CM_ SG_ 322 ReSideRdrLeDetn55RdrDetnSts "Refer to the data element description in ReSideRdrLeDetn1 with the same data element name";
CM_ SG_ 322 ReSideRdrLeDetn56RdrDetnAzi "Refer to the data element description in ReSideRdrLeDetn1 with the same data element name";
CM_ SG_ 322 ReSideRdrLeDetn56RdrDetnChks "Refer to the data element description in ReSideRdrLeDetn1 with the same data element name";
CM_ SG_ 322 ReSideRdrLeDetn56RdrDetnCntr "Refer to the data element description in ReSideRdrLeDetn1 with the same data element name";
CM_ SG_ 322 ReSideRdrLeDetn56RdrDetnConf "Refer to the data element description in ReSideRdrLeDetn1 with the same data element name";
CM_ SG_ 322 ReSideRdrLeDetn56RdrDetnElevn "Refer to the data element description in ReSideRdrLeDetn1 with the same data element name";
CM_ SG_ 322 ReSideRdrLeDetn56RdrDetnPwr "Refer to the data element description in ReSideRdrLeDetn1 with the same data element name";
CM_ SG_ 322 ReSideRdrLeDetn56RdrDetnRng "Refer to the data element description in ReSideRdrLeDetn1 with the same data element name";
CM_ SG_ 322 ReSideRdrLeDetn56RdrDetnRngV "Range Velocity";
CM_ SG_ 322 ReSideRdrLeDetn56RdrDetnSts "Refer to the data element description in ReSideRdrLeDetn1 with the same data element name";
CM_ SG_ 322 ReSideRdrLeDetn57RdrDetnAzi "Refer to the data element description in ReSideRdrLeDetn1 with the same data element name";
CM_ SG_ 322 ReSideRdrLeDetn57RdrDetnChks "Refer to the data element description in ReSideRdrLeDetn1 with the same data element name";
CM_ SG_ 322 ReSideRdrLeDetn57RdrDetnCntr "Refer to the data element description in ReSideRdrLeDetn1 with the same data element name";
CM_ SG_ 322 ReSideRdrLeDetn57RdrDetnConf "Refer to the data element description in ReSideRdrLeDetn1 with the same data element name";
CM_ SG_ 322 ReSideRdrLeDetn57RdrDetnElevn "Refer to the data element description in ReSideRdrLeDetn1 with the same data element name";
CM_ SG_ 322 ReSideRdrLeDetn57RdrDetnPwr "Refer to the data element description in ReSideRdrLeDetn1 with the same data element name";
CM_ SG_ 322 ReSideRdrLeDetn57RdrDetnRng "Refer to the data element description in ReSideRdrLeDetn1 with the same data element name";
CM_ SG_ 322 ReSideRdrLeDetn57RdrDetnRngV "Range Velocity";
CM_ SG_ 322 ReSideRdrLeDetn57RdrDetnSts "Refer to the data element description in ReSideRdrLeDetn1 with the same data element name";
CM_ SG_ 322 ReSideRdrLeDetn58RdrDetnAzi "Refer to the data element description in ReSideRdrLeDetn1 with the same data element name";
CM_ SG_ 322 ReSideRdrLeDetn58RdrDetnChks "Refer to the data element description in ReSideRdrLeDetn1 with the same data element name";
CM_ SG_ 322 ReSideRdrLeDetn58RdrDetnCntr "Refer to the data element description in ReSideRdrLeDetn1 with the same data element name";
CM_ SG_ 322 ReSideRdrLeDetn58RdrDetnConf "Refer to the data element description in ReSideRdrLeDetn1 with the same data element name";
CM_ SG_ 322 ReSideRdrLeDetn58RdrDetnElevn "Refer to the data element description in ReSideRdrLeDetn1 with the same data element name";
CM_ SG_ 322 ReSideRdrLeDetn58RdrDetnPwr "Refer to the data element description in ReSideRdrLeDetn1 with the same data element name";
CM_ SG_ 322 ReSideRdrLeDetn58RdrDetnRng "Refer to the data element description in ReSideRdrLeDetn1 with the same data element name";
CM_ SG_ 322 ReSideRdrLeDetn58RdrDetnRngV "Range Velocity";
CM_ SG_ 322 ReSideRdrLeDetn58RdrDetnSts "Refer to the data element description in ReSideRdrLeDetn1 with the same data element name";
CM_ SG_ 322 ReSideRdrLeDetn59RdrDetnAzi "Refer to the data element description in ReSideRdrLeDetn1 with the same data element name";
CM_ SG_ 322 ReSideRdrLeDetn59RdrDetnChks "Refer to the data element description in ReSideRdrLeDetn1 with the same data element name";
CM_ SG_ 322 ReSideRdrLeDetn59RdrDetnCntr "Refer to the data element description in ReSideRdrLeDetn1 with the same data element name";
CM_ SG_ 322 ReSideRdrLeDetn59RdrDetnConf "Refer to the data element description in ReSideRdrLeDetn1 with the same data element name";
CM_ SG_ 322 ReSideRdrLeDetn59RdrDetnElevn "Refer to the data element description in ReSideRdrLeDetn1 with the same data element name";
CM_ SG_ 322 ReSideRdrLeDetn59RdrDetnPwr "Refer to the data element description in ReSideRdrLeDetn1 with the same data element name";
CM_ SG_ 322 ReSideRdrLeDetn59RdrDetnRng "Refer to the data element description in ReSideRdrLeDetn1 with the same data element name";
CM_ SG_ 322 ReSideRdrLeDetn59RdrDetnRngV "Range Velocity";
CM_ SG_ 322 ReSideRdrLeDetn59RdrDetnSts "Refer to the data element description in ReSideRdrLeDetn1 with the same data element name";
CM_ SG_ 322 ReSideRdrLeDetn60RdrDetnAzi "Refer to the data element description in ReSideRdrLeDetn1 with the same data element name";
CM_ SG_ 322 ReSideRdrLeDetn60RdrDetnChks "Refer to the data element description in ReSideRdrLeDetn1 with the same data element name";
CM_ SG_ 322 ReSideRdrLeDetn60RdrDetnCntr "Refer to the data element description in ReSideRdrLeDetn1 with the same data element name";
CM_ SG_ 322 ReSideRdrLeDetn60RdrDetnConf "Refer to the data element description in ReSideRdrLeDetn1 with the same data element name";
CM_ SG_ 322 ReSideRdrLeDetn60RdrDetnElevn "Refer to the data element description in ReSideRdrLeDetn1 with the same data element name";
CM_ SG_ 322 ReSideRdrLeDetn60RdrDetnPwr "Refer to the data element description in ReSideRdrLeDetn1 with the same data element name";
CM_ SG_ 322 ReSideRdrLeDetn60RdrDetnRng "Refer to the data element description in ReSideRdrLeDetn1 with the same data element name";
CM_ SG_ 322 ReSideRdrLeDetn60RdrDetnRngV "Range Velocity";
CM_ SG_ 322 ReSideRdrLeDetn60RdrDetnSts "Refer to the data element description in ReSideRdrLeDetn1 with the same data element name";
CM_ SG_ 324 ReSideRdrLeDetn61RdrDetnAzi "Refer to the data element description in ReSideRdrLeDetn1 with the same data element name";
CM_ SG_ 324 ReSideRdrLeDetn61RdrDetnChks "Refer to the data element description in ReSideRdrLeDetn1 with the same data element name";
CM_ SG_ 324 ReSideRdrLeDetn61RdrDetnCntr "Refer to the data element description in ReSideRdrLeDetn1 with the same data element name";
CM_ SG_ 324 ReSideRdrLeDetn61RdrDetnConf "Refer to the data element description in ReSideRdrLeDetn1 with the same data element name";
CM_ SG_ 324 ReSideRdrLeDetn61RdrDetnElevn "Refer to the data element description in ReSideRdrLeDetn1 with the same data element name";
CM_ SG_ 324 ReSideRdrLeDetn61RdrDetnPwr "Refer to the data element description in ReSideRdrLeDetn1 with the same data element name";
CM_ SG_ 324 ReSideRdrLeDetn61RdrDetnRng "Refer to the data element description in ReSideRdrLeDetn1 with the same data element name";
CM_ SG_ 324 ReSideRdrLeDetn61RdrDetnRngV "Range Velocity";
CM_ SG_ 324 ReSideRdrLeDetn61RdrDetnSts "Refer to the data element description in ReSideRdrLeDetn1 with the same data element name";
CM_ SG_ 324 ReSideRdrLeDetn62RdrDetnAzi "Refer to the data element description in ReSideRdrLeDetn1 with the same data element name";
CM_ SG_ 324 ReSideRdrLeDetn62RdrDetnChks "Refer to the data element description in ReSideRdrLeDetn1 with the same data element name";
CM_ SG_ 324 ReSideRdrLeDetn62RdrDetnCntr "Refer to the data element description in ReSideRdrLeDetn1 with the same data element name";
CM_ SG_ 324 ReSideRdrLeDetn62RdrDetnConf "Refer to the data element description in ReSideRdrLeDetn1 with the same data element name";
CM_ SG_ 324 ReSideRdrLeDetn62RdrDetnElevn "Refer to the data element description in ReSideRdrLeDetn1 with the same data element name";
CM_ SG_ 324 ReSideRdrLeDetn62RdrDetnPwr "Refer to the data element description in ReSideRdrLeDetn1 with the same data element name";
CM_ SG_ 324 ReSideRdrLeDetn62RdrDetnRng "Refer to the data element description in ReSideRdrLeDetn1 with the same data element name";
CM_ SG_ 324 ReSideRdrLeDetn62RdrDetnRngV "Range Velocity";
CM_ SG_ 324 ReSideRdrLeDetn62RdrDetnSts "Refer to the data element description in ReSideRdrLeDetn1 with the same data element name";
CM_ SG_ 324 ReSideRdrLeDetn63RdrDetnAzi "Refer to the data element description in ReSideRdrLeDetn1 with the same data element name";
CM_ SG_ 324 ReSideRdrLeDetn63RdrDetnChks "Refer to the data element description in ReSideRdrLeDetn1 with the same data element name";
CM_ SG_ 324 ReSideRdrLeDetn63RdrDetnCntr "Refer to the data element description in ReSideRdrLeDetn1 with the same data element name";
CM_ SG_ 324 ReSideRdrLeDetn63RdrDetnConf "Refer to the data element description in ReSideRdrLeDetn1 with the same data element name";
CM_ SG_ 324 ReSideRdrLeDetn63RdrDetnElevn "Refer to the data element description in ReSideRdrLeDetn1 with the same data element name";
CM_ SG_ 324 ReSideRdrLeDetn63RdrDetnPwr "Refer to the data element description in ReSideRdrLeDetn1 with the same data element name";
CM_ SG_ 324 ReSideRdrLeDetn63RdrDetnRng "Refer to the data element description in ReSideRdrLeDetn1 with the same data element name";
CM_ SG_ 324 ReSideRdrLeDetn63RdrDetnRngV "Range Velocity";
CM_ SG_ 324 ReSideRdrLeDetn63RdrDetnSts "Refer to the data element description in ReSideRdrLeDetn1 with the same data element name";
CM_ SG_ 324 ReSideRdrLeDetn64RdrDetnAzi "Refer to the data element description in ReSideRdrLeDetn1 with the same data element name";
CM_ SG_ 324 ReSideRdrLeDetn64RdrDetnChks "Refer to the data element description in ReSideRdrLeDetn1 with the same data element name";
CM_ SG_ 324 ReSideRdrLeDetn64RdrDetnCntr "Refer to the data element description in ReSideRdrLeDetn1 with the same data element name";
CM_ SG_ 324 ReSideRdrLeDetn64RdrDetnConf "Refer to the data element description in ReSideRdrLeDetn1 with the same data element name";
CM_ SG_ 324 ReSideRdrLeDetn64RdrDetnElevn "Refer to the data element description in ReSideRdrLeDetn1 with the same data element name";
CM_ SG_ 324 ReSideRdrLeDetn64RdrDetnPwr "Refer to the data element description in ReSideRdrLeDetn1 with the same data element name";
CM_ SG_ 324 ReSideRdrLeDetn64RdrDetnRng "Refer to the data element description in ReSideRdrLeDetn1 with the same data element name";
CM_ SG_ 324 ReSideRdrLeDetn64RdrDetnRngV "Range Velocity";
CM_ SG_ 324 ReSideRdrLeDetn64RdrDetnSts "Refer to the data element description in ReSideRdrLeDetn1 with the same data element name";
CM_ SG_ 324 ReSideRdrLeDetn65RdrDetnAzi "Refer to the data element description in ReSideRdrLeDetn1 with the same data element name";
CM_ SG_ 324 ReSideRdrLeDetn65RdrDetnChks "Refer to the data element description in ReSideRdrLeDetn1 with the same data element name";
CM_ SG_ 324 ReSideRdrLeDetn65RdrDetnCntr "Refer to the data element description in ReSideRdrLeDetn1 with the same data element name";
CM_ SG_ 324 ReSideRdrLeDetn65RdrDetnConf "Refer to the data element description in ReSideRdrLeDetn1 with the same data element name";
CM_ SG_ 324 ReSideRdrLeDetn65RdrDetnElevn "Refer to the data element description in ReSideRdrLeDetn1 with the same data element name";
CM_ SG_ 324 ReSideRdrLeDetn65RdrDetnPwr "Refer to the data element description in ReSideRdrLeDetn1 with the same data element name";
CM_ SG_ 324 ReSideRdrLeDetn65RdrDetnRng "Refer to the data element description in ReSideRdrLeDetn1 with the same data element name";
CM_ SG_ 324 ReSideRdrLeDetn65RdrDetnRngV "Range Velocity";
CM_ SG_ 324 ReSideRdrLeDetn65RdrDetnSts "Refer to the data element description in ReSideRdrLeDetn1 with the same data element name";
CM_ SG_ 324 ReSideRdrLeDetn66RdrDetnAzi "Refer to the data element description in ReSideRdrLeDetn1 with the same data element name";
CM_ SG_ 324 ReSideRdrLeDetn66RdrDetnChks "Refer to the data element description in ReSideRdrLeDetn1 with the same data element name";
CM_ SG_ 324 ReSideRdrLeDetn66RdrDetnCntr "Refer to the data element description in ReSideRdrLeDetn1 with the same data element name";
CM_ SG_ 324 ReSideRdrLeDetn66RdrDetnConf "Refer to the data element description in ReSideRdrLeDetn1 with the same data element name";
CM_ SG_ 324 ReSideRdrLeDetn66RdrDetnElevn "Refer to the data element description in ReSideRdrLeDetn1 with the same data element name";
CM_ SG_ 324 ReSideRdrLeDetn66RdrDetnPwr "Refer to the data element description in ReSideRdrLeDetn1 with the same data element name";
CM_ SG_ 324 ReSideRdrLeDetn66RdrDetnRng "Refer to the data element description in ReSideRdrLeDetn1 with the same data element name";
CM_ SG_ 324 ReSideRdrLeDetn66RdrDetnRngV "Range Velocity";
CM_ SG_ 324 ReSideRdrLeDetn66RdrDetnSts "Refer to the data element description in ReSideRdrLeDetn1 with the same data element name";
CM_ SG_ 326 ReSideRdrLeDetn67RdrDetnAzi "Refer to the data element description in ReSideRdrLeDetn1 with the same data element name";
CM_ SG_ 326 ReSideRdrLeDetn67RdrDetnChks "Refer to the data element description in ReSideRdrLeDetn1 with the same data element name";
CM_ SG_ 326 ReSideRdrLeDetn67RdrDetnCntr "Refer to the data element description in ReSideRdrLeDetn1 with the same data element name";
CM_ SG_ 326 ReSideRdrLeDetn67RdrDetnConf "Refer to the data element description in ReSideRdrLeDetn1 with the same data element name";
CM_ SG_ 326 ReSideRdrLeDetn67RdrDetnElevn "Refer to the data element description in ReSideRdrLeDetn1 with the same data element name";
CM_ SG_ 326 ReSideRdrLeDetn67RdrDetnPwr "Refer to the data element description in ReSideRdrLeDetn1 with the same data element name";
CM_ SG_ 326 ReSideRdrLeDetn67RdrDetnRng "Refer to the data element description in ReSideRdrLeDetn1 with the same data element name";
CM_ SG_ 326 ReSideRdrLeDetn67RdrDetnRngV "Range Velocity";
CM_ SG_ 326 ReSideRdrLeDetn67RdrDetnSts "Refer to the data element description in ReSideRdrLeDetn1 with the same data element name";
CM_ SG_ 326 ReSideRdrLeDetn68RdrDetnAzi "Refer to the data element description in ReSideRdrLeDetn1 with the same data element name";
CM_ SG_ 326 ReSideRdrLeDetn68RdrDetnChks "Refer to the data element description in ReSideRdrLeDetn1 with the same data element name";
CM_ SG_ 326 ReSideRdrLeDetn68RdrDetnCntr "Refer to the data element description in ReSideRdrLeDetn1 with the same data element name";
CM_ SG_ 326 ReSideRdrLeDetn68RdrDetnConf "Refer to the data element description in ReSideRdrLeDetn1 with the same data element name";
CM_ SG_ 326 ReSideRdrLeDetn68RdrDetnElevn "Refer to the data element description in ReSideRdrLeDetn1 with the same data element name";
CM_ SG_ 326 ReSideRdrLeDetn68RdrDetnPwr "Refer to the data element description in ReSideRdrLeDetn1 with the same data element name";
CM_ SG_ 326 ReSideRdrLeDetn68RdrDetnRng "Refer to the data element description in ReSideRdrLeDetn1 with the same data element name";
CM_ SG_ 326 ReSideRdrLeDetn68RdrDetnRngV "Range Velocity";
CM_ SG_ 326 ReSideRdrLeDetn68RdrDetnSts "Refer to the data element description in ReSideRdrLeDetn1 with the same data element name";
CM_ SG_ 326 ReSideRdrLeDetn69RdrDetnAzi "Refer to the data element description in ReSideRdrLeDetn1 with the same data element name";
CM_ SG_ 326 ReSideRdrLeDetn69RdrDetnChks "Refer to the data element description in ReSideRdrLeDetn1 with the same data element name";
CM_ SG_ 326 ReSideRdrLeDetn69RdrDetnCntr "Refer to the data element description in ReSideRdrLeDetn1 with the same data element name";
CM_ SG_ 326 ReSideRdrLeDetn69RdrDetnConf "Refer to the data element description in ReSideRdrLeDetn1 with the same data element name";
CM_ SG_ 326 ReSideRdrLeDetn69RdrDetnElevn "Refer to the data element description in ReSideRdrLeDetn1 with the same data element name";
CM_ SG_ 326 ReSideRdrLeDetn69RdrDetnPwr "Refer to the data element description in ReSideRdrLeDetn1 with the same data element name";
CM_ SG_ 326 ReSideRdrLeDetn69RdrDetnRng "Refer to the data element description in ReSideRdrLeDetn1 with the same data element name";
CM_ SG_ 326 ReSideRdrLeDetn69RdrDetnRngV "Range Velocity";
CM_ SG_ 326 ReSideRdrLeDetn69RdrDetnSts "Refer to the data element description in ReSideRdrLeDetn1 with the same data element name";
CM_ SG_ 326 ReSideRdrLeDetn70RdrDetnAzi "Refer to the data element description in ReSideRdrLeDetn1 with the same data element name";
CM_ SG_ 326 ReSideRdrLeDetn70RdrDetnChks "Refer to the data element description in ReSideRdrLeDetn1 with the same data element name";
CM_ SG_ 326 ReSideRdrLeDetn70RdrDetnCntr "Refer to the data element description in ReSideRdrLeDetn1 with the same data element name";
CM_ SG_ 326 ReSideRdrLeDetn70RdrDetnConf "Refer to the data element description in ReSideRdrLeDetn1 with the same data element name";
CM_ SG_ 326 ReSideRdrLeDetn70RdrDetnElevn "Refer to the data element description in ReSideRdrLeDetn1 with the same data element name";
CM_ SG_ 326 ReSideRdrLeDetn70RdrDetnPwr "Refer to the data element description in ReSideRdrLeDetn1 with the same data element name";
CM_ SG_ 326 ReSideRdrLeDetn70RdrDetnRng "Refer to the data element description in ReSideRdrLeDetn1 with the same data element name";
CM_ SG_ 326 ReSideRdrLeDetn70RdrDetnRngV "Range Velocity";
CM_ SG_ 326 ReSideRdrLeDetn70RdrDetnSts "Refer to the data element description in ReSideRdrLeDetn1 with the same data element name";
CM_ SG_ 326 ReSideRdrLeDetn71RdrDetnAzi "Refer to the data element description in ReSideRdrLeDetn1 with the same data element name";
CM_ SG_ 326 ReSideRdrLeDetn71RdrDetnChks "Refer to the data element description in ReSideRdrLeDetn1 with the same data element name";
CM_ SG_ 326 ReSideRdrLeDetn71RdrDetnCntr "Refer to the data element description in ReSideRdrLeDetn1 with the same data element name";
CM_ SG_ 326 ReSideRdrLeDetn71RdrDetnConf "Refer to the data element description in ReSideRdrLeDetn1 with the same data element name";
CM_ SG_ 326 ReSideRdrLeDetn71RdrDetnElevn "Refer to the data element description in ReSideRdrLeDetn1 with the same data element name";
CM_ SG_ 326 ReSideRdrLeDetn71RdrDetnPwr "Refer to the data element description in ReSideRdrLeDetn1 with the same data element name";
CM_ SG_ 326 ReSideRdrLeDetn71RdrDetnRng "Refer to the data element description in ReSideRdrLeDetn1 with the same data element name";
CM_ SG_ 326 ReSideRdrLeDetn71RdrDetnRngV "Range Velocity";
CM_ SG_ 326 ReSideRdrLeDetn71RdrDetnSts "Refer to the data element description in ReSideRdrLeDetn1 with the same data element name";
CM_ SG_ 326 ReSideRdrLeDetn72RdrDetnAzi "Refer to the data element description in ReSideRdrLeDetn1 with the same data element name";
CM_ SG_ 326 ReSideRdrLeDetn72RdrDetnChks "Refer to the data element description in ReSideRdrLeDetn1 with the same data element name";
CM_ SG_ 326 ReSideRdrLeDetn72RdrDetnCntr "Refer to the data element description in ReSideRdrLeDetn1 with the same data element name";
CM_ SG_ 326 ReSideRdrLeDetn72RdrDetnConf "Refer to the data element description in ReSideRdrLeDetn1 with the same data element name";
CM_ SG_ 326 ReSideRdrLeDetn72RdrDetnElevn "Refer to the data element description in ReSideRdrLeDetn1 with the same data element name";
CM_ SG_ 326 ReSideRdrLeDetn72RdrDetnPwr "Refer to the data element description in ReSideRdrLeDetn1 with the same data element name";
CM_ SG_ 326 ReSideRdrLeDetn72RdrDetnRng "Refer to the data element description in ReSideRdrLeDetn1 with the same data element name";
CM_ SG_ 326 ReSideRdrLeDetn72RdrDetnRngV "Range Velocity";
CM_ SG_ 326 ReSideRdrLeDetn72RdrDetnSts "Refer to the data element description in ReSideRdrLeDetn1 with the same data element name";
CM_ SG_ 328 ReSideRdrLeDetn73RdrDetnAzi "Refer to the data element description in ReSideRdrLeDetn1 with the same data element name";
CM_ SG_ 328 ReSideRdrLeDetn73RdrDetnChks "Refer to the data element description in ReSideRdrLeDetn1 with the same data element name";
CM_ SG_ 328 ReSideRdrLeDetn73RdrDetnCntr "Refer to the data element description in ReSideRdrLeDetn1 with the same data element name";
CM_ SG_ 328 ReSideRdrLeDetn73RdrDetnConf "Refer to the data element description in ReSideRdrLeDetn1 with the same data element name";
CM_ SG_ 328 ReSideRdrLeDetn73RdrDetnElevn "Refer to the data element description in ReSideRdrLeDetn1 with the same data element name";
CM_ SG_ 328 ReSideRdrLeDetn73RdrDetnPwr "Refer to the data element description in ReSideRdrLeDetn1 with the same data element name";
CM_ SG_ 328 ReSideRdrLeDetn73RdrDetnRng "Refer to the data element description in ReSideRdrLeDetn1 with the same data element name";
CM_ SG_ 328 ReSideRdrLeDetn73RdrDetnRngV "Range Velocity";
CM_ SG_ 328 ReSideRdrLeDetn73RdrDetnSts "Refer to the data element description in ReSideRdrLeDetn1 with the same data element name";
CM_ SG_ 328 ReSideRdrLeDetn74RdrDetnAzi "Refer to the data element description in ReSideRdrLeDetn1 with the same data element name";
CM_ SG_ 328 ReSideRdrLeDetn74RdrDetnChks "Refer to the data element description in ReSideRdrLeDetn1 with the same data element name";
CM_ SG_ 328 ReSideRdrLeDetn74RdrDetnCntr "Refer to the data element description in ReSideRdrLeDetn1 with the same data element name";
CM_ SG_ 328 ReSideRdrLeDetn74RdrDetnConf "Refer to the data element description in ReSideRdrLeDetn1 with the same data element name";
CM_ SG_ 328 ReSideRdrLeDetn74RdrDetnElevn "Refer to the data element description in ReSideRdrLeDetn1 with the same data element name";
CM_ SG_ 328 ReSideRdrLeDetn74RdrDetnPwr "Refer to the data element description in ReSideRdrLeDetn1 with the same data element name";
CM_ SG_ 328 ReSideRdrLeDetn74RdrDetnRng "Refer to the data element description in ReSideRdrLeDetn1 with the same data element name";
CM_ SG_ 328 ReSideRdrLeDetn74RdrDetnRngV "Range Velocity";
CM_ SG_ 328 ReSideRdrLeDetn74RdrDetnSts "Refer to the data element description in ReSideRdrLeDetn1 with the same data element name";
CM_ SG_ 328 ReSideRdrLeDetn75RdrDetnAzi "Refer to the data element description in ReSideRdrLeDetn1 with the same data element name";
CM_ SG_ 328 ReSideRdrLeDetn75RdrDetnChks "Refer to the data element description in ReSideRdrLeDetn1 with the same data element name";
CM_ SG_ 328 ReSideRdrLeDetn75RdrDetnCntr "Refer to the data element description in ReSideRdrLeDetn1 with the same data element name";
CM_ SG_ 328 ReSideRdrLeDetn75RdrDetnConf "Refer to the data element description in ReSideRdrLeDetn1 with the same data element name";
CM_ SG_ 328 ReSideRdrLeDetn75RdrDetnElevn "Refer to the data element description in ReSideRdrLeDetn1 with the same data element name";
CM_ SG_ 328 ReSideRdrLeDetn75RdrDetnPwr "Refer to the data element description in ReSideRdrLeDetn1 with the same data element name";
CM_ SG_ 328 ReSideRdrLeDetn75RdrDetnRng "Refer to the data element description in ReSideRdrLeDetn1 with the same data element name";
CM_ SG_ 328 ReSideRdrLeDetn75RdrDetnRngV "Range Velocity";
CM_ SG_ 328 ReSideRdrLeDetn75RdrDetnSts "Refer to the data element description in ReSideRdrLeDetn1 with the same data element name";
CM_ SG_ 328 ReSideRdrLeDetn76RdrDetnAzi "Refer to the data element description in ReSideRdrLeDetn1 with the same data element name";
CM_ SG_ 328 ReSideRdrLeDetn76RdrDetnChks "Refer to the data element description in ReSideRdrLeDetn1 with the same data element name";
CM_ SG_ 328 ReSideRdrLeDetn76RdrDetnCntr "Refer to the data element description in ReSideRdrLeDetn1 with the same data element name";
CM_ SG_ 328 ReSideRdrLeDetn76RdrDetnConf "Refer to the data element description in ReSideRdrLeDetn1 with the same data element name";
CM_ SG_ 328 ReSideRdrLeDetn76RdrDetnElevn "Refer to the data element description in ReSideRdrLeDetn1 with the same data element name";
CM_ SG_ 328 ReSideRdrLeDetn76RdrDetnPwr "Refer to the data element description in ReSideRdrLeDetn1 with the same data element name";
CM_ SG_ 328 ReSideRdrLeDetn76RdrDetnRng "Refer to the data element description in ReSideRdrLeDetn1 with the same data element name";
CM_ SG_ 328 ReSideRdrLeDetn76RdrDetnRngV "Range Velocity";
CM_ SG_ 328 ReSideRdrLeDetn76RdrDetnSts "Refer to the data element description in ReSideRdrLeDetn1 with the same data element name";
CM_ SG_ 328 ReSideRdrLeDetn77RdrDetnAzi "Refer to the data element description in ReSideRdrLeDetn1 with the same data element name";
CM_ SG_ 328 ReSideRdrLeDetn77RdrDetnChks "Refer to the data element description in ReSideRdrLeDetn1 with the same data element name";
CM_ SG_ 328 ReSideRdrLeDetn77RdrDetnCntr "Refer to the data element description in ReSideRdrLeDetn1 with the same data element name";
CM_ SG_ 328 ReSideRdrLeDetn77RdrDetnConf "Refer to the data element description in ReSideRdrLeDetn1 with the same data element name";
CM_ SG_ 328 ReSideRdrLeDetn77RdrDetnElevn "Refer to the data element description in ReSideRdrLeDetn1 with the same data element name";
CM_ SG_ 328 ReSideRdrLeDetn77RdrDetnPwr "Refer to the data element description in ReSideRdrLeDetn1 with the same data element name";
CM_ SG_ 328 ReSideRdrLeDetn77RdrDetnRng "Refer to the data element description in ReSideRdrLeDetn1 with the same data element name";
CM_ SG_ 328 ReSideRdrLeDetn77RdrDetnRngV "Range Velocity";
CM_ SG_ 328 ReSideRdrLeDetn77RdrDetnSts "Refer to the data element description in ReSideRdrLeDetn1 with the same data element name";
CM_ SG_ 328 ReSideRdrLeDetn78RdrDetnAzi "Refer to the data element description in ReSideRdrLeDetn1 with the same data element name";
CM_ SG_ 328 ReSideRdrLeDetn78RdrDetnChks "Refer to the data element description in ReSideRdrLeDetn1 with the same data element name";
CM_ SG_ 328 ReSideRdrLeDetn78RdrDetnCntr "Refer to the data element description in ReSideRdrLeDetn1 with the same data element name";
CM_ SG_ 328 ReSideRdrLeDetn78RdrDetnConf "Refer to the data element description in ReSideRdrLeDetn1 with the same data element name";
CM_ SG_ 328 ReSideRdrLeDetn78RdrDetnElevn "Refer to the data element description in ReSideRdrLeDetn1 with the same data element name";
CM_ SG_ 328 ReSideRdrLeDetn78RdrDetnPwr "Refer to the data element description in ReSideRdrLeDetn1 with the same data element name";
CM_ SG_ 328 ReSideRdrLeDetn78RdrDetnRng "Refer to the data element description in ReSideRdrLeDetn1 with the same data element name";
CM_ SG_ 328 ReSideRdrLeDetn78RdrDetnRngV "Range Velocity";
CM_ SG_ 328 ReSideRdrLeDetn78RdrDetnSts "Refer to the data element description in ReSideRdrLeDetn1 with the same data element name";
CM_ SG_ 330 ReSideRdrLeDetn79RdrDetnAzi "Refer to the data element description in ReSideRdrLeDetn1 with the same data element name";
CM_ SG_ 330 ReSideRdrLeDetn79RdrDetnChks "Refer to the data element description in ReSideRdrLeDetn1 with the same data element name";
CM_ SG_ 330 ReSideRdrLeDetn79RdrDetnCntr "Refer to the data element description in ReSideRdrLeDetn1 with the same data element name";
CM_ SG_ 330 ReSideRdrLeDetn79RdrDetnConf "Refer to the data element description in ReSideRdrLeDetn1 with the same data element name";
CM_ SG_ 330 ReSideRdrLeDetn79RdrDetnElevn "Refer to the data element description in ReSideRdrLeDetn1 with the same data element name";
CM_ SG_ 330 ReSideRdrLeDetn79RdrDetnPwr "Refer to the data element description in ReSideRdrLeDetn1 with the same data element name";
CM_ SG_ 330 ReSideRdrLeDetn79RdrDetnRng "Refer to the data element description in ReSideRdrLeDetn1 with the same data element name";
CM_ SG_ 330 ReSideRdrLeDetn79RdrDetnRngV "Range Velocity";
CM_ SG_ 330 ReSideRdrLeDetn79RdrDetnSts "Refer to the data element description in ReSideRdrLeDetn1 with the same data element name";
CM_ SG_ 330 ReSideRdrLeDetn80RdrDetnAzi "Refer to the data element description in ReSideRdrLeDetn1 with the same data element name";
CM_ SG_ 330 ReSideRdrLeDetn80RdrDetnChks "Refer to the data element description in ReSideRdrLeDetn1 with the same data element name";
CM_ SG_ 330 ReSideRdrLeDetn80RdrDetnCntr "Refer to the data element description in ReSideRdrLeDetn1 with the same data element name";
CM_ SG_ 330 ReSideRdrLeDetn80RdrDetnConf "Refer to the data element description in ReSideRdrLeDetn1 with the same data element name";
CM_ SG_ 330 ReSideRdrLeDetn80RdrDetnElevn "Refer to the data element description in ReSideRdrLeDetn1 with the same data element name";
CM_ SG_ 330 ReSideRdrLeDetn80RdrDetnPwr "Refer to the data element description in ReSideRdrLeDetn1 with the same data element name";
CM_ SG_ 330 ReSideRdrLeDetn80RdrDetnRng "Refer to the data element description in ReSideRdrLeDetn1 with the same data element name";
CM_ SG_ 330 ReSideRdrLeDetn80RdrDetnRngV "Range Velocity";
CM_ SG_ 330 ReSideRdrLeDetn80RdrDetnSts "Refer to the data element description in ReSideRdrLeDetn1 with the same data element name";
CM_ SG_ 330 ReSideRdrLeDetn81RdrDetnAzi "Refer to the data element description in ReSideRdrLeDetn1 with the same data element name";
CM_ SG_ 330 ReSideRdrLeDetn81RdrDetnChks "Refer to the data element description in ReSideRdrLeDetn1 with the same data element name";
CM_ SG_ 330 ReSideRdrLeDetn81RdrDetnCntr "Refer to the data element description in ReSideRdrLeDetn1 with the same data element name";
CM_ SG_ 330 ReSideRdrLeDetn81RdrDetnConf "Refer to the data element description in ReSideRdrLeDetn1 with the same data element name";
CM_ SG_ 330 ReSideRdrLeDetn81RdrDetnElevn "Refer to the data element description in ReSideRdrLeDetn1 with the same data element name";
CM_ SG_ 330 ReSideRdrLeDetn81RdrDetnPwr "Refer to the data element description in ReSideRdrLeDetn1 with the same data element name";
CM_ SG_ 330 ReSideRdrLeDetn81RdrDetnRng "Refer to the data element description in ReSideRdrLeDetn1 with the same data element name";
CM_ SG_ 330 ReSideRdrLeDetn81RdrDetnRngV "Range Velocity";
CM_ SG_ 330 ReSideRdrLeDetn81RdrDetnSts "Refer to the data element description in ReSideRdrLeDetn1 with the same data element name";
CM_ SG_ 330 ReSideRdrLeDetn82RdrDetnAzi "Refer to the data element description in ReSideRdrLeDetn1 with the same data element name";
CM_ SG_ 330 ReSideRdrLeDetn82RdrDetnChks "Refer to the data element description in ReSideRdrLeDetn1 with the same data element name";
CM_ SG_ 330 ReSideRdrLeDetn82RdrDetnCntr "Refer to the data element description in ReSideRdrLeDetn1 with the same data element name";
CM_ SG_ 330 ReSideRdrLeDetn82RdrDetnConf "Refer to the data element description in ReSideRdrLeDetn1 with the same data element name";
CM_ SG_ 330 ReSideRdrLeDetn82RdrDetnElevn "Refer to the data element description in ReSideRdrLeDetn1 with the same data element name";
CM_ SG_ 330 ReSideRdrLeDetn82RdrDetnPwr "Refer to the data element description in ReSideRdrLeDetn1 with the same data element name";
CM_ SG_ 330 ReSideRdrLeDetn82RdrDetnRng "Refer to the data element description in ReSideRdrLeDetn1 with the same data element name";
CM_ SG_ 330 ReSideRdrLeDetn82RdrDetnRngV "Range Velocity";
CM_ SG_ 330 ReSideRdrLeDetn82RdrDetnSts "Refer to the data element description in ReSideRdrLeDetn1 with the same data element name";
CM_ SG_ 330 ReSideRdrLeDetn83RdrDetnAzi "Refer to the data element description in ReSideRdrLeDetn1 with the same data element name";
CM_ SG_ 330 ReSideRdrLeDetn83RdrDetnChks "Refer to the data element description in ReSideRdrLeDetn1 with the same data element name";
CM_ SG_ 330 ReSideRdrLeDetn83RdrDetnCntr "Refer to the data element description in ReSideRdrLeDetn1 with the same data element name";
CM_ SG_ 330 ReSideRdrLeDetn83RdrDetnConf "Refer to the data element description in ReSideRdrLeDetn1 with the same data element name";
CM_ SG_ 330 ReSideRdrLeDetn83RdrDetnElevn "Refer to the data element description in ReSideRdrLeDetn1 with the same data element name";
CM_ SG_ 330 ReSideRdrLeDetn83RdrDetnPwr "Refer to the data element description in ReSideRdrLeDetn1 with the same data element name";
CM_ SG_ 330 ReSideRdrLeDetn83RdrDetnRng "Refer to the data element description in ReSideRdrLeDetn1 with the same data element name";
CM_ SG_ 330 ReSideRdrLeDetn83RdrDetnRngV "Range Velocity";
CM_ SG_ 330 ReSideRdrLeDetn83RdrDetnSts "Refer to the data element description in ReSideRdrLeDetn1 with the same data element name";
CM_ SG_ 330 ReSideRdrLeDetn84RdrDetnAzi "Refer to the data element description in ReSideRdrLeDetn1 with the same data element name";
CM_ SG_ 330 ReSideRdrLeDetn84RdrDetnChks "Refer to the data element description in ReSideRdrLeDetn1 with the same data element name";
CM_ SG_ 330 ReSideRdrLeDetn84RdrDetnCntr "Refer to the data element description in ReSideRdrLeDetn1 with the same data element name";
CM_ SG_ 330 ReSideRdrLeDetn84RdrDetnConf "Refer to the data element description in ReSideRdrLeDetn1 with the same data element name";
CM_ SG_ 330 ReSideRdrLeDetn84RdrDetnElevn "Refer to the data element description in ReSideRdrLeDetn1 with the same data element name";
CM_ SG_ 330 ReSideRdrLeDetn84RdrDetnPwr "Refer to the data element description in ReSideRdrLeDetn1 with the same data element name";
CM_ SG_ 330 ReSideRdrLeDetn84RdrDetnRng "Refer to the data element description in ReSideRdrLeDetn1 with the same data element name";
CM_ SG_ 330 ReSideRdrLeDetn84RdrDetnRngV "Range Velocity";
CM_ SG_ 330 ReSideRdrLeDetn84RdrDetnSts "Refer to the data element description in ReSideRdrLeDetn1 with the same data element name";
BA_DEF_ BO_ "VFrameFormat" ENUM "StandardCAN","ExtendedCAN","reserved","J1939PG","reserved","reserved","reserved","reserved","reserved","reserved","reserved","reserved","reserved","reserved","StandardCAN_FD","ExtendedCAN_FD";
BA_DEF_ BO_ "CANFD_BRS" ENUM "0","1";
BA_DEF_ BO_ "GenMsgSendType" ENUM "cyclic", "spontaneous", "not-used", "not-used", "not-used", "cyclicAndSpontaneous", "not-used", "cyclicIfActive", "NoMsgSendType"; // [us]
BA_DEF_ BO_ "GenMsgCycleTime" INT 0 65536; // [ms]
BA_DEF_ BO_ "GenMsgStartDelayTime" INT 0 65536; // [ms]
BA_DEF_ BO_ "GenMsgDelayTime" INT 0 65536; // [ms]
BA_DEF_ SG_ "GenSigSendType" ENUM "Cyclic","OnWrite","OnWriteWithRepetition","OnChange","OnChangeWithRepetition","IfActive","IfActiveWithRepetition","NoSigSendType";
BA_DEF_ SG_ "GenSigStartValue" HEX 0 80000000;
BA_DEF_ BO_ "GenMsgILSupport" ENUM "No","Yes";
BA_DEF_ BO_ "NmAsrMessage" ENUM "No","Yes";
BA_DEF_ SG_ "GenSigFuncType" ENUM "NoFunction","n/a","n/a","n/a","n/a","n/a","n/a","n/a","n/a","n/a","n/a","n/a","n/a","n/a","n/a","CHK","CNTR","n/a","n/a","n/a","CNTR_AR_01","CRC_AR_01_BOTH","CRC_AR_01_ALT","CRC_AR_01_LOW","CRC_AR_01_NIBBLE","CNTR_AR_04","CRC_AR_04A","CNTR_AR_05","CRC_AR_05";
BA_DEF_ SG_ "GenSigDataID" STRING;

BA_DEF_DEF_ "VFrameFormat" "J1939PG";
BA_DEF_DEF_ "CANFD_BRS" "1";
BA_DEF_DEF_ "GenSigStartValue" 0;
BA_DEF_DEF_ "GenSigSendType" "NoSigSendType";
BA_DEF_DEF_ "GenMsgCycleTime" 0;
BA_DEF_DEF_ "GenMsgDelayTime" 0;
BA_DEF_DEF_ "GenMsgStartDelayTime" 0;
BA_DEF_DEF_ "GenMsgSendType" "NoMsgSendType";
BA_DEF_DEF_ "GenMsgILSupport" "Yes";
BA_DEF_DEF_ "NmAsrMessage" "No";
BA_DEF_DEF_ "GenSigFuncType" "NoFunction";
BA_DEF_DEF_ "GenSigDataID" "";
// Frame: SODLSafetyCANFD3Frame07
BA_ "VFrameFormat" BO_ 316 14;
BA_ "GenMsgSendType" BO_ 316 0;
BA_ "GenMsgCycleTime" BO_ 316 50.000;
BA_ "GenSigStartValue" SG_ 316 ReSideRdrLeDetn37RdrDetnAzi 900;
BA_ "GenSigSendType" SG_ 316 ReSideRdrLeDetn37RdrDetnAzi 0;
BA_ "GenSigSendType" SG_ 316 ReSideRdrLeDetn37RdrDetnChks 0;
BA_ "GenSigFuncType" SG_ 316 ReSideRdrLeDetn37RdrDetnChks 15;
BA_ "GenSigDataID" SG_ 316 ReSideRdrLeDetn37RdrDetnChks "0x9B6";
BA_ "GenSigSendType" SG_ 316 ReSideRdrLeDetn37RdrDetnCntr 0;
BA_ "GenSigFuncType" SG_ 316 ReSideRdrLeDetn37RdrDetnCntr 16;
BA_ "GenSigSendType" SG_ 316 ReSideRdrLeDetn37RdrDetnConf 0;
BA_ "GenSigStartValue" SG_ 316 ReSideRdrLeDetn37RdrDetnElevn 15;
BA_ "GenSigSendType" SG_ 316 ReSideRdrLeDetn37RdrDetnElevn 0;
BA_ "GenSigSendType" SG_ 316 ReSideRdrLeDetn37RdrDetnPwr 0;
BA_ "GenSigStartValue" SG_ 316 ReSideRdrLeDetn37RdrDetnRng 10050;
BA_ "GenSigSendType" SG_ 316 ReSideRdrLeDetn37RdrDetnRng 0;
BA_ "GenSigStartValue" SG_ 316 ReSideRdrLeDetn37RdrDetnRngV 4000;
BA_ "GenSigSendType" SG_ 316 ReSideRdrLeDetn37RdrDetnRngV 0;
BA_ "GenSigStartValue" SG_ 316 ReSideRdrLeDetn37RdrDetnSts 3;
BA_ "GenSigSendType" SG_ 316 ReSideRdrLeDetn37RdrDetnSts 0;
BA_ "GenSigStartValue" SG_ 316 ReSideRdrLeDetn38RdrDetnAzi 900;
BA_ "GenSigSendType" SG_ 316 ReSideRdrLeDetn38RdrDetnAzi 0;
BA_ "GenSigSendType" SG_ 316 ReSideRdrLeDetn38RdrDetnChks 0;
BA_ "GenSigFuncType" SG_ 316 ReSideRdrLeDetn38RdrDetnChks 15;
BA_ "GenSigDataID" SG_ 316 ReSideRdrLeDetn38RdrDetnChks "0x9B7";
BA_ "GenSigSendType" SG_ 316 ReSideRdrLeDetn38RdrDetnCntr 0;
BA_ "GenSigFuncType" SG_ 316 ReSideRdrLeDetn38RdrDetnCntr 16;
BA_ "GenSigSendType" SG_ 316 ReSideRdrLeDetn38RdrDetnConf 0;
BA_ "GenSigStartValue" SG_ 316 ReSideRdrLeDetn38RdrDetnElevn 15;
BA_ "GenSigSendType" SG_ 316 ReSideRdrLeDetn38RdrDetnElevn 0;
BA_ "GenSigSendType" SG_ 316 ReSideRdrLeDetn38RdrDetnPwr 0;
BA_ "GenSigStartValue" SG_ 316 ReSideRdrLeDetn38RdrDetnRng 10050;
BA_ "GenSigSendType" SG_ 316 ReSideRdrLeDetn38RdrDetnRng 0;
BA_ "GenSigStartValue" SG_ 316 ReSideRdrLeDetn38RdrDetnRngV 4000;
BA_ "GenSigSendType" SG_ 316 ReSideRdrLeDetn38RdrDetnRngV 0;
BA_ "GenSigStartValue" SG_ 316 ReSideRdrLeDetn38RdrDetnSts 3;
BA_ "GenSigSendType" SG_ 316 ReSideRdrLeDetn38RdrDetnSts 0;
BA_ "GenSigStartValue" SG_ 316 ReSideRdrLeDetn39RdrDetnAzi 900;
BA_ "GenSigSendType" SG_ 316 ReSideRdrLeDetn39RdrDetnAzi 0;
BA_ "GenSigSendType" SG_ 316 ReSideRdrLeDetn39RdrDetnChks 0;
BA_ "GenSigFuncType" SG_ 316 ReSideRdrLeDetn39RdrDetnChks 15;
BA_ "GenSigDataID" SG_ 316 ReSideRdrLeDetn39RdrDetnChks "0x9B8";
BA_ "GenSigSendType" SG_ 316 ReSideRdrLeDetn39RdrDetnCntr 0;
BA_ "GenSigFuncType" SG_ 316 ReSideRdrLeDetn39RdrDetnCntr 16;
BA_ "GenSigSendType" SG_ 316 ReSideRdrLeDetn39RdrDetnConf 0;
BA_ "GenSigStartValue" SG_ 316 ReSideRdrLeDetn39RdrDetnElevn 15;
BA_ "GenSigSendType" SG_ 316 ReSideRdrLeDetn39RdrDetnElevn 0;
BA_ "GenSigSendType" SG_ 316 ReSideRdrLeDetn39RdrDetnPwr 0;
BA_ "GenSigStartValue" SG_ 316 ReSideRdrLeDetn39RdrDetnRng 10050;
BA_ "GenSigSendType" SG_ 316 ReSideRdrLeDetn39RdrDetnRng 0;
BA_ "GenSigStartValue" SG_ 316 ReSideRdrLeDetn39RdrDetnRngV 4000;
BA_ "GenSigSendType" SG_ 316 ReSideRdrLeDetn39RdrDetnRngV 0;
BA_ "GenSigStartValue" SG_ 316 ReSideRdrLeDetn39RdrDetnSts 3;
BA_ "GenSigSendType" SG_ 316 ReSideRdrLeDetn39RdrDetnSts 0;
BA_ "GenSigStartValue" SG_ 316 ReSideRdrLeDetn40RdrDetnAzi 900;
BA_ "GenSigSendType" SG_ 316 ReSideRdrLeDetn40RdrDetnAzi 0;
BA_ "GenSigSendType" SG_ 316 ReSideRdrLeDetn40RdrDetnChks 0;
BA_ "GenSigFuncType" SG_ 316 ReSideRdrLeDetn40RdrDetnChks 15;
BA_ "GenSigDataID" SG_ 316 ReSideRdrLeDetn40RdrDetnChks "0x9B9";
BA_ "GenSigSendType" SG_ 316 ReSideRdrLeDetn40RdrDetnCntr 0;
BA_ "GenSigFuncType" SG_ 316 ReSideRdrLeDetn40RdrDetnCntr 16;
BA_ "GenSigSendType" SG_ 316 ReSideRdrLeDetn40RdrDetnConf 0;
BA_ "GenSigStartValue" SG_ 316 ReSideRdrLeDetn40RdrDetnElevn 15;
BA_ "GenSigSendType" SG_ 316 ReSideRdrLeDetn40RdrDetnElevn 0;
BA_ "GenSigSendType" SG_ 316 ReSideRdrLeDetn40RdrDetnPwr 0;
BA_ "GenSigStartValue" SG_ 316 ReSideRdrLeDetn40RdrDetnRng 10050;
BA_ "GenSigSendType" SG_ 316 ReSideRdrLeDetn40RdrDetnRng 0;
BA_ "GenSigStartValue" SG_ 316 ReSideRdrLeDetn40RdrDetnRngV 4000;
BA_ "GenSigSendType" SG_ 316 ReSideRdrLeDetn40RdrDetnRngV 0;
BA_ "GenSigStartValue" SG_ 316 ReSideRdrLeDetn40RdrDetnSts 3;
BA_ "GenSigSendType" SG_ 316 ReSideRdrLeDetn40RdrDetnSts 0;
BA_ "GenSigStartValue" SG_ 316 ReSideRdrLeDetn41RdrDetnAzi 900;
BA_ "GenSigSendType" SG_ 316 ReSideRdrLeDetn41RdrDetnAzi 0;
BA_ "GenSigSendType" SG_ 316 ReSideRdrLeDetn41RdrDetnChks 0;
BA_ "GenSigFuncType" SG_ 316 ReSideRdrLeDetn41RdrDetnChks 15;
BA_ "GenSigDataID" SG_ 316 ReSideRdrLeDetn41RdrDetnChks "0x9BA";
BA_ "GenSigSendType" SG_ 316 ReSideRdrLeDetn41RdrDetnCntr 0;
BA_ "GenSigFuncType" SG_ 316 ReSideRdrLeDetn41RdrDetnCntr 16;
BA_ "GenSigSendType" SG_ 316 ReSideRdrLeDetn41RdrDetnConf 0;
BA_ "GenSigStartValue" SG_ 316 ReSideRdrLeDetn41RdrDetnElevn 15;
BA_ "GenSigSendType" SG_ 316 ReSideRdrLeDetn41RdrDetnElevn 0;
BA_ "GenSigSendType" SG_ 316 ReSideRdrLeDetn41RdrDetnPwr 0;
BA_ "GenSigStartValue" SG_ 316 ReSideRdrLeDetn41RdrDetnRng 10050;
BA_ "GenSigSendType" SG_ 316 ReSideRdrLeDetn41RdrDetnRng 0;
BA_ "GenSigStartValue" SG_ 316 ReSideRdrLeDetn41RdrDetnRngV 4000;
BA_ "GenSigSendType" SG_ 316 ReSideRdrLeDetn41RdrDetnRngV 0;
BA_ "GenSigStartValue" SG_ 316 ReSideRdrLeDetn41RdrDetnSts 3;
BA_ "GenSigSendType" SG_ 316 ReSideRdrLeDetn41RdrDetnSts 0;
BA_ "GenSigStartValue" SG_ 316 ReSideRdrLeDetn42RdrDetnAzi 900;
BA_ "GenSigSendType" SG_ 316 ReSideRdrLeDetn42RdrDetnAzi 0;
BA_ "GenSigSendType" SG_ 316 ReSideRdrLeDetn42RdrDetnChks 0;
BA_ "GenSigFuncType" SG_ 316 ReSideRdrLeDetn42RdrDetnChks 15;
BA_ "GenSigDataID" SG_ 316 ReSideRdrLeDetn42RdrDetnChks "0x9BB";
BA_ "GenSigSendType" SG_ 316 ReSideRdrLeDetn42RdrDetnCntr 0;
BA_ "GenSigFuncType" SG_ 316 ReSideRdrLeDetn42RdrDetnCntr 16;
BA_ "GenSigSendType" SG_ 316 ReSideRdrLeDetn42RdrDetnConf 0;
BA_ "GenSigStartValue" SG_ 316 ReSideRdrLeDetn42RdrDetnElevn 15;
BA_ "GenSigSendType" SG_ 316 ReSideRdrLeDetn42RdrDetnElevn 0;
BA_ "GenSigSendType" SG_ 316 ReSideRdrLeDetn42RdrDetnPwr 0;
BA_ "GenSigStartValue" SG_ 316 ReSideRdrLeDetn42RdrDetnRng 10050;
BA_ "GenSigSendType" SG_ 316 ReSideRdrLeDetn42RdrDetnRng 0;
BA_ "GenSigStartValue" SG_ 316 ReSideRdrLeDetn42RdrDetnRngV 4000;
BA_ "GenSigSendType" SG_ 316 ReSideRdrLeDetn42RdrDetnRngV 0;
BA_ "GenSigStartValue" SG_ 316 ReSideRdrLeDetn42RdrDetnSts 3;
BA_ "GenSigSendType" SG_ 316 ReSideRdrLeDetn42RdrDetnSts 0;
// Frame: SODLSafetyCANFD3Frame08
BA_ "VFrameFormat" BO_ 318 14;
BA_ "GenMsgSendType" BO_ 318 0;
BA_ "GenMsgCycleTime" BO_ 318 50.000;
BA_ "GenSigStartValue" SG_ 318 ReSideRdrLeDetn43RdrDetnAzi 900;
BA_ "GenSigSendType" SG_ 318 ReSideRdrLeDetn43RdrDetnAzi 0;
BA_ "GenSigSendType" SG_ 318 ReSideRdrLeDetn43RdrDetnChks 0;
BA_ "GenSigFuncType" SG_ 318 ReSideRdrLeDetn43RdrDetnChks 15;
BA_ "GenSigDataID" SG_ 318 ReSideRdrLeDetn43RdrDetnChks "0x9BC";
BA_ "GenSigSendType" SG_ 318 ReSideRdrLeDetn43RdrDetnCntr 0;
BA_ "GenSigFuncType" SG_ 318 ReSideRdrLeDetn43RdrDetnCntr 16;
BA_ "GenSigSendType" SG_ 318 ReSideRdrLeDetn43RdrDetnConf 0;
BA_ "GenSigStartValue" SG_ 318 ReSideRdrLeDetn43RdrDetnElevn 15;
BA_ "GenSigSendType" SG_ 318 ReSideRdrLeDetn43RdrDetnElevn 0;
BA_ "GenSigSendType" SG_ 318 ReSideRdrLeDetn43RdrDetnPwr 0;
BA_ "GenSigStartValue" SG_ 318 ReSideRdrLeDetn43RdrDetnRng 10050;
BA_ "GenSigSendType" SG_ 318 ReSideRdrLeDetn43RdrDetnRng 0;
BA_ "GenSigStartValue" SG_ 318 ReSideRdrLeDetn43RdrDetnRngV 4000;
BA_ "GenSigSendType" SG_ 318 ReSideRdrLeDetn43RdrDetnRngV 0;
BA_ "GenSigStartValue" SG_ 318 ReSideRdrLeDetn43RdrDetnSts 3;
BA_ "GenSigSendType" SG_ 318 ReSideRdrLeDetn43RdrDetnSts 0;
BA_ "GenSigStartValue" SG_ 318 ReSideRdrLeDetn44RdrDetnAzi 900;
BA_ "GenSigSendType" SG_ 318 ReSideRdrLeDetn44RdrDetnAzi 0;
BA_ "GenSigSendType" SG_ 318 ReSideRdrLeDetn44RdrDetnChks 0;
BA_ "GenSigFuncType" SG_ 318 ReSideRdrLeDetn44RdrDetnChks 15;
BA_ "GenSigDataID" SG_ 318 ReSideRdrLeDetn44RdrDetnChks "0x9BD";
BA_ "GenSigSendType" SG_ 318 ReSideRdrLeDetn44RdrDetnCntr 0;
BA_ "GenSigFuncType" SG_ 318 ReSideRdrLeDetn44RdrDetnCntr 16;
BA_ "GenSigSendType" SG_ 318 ReSideRdrLeDetn44RdrDetnConf 0;
BA_ "GenSigStartValue" SG_ 318 ReSideRdrLeDetn44RdrDetnElevn 15;
BA_ "GenSigSendType" SG_ 318 ReSideRdrLeDetn44RdrDetnElevn 0;
BA_ "GenSigSendType" SG_ 318 ReSideRdrLeDetn44RdrDetnPwr 0;
BA_ "GenSigStartValue" SG_ 318 ReSideRdrLeDetn44RdrDetnRng 10050;
BA_ "GenSigSendType" SG_ 318 ReSideRdrLeDetn44RdrDetnRng 0;
BA_ "GenSigStartValue" SG_ 318 ReSideRdrLeDetn44RdrDetnRngV 4000;
BA_ "GenSigSendType" SG_ 318 ReSideRdrLeDetn44RdrDetnRngV 0;
BA_ "GenSigStartValue" SG_ 318 ReSideRdrLeDetn44RdrDetnSts 3;
BA_ "GenSigSendType" SG_ 318 ReSideRdrLeDetn44RdrDetnSts 0;
BA_ "GenSigStartValue" SG_ 318 ReSideRdrLeDetn45RdrDetnAzi 900;
BA_ "GenSigSendType" SG_ 318 ReSideRdrLeDetn45RdrDetnAzi 0;
BA_ "GenSigSendType" SG_ 318 ReSideRdrLeDetn45RdrDetnChks 0;
BA_ "GenSigFuncType" SG_ 318 ReSideRdrLeDetn45RdrDetnChks 15;
BA_ "GenSigDataID" SG_ 318 ReSideRdrLeDetn45RdrDetnChks "0x9BE";
BA_ "GenSigSendType" SG_ 318 ReSideRdrLeDetn45RdrDetnCntr 0;
BA_ "GenSigFuncType" SG_ 318 ReSideRdrLeDetn45RdrDetnCntr 16;
BA_ "GenSigSendType" SG_ 318 ReSideRdrLeDetn45RdrDetnConf 0;
BA_ "GenSigStartValue" SG_ 318 ReSideRdrLeDetn45RdrDetnElevn 15;
BA_ "GenSigSendType" SG_ 318 ReSideRdrLeDetn45RdrDetnElevn 0;
BA_ "GenSigSendType" SG_ 318 ReSideRdrLeDetn45RdrDetnPwr 0;
BA_ "GenSigStartValue" SG_ 318 ReSideRdrLeDetn45RdrDetnRng 10050;
BA_ "GenSigSendType" SG_ 318 ReSideRdrLeDetn45RdrDetnRng 0;
BA_ "GenSigStartValue" SG_ 318 ReSideRdrLeDetn45RdrDetnRngV 4000;
BA_ "GenSigSendType" SG_ 318 ReSideRdrLeDetn45RdrDetnRngV 0;
BA_ "GenSigStartValue" SG_ 318 ReSideRdrLeDetn45RdrDetnSts 3;
BA_ "GenSigSendType" SG_ 318 ReSideRdrLeDetn45RdrDetnSts 0;
BA_ "GenSigStartValue" SG_ 318 ReSideRdrLeDetn46RdrDetnAzi 900;
BA_ "GenSigSendType" SG_ 318 ReSideRdrLeDetn46RdrDetnAzi 0;
BA_ "GenSigSendType" SG_ 318 ReSideRdrLeDetn46RdrDetnChks 0;
BA_ "GenSigFuncType" SG_ 318 ReSideRdrLeDetn46RdrDetnChks 15;
BA_ "GenSigDataID" SG_ 318 ReSideRdrLeDetn46RdrDetnChks "0x9BF";
BA_ "GenSigSendType" SG_ 318 ReSideRdrLeDetn46RdrDetnCntr 0;
BA_ "GenSigFuncType" SG_ 318 ReSideRdrLeDetn46RdrDetnCntr 16;
BA_ "GenSigSendType" SG_ 318 ReSideRdrLeDetn46RdrDetnConf 0;
BA_ "GenSigStartValue" SG_ 318 ReSideRdrLeDetn46RdrDetnElevn 15;
BA_ "GenSigSendType" SG_ 318 ReSideRdrLeDetn46RdrDetnElevn 0;
BA_ "GenSigSendType" SG_ 318 ReSideRdrLeDetn46RdrDetnPwr 0;
BA_ "GenSigStartValue" SG_ 318 ReSideRdrLeDetn46RdrDetnRng 10050;
BA_ "GenSigSendType" SG_ 318 ReSideRdrLeDetn46RdrDetnRng 0;
BA_ "GenSigStartValue" SG_ 318 ReSideRdrLeDetn46RdrDetnRngV 4000;
BA_ "GenSigSendType" SG_ 318 ReSideRdrLeDetn46RdrDetnRngV 0;
BA_ "GenSigStartValue" SG_ 318 ReSideRdrLeDetn46RdrDetnSts 3;
BA_ "GenSigSendType" SG_ 318 ReSideRdrLeDetn46RdrDetnSts 0;
BA_ "GenSigStartValue" SG_ 318 ReSideRdrLeDetn47RdrDetnAzi 900;
BA_ "GenSigSendType" SG_ 318 ReSideRdrLeDetn47RdrDetnAzi 0;
BA_ "GenSigSendType" SG_ 318 ReSideRdrLeDetn47RdrDetnChks 0;
BA_ "GenSigFuncType" SG_ 318 ReSideRdrLeDetn47RdrDetnChks 15;
BA_ "GenSigDataID" SG_ 318 ReSideRdrLeDetn47RdrDetnChks "0x9C0";
BA_ "GenSigSendType" SG_ 318 ReSideRdrLeDetn47RdrDetnCntr 0;
BA_ "GenSigFuncType" SG_ 318 ReSideRdrLeDetn47RdrDetnCntr 16;
BA_ "GenSigSendType" SG_ 318 ReSideRdrLeDetn47RdrDetnConf 0;
BA_ "GenSigStartValue" SG_ 318 ReSideRdrLeDetn47RdrDetnElevn 15;
BA_ "GenSigSendType" SG_ 318 ReSideRdrLeDetn47RdrDetnElevn 0;
BA_ "GenSigSendType" SG_ 318 ReSideRdrLeDetn47RdrDetnPwr 0;
BA_ "GenSigStartValue" SG_ 318 ReSideRdrLeDetn47RdrDetnRng 10050;
BA_ "GenSigSendType" SG_ 318 ReSideRdrLeDetn47RdrDetnRng 0;
BA_ "GenSigStartValue" SG_ 318 ReSideRdrLeDetn47RdrDetnRngV 4000;
BA_ "GenSigSendType" SG_ 318 ReSideRdrLeDetn47RdrDetnRngV 0;
BA_ "GenSigStartValue" SG_ 318 ReSideRdrLeDetn47RdrDetnSts 3;
BA_ "GenSigSendType" SG_ 318 ReSideRdrLeDetn47RdrDetnSts 0;
BA_ "GenSigStartValue" SG_ 318 ReSideRdrLeDetn48RdrDetnAzi 900;
BA_ "GenSigSendType" SG_ 318 ReSideRdrLeDetn48RdrDetnAzi 0;
BA_ "GenSigSendType" SG_ 318 ReSideRdrLeDetn48RdrDetnChks 0;
BA_ "GenSigFuncType" SG_ 318 ReSideRdrLeDetn48RdrDetnChks 15;
BA_ "GenSigDataID" SG_ 318 ReSideRdrLeDetn48RdrDetnChks "0x9C1";
BA_ "GenSigSendType" SG_ 318 ReSideRdrLeDetn48RdrDetnCntr 0;
BA_ "GenSigFuncType" SG_ 318 ReSideRdrLeDetn48RdrDetnCntr 16;
BA_ "GenSigSendType" SG_ 318 ReSideRdrLeDetn48RdrDetnConf 0;
BA_ "GenSigStartValue" SG_ 318 ReSideRdrLeDetn48RdrDetnElevn 15;
BA_ "GenSigSendType" SG_ 318 ReSideRdrLeDetn48RdrDetnElevn 0;
BA_ "GenSigSendType" SG_ 318 ReSideRdrLeDetn48RdrDetnPwr 0;
BA_ "GenSigStartValue" SG_ 318 ReSideRdrLeDetn48RdrDetnRng 10050;
BA_ "GenSigSendType" SG_ 318 ReSideRdrLeDetn48RdrDetnRng 0;
BA_ "GenSigStartValue" SG_ 318 ReSideRdrLeDetn48RdrDetnRngV 4000;
BA_ "GenSigSendType" SG_ 318 ReSideRdrLeDetn48RdrDetnRngV 0;
BA_ "GenSigStartValue" SG_ 318 ReSideRdrLeDetn48RdrDetnSts 3;
BA_ "GenSigSendType" SG_ 318 ReSideRdrLeDetn48RdrDetnSts 0;
// Frame: SODLSafetyCANFD3Frame09
BA_ "VFrameFormat" BO_ 320 14;
BA_ "GenMsgSendType" BO_ 320 0;
BA_ "GenMsgCycleTime" BO_ 320 50.000;
BA_ "GenSigStartValue" SG_ 320 ReSideRdrLeDetn49RdrDetnAzi 900;
BA_ "GenSigSendType" SG_ 320 ReSideRdrLeDetn49RdrDetnAzi 0;
BA_ "GenSigSendType" SG_ 320 ReSideRdrLeDetn49RdrDetnChks 0;
BA_ "GenSigFuncType" SG_ 320 ReSideRdrLeDetn49RdrDetnChks 15;
BA_ "GenSigDataID" SG_ 320 ReSideRdrLeDetn49RdrDetnChks "0x9C2";
BA_ "GenSigSendType" SG_ 320 ReSideRdrLeDetn49RdrDetnCntr 0;
BA_ "GenSigFuncType" SG_ 320 ReSideRdrLeDetn49RdrDetnCntr 16;
BA_ "GenSigSendType" SG_ 320 ReSideRdrLeDetn49RdrDetnConf 0;
BA_ "GenSigStartValue" SG_ 320 ReSideRdrLeDetn49RdrDetnElevn 15;
BA_ "GenSigSendType" SG_ 320 ReSideRdrLeDetn49RdrDetnElevn 0;
BA_ "GenSigSendType" SG_ 320 ReSideRdrLeDetn49RdrDetnPwr 0;
BA_ "GenSigStartValue" SG_ 320 ReSideRdrLeDetn49RdrDetnRng 10050;
BA_ "GenSigSendType" SG_ 320 ReSideRdrLeDetn49RdrDetnRng 0;
BA_ "GenSigStartValue" SG_ 320 ReSideRdrLeDetn49RdrDetnRngV 4000;
BA_ "GenSigSendType" SG_ 320 ReSideRdrLeDetn49RdrDetnRngV 0;
BA_ "GenSigStartValue" SG_ 320 ReSideRdrLeDetn49RdrDetnSts 3;
BA_ "GenSigSendType" SG_ 320 ReSideRdrLeDetn49RdrDetnSts 0;
BA_ "GenSigStartValue" SG_ 320 ReSideRdrLeDetn50RdrDetnAzi 900;
BA_ "GenSigSendType" SG_ 320 ReSideRdrLeDetn50RdrDetnAzi 0;
BA_ "GenSigSendType" SG_ 320 ReSideRdrLeDetn50RdrDetnChks 0;
BA_ "GenSigFuncType" SG_ 320 ReSideRdrLeDetn50RdrDetnChks 15;
BA_ "GenSigDataID" SG_ 320 ReSideRdrLeDetn50RdrDetnChks "0x9C3";
BA_ "GenSigSendType" SG_ 320 ReSideRdrLeDetn50RdrDetnCntr 0;
BA_ "GenSigFuncType" SG_ 320 ReSideRdrLeDetn50RdrDetnCntr 16;
BA_ "GenSigSendType" SG_ 320 ReSideRdrLeDetn50RdrDetnConf 0;
BA_ "GenSigStartValue" SG_ 320 ReSideRdrLeDetn50RdrDetnElevn 15;
BA_ "GenSigSendType" SG_ 320 ReSideRdrLeDetn50RdrDetnElevn 0;
BA_ "GenSigSendType" SG_ 320 ReSideRdrLeDetn50RdrDetnPwr 0;
BA_ "GenSigStartValue" SG_ 320 ReSideRdrLeDetn50RdrDetnRng 10050;
BA_ "GenSigSendType" SG_ 320 ReSideRdrLeDetn50RdrDetnRng 0;
BA_ "GenSigStartValue" SG_ 320 ReSideRdrLeDetn50RdrDetnRngV 4000;
BA_ "GenSigSendType" SG_ 320 ReSideRdrLeDetn50RdrDetnRngV 0;
BA_ "GenSigStartValue" SG_ 320 ReSideRdrLeDetn50RdrDetnSts 3;
BA_ "GenSigSendType" SG_ 320 ReSideRdrLeDetn50RdrDetnSts 0;
BA_ "GenSigStartValue" SG_ 320 ReSideRdrLeDetn51RdrDetnAzi 900;
BA_ "GenSigSendType" SG_ 320 ReSideRdrLeDetn51RdrDetnAzi 0;
BA_ "GenSigSendType" SG_ 320 ReSideRdrLeDetn51RdrDetnChks 0;
BA_ "GenSigFuncType" SG_ 320 ReSideRdrLeDetn51RdrDetnChks 15;
BA_ "GenSigDataID" SG_ 320 ReSideRdrLeDetn51RdrDetnChks "0x9C4";
BA_ "GenSigSendType" SG_ 320 ReSideRdrLeDetn51RdrDetnCntr 0;
BA_ "GenSigFuncType" SG_ 320 ReSideRdrLeDetn51RdrDetnCntr 16;
BA_ "GenSigSendType" SG_ 320 ReSideRdrLeDetn51RdrDetnConf 0;
BA_ "GenSigStartValue" SG_ 320 ReSideRdrLeDetn51RdrDetnElevn 15;
BA_ "GenSigSendType" SG_ 320 ReSideRdrLeDetn51RdrDetnElevn 0;
BA_ "GenSigSendType" SG_ 320 ReSideRdrLeDetn51RdrDetnPwr 0;
BA_ "GenSigStartValue" SG_ 320 ReSideRdrLeDetn51RdrDetnRng 10050;
BA_ "GenSigSendType" SG_ 320 ReSideRdrLeDetn51RdrDetnRng 0;
BA_ "GenSigStartValue" SG_ 320 ReSideRdrLeDetn51RdrDetnRngV 4000;
BA_ "GenSigSendType" SG_ 320 ReSideRdrLeDetn51RdrDetnRngV 0;
BA_ "GenSigStartValue" SG_ 320 ReSideRdrLeDetn51RdrDetnSts 3;
BA_ "GenSigSendType" SG_ 320 ReSideRdrLeDetn51RdrDetnSts 0;
BA_ "GenSigStartValue" SG_ 320 ReSideRdrLeDetn52RdrDetnAzi 900;
BA_ "GenSigSendType" SG_ 320 ReSideRdrLeDetn52RdrDetnAzi 0;
BA_ "GenSigSendType" SG_ 320 ReSideRdrLeDetn52RdrDetnChks 0;
BA_ "GenSigFuncType" SG_ 320 ReSideRdrLeDetn52RdrDetnChks 15;
BA_ "GenSigDataID" SG_ 320 ReSideRdrLeDetn52RdrDetnChks "0x9C5";
BA_ "GenSigSendType" SG_ 320 ReSideRdrLeDetn52RdrDetnCntr 0;
BA_ "GenSigFuncType" SG_ 320 ReSideRdrLeDetn52RdrDetnCntr 16;
BA_ "GenSigSendType" SG_ 320 ReSideRdrLeDetn52RdrDetnConf 0;
BA_ "GenSigStartValue" SG_ 320 ReSideRdrLeDetn52RdrDetnElevn 15;
BA_ "GenSigSendType" SG_ 320 ReSideRdrLeDetn52RdrDetnElevn 0;
BA_ "GenSigSendType" SG_ 320 ReSideRdrLeDetn52RdrDetnPwr 0;
BA_ "GenSigStartValue" SG_ 320 ReSideRdrLeDetn52RdrDetnRng 10050;
BA_ "GenSigSendType" SG_ 320 ReSideRdrLeDetn52RdrDetnRng 0;
BA_ "GenSigStartValue" SG_ 320 ReSideRdrLeDetn52RdrDetnRngV 4000;
BA_ "GenSigSendType" SG_ 320 ReSideRdrLeDetn52RdrDetnRngV 0;
BA_ "GenSigStartValue" SG_ 320 ReSideRdrLeDetn52RdrDetnSts 3;
BA_ "GenSigSendType" SG_ 320 ReSideRdrLeDetn52RdrDetnSts 0;
BA_ "GenSigStartValue" SG_ 320 ReSideRdrLeDetn53RdrDetnAzi 900;
BA_ "GenSigSendType" SG_ 320 ReSideRdrLeDetn53RdrDetnAzi 0;
BA_ "GenSigSendType" SG_ 320 ReSideRdrLeDetn53RdrDetnChks 0;
BA_ "GenSigFuncType" SG_ 320 ReSideRdrLeDetn53RdrDetnChks 15;
BA_ "GenSigDataID" SG_ 320 ReSideRdrLeDetn53RdrDetnChks "0x9C6";
BA_ "GenSigSendType" SG_ 320 ReSideRdrLeDetn53RdrDetnCntr 0;
BA_ "GenSigFuncType" SG_ 320 ReSideRdrLeDetn53RdrDetnCntr 16;
BA_ "GenSigSendType" SG_ 320 ReSideRdrLeDetn53RdrDetnConf 0;
BA_ "GenSigStartValue" SG_ 320 ReSideRdrLeDetn53RdrDetnElevn 15;
BA_ "GenSigSendType" SG_ 320 ReSideRdrLeDetn53RdrDetnElevn 0;
BA_ "GenSigSendType" SG_ 320 ReSideRdrLeDetn53RdrDetnPwr 0;
BA_ "GenSigStartValue" SG_ 320 ReSideRdrLeDetn53RdrDetnRng 10050;
BA_ "GenSigSendType" SG_ 320 ReSideRdrLeDetn53RdrDetnRng 0;
BA_ "GenSigStartValue" SG_ 320 ReSideRdrLeDetn53RdrDetnRngV 4000;
BA_ "GenSigSendType" SG_ 320 ReSideRdrLeDetn53RdrDetnRngV 0;
BA_ "GenSigStartValue" SG_ 320 ReSideRdrLeDetn53RdrDetnSts 3;
BA_ "GenSigSendType" SG_ 320 ReSideRdrLeDetn53RdrDetnSts 0;
BA_ "GenSigStartValue" SG_ 320 ReSideRdrLeDetn54RdrDetnAzi 900;
BA_ "GenSigSendType" SG_ 320 ReSideRdrLeDetn54RdrDetnAzi 0;
BA_ "GenSigSendType" SG_ 320 ReSideRdrLeDetn54RdrDetnChks 0;
BA_ "GenSigFuncType" SG_ 320 ReSideRdrLeDetn54RdrDetnChks 15;
BA_ "GenSigDataID" SG_ 320 ReSideRdrLeDetn54RdrDetnChks "0x9C7";
BA_ "GenSigSendType" SG_ 320 ReSideRdrLeDetn54RdrDetnCntr 0;
BA_ "GenSigFuncType" SG_ 320 ReSideRdrLeDetn54RdrDetnCntr 16;
BA_ "GenSigSendType" SG_ 320 ReSideRdrLeDetn54RdrDetnConf 0;
BA_ "GenSigStartValue" SG_ 320 ReSideRdrLeDetn54RdrDetnElevn 15;
BA_ "GenSigSendType" SG_ 320 ReSideRdrLeDetn54RdrDetnElevn 0;
BA_ "GenSigSendType" SG_ 320 ReSideRdrLeDetn54RdrDetnPwr 0;
BA_ "GenSigStartValue" SG_ 320 ReSideRdrLeDetn54RdrDetnRng 10050;
BA_ "GenSigSendType" SG_ 320 ReSideRdrLeDetn54RdrDetnRng 0;
BA_ "GenSigStartValue" SG_ 320 ReSideRdrLeDetn54RdrDetnRngV 4000;
BA_ "GenSigSendType" SG_ 320 ReSideRdrLeDetn54RdrDetnRngV 0;
BA_ "GenSigStartValue" SG_ 320 ReSideRdrLeDetn54RdrDetnSts 3;
BA_ "GenSigSendType" SG_ 320 ReSideRdrLeDetn54RdrDetnSts 0;
// Frame: SODLSafetyCANFD3Frame10
BA_ "VFrameFormat" BO_ 322 14;
BA_ "GenMsgSendType" BO_ 322 0;
BA_ "GenMsgCycleTime" BO_ 322 50.000;
BA_ "GenSigStartValue" SG_ 322 ReSideRdrLeDetn55RdrDetnAzi 900;
BA_ "GenSigSendType" SG_ 322 ReSideRdrLeDetn55RdrDetnAzi 0;
BA_ "GenSigSendType" SG_ 322 ReSideRdrLeDetn55RdrDetnChks 0;
BA_ "GenSigFuncType" SG_ 322 ReSideRdrLeDetn55RdrDetnChks 15;
BA_ "GenSigDataID" SG_ 322 ReSideRdrLeDetn55RdrDetnChks "0x9C8";
BA_ "GenSigSendType" SG_ 322 ReSideRdrLeDetn55RdrDetnCntr 0;
BA_ "GenSigFuncType" SG_ 322 ReSideRdrLeDetn55RdrDetnCntr 16;
BA_ "GenSigSendType" SG_ 322 ReSideRdrLeDetn55RdrDetnConf 0;
BA_ "GenSigStartValue" SG_ 322 ReSideRdrLeDetn55RdrDetnElevn 15;
BA_ "GenSigSendType" SG_ 322 ReSideRdrLeDetn55RdrDetnElevn 0;
BA_ "GenSigSendType" SG_ 322 ReSideRdrLeDetn55RdrDetnPwr 0;
BA_ "GenSigStartValue" SG_ 322 ReSideRdrLeDetn55RdrDetnRng 10050;
BA_ "GenSigSendType" SG_ 322 ReSideRdrLeDetn55RdrDetnRng 0;
BA_ "GenSigStartValue" SG_ 322 ReSideRdrLeDetn55RdrDetnRngV 4000;
BA_ "GenSigSendType" SG_ 322 ReSideRdrLeDetn55RdrDetnRngV 0;
BA_ "GenSigStartValue" SG_ 322 ReSideRdrLeDetn55RdrDetnSts 3;
BA_ "GenSigSendType" SG_ 322 ReSideRdrLeDetn55RdrDetnSts 0;
BA_ "GenSigStartValue" SG_ 322 ReSideRdrLeDetn56RdrDetnAzi 900;
BA_ "GenSigSendType" SG_ 322 ReSideRdrLeDetn56RdrDetnAzi 0;
BA_ "GenSigSendType" SG_ 322 ReSideRdrLeDetn56RdrDetnChks 0;
BA_ "GenSigFuncType" SG_ 322 ReSideRdrLeDetn56RdrDetnChks 15;
BA_ "GenSigDataID" SG_ 322 ReSideRdrLeDetn56RdrDetnChks "0x9C9";
BA_ "GenSigSendType" SG_ 322 ReSideRdrLeDetn56RdrDetnCntr 0;
BA_ "GenSigFuncType" SG_ 322 ReSideRdrLeDetn56RdrDetnCntr 16;
BA_ "GenSigSendType" SG_ 322 ReSideRdrLeDetn56RdrDetnConf 0;
BA_ "GenSigStartValue" SG_ 322 ReSideRdrLeDetn56RdrDetnElevn 15;
BA_ "GenSigSendType" SG_ 322 ReSideRdrLeDetn56RdrDetnElevn 0;
BA_ "GenSigSendType" SG_ 322 ReSideRdrLeDetn56RdrDetnPwr 0;
BA_ "GenSigStartValue" SG_ 322 ReSideRdrLeDetn56RdrDetnRng 10050;
BA_ "GenSigSendType" SG_ 322 ReSideRdrLeDetn56RdrDetnRng 0;
BA_ "GenSigStartValue" SG_ 322 ReSideRdrLeDetn56RdrDetnRngV 4000;
BA_ "GenSigSendType" SG_ 322 ReSideRdrLeDetn56RdrDetnRngV 0;
BA_ "GenSigStartValue" SG_ 322 ReSideRdrLeDetn56RdrDetnSts 3;
BA_ "GenSigSendType" SG_ 322 ReSideRdrLeDetn56RdrDetnSts 0;
BA_ "GenSigStartValue" SG_ 322 ReSideRdrLeDetn57RdrDetnAzi 900;
BA_ "GenSigSendType" SG_ 322 ReSideRdrLeDetn57RdrDetnAzi 0;
BA_ "GenSigSendType" SG_ 322 ReSideRdrLeDetn57RdrDetnChks 0;
BA_ "GenSigFuncType" SG_ 322 ReSideRdrLeDetn57RdrDetnChks 15;
BA_ "GenSigDataID" SG_ 322 ReSideRdrLeDetn57RdrDetnChks "0x9CA";
BA_ "GenSigSendType" SG_ 322 ReSideRdrLeDetn57RdrDetnCntr 0;
BA_ "GenSigFuncType" SG_ 322 ReSideRdrLeDetn57RdrDetnCntr 16;
BA_ "GenSigSendType" SG_ 322 ReSideRdrLeDetn57RdrDetnConf 0;
BA_ "GenSigStartValue" SG_ 322 ReSideRdrLeDetn57RdrDetnElevn 15;
BA_ "GenSigSendType" SG_ 322 ReSideRdrLeDetn57RdrDetnElevn 0;
BA_ "GenSigSendType" SG_ 322 ReSideRdrLeDetn57RdrDetnPwr 0;
BA_ "GenSigStartValue" SG_ 322 ReSideRdrLeDetn57RdrDetnRng 10050;
BA_ "GenSigSendType" SG_ 322 ReSideRdrLeDetn57RdrDetnRng 0;
BA_ "GenSigStartValue" SG_ 322 ReSideRdrLeDetn57RdrDetnRngV 4000;
BA_ "GenSigSendType" SG_ 322 ReSideRdrLeDetn57RdrDetnRngV 0;
BA_ "GenSigStartValue" SG_ 322 ReSideRdrLeDetn57RdrDetnSts 3;
BA_ "GenSigSendType" SG_ 322 ReSideRdrLeDetn57RdrDetnSts 0;
BA_ "GenSigStartValue" SG_ 322 ReSideRdrLeDetn58RdrDetnAzi 900;
BA_ "GenSigSendType" SG_ 322 ReSideRdrLeDetn58RdrDetnAzi 0;
BA_ "GenSigSendType" SG_ 322 ReSideRdrLeDetn58RdrDetnChks 0;
BA_ "GenSigFuncType" SG_ 322 ReSideRdrLeDetn58RdrDetnChks 15;
BA_ "GenSigDataID" SG_ 322 ReSideRdrLeDetn58RdrDetnChks "0x9CB";
BA_ "GenSigSendType" SG_ 322 ReSideRdrLeDetn58RdrDetnCntr 0;
BA_ "GenSigFuncType" SG_ 322 ReSideRdrLeDetn58RdrDetnCntr 16;
BA_ "GenSigSendType" SG_ 322 ReSideRdrLeDetn58RdrDetnConf 0;
BA_ "GenSigStartValue" SG_ 322 ReSideRdrLeDetn58RdrDetnElevn 15;
BA_ "GenSigSendType" SG_ 322 ReSideRdrLeDetn58RdrDetnElevn 0;
BA_ "GenSigSendType" SG_ 322 ReSideRdrLeDetn58RdrDetnPwr 0;
BA_ "GenSigStartValue" SG_ 322 ReSideRdrLeDetn58RdrDetnRng 10050;
BA_ "GenSigSendType" SG_ 322 ReSideRdrLeDetn58RdrDetnRng 0;
BA_ "GenSigStartValue" SG_ 322 ReSideRdrLeDetn58RdrDetnRngV 4000;
BA_ "GenSigSendType" SG_ 322 ReSideRdrLeDetn58RdrDetnRngV 0;
BA_ "GenSigStartValue" SG_ 322 ReSideRdrLeDetn58RdrDetnSts 3;
BA_ "GenSigSendType" SG_ 322 ReSideRdrLeDetn58RdrDetnSts 0;
BA_ "GenSigStartValue" SG_ 322 ReSideRdrLeDetn59RdrDetnAzi 900;
BA_ "GenSigSendType" SG_ 322 ReSideRdrLeDetn59RdrDetnAzi 0;
BA_ "GenSigSendType" SG_ 322 ReSideRdrLeDetn59RdrDetnChks 0;
BA_ "GenSigFuncType" SG_ 322 ReSideRdrLeDetn59RdrDetnChks 15;
BA_ "GenSigDataID" SG_ 322 ReSideRdrLeDetn59RdrDetnChks "0x9CC";
BA_ "GenSigSendType" SG_ 322 ReSideRdrLeDetn59RdrDetnCntr 0;
BA_ "GenSigFuncType" SG_ 322 ReSideRdrLeDetn59RdrDetnCntr 16;
BA_ "GenSigSendType" SG_ 322 ReSideRdrLeDetn59RdrDetnConf 0;
BA_ "GenSigStartValue" SG_ 322 ReSideRdrLeDetn59RdrDetnElevn 15;
BA_ "GenSigSendType" SG_ 322 ReSideRdrLeDetn59RdrDetnElevn 0;
BA_ "GenSigSendType" SG_ 322 ReSideRdrLeDetn59RdrDetnPwr 0;
BA_ "GenSigStartValue" SG_ 322 ReSideRdrLeDetn59RdrDetnRng 10050;
BA_ "GenSigSendType" SG_ 322 ReSideRdrLeDetn59RdrDetnRng 0;
BA_ "GenSigStartValue" SG_ 322 ReSideRdrLeDetn59RdrDetnRngV 4000;
BA_ "GenSigSendType" SG_ 322 ReSideRdrLeDetn59RdrDetnRngV 0;
BA_ "GenSigStartValue" SG_ 322 ReSideRdrLeDetn59RdrDetnSts 3;
BA_ "GenSigSendType" SG_ 322 ReSideRdrLeDetn59RdrDetnSts 0;
BA_ "GenSigStartValue" SG_ 322 ReSideRdrLeDetn60RdrDetnAzi 900;
BA_ "GenSigSendType" SG_ 322 ReSideRdrLeDetn60RdrDetnAzi 0;
BA_ "GenSigSendType" SG_ 322 ReSideRdrLeDetn60RdrDetnChks 0;
BA_ "GenSigFuncType" SG_ 322 ReSideRdrLeDetn60RdrDetnChks 15;
BA_ "GenSigDataID" SG_ 322 ReSideRdrLeDetn60RdrDetnChks "0x9CD";
BA_ "GenSigSendType" SG_ 322 ReSideRdrLeDetn60RdrDetnCntr 0;
BA_ "GenSigFuncType" SG_ 322 ReSideRdrLeDetn60RdrDetnCntr 16;
BA_ "GenSigSendType" SG_ 322 ReSideRdrLeDetn60RdrDetnConf 0;
BA_ "GenSigStartValue" SG_ 322 ReSideRdrLeDetn60RdrDetnElevn 15;
BA_ "GenSigSendType" SG_ 322 ReSideRdrLeDetn60RdrDetnElevn 0;
BA_ "GenSigSendType" SG_ 322 ReSideRdrLeDetn60RdrDetnPwr 0;
BA_ "GenSigStartValue" SG_ 322 ReSideRdrLeDetn60RdrDetnRng 10050;
BA_ "GenSigSendType" SG_ 322 ReSideRdrLeDetn60RdrDetnRng 0;
BA_ "GenSigStartValue" SG_ 322 ReSideRdrLeDetn60RdrDetnRngV 4000;
BA_ "GenSigSendType" SG_ 322 ReSideRdrLeDetn60RdrDetnRngV 0;
BA_ "GenSigStartValue" SG_ 322 ReSideRdrLeDetn60RdrDetnSts 3;
BA_ "GenSigSendType" SG_ 322 ReSideRdrLeDetn60RdrDetnSts 0;
// Frame: SODLSafetyCANFD3Frame11
BA_ "VFrameFormat" BO_ 324 14;
BA_ "GenMsgSendType" BO_ 324 0;
BA_ "GenMsgCycleTime" BO_ 324 50.000;
BA_ "GenSigStartValue" SG_ 324 ReSideRdrLeDetn61RdrDetnAzi 900;
BA_ "GenSigSendType" SG_ 324 ReSideRdrLeDetn61RdrDetnAzi 0;
BA_ "GenSigSendType" SG_ 324 ReSideRdrLeDetn61RdrDetnChks 0;
BA_ "GenSigFuncType" SG_ 324 ReSideRdrLeDetn61RdrDetnChks 15;
BA_ "GenSigDataID" SG_ 324 ReSideRdrLeDetn61RdrDetnChks "0x9CE";
BA_ "GenSigSendType" SG_ 324 ReSideRdrLeDetn61RdrDetnCntr 0;
BA_ "GenSigFuncType" SG_ 324 ReSideRdrLeDetn61RdrDetnCntr 16;
BA_ "GenSigSendType" SG_ 324 ReSideRdrLeDetn61RdrDetnConf 0;
BA_ "GenSigStartValue" SG_ 324 ReSideRdrLeDetn61RdrDetnElevn 15;
BA_ "GenSigSendType" SG_ 324 ReSideRdrLeDetn61RdrDetnElevn 0;
BA_ "GenSigSendType" SG_ 324 ReSideRdrLeDetn61RdrDetnPwr 0;
BA_ "GenSigStartValue" SG_ 324 ReSideRdrLeDetn61RdrDetnRng 10050;
BA_ "GenSigSendType" SG_ 324 ReSideRdrLeDetn61RdrDetnRng 0;
BA_ "GenSigStartValue" SG_ 324 ReSideRdrLeDetn61RdrDetnRngV 4000;
BA_ "GenSigSendType" SG_ 324 ReSideRdrLeDetn61RdrDetnRngV 0;
BA_ "GenSigStartValue" SG_ 324 ReSideRdrLeDetn61RdrDetnSts 3;
BA_ "GenSigSendType" SG_ 324 ReSideRdrLeDetn61RdrDetnSts 0;
BA_ "GenSigStartValue" SG_ 324 ReSideRdrLeDetn62RdrDetnAzi 900;
BA_ "GenSigSendType" SG_ 324 ReSideRdrLeDetn62RdrDetnAzi 0;
BA_ "GenSigSendType" SG_ 324 ReSideRdrLeDetn62RdrDetnChks 0;
BA_ "GenSigFuncType" SG_ 324 ReSideRdrLeDetn62RdrDetnChks 15;
BA_ "GenSigDataID" SG_ 324 ReSideRdrLeDetn62RdrDetnChks "0x9CF";
BA_ "GenSigSendType" SG_ 324 ReSideRdrLeDetn62RdrDetnCntr 0;
BA_ "GenSigFuncType" SG_ 324 ReSideRdrLeDetn62RdrDetnCntr 16;
BA_ "GenSigSendType" SG_ 324 ReSideRdrLeDetn62RdrDetnConf 0;
BA_ "GenSigStartValue" SG_ 324 ReSideRdrLeDetn62RdrDetnElevn 15;
BA_ "GenSigSendType" SG_ 324 ReSideRdrLeDetn62RdrDetnElevn 0;
BA_ "GenSigSendType" SG_ 324 ReSideRdrLeDetn62RdrDetnPwr 0;
BA_ "GenSigStartValue" SG_ 324 ReSideRdrLeDetn62RdrDetnRng 10050;
BA_ "GenSigSendType" SG_ 324 ReSideRdrLeDetn62RdrDetnRng 0;
BA_ "GenSigStartValue" SG_ 324 ReSideRdrLeDetn62RdrDetnRngV 4000;
BA_ "GenSigSendType" SG_ 324 ReSideRdrLeDetn62RdrDetnRngV 0;
BA_ "GenSigStartValue" SG_ 324 ReSideRdrLeDetn62RdrDetnSts 3;
BA_ "GenSigSendType" SG_ 324 ReSideRdrLeDetn62RdrDetnSts 0;
BA_ "GenSigStartValue" SG_ 324 ReSideRdrLeDetn63RdrDetnAzi 900;
BA_ "GenSigSendType" SG_ 324 ReSideRdrLeDetn63RdrDetnAzi 0;
BA_ "GenSigSendType" SG_ 324 ReSideRdrLeDetn63RdrDetnChks 0;
BA_ "GenSigFuncType" SG_ 324 ReSideRdrLeDetn63RdrDetnChks 15;
BA_ "GenSigDataID" SG_ 324 ReSideRdrLeDetn63RdrDetnChks "0x9D0";
BA_ "GenSigSendType" SG_ 324 ReSideRdrLeDetn63RdrDetnCntr 0;
BA_ "GenSigFuncType" SG_ 324 ReSideRdrLeDetn63RdrDetnCntr 16;
BA_ "GenSigSendType" SG_ 324 ReSideRdrLeDetn63RdrDetnConf 0;
BA_ "GenSigStartValue" SG_ 324 ReSideRdrLeDetn63RdrDetnElevn 15;
BA_ "GenSigSendType" SG_ 324 ReSideRdrLeDetn63RdrDetnElevn 0;
BA_ "GenSigSendType" SG_ 324 ReSideRdrLeDetn63RdrDetnPwr 0;
BA_ "GenSigStartValue" SG_ 324 ReSideRdrLeDetn63RdrDetnRng 10050;
BA_ "GenSigSendType" SG_ 324 ReSideRdrLeDetn63RdrDetnRng 0;
BA_ "GenSigStartValue" SG_ 324 ReSideRdrLeDetn63RdrDetnRngV 4000;
BA_ "GenSigSendType" SG_ 324 ReSideRdrLeDetn63RdrDetnRngV 0;
BA_ "GenSigStartValue" SG_ 324 ReSideRdrLeDetn63RdrDetnSts 3;
BA_ "GenSigSendType" SG_ 324 ReSideRdrLeDetn63RdrDetnSts 0;
BA_ "GenSigStartValue" SG_ 324 ReSideRdrLeDetn64RdrDetnAzi 900;
BA_ "GenSigSendType" SG_ 324 ReSideRdrLeDetn64RdrDetnAzi 0;
BA_ "GenSigSendType" SG_ 324 ReSideRdrLeDetn64RdrDetnChks 0;
BA_ "GenSigFuncType" SG_ 324 ReSideRdrLeDetn64RdrDetnChks 15;
BA_ "GenSigDataID" SG_ 324 ReSideRdrLeDetn64RdrDetnChks "0x9D1";
BA_ "GenSigSendType" SG_ 324 ReSideRdrLeDetn64RdrDetnCntr 0;
BA_ "GenSigFuncType" SG_ 324 ReSideRdrLeDetn64RdrDetnCntr 16;
BA_ "GenSigSendType" SG_ 324 ReSideRdrLeDetn64RdrDetnConf 0;
BA_ "GenSigStartValue" SG_ 324 ReSideRdrLeDetn64RdrDetnElevn 15;
BA_ "GenSigSendType" SG_ 324 ReSideRdrLeDetn64RdrDetnElevn 0;
BA_ "GenSigSendType" SG_ 324 ReSideRdrLeDetn64RdrDetnPwr 0;
BA_ "GenSigStartValue" SG_ 324 ReSideRdrLeDetn64RdrDetnRng 10050;
BA_ "GenSigSendType" SG_ 324 ReSideRdrLeDetn64RdrDetnRng 0;
BA_ "GenSigStartValue" SG_ 324 ReSideRdrLeDetn64RdrDetnRngV 4000;
BA_ "GenSigSendType" SG_ 324 ReSideRdrLeDetn64RdrDetnRngV 0;
BA_ "GenSigStartValue" SG_ 324 ReSideRdrLeDetn64RdrDetnSts 3;
BA_ "GenSigSendType" SG_ 324 ReSideRdrLeDetn64RdrDetnSts 0;
BA_ "GenSigStartValue" SG_ 324 ReSideRdrLeDetn65RdrDetnAzi 900;
BA_ "GenSigSendType" SG_ 324 ReSideRdrLeDetn65RdrDetnAzi 0;
BA_ "GenSigSendType" SG_ 324 ReSideRdrLeDetn65RdrDetnChks 0;
BA_ "GenSigFuncType" SG_ 324 ReSideRdrLeDetn65RdrDetnChks 15;
BA_ "GenSigDataID" SG_ 324 ReSideRdrLeDetn65RdrDetnChks "0x9D2";
BA_ "GenSigSendType" SG_ 324 ReSideRdrLeDetn65RdrDetnCntr 0;
BA_ "GenSigFuncType" SG_ 324 ReSideRdrLeDetn65RdrDetnCntr 16;
BA_ "GenSigSendType" SG_ 324 ReSideRdrLeDetn65RdrDetnConf 0;
BA_ "GenSigStartValue" SG_ 324 ReSideRdrLeDetn65RdrDetnElevn 15;
BA_ "GenSigSendType" SG_ 324 ReSideRdrLeDetn65RdrDetnElevn 0;
BA_ "GenSigSendType" SG_ 324 ReSideRdrLeDetn65RdrDetnPwr 0;
BA_ "GenSigStartValue" SG_ 324 ReSideRdrLeDetn65RdrDetnRng 10050;
BA_ "GenSigSendType" SG_ 324 ReSideRdrLeDetn65RdrDetnRng 0;
BA_ "GenSigStartValue" SG_ 324 ReSideRdrLeDetn65RdrDetnRngV 4000;
BA_ "GenSigSendType" SG_ 324 ReSideRdrLeDetn65RdrDetnRngV 0;
BA_ "GenSigStartValue" SG_ 324 ReSideRdrLeDetn65RdrDetnSts 3;
BA_ "GenSigSendType" SG_ 324 ReSideRdrLeDetn65RdrDetnSts 0;
BA_ "GenSigStartValue" SG_ 324 ReSideRdrLeDetn66RdrDetnAzi 900;
BA_ "GenSigSendType" SG_ 324 ReSideRdrLeDetn66RdrDetnAzi 0;
BA_ "GenSigSendType" SG_ 324 ReSideRdrLeDetn66RdrDetnChks 0;
BA_ "GenSigFuncType" SG_ 324 ReSideRdrLeDetn66RdrDetnChks 15;
BA_ "GenSigDataID" SG_ 324 ReSideRdrLeDetn66RdrDetnChks "0x9D3";
BA_ "GenSigSendType" SG_ 324 ReSideRdrLeDetn66RdrDetnCntr 0;
BA_ "GenSigFuncType" SG_ 324 ReSideRdrLeDetn66RdrDetnCntr 16;
BA_ "GenSigSendType" SG_ 324 ReSideRdrLeDetn66RdrDetnConf 0;
BA_ "GenSigStartValue" SG_ 324 ReSideRdrLeDetn66RdrDetnElevn 15;
BA_ "GenSigSendType" SG_ 324 ReSideRdrLeDetn66RdrDetnElevn 0;
BA_ "GenSigSendType" SG_ 324 ReSideRdrLeDetn66RdrDetnPwr 0;
BA_ "GenSigStartValue" SG_ 324 ReSideRdrLeDetn66RdrDetnRng 10050;
BA_ "GenSigSendType" SG_ 324 ReSideRdrLeDetn66RdrDetnRng 0;
BA_ "GenSigStartValue" SG_ 324 ReSideRdrLeDetn66RdrDetnRngV 4000;
BA_ "GenSigSendType" SG_ 324 ReSideRdrLeDetn66RdrDetnRngV 0;
BA_ "GenSigStartValue" SG_ 324 ReSideRdrLeDetn66RdrDetnSts 3;
BA_ "GenSigSendType" SG_ 324 ReSideRdrLeDetn66RdrDetnSts 0;
// Frame: SODLSafetyCANFD3Frame12
BA_ "VFrameFormat" BO_ 326 14;
BA_ "GenMsgSendType" BO_ 326 0;
BA_ "GenMsgCycleTime" BO_ 326 50.000;
BA_ "GenSigStartValue" SG_ 326 ReSideRdrLeDetn67RdrDetnAzi 900;
BA_ "GenSigSendType" SG_ 326 ReSideRdrLeDetn67RdrDetnAzi 0;
BA_ "GenSigSendType" SG_ 326 ReSideRdrLeDetn67RdrDetnChks 0;
BA_ "GenSigFuncType" SG_ 326 ReSideRdrLeDetn67RdrDetnChks 15;
BA_ "GenSigDataID" SG_ 326 ReSideRdrLeDetn67RdrDetnChks "0x9D4";
BA_ "GenSigSendType" SG_ 326 ReSideRdrLeDetn67RdrDetnCntr 0;
BA_ "GenSigFuncType" SG_ 326 ReSideRdrLeDetn67RdrDetnCntr 16;
BA_ "GenSigSendType" SG_ 326 ReSideRdrLeDetn67RdrDetnConf 0;
BA_ "GenSigStartValue" SG_ 326 ReSideRdrLeDetn67RdrDetnElevn 15;
BA_ "GenSigSendType" SG_ 326 ReSideRdrLeDetn67RdrDetnElevn 0;
BA_ "GenSigSendType" SG_ 326 ReSideRdrLeDetn67RdrDetnPwr 0;
BA_ "GenSigStartValue" SG_ 326 ReSideRdrLeDetn67RdrDetnRng 10050;
BA_ "GenSigSendType" SG_ 326 ReSideRdrLeDetn67RdrDetnRng 0;
BA_ "GenSigStartValue" SG_ 326 ReSideRdrLeDetn67RdrDetnRngV 4000;
BA_ "GenSigSendType" SG_ 326 ReSideRdrLeDetn67RdrDetnRngV 0;
BA_ "GenSigStartValue" SG_ 326 ReSideRdrLeDetn67RdrDetnSts 3;
BA_ "GenSigSendType" SG_ 326 ReSideRdrLeDetn67RdrDetnSts 0;
BA_ "GenSigStartValue" SG_ 326 ReSideRdrLeDetn68RdrDetnAzi 900;
BA_ "GenSigSendType" SG_ 326 ReSideRdrLeDetn68RdrDetnAzi 0;
BA_ "GenSigSendType" SG_ 326 ReSideRdrLeDetn68RdrDetnChks 0;
BA_ "GenSigFuncType" SG_ 326 ReSideRdrLeDetn68RdrDetnChks 15;
BA_ "GenSigDataID" SG_ 326 ReSideRdrLeDetn68RdrDetnChks "0x9D5";
BA_ "GenSigSendType" SG_ 326 ReSideRdrLeDetn68RdrDetnCntr 0;
BA_ "GenSigFuncType" SG_ 326 ReSideRdrLeDetn68RdrDetnCntr 16;
BA_ "GenSigSendType" SG_ 326 ReSideRdrLeDetn68RdrDetnConf 0;
BA_ "GenSigStartValue" SG_ 326 ReSideRdrLeDetn68RdrDetnElevn 15;
BA_ "GenSigSendType" SG_ 326 ReSideRdrLeDetn68RdrDetnElevn 0;
BA_ "GenSigSendType" SG_ 326 ReSideRdrLeDetn68RdrDetnPwr 0;
BA_ "GenSigStartValue" SG_ 326 ReSideRdrLeDetn68RdrDetnRng 10050;
BA_ "GenSigSendType" SG_ 326 ReSideRdrLeDetn68RdrDetnRng 0;
BA_ "GenSigStartValue" SG_ 326 ReSideRdrLeDetn68RdrDetnRngV 4000;
BA_ "GenSigSendType" SG_ 326 ReSideRdrLeDetn68RdrDetnRngV 0;
BA_ "GenSigStartValue" SG_ 326 ReSideRdrLeDetn68RdrDetnSts 3;
BA_ "GenSigSendType" SG_ 326 ReSideRdrLeDetn68RdrDetnSts 0;
BA_ "GenSigStartValue" SG_ 326 ReSideRdrLeDetn69RdrDetnAzi 900;
BA_ "GenSigSendType" SG_ 326 ReSideRdrLeDetn69RdrDetnAzi 0;
BA_ "GenSigSendType" SG_ 326 ReSideRdrLeDetn69RdrDetnChks 0;
BA_ "GenSigFuncType" SG_ 326 ReSideRdrLeDetn69RdrDetnChks 15;
BA_ "GenSigDataID" SG_ 326 ReSideRdrLeDetn69RdrDetnChks "0x9D6";
BA_ "GenSigSendType" SG_ 326 ReSideRdrLeDetn69RdrDetnCntr 0;
BA_ "GenSigFuncType" SG_ 326 ReSideRdrLeDetn69RdrDetnCntr 16;
BA_ "GenSigSendType" SG_ 326 ReSideRdrLeDetn69RdrDetnConf 0;
BA_ "GenSigStartValue" SG_ 326 ReSideRdrLeDetn69RdrDetnElevn 15;
BA_ "GenSigSendType" SG_ 326 ReSideRdrLeDetn69RdrDetnElevn 0;
BA_ "GenSigSendType" SG_ 326 ReSideRdrLeDetn69RdrDetnPwr 0;
BA_ "GenSigStartValue" SG_ 326 ReSideRdrLeDetn69RdrDetnRng 10050;
BA_ "GenSigSendType" SG_ 326 ReSideRdrLeDetn69RdrDetnRng 0;
BA_ "GenSigStartValue" SG_ 326 ReSideRdrLeDetn69RdrDetnRngV 4000;
BA_ "GenSigSendType" SG_ 326 ReSideRdrLeDetn69RdrDetnRngV 0;
BA_ "GenSigStartValue" SG_ 326 ReSideRdrLeDetn69RdrDetnSts 3;
BA_ "GenSigSendType" SG_ 326 ReSideRdrLeDetn69RdrDetnSts 0;
BA_ "GenSigStartValue" SG_ 326 ReSideRdrLeDetn70RdrDetnAzi 900;
BA_ "GenSigSendType" SG_ 326 ReSideRdrLeDetn70RdrDetnAzi 0;
BA_ "GenSigSendType" SG_ 326 ReSideRdrLeDetn70RdrDetnChks 0;
BA_ "GenSigFuncType" SG_ 326 ReSideRdrLeDetn70RdrDetnChks 15;
BA_ "GenSigDataID" SG_ 326 ReSideRdrLeDetn70RdrDetnChks "0x9D7";
BA_ "GenSigSendType" SG_ 326 ReSideRdrLeDetn70RdrDetnCntr 0;
BA_ "GenSigFuncType" SG_ 326 ReSideRdrLeDetn70RdrDetnCntr 16;
BA_ "GenSigSendType" SG_ 326 ReSideRdrLeDetn70RdrDetnConf 0;
BA_ "GenSigStartValue" SG_ 326 ReSideRdrLeDetn70RdrDetnElevn 15;
BA_ "GenSigSendType" SG_ 326 ReSideRdrLeDetn70RdrDetnElevn 0;
BA_ "GenSigSendType" SG_ 326 ReSideRdrLeDetn70RdrDetnPwr 0;
BA_ "GenSigStartValue" SG_ 326 ReSideRdrLeDetn70RdrDetnRng 10050;
BA_ "GenSigSendType" SG_ 326 ReSideRdrLeDetn70RdrDetnRng 0;
BA_ "GenSigStartValue" SG_ 326 ReSideRdrLeDetn70RdrDetnRngV 4000;
BA_ "GenSigSendType" SG_ 326 ReSideRdrLeDetn70RdrDetnRngV 0;
BA_ "GenSigStartValue" SG_ 326 ReSideRdrLeDetn70RdrDetnSts 3;
BA_ "GenSigSendType" SG_ 326 ReSideRdrLeDetn70RdrDetnSts 0;
BA_ "GenSigStartValue" SG_ 326 ReSideRdrLeDetn71RdrDetnAzi 900;
BA_ "GenSigSendType" SG_ 326 ReSideRdrLeDetn71RdrDetnAzi 0;
BA_ "GenSigSendType" SG_ 326 ReSideRdrLeDetn71RdrDetnChks 0;
BA_ "GenSigFuncType" SG_ 326 ReSideRdrLeDetn71RdrDetnChks 15;
BA_ "GenSigDataID" SG_ 326 ReSideRdrLeDetn71RdrDetnChks "0x9D8";
BA_ "GenSigSendType" SG_ 326 ReSideRdrLeDetn71RdrDetnCntr 0;
BA_ "GenSigFuncType" SG_ 326 ReSideRdrLeDetn71RdrDetnCntr 16;
BA_ "GenSigSendType" SG_ 326 ReSideRdrLeDetn71RdrDetnConf 0;
BA_ "GenSigStartValue" SG_ 326 ReSideRdrLeDetn71RdrDetnElevn 15;
BA_ "GenSigSendType" SG_ 326 ReSideRdrLeDetn71RdrDetnElevn 0;
BA_ "GenSigSendType" SG_ 326 ReSideRdrLeDetn71RdrDetnPwr 0;
BA_ "GenSigStartValue" SG_ 326 ReSideRdrLeDetn71RdrDetnRng 10050;
BA_ "GenSigSendType" SG_ 326 ReSideRdrLeDetn71RdrDetnRng 0;
BA_ "GenSigStartValue" SG_ 326 ReSideRdrLeDetn71RdrDetnRngV 4000;
BA_ "GenSigSendType" SG_ 326 ReSideRdrLeDetn71RdrDetnRngV 0;
BA_ "GenSigStartValue" SG_ 326 ReSideRdrLeDetn71RdrDetnSts 3;
BA_ "GenSigSendType" SG_ 326 ReSideRdrLeDetn71RdrDetnSts 0;
BA_ "GenSigStartValue" SG_ 326 ReSideRdrLeDetn72RdrDetnAzi 900;
BA_ "GenSigSendType" SG_ 326 ReSideRdrLeDetn72RdrDetnAzi 0;
BA_ "GenSigSendType" SG_ 326 ReSideRdrLeDetn72RdrDetnChks 0;
BA_ "GenSigFuncType" SG_ 326 ReSideRdrLeDetn72RdrDetnChks 15;
BA_ "GenSigDataID" SG_ 326 ReSideRdrLeDetn72RdrDetnChks "0x9D9";
BA_ "GenSigSendType" SG_ 326 ReSideRdrLeDetn72RdrDetnCntr 0;
BA_ "GenSigFuncType" SG_ 326 ReSideRdrLeDetn72RdrDetnCntr 16;
BA_ "GenSigSendType" SG_ 326 ReSideRdrLeDetn72RdrDetnConf 0;
BA_ "GenSigStartValue" SG_ 326 ReSideRdrLeDetn72RdrDetnElevn 15;
BA_ "GenSigSendType" SG_ 326 ReSideRdrLeDetn72RdrDetnElevn 0;
BA_ "GenSigSendType" SG_ 326 ReSideRdrLeDetn72RdrDetnPwr 0;
BA_ "GenSigStartValue" SG_ 326 ReSideRdrLeDetn72RdrDetnRng 10050;
BA_ "GenSigSendType" SG_ 326 ReSideRdrLeDetn72RdrDetnRng 0;
BA_ "GenSigStartValue" SG_ 326 ReSideRdrLeDetn72RdrDetnRngV 4000;
BA_ "GenSigSendType" SG_ 326 ReSideRdrLeDetn72RdrDetnRngV 0;
BA_ "GenSigStartValue" SG_ 326 ReSideRdrLeDetn72RdrDetnSts 3;
BA_ "GenSigSendType" SG_ 326 ReSideRdrLeDetn72RdrDetnSts 0;
// Frame: SODLSafetyCANFD3Frame13
BA_ "VFrameFormat" BO_ 328 14;
BA_ "GenMsgSendType" BO_ 328 0;
BA_ "GenMsgCycleTime" BO_ 328 50.000;
BA_ "GenSigStartValue" SG_ 328 ReSideRdrLeDetn73RdrDetnAzi 900;
BA_ "GenSigSendType" SG_ 328 ReSideRdrLeDetn73RdrDetnAzi 0;
BA_ "GenSigSendType" SG_ 328 ReSideRdrLeDetn73RdrDetnChks 0;
BA_ "GenSigFuncType" SG_ 328 ReSideRdrLeDetn73RdrDetnChks 15;
BA_ "GenSigDataID" SG_ 328 ReSideRdrLeDetn73RdrDetnChks "0x9DA";
BA_ "GenSigSendType" SG_ 328 ReSideRdrLeDetn73RdrDetnCntr 0;
BA_ "GenSigFuncType" SG_ 328 ReSideRdrLeDetn73RdrDetnCntr 16;
BA_ "GenSigSendType" SG_ 328 ReSideRdrLeDetn73RdrDetnConf 0;
BA_ "GenSigStartValue" SG_ 328 ReSideRdrLeDetn73RdrDetnElevn 15;
BA_ "GenSigSendType" SG_ 328 ReSideRdrLeDetn73RdrDetnElevn 0;
BA_ "GenSigSendType" SG_ 328 ReSideRdrLeDetn73RdrDetnPwr 0;
BA_ "GenSigStartValue" SG_ 328 ReSideRdrLeDetn73RdrDetnRng 10050;
BA_ "GenSigSendType" SG_ 328 ReSideRdrLeDetn73RdrDetnRng 0;
BA_ "GenSigStartValue" SG_ 328 ReSideRdrLeDetn73RdrDetnRngV 4000;
BA_ "GenSigSendType" SG_ 328 ReSideRdrLeDetn73RdrDetnRngV 0;
BA_ "GenSigStartValue" SG_ 328 ReSideRdrLeDetn73RdrDetnSts 3;
BA_ "GenSigSendType" SG_ 328 ReSideRdrLeDetn73RdrDetnSts 0;
BA_ "GenSigStartValue" SG_ 328 ReSideRdrLeDetn74RdrDetnAzi 900;
BA_ "GenSigSendType" SG_ 328 ReSideRdrLeDetn74RdrDetnAzi 0;
BA_ "GenSigSendType" SG_ 328 ReSideRdrLeDetn74RdrDetnChks 0;
BA_ "GenSigFuncType" SG_ 328 ReSideRdrLeDetn74RdrDetnChks 15;
BA_ "GenSigDataID" SG_ 328 ReSideRdrLeDetn74RdrDetnChks "0x9DB";
BA_ "GenSigSendType" SG_ 328 ReSideRdrLeDetn74RdrDetnCntr 0;
BA_ "GenSigFuncType" SG_ 328 ReSideRdrLeDetn74RdrDetnCntr 16;
BA_ "GenSigSendType" SG_ 328 ReSideRdrLeDetn74RdrDetnConf 0;
BA_ "GenSigStartValue" SG_ 328 ReSideRdrLeDetn74RdrDetnElevn 15;
BA_ "GenSigSendType" SG_ 328 ReSideRdrLeDetn74RdrDetnElevn 0;
BA_ "GenSigSendType" SG_ 328 ReSideRdrLeDetn74RdrDetnPwr 0;
BA_ "GenSigStartValue" SG_ 328 ReSideRdrLeDetn74RdrDetnRng 10050;
BA_ "GenSigSendType" SG_ 328 ReSideRdrLeDetn74RdrDetnRng 0;
BA_ "GenSigStartValue" SG_ 328 ReSideRdrLeDetn74RdrDetnRngV 4000;
BA_ "GenSigSendType" SG_ 328 ReSideRdrLeDetn74RdrDetnRngV 0;
BA_ "GenSigStartValue" SG_ 328 ReSideRdrLeDetn74RdrDetnSts 3;
BA_ "GenSigSendType" SG_ 328 ReSideRdrLeDetn74RdrDetnSts 0;
BA_ "GenSigStartValue" SG_ 328 ReSideRdrLeDetn75RdrDetnAzi 900;
BA_ "GenSigSendType" SG_ 328 ReSideRdrLeDetn75RdrDetnAzi 0;
BA_ "GenSigSendType" SG_ 328 ReSideRdrLeDetn75RdrDetnChks 0;
BA_ "GenSigFuncType" SG_ 328 ReSideRdrLeDetn75RdrDetnChks 15;
BA_ "GenSigDataID" SG_ 328 ReSideRdrLeDetn75RdrDetnChks "0x9DC";
BA_ "GenSigSendType" SG_ 328 ReSideRdrLeDetn75RdrDetnCntr 0;
BA_ "GenSigFuncType" SG_ 328 ReSideRdrLeDetn75RdrDetnCntr 16;
BA_ "GenSigSendType" SG_ 328 ReSideRdrLeDetn75RdrDetnConf 0;
BA_ "GenSigStartValue" SG_ 328 ReSideRdrLeDetn75RdrDetnElevn 15;
BA_ "GenSigSendType" SG_ 328 ReSideRdrLeDetn75RdrDetnElevn 0;
BA_ "GenSigSendType" SG_ 328 ReSideRdrLeDetn75RdrDetnPwr 0;
BA_ "GenSigStartValue" SG_ 328 ReSideRdrLeDetn75RdrDetnRng 10050;
BA_ "GenSigSendType" SG_ 328 ReSideRdrLeDetn75RdrDetnRng 0;
BA_ "GenSigStartValue" SG_ 328 ReSideRdrLeDetn75RdrDetnRngV 4000;
BA_ "GenSigSendType" SG_ 328 ReSideRdrLeDetn75RdrDetnRngV 0;
BA_ "GenSigStartValue" SG_ 328 ReSideRdrLeDetn75RdrDetnSts 3;
BA_ "GenSigSendType" SG_ 328 ReSideRdrLeDetn75RdrDetnSts 0;
BA_ "GenSigStartValue" SG_ 328 ReSideRdrLeDetn76RdrDetnAzi 900;
BA_ "GenSigSendType" SG_ 328 ReSideRdrLeDetn76RdrDetnAzi 0;
BA_ "GenSigSendType" SG_ 328 ReSideRdrLeDetn76RdrDetnChks 0;
BA_ "GenSigFuncType" SG_ 328 ReSideRdrLeDetn76RdrDetnChks 15;
BA_ "GenSigDataID" SG_ 328 ReSideRdrLeDetn76RdrDetnChks "0x9DD";
BA_ "GenSigSendType" SG_ 328 ReSideRdrLeDetn76RdrDetnCntr 0;
BA_ "GenSigFuncType" SG_ 328 ReSideRdrLeDetn76RdrDetnCntr 16;
BA_ "GenSigSendType" SG_ 328 ReSideRdrLeDetn76RdrDetnConf 0;
BA_ "GenSigStartValue" SG_ 328 ReSideRdrLeDetn76RdrDetnElevn 15;
BA_ "GenSigSendType" SG_ 328 ReSideRdrLeDetn76RdrDetnElevn 0;
BA_ "GenSigSendType" SG_ 328 ReSideRdrLeDetn76RdrDetnPwr 0;
BA_ "GenSigStartValue" SG_ 328 ReSideRdrLeDetn76RdrDetnRng 10050;
BA_ "GenSigSendType" SG_ 328 ReSideRdrLeDetn76RdrDetnRng 0;
BA_ "GenSigStartValue" SG_ 328 ReSideRdrLeDetn76RdrDetnRngV 4000;
BA_ "GenSigSendType" SG_ 328 ReSideRdrLeDetn76RdrDetnRngV 0;
BA_ "GenSigStartValue" SG_ 328 ReSideRdrLeDetn76RdrDetnSts 3;
BA_ "GenSigSendType" SG_ 328 ReSideRdrLeDetn76RdrDetnSts 0;
BA_ "GenSigStartValue" SG_ 328 ReSideRdrLeDetn77RdrDetnAzi 900;
BA_ "GenSigSendType" SG_ 328 ReSideRdrLeDetn77RdrDetnAzi 0;
BA_ "GenSigSendType" SG_ 328 ReSideRdrLeDetn77RdrDetnChks 0;
BA_ "GenSigFuncType" SG_ 328 ReSideRdrLeDetn77RdrDetnChks 15;
BA_ "GenSigDataID" SG_ 328 ReSideRdrLeDetn77RdrDetnChks "0x9DE";
BA_ "GenSigSendType" SG_ 328 ReSideRdrLeDetn77RdrDetnCntr 0;
BA_ "GenSigFuncType" SG_ 328 ReSideRdrLeDetn77RdrDetnCntr 16;
BA_ "GenSigSendType" SG_ 328 ReSideRdrLeDetn77RdrDetnConf 0;
BA_ "GenSigStartValue" SG_ 328 ReSideRdrLeDetn77RdrDetnElevn 15;
BA_ "GenSigSendType" SG_ 328 ReSideRdrLeDetn77RdrDetnElevn 0;
BA_ "GenSigSendType" SG_ 328 ReSideRdrLeDetn77RdrDetnPwr 0;
BA_ "GenSigStartValue" SG_ 328 ReSideRdrLeDetn77RdrDetnRng 10050;
BA_ "GenSigSendType" SG_ 328 ReSideRdrLeDetn77RdrDetnRng 0;
BA_ "GenSigStartValue" SG_ 328 ReSideRdrLeDetn77RdrDetnRngV 4000;
BA_ "GenSigSendType" SG_ 328 ReSideRdrLeDetn77RdrDetnRngV 0;
BA_ "GenSigStartValue" SG_ 328 ReSideRdrLeDetn77RdrDetnSts 3;
BA_ "GenSigSendType" SG_ 328 ReSideRdrLeDetn77RdrDetnSts 0;
BA_ "GenSigStartValue" SG_ 328 ReSideRdrLeDetn78RdrDetnAzi 900;
BA_ "GenSigSendType" SG_ 328 ReSideRdrLeDetn78RdrDetnAzi 0;
BA_ "GenSigSendType" SG_ 328 ReSideRdrLeDetn78RdrDetnChks 0;
BA_ "GenSigFuncType" SG_ 328 ReSideRdrLeDetn78RdrDetnChks 15;
BA_ "GenSigDataID" SG_ 328 ReSideRdrLeDetn78RdrDetnChks "0x9DF";
BA_ "GenSigSendType" SG_ 328 ReSideRdrLeDetn78RdrDetnCntr 0;
BA_ "GenSigFuncType" SG_ 328 ReSideRdrLeDetn78RdrDetnCntr 16;
BA_ "GenSigSendType" SG_ 328 ReSideRdrLeDetn78RdrDetnConf 0;
BA_ "GenSigStartValue" SG_ 328 ReSideRdrLeDetn78RdrDetnElevn 15;
BA_ "GenSigSendType" SG_ 328 ReSideRdrLeDetn78RdrDetnElevn 0;
BA_ "GenSigSendType" SG_ 328 ReSideRdrLeDetn78RdrDetnPwr 0;
BA_ "GenSigStartValue" SG_ 328 ReSideRdrLeDetn78RdrDetnRng 10050;
BA_ "GenSigSendType" SG_ 328 ReSideRdrLeDetn78RdrDetnRng 0;
BA_ "GenSigStartValue" SG_ 328 ReSideRdrLeDetn78RdrDetnRngV 4000;
BA_ "GenSigSendType" SG_ 328 ReSideRdrLeDetn78RdrDetnRngV 0;
BA_ "GenSigStartValue" SG_ 328 ReSideRdrLeDetn78RdrDetnSts 3;
BA_ "GenSigSendType" SG_ 328 ReSideRdrLeDetn78RdrDetnSts 0;
// Frame: SODLSafetyCANFD3Frame14
BA_ "VFrameFormat" BO_ 330 14;
BA_ "GenMsgSendType" BO_ 330 0;
BA_ "GenMsgCycleTime" BO_ 330 50.000;
BA_ "GenSigStartValue" SG_ 330 ReSideRdrLeDetn79RdrDetnAzi 900;
BA_ "GenSigSendType" SG_ 330 ReSideRdrLeDetn79RdrDetnAzi 0;
BA_ "GenSigSendType" SG_ 330 ReSideRdrLeDetn79RdrDetnChks 0;
BA_ "GenSigFuncType" SG_ 330 ReSideRdrLeDetn79RdrDetnChks 15;
BA_ "GenSigDataID" SG_ 330 ReSideRdrLeDetn79RdrDetnChks "0x9E0";
BA_ "GenSigSendType" SG_ 330 ReSideRdrLeDetn79RdrDetnCntr 0;
BA_ "GenSigFuncType" SG_ 330 ReSideRdrLeDetn79RdrDetnCntr 16;
BA_ "GenSigSendType" SG_ 330 ReSideRdrLeDetn79RdrDetnConf 0;
BA_ "GenSigStartValue" SG_ 330 ReSideRdrLeDetn79RdrDetnElevn 15;
BA_ "GenSigSendType" SG_ 330 ReSideRdrLeDetn79RdrDetnElevn 0;
BA_ "GenSigSendType" SG_ 330 ReSideRdrLeDetn79RdrDetnPwr 0;
BA_ "GenSigStartValue" SG_ 330 ReSideRdrLeDetn79RdrDetnRng 10050;
BA_ "GenSigSendType" SG_ 330 ReSideRdrLeDetn79RdrDetnRng 0;
BA_ "GenSigStartValue" SG_ 330 ReSideRdrLeDetn79RdrDetnRngV 4000;
BA_ "GenSigSendType" SG_ 330 ReSideRdrLeDetn79RdrDetnRngV 0;
BA_ "GenSigStartValue" SG_ 330 ReSideRdrLeDetn79RdrDetnSts 3;
BA_ "GenSigSendType" SG_ 330 ReSideRdrLeDetn79RdrDetnSts 0;
BA_ "GenSigStartValue" SG_ 330 ReSideRdrLeDetn80RdrDetnAzi 900;
BA_ "GenSigSendType" SG_ 330 ReSideRdrLeDetn80RdrDetnAzi 0;
BA_ "GenSigSendType" SG_ 330 ReSideRdrLeDetn80RdrDetnChks 0;
BA_ "GenSigFuncType" SG_ 330 ReSideRdrLeDetn80RdrDetnChks 15;
BA_ "GenSigDataID" SG_ 330 ReSideRdrLeDetn80RdrDetnChks "0x9E1";
BA_ "GenSigSendType" SG_ 330 ReSideRdrLeDetn80RdrDetnCntr 0;
BA_ "GenSigFuncType" SG_ 330 ReSideRdrLeDetn80RdrDetnCntr 16;
BA_ "GenSigSendType" SG_ 330 ReSideRdrLeDetn80RdrDetnConf 0;
BA_ "GenSigStartValue" SG_ 330 ReSideRdrLeDetn80RdrDetnElevn 15;
BA_ "GenSigSendType" SG_ 330 ReSideRdrLeDetn80RdrDetnElevn 0;
BA_ "GenSigSendType" SG_ 330 ReSideRdrLeDetn80RdrDetnPwr 0;
BA_ "GenSigStartValue" SG_ 330 ReSideRdrLeDetn80RdrDetnRng 10050;
BA_ "GenSigSendType" SG_ 330 ReSideRdrLeDetn80RdrDetnRng 0;
BA_ "GenSigStartValue" SG_ 330 ReSideRdrLeDetn80RdrDetnRngV 4000;
BA_ "GenSigSendType" SG_ 330 ReSideRdrLeDetn80RdrDetnRngV 0;
BA_ "GenSigStartValue" SG_ 330 ReSideRdrLeDetn80RdrDetnSts 3;
BA_ "GenSigSendType" SG_ 330 ReSideRdrLeDetn80RdrDetnSts 0;
BA_ "GenSigStartValue" SG_ 330 ReSideRdrLeDetn81RdrDetnAzi 900;
BA_ "GenSigSendType" SG_ 330 ReSideRdrLeDetn81RdrDetnAzi 0;
BA_ "GenSigSendType" SG_ 330 ReSideRdrLeDetn81RdrDetnChks 0;
BA_ "GenSigFuncType" SG_ 330 ReSideRdrLeDetn81RdrDetnChks 15;
BA_ "GenSigDataID" SG_ 330 ReSideRdrLeDetn81RdrDetnChks "0x9E2";
BA_ "GenSigSendType" SG_ 330 ReSideRdrLeDetn81RdrDetnCntr 0;
BA_ "GenSigFuncType" SG_ 330 ReSideRdrLeDetn81RdrDetnCntr 16;
BA_ "GenSigSendType" SG_ 330 ReSideRdrLeDetn81RdrDetnConf 0;
BA_ "GenSigStartValue" SG_ 330 ReSideRdrLeDetn81RdrDetnElevn 15;
BA_ "GenSigSendType" SG_ 330 ReSideRdrLeDetn81RdrDetnElevn 0;
BA_ "GenSigSendType" SG_ 330 ReSideRdrLeDetn81RdrDetnPwr 0;
BA_ "GenSigStartValue" SG_ 330 ReSideRdrLeDetn81RdrDetnRng 10050;
BA_ "GenSigSendType" SG_ 330 ReSideRdrLeDetn81RdrDetnRng 0;
BA_ "GenSigStartValue" SG_ 330 ReSideRdrLeDetn81RdrDetnRngV 4000;
BA_ "GenSigSendType" SG_ 330 ReSideRdrLeDetn81RdrDetnRngV 0;
BA_ "GenSigStartValue" SG_ 330 ReSideRdrLeDetn81RdrDetnSts 3;
BA_ "GenSigSendType" SG_ 330 ReSideRdrLeDetn81RdrDetnSts 0;
BA_ "GenSigStartValue" SG_ 330 ReSideRdrLeDetn82RdrDetnAzi 900;
BA_ "GenSigSendType" SG_ 330 ReSideRdrLeDetn82RdrDetnAzi 0;
BA_ "GenSigSendType" SG_ 330 ReSideRdrLeDetn82RdrDetnChks 0;
BA_ "GenSigFuncType" SG_ 330 ReSideRdrLeDetn82RdrDetnChks 15;
BA_ "GenSigDataID" SG_ 330 ReSideRdrLeDetn82RdrDetnChks "0x9E3";
BA_ "GenSigSendType" SG_ 330 ReSideRdrLeDetn82RdrDetnCntr 0;
BA_ "GenSigFuncType" SG_ 330 ReSideRdrLeDetn82RdrDetnCntr 16;
BA_ "GenSigSendType" SG_ 330 ReSideRdrLeDetn82RdrDetnConf 0;
BA_ "GenSigStartValue" SG_ 330 ReSideRdrLeDetn82RdrDetnElevn 15;
BA_ "GenSigSendType" SG_ 330 ReSideRdrLeDetn82RdrDetnElevn 0;
BA_ "GenSigSendType" SG_ 330 ReSideRdrLeDetn82RdrDetnPwr 0;
BA_ "GenSigStartValue" SG_ 330 ReSideRdrLeDetn82RdrDetnRng 10050;
BA_ "GenSigSendType" SG_ 330 ReSideRdrLeDetn82RdrDetnRng 0;
BA_ "GenSigStartValue" SG_ 330 ReSideRdrLeDetn82RdrDetnRngV 4000;
BA_ "GenSigSendType" SG_ 330 ReSideRdrLeDetn82RdrDetnRngV 0;
BA_ "GenSigStartValue" SG_ 330 ReSideRdrLeDetn82RdrDetnSts 3;
BA_ "GenSigSendType" SG_ 330 ReSideRdrLeDetn82RdrDetnSts 0;
BA_ "GenSigStartValue" SG_ 330 ReSideRdrLeDetn83RdrDetnAzi 900;
BA_ "GenSigSendType" SG_ 330 ReSideRdrLeDetn83RdrDetnAzi 0;
BA_ "GenSigSendType" SG_ 330 ReSideRdrLeDetn83RdrDetnChks 0;
BA_ "GenSigFuncType" SG_ 330 ReSideRdrLeDetn83RdrDetnChks 15;
BA_ "GenSigDataID" SG_ 330 ReSideRdrLeDetn83RdrDetnChks "0x9E4";
BA_ "GenSigSendType" SG_ 330 ReSideRdrLeDetn83RdrDetnCntr 0;
BA_ "GenSigFuncType" SG_ 330 ReSideRdrLeDetn83RdrDetnCntr 16;
BA_ "GenSigSendType" SG_ 330 ReSideRdrLeDetn83RdrDetnConf 0;
BA_ "GenSigStartValue" SG_ 330 ReSideRdrLeDetn83RdrDetnElevn 15;
BA_ "GenSigSendType" SG_ 330 ReSideRdrLeDetn83RdrDetnElevn 0;
BA_ "GenSigSendType" SG_ 330 ReSideRdrLeDetn83RdrDetnPwr 0;
BA_ "GenSigStartValue" SG_ 330 ReSideRdrLeDetn83RdrDetnRng 10050;
BA_ "GenSigSendType" SG_ 330 ReSideRdrLeDetn83RdrDetnRng 0;
BA_ "GenSigStartValue" SG_ 330 ReSideRdrLeDetn83RdrDetnRngV 4000;
BA_ "GenSigSendType" SG_ 330 ReSideRdrLeDetn83RdrDetnRngV 0;
BA_ "GenSigStartValue" SG_ 330 ReSideRdrLeDetn83RdrDetnSts 3;
BA_ "GenSigSendType" SG_ 330 ReSideRdrLeDetn83RdrDetnSts 0;
BA_ "GenSigStartValue" SG_ 330 ReSideRdrLeDetn84RdrDetnAzi 900;
BA_ "GenSigSendType" SG_ 330 ReSideRdrLeDetn84RdrDetnAzi 0;
BA_ "GenSigSendType" SG_ 330 ReSideRdrLeDetn84RdrDetnChks 0;
BA_ "GenSigFuncType" SG_ 330 ReSideRdrLeDetn84RdrDetnChks 15;
BA_ "GenSigDataID" SG_ 330 ReSideRdrLeDetn84RdrDetnChks "0x9E5";
BA_ "GenSigSendType" SG_ 330 ReSideRdrLeDetn84RdrDetnCntr 0;
BA_ "GenSigFuncType" SG_ 330 ReSideRdrLeDetn84RdrDetnCntr 16;
BA_ "GenSigSendType" SG_ 330 ReSideRdrLeDetn84RdrDetnConf 0;
BA_ "GenSigStartValue" SG_ 330 ReSideRdrLeDetn84RdrDetnElevn 15;
BA_ "GenSigSendType" SG_ 330 ReSideRdrLeDetn84RdrDetnElevn 0;
BA_ "GenSigSendType" SG_ 330 ReSideRdrLeDetn84RdrDetnPwr 0;
BA_ "GenSigStartValue" SG_ 330 ReSideRdrLeDetn84RdrDetnRng 10050;
BA_ "GenSigSendType" SG_ 330 ReSideRdrLeDetn84RdrDetnRng 0;
BA_ "GenSigStartValue" SG_ 330 ReSideRdrLeDetn84RdrDetnRngV 4000;
BA_ "GenSigSendType" SG_ 330 ReSideRdrLeDetn84RdrDetnRngV 0;
BA_ "GenSigStartValue" SG_ 330 ReSideRdrLeDetn84RdrDetnSts 3;
BA_ "GenSigSendType" SG_ 330 ReSideRdrLeDetn84RdrDetnSts 0;
VAL_ 316 ReSideRdrLeDetn37RdrDetnSts 0 "RdrDetnSts_Ukwn" 1 "RdrDetnSts_Movg" 2 "RdrDetnSts_Staty" 3 "RdrDetnSts_Invalid";
VAL_ 316 ReSideRdrLeDetn38RdrDetnSts 0 "RdrDetnSts_Ukwn" 1 "RdrDetnSts_Movg" 2 "RdrDetnSts_Staty" 3 "RdrDetnSts_Invalid";
VAL_ 316 ReSideRdrLeDetn39RdrDetnSts 0 "RdrDetnSts_Ukwn" 1 "RdrDetnSts_Movg" 2 "RdrDetnSts_Staty" 3 "RdrDetnSts_Invalid";
VAL_ 316 ReSideRdrLeDetn40RdrDetnSts 0 "RdrDetnSts_Ukwn" 1 "RdrDetnSts_Movg" 2 "RdrDetnSts_Staty" 3 "RdrDetnSts_Invalid";
VAL_ 316 ReSideRdrLeDetn41RdrDetnSts 0 "RdrDetnSts_Ukwn" 1 "RdrDetnSts_Movg" 2 "RdrDetnSts_Staty" 3 "RdrDetnSts_Invalid";
VAL_ 316 ReSideRdrLeDetn42RdrDetnSts 0 "RdrDetnSts_Ukwn" 1 "RdrDetnSts_Movg" 2 "RdrDetnSts_Staty" 3 "RdrDetnSts_Invalid";
VAL_ 318 ReSideRdrLeDetn43RdrDetnSts 0 "RdrDetnSts_Ukwn" 1 "RdrDetnSts_Movg" 2 "RdrDetnSts_Staty" 3 "RdrDetnSts_Invalid";
VAL_ 318 ReSideRdrLeDetn44RdrDetnSts 0 "RdrDetnSts_Ukwn" 1 "RdrDetnSts_Movg" 2 "RdrDetnSts_Staty" 3 "RdrDetnSts_Invalid";
VAL_ 318 ReSideRdrLeDetn45RdrDetnSts 0 "RdrDetnSts_Ukwn" 1 "RdrDetnSts_Movg" 2 "RdrDetnSts_Staty" 3 "RdrDetnSts_Invalid";
VAL_ 318 ReSideRdrLeDetn46RdrDetnSts 0 "RdrDetnSts_Ukwn" 1 "RdrDetnSts_Movg" 2 "RdrDetnSts_Staty" 3 "RdrDetnSts_Invalid";
VAL_ 318 ReSideRdrLeDetn47RdrDetnSts 0 "RdrDetnSts_Ukwn" 1 "RdrDetnSts_Movg" 2 "RdrDetnSts_Staty" 3 "RdrDetnSts_Invalid";
VAL_ 318 ReSideRdrLeDetn48RdrDetnSts 0 "RdrDetnSts_Ukwn" 1 "RdrDetnSts_Movg" 2 "RdrDetnSts_Staty" 3 "RdrDetnSts_Invalid";
VAL_ 320 ReSideRdrLeDetn49RdrDetnSts 0 "RdrDetnSts_Ukwn" 1 "RdrDetnSts_Movg" 2 "RdrDetnSts_Staty" 3 "RdrDetnSts_Invalid";
VAL_ 320 ReSideRdrLeDetn50RdrDetnSts 0 "RdrDetnSts_Ukwn" 1 "RdrDetnSts_Movg" 2 "RdrDetnSts_Staty" 3 "RdrDetnSts_Invalid";
VAL_ 320 ReSideRdrLeDetn51RdrDetnSts 0 "RdrDetnSts_Ukwn" 1 "RdrDetnSts_Movg" 2 "RdrDetnSts_Staty" 3 "RdrDetnSts_Invalid";
VAL_ 320 ReSideRdrLeDetn52RdrDetnSts 0 "RdrDetnSts_Ukwn" 1 "RdrDetnSts_Movg" 2 "RdrDetnSts_Staty" 3 "RdrDetnSts_Invalid";
VAL_ 320 ReSideRdrLeDetn53RdrDetnSts 0 "RdrDetnSts_Ukwn" 1 "RdrDetnSts_Movg" 2 "RdrDetnSts_Staty" 3 "RdrDetnSts_Invalid";
VAL_ 320 ReSideRdrLeDetn54RdrDetnSts 0 "RdrDetnSts_Ukwn" 1 "RdrDetnSts_Movg" 2 "RdrDetnSts_Staty" 3 "RdrDetnSts_Invalid";
VAL_ 322 ReSideRdrLeDetn55RdrDetnSts 0 "RdrDetnSts_Ukwn" 1 "RdrDetnSts_Movg" 2 "RdrDetnSts_Staty" 3 "RdrDetnSts_Invalid";
VAL_ 322 ReSideRdrLeDetn56RdrDetnSts 0 "RdrDetnSts_Ukwn" 1 "RdrDetnSts_Movg" 2 "RdrDetnSts_Staty" 3 "RdrDetnSts_Invalid";
VAL_ 322 ReSideRdrLeDetn57RdrDetnSts 0 "RdrDetnSts_Ukwn" 1 "RdrDetnSts_Movg" 2 "RdrDetnSts_Staty" 3 "RdrDetnSts_Invalid";
VAL_ 322 ReSideRdrLeDetn58RdrDetnSts 0 "RdrDetnSts_Ukwn" 1 "RdrDetnSts_Movg" 2 "RdrDetnSts_Staty" 3 "RdrDetnSts_Invalid";
VAL_ 322 ReSideRdrLeDetn59RdrDetnSts 0 "RdrDetnSts_Ukwn" 1 "RdrDetnSts_Movg" 2 "RdrDetnSts_Staty" 3 "RdrDetnSts_Invalid";
VAL_ 322 ReSideRdrLeDetn60RdrDetnSts 0 "RdrDetnSts_Ukwn" 1 "RdrDetnSts_Movg" 2 "RdrDetnSts_Staty" 3 "RdrDetnSts_Invalid";
VAL_ 324 ReSideRdrLeDetn61RdrDetnSts 0 "RdrDetnSts_Ukwn" 1 "RdrDetnSts_Movg" 2 "RdrDetnSts_Staty" 3 "RdrDetnSts_Invalid";
VAL_ 324 ReSideRdrLeDetn62RdrDetnSts 0 "RdrDetnSts_Ukwn" 1 "RdrDetnSts_Movg" 2 "RdrDetnSts_Staty" 3 "RdrDetnSts_Invalid";
VAL_ 324 ReSideRdrLeDetn63RdrDetnSts 0 "RdrDetnSts_Ukwn" 1 "RdrDetnSts_Movg" 2 "RdrDetnSts_Staty" 3 "RdrDetnSts_Invalid";
VAL_ 324 ReSideRdrLeDetn64RdrDetnSts 0 "RdrDetnSts_Ukwn" 1 "RdrDetnSts_Movg" 2 "RdrDetnSts_Staty" 3 "RdrDetnSts_Invalid";
VAL_ 324 ReSideRdrLeDetn65RdrDetnSts 0 "RdrDetnSts_Ukwn" 1 "RdrDetnSts_Movg" 2 "RdrDetnSts_Staty" 3 "RdrDetnSts_Invalid";
VAL_ 324 ReSideRdrLeDetn66RdrDetnSts 0 "RdrDetnSts_Ukwn" 1 "RdrDetnSts_Movg" 2 "RdrDetnSts_Staty" 3 "RdrDetnSts_Invalid";
VAL_ 326 ReSideRdrLeDetn67RdrDetnSts 0 "RdrDetnSts_Ukwn" 1 "RdrDetnSts_Movg" 2 "RdrDetnSts_Staty" 3 "RdrDetnSts_Invalid";
VAL_ 326 ReSideRdrLeDetn68RdrDetnSts 0 "RdrDetnSts_Ukwn" 1 "RdrDetnSts_Movg" 2 "RdrDetnSts_Staty" 3 "RdrDetnSts_Invalid";
VAL_ 326 ReSideRdrLeDetn69RdrDetnSts 0 "RdrDetnSts_Ukwn" 1 "RdrDetnSts_Movg" 2 "RdrDetnSts_Staty" 3 "RdrDetnSts_Invalid";
VAL_ 326 ReSideRdrLeDetn70RdrDetnSts 0 "RdrDetnSts_Ukwn" 1 "RdrDetnSts_Movg" 2 "RdrDetnSts_Staty" 3 "RdrDetnSts_Invalid";
VAL_ 326 ReSideRdrLeDetn71RdrDetnSts 0 "RdrDetnSts_Ukwn" 1 "RdrDetnSts_Movg" 2 "RdrDetnSts_Staty" 3 "RdrDetnSts_Invalid";
VAL_ 326 ReSideRdrLeDetn72RdrDetnSts 0 "RdrDetnSts_Ukwn" 1 "RdrDetnSts_Movg" 2 "RdrDetnSts_Staty" 3 "RdrDetnSts_Invalid";
VAL_ 328 ReSideRdrLeDetn73RdrDetnSts 0 "RdrDetnSts_Ukwn" 1 "RdrDetnSts_Movg" 2 "RdrDetnSts_Staty" 3 "RdrDetnSts_Invalid";
VAL_ 328 ReSideRdrLeDetn74RdrDetnSts 0 "RdrDetnSts_Ukwn" 1 "RdrDetnSts_Movg" 2 "RdrDetnSts_Staty" 3 "RdrDetnSts_Invalid";
VAL_ 328 ReSideRdrLeDetn75RdrDetnSts 0 "RdrDetnSts_Ukwn" 1 "RdrDetnSts_Movg" 2 "RdrDetnSts_Staty" 3 "RdrDetnSts_Invalid";
VAL_ 328 ReSideRdrLeDetn76RdrDetnSts 0 "RdrDetnSts_Ukwn" 1 "RdrDetnSts_Movg" 2 "RdrDetnSts_Staty" 3 "RdrDetnSts_Invalid";
VAL_ 328 ReSideRdrLeDetn77RdrDetnSts 0 "RdrDetnSts_Ukwn" 1 "RdrDetnSts_Movg" 2 "RdrDetnSts_Staty" 3 "RdrDetnSts_Invalid";
VAL_ 328 ReSideRdrLeDetn78RdrDetnSts 0 "RdrDetnSts_Ukwn" 1 "RdrDetnSts_Movg" 2 "RdrDetnSts_Staty" 3 "RdrDetnSts_Invalid";
VAL_ 330 ReSideRdrLeDetn79RdrDetnSts 0 "RdrDetnSts_Ukwn" 1 "RdrDetnSts_Movg" 2 "RdrDetnSts_Staty" 3 "RdrDetnSts_Invalid";
VAL_ 330 ReSideRdrLeDetn80RdrDetnSts 0 "RdrDetnSts_Ukwn" 1 "RdrDetnSts_Movg" 2 "RdrDetnSts_Staty" 3 "RdrDetnSts_Invalid";
VAL_ 330 ReSideRdrLeDetn81RdrDetnSts 0 "RdrDetnSts_Ukwn" 1 "RdrDetnSts_Movg" 2 "RdrDetnSts_Staty" 3 "RdrDetnSts_Invalid";
VAL_ 330 ReSideRdrLeDetn82RdrDetnSts 0 "RdrDetnSts_Ukwn" 1 "RdrDetnSts_Movg" 2 "RdrDetnSts_Staty" 3 "RdrDetnSts_Invalid";
VAL_ 330 ReSideRdrLeDetn83RdrDetnSts 0 "RdrDetnSts_Ukwn" 1 "RdrDetnSts_Movg" 2 "RdrDetnSts_Staty" 3 "RdrDetnSts_Invalid";
VAL_ 330 ReSideRdrLeDetn84RdrDetnSts 0 "RdrDetnSts_Ukwn" 1 "RdrDetnSts_Movg" 2 "RdrDetnSts_Staty" 3 "RdrDetnSts_Invalid";
SIG_GROUP_ 316 ReSideRdrLeDetn37 1 : ReSideRdrLeDetn37RdrDetnAzi ReSideRdrLeDetn37RdrDetnChks ReSideRdrLeDetn37RdrDetnCntr ReSideRdrLeDetn37RdrDetnConf ReSideRdrLeDetn37RdrDetnElevn ReSideRdrLeDetn37RdrDetnPwr ReSideRdrLeDetn37RdrDetnRng ReSideRdrLeDetn37RdrDetnRngV ReSideRdrLeDetn37RdrDetnSts;
SIG_GROUP_ 316 ReSideRdrLeDetn38 1 : ReSideRdrLeDetn38RdrDetnAzi ReSideRdrLeDetn38RdrDetnChks ReSideRdrLeDetn38RdrDetnCntr ReSideRdrLeDetn38RdrDetnConf ReSideRdrLeDetn38RdrDetnElevn ReSideRdrLeDetn38RdrDetnPwr ReSideRdrLeDetn38RdrDetnRng ReSideRdrLeDetn38RdrDetnRngV ReSideRdrLeDetn38RdrDetnSts;
SIG_GROUP_ 316 ReSideRdrLeDetn39 1 : ReSideRdrLeDetn39RdrDetnAzi ReSideRdrLeDetn39RdrDetnChks ReSideRdrLeDetn39RdrDetnCntr ReSideRdrLeDetn39RdrDetnConf ReSideRdrLeDetn39RdrDetnElevn ReSideRdrLeDetn39RdrDetnPwr ReSideRdrLeDetn39RdrDetnRng ReSideRdrLeDetn39RdrDetnRngV ReSideRdrLeDetn39RdrDetnSts;
SIG_GROUP_ 316 ReSideRdrLeDetn40 1 : ReSideRdrLeDetn40RdrDetnAzi ReSideRdrLeDetn40RdrDetnChks ReSideRdrLeDetn40RdrDetnCntr ReSideRdrLeDetn40RdrDetnConf ReSideRdrLeDetn40RdrDetnElevn ReSideRdrLeDetn40RdrDetnPwr ReSideRdrLeDetn40RdrDetnRng ReSideRdrLeDetn40RdrDetnRngV ReSideRdrLeDetn40RdrDetnSts;
SIG_GROUP_ 316 ReSideRdrLeDetn41 1 : ReSideRdrLeDetn41RdrDetnAzi ReSideRdrLeDetn41RdrDetnChks ReSideRdrLeDetn41RdrDetnCntr ReSideRdrLeDetn41RdrDetnConf ReSideRdrLeDetn41RdrDetnElevn ReSideRdrLeDetn41RdrDetnPwr ReSideRdrLeDetn41RdrDetnRng ReSideRdrLeDetn41RdrDetnRngV ReSideRdrLeDetn41RdrDetnSts;
SIG_GROUP_ 316 ReSideRdrLeDetn42 1 : ReSideRdrLeDetn42RdrDetnAzi ReSideRdrLeDetn42RdrDetnChks ReSideRdrLeDetn42RdrDetnCntr ReSideRdrLeDetn42RdrDetnConf ReSideRdrLeDetn42RdrDetnElevn ReSideRdrLeDetn42RdrDetnPwr ReSideRdrLeDetn42RdrDetnRng ReSideRdrLeDetn42RdrDetnRngV ReSideRdrLeDetn42RdrDetnSts;
SIG_GROUP_ 318 ReSideRdrLeDetn43 1 : ReSideRdrLeDetn43RdrDetnAzi ReSideRdrLeDetn43RdrDetnChks ReSideRdrLeDetn43RdrDetnCntr ReSideRdrLeDetn43RdrDetnConf ReSideRdrLeDetn43RdrDetnElevn ReSideRdrLeDetn43RdrDetnPwr ReSideRdrLeDetn43RdrDetnRng ReSideRdrLeDetn43RdrDetnRngV ReSideRdrLeDetn43RdrDetnSts;
SIG_GROUP_ 318 ReSideRdrLeDetn44 1 : ReSideRdrLeDetn44RdrDetnAzi ReSideRdrLeDetn44RdrDetnChks ReSideRdrLeDetn44RdrDetnCntr ReSideRdrLeDetn44RdrDetnConf ReSideRdrLeDetn44RdrDetnElevn ReSideRdrLeDetn44RdrDetnPwr ReSideRdrLeDetn44RdrDetnRng ReSideRdrLeDetn44RdrDetnRngV ReSideRdrLeDetn44RdrDetnSts;
SIG_GROUP_ 318 ReSideRdrLeDetn45 1 : ReSideRdrLeDetn45RdrDetnAzi ReSideRdrLeDetn45RdrDetnChks ReSideRdrLeDetn45RdrDetnCntr ReSideRdrLeDetn45RdrDetnConf ReSideRdrLeDetn45RdrDetnElevn ReSideRdrLeDetn45RdrDetnPwr ReSideRdrLeDetn45RdrDetnRng ReSideRdrLeDetn45RdrDetnRngV ReSideRdrLeDetn45RdrDetnSts;
SIG_GROUP_ 318 ReSideRdrLeDetn46 1 : ReSideRdrLeDetn46RdrDetnAzi ReSideRdrLeDetn46RdrDetnChks ReSideRdrLeDetn46RdrDetnCntr ReSideRdrLeDetn46RdrDetnConf ReSideRdrLeDetn46RdrDetnElevn ReSideRdrLeDetn46RdrDetnPwr ReSideRdrLeDetn46RdrDetnRng ReSideRdrLeDetn46RdrDetnRngV ReSideRdrLeDetn46RdrDetnSts;
SIG_GROUP_ 318 ReSideRdrLeDetn47 1 : ReSideRdrLeDetn47RdrDetnAzi ReSideRdrLeDetn47RdrDetnChks ReSideRdrLeDetn47RdrDetnCntr ReSideRdrLeDetn47RdrDetnConf ReSideRdrLeDetn47RdrDetnElevn ReSideRdrLeDetn47RdrDetnPwr ReSideRdrLeDetn47RdrDetnRng ReSideRdrLeDetn47RdrDetnRngV ReSideRdrLeDetn47RdrDetnSts;
SIG_GROUP_ 318 ReSideRdrLeDetn48 1 : ReSideRdrLeDetn48RdrDetnAzi ReSideRdrLeDetn48RdrDetnChks ReSideRdrLeDetn48RdrDetnCntr ReSideRdrLeDetn48RdrDetnConf ReSideRdrLeDetn48RdrDetnElevn ReSideRdrLeDetn48RdrDetnPwr ReSideRdrLeDetn48RdrDetnRng ReSideRdrLeDetn48RdrDetnRngV ReSideRdrLeDetn48RdrDetnSts;
SIG_GROUP_ 320 ReSideRdrLeDetn49 1 : ReSideRdrLeDetn49RdrDetnAzi ReSideRdrLeDetn49RdrDetnChks ReSideRdrLeDetn49RdrDetnCntr ReSideRdrLeDetn49RdrDetnConf ReSideRdrLeDetn49RdrDetnElevn ReSideRdrLeDetn49RdrDetnPwr ReSideRdrLeDetn49RdrDetnRng ReSideRdrLeDetn49RdrDetnRngV ReSideRdrLeDetn49RdrDetnSts;
SIG_GROUP_ 320 ReSideRdrLeDetn50 1 : ReSideRdrLeDetn50RdrDetnAzi ReSideRdrLeDetn50RdrDetnChks ReSideRdrLeDetn50RdrDetnCntr ReSideRdrLeDetn50RdrDetnConf ReSideRdrLeDetn50RdrDetnElevn ReSideRdrLeDetn50RdrDetnPwr ReSideRdrLeDetn50RdrDetnRng ReSideRdrLeDetn50RdrDetnRngV ReSideRdrLeDetn50RdrDetnSts;
SIG_GROUP_ 320 ReSideRdrLeDetn51 1 : ReSideRdrLeDetn51RdrDetnAzi ReSideRdrLeDetn51RdrDetnChks ReSideRdrLeDetn51RdrDetnCntr ReSideRdrLeDetn51RdrDetnConf ReSideRdrLeDetn51RdrDetnElevn ReSideRdrLeDetn51RdrDetnPwr ReSideRdrLeDetn51RdrDetnRng ReSideRdrLeDetn51RdrDetnRngV ReSideRdrLeDetn51RdrDetnSts;
SIG_GROUP_ 320 ReSideRdrLeDetn52 1 : ReSideRdrLeDetn52RdrDetnAzi ReSideRdrLeDetn52RdrDetnChks ReSideRdrLeDetn52RdrDetnCntr ReSideRdrLeDetn52RdrDetnConf ReSideRdrLeDetn52RdrDetnElevn ReSideRdrLeDetn52RdrDetnPwr ReSideRdrLeDetn52RdrDetnRng ReSideRdrLeDetn52RdrDetnRngV ReSideRdrLeDetn52RdrDetnSts;
SIG_GROUP_ 320 ReSideRdrLeDetn53 1 : ReSideRdrLeDetn53RdrDetnAzi ReSideRdrLeDetn53RdrDetnChks ReSideRdrLeDetn53RdrDetnCntr ReSideRdrLeDetn53RdrDetnConf ReSideRdrLeDetn53RdrDetnElevn ReSideRdrLeDetn53RdrDetnPwr ReSideRdrLeDetn53RdrDetnRng ReSideRdrLeDetn53RdrDetnRngV ReSideRdrLeDetn53RdrDetnSts;
SIG_GROUP_ 320 ReSideRdrLeDetn54 1 : ReSideRdrLeDetn54RdrDetnAzi ReSideRdrLeDetn54RdrDetnChks ReSideRdrLeDetn54RdrDetnCntr ReSideRdrLeDetn54RdrDetnConf ReSideRdrLeDetn54RdrDetnElevn ReSideRdrLeDetn54RdrDetnPwr ReSideRdrLeDetn54RdrDetnRng ReSideRdrLeDetn54RdrDetnRngV ReSideRdrLeDetn54RdrDetnSts;
SIG_GROUP_ 322 ReSideRdrLeDetn55 1 : ReSideRdrLeDetn55RdrDetnAzi ReSideRdrLeDetn55RdrDetnChks ReSideRdrLeDetn55RdrDetnCntr ReSideRdrLeDetn55RdrDetnConf ReSideRdrLeDetn55RdrDetnElevn ReSideRdrLeDetn55RdrDetnPwr ReSideRdrLeDetn55RdrDetnRng ReSideRdrLeDetn55RdrDetnRngV ReSideRdrLeDetn55RdrDetnSts;
SIG_GROUP_ 322 ReSideRdrLeDetn56 1 : ReSideRdrLeDetn56RdrDetnAzi ReSideRdrLeDetn56RdrDetnChks ReSideRdrLeDetn56RdrDetnCntr ReSideRdrLeDetn56RdrDetnConf ReSideRdrLeDetn56RdrDetnElevn ReSideRdrLeDetn56RdrDetnPwr ReSideRdrLeDetn56RdrDetnRng ReSideRdrLeDetn56RdrDetnRngV ReSideRdrLeDetn56RdrDetnSts;
SIG_GROUP_ 322 ReSideRdrLeDetn57 1 : ReSideRdrLeDetn57RdrDetnAzi ReSideRdrLeDetn57RdrDetnChks ReSideRdrLeDetn57RdrDetnCntr ReSideRdrLeDetn57RdrDetnConf ReSideRdrLeDetn57RdrDetnElevn ReSideRdrLeDetn57RdrDetnPwr ReSideRdrLeDetn57RdrDetnRng ReSideRdrLeDetn57RdrDetnRngV ReSideRdrLeDetn57RdrDetnSts;
SIG_GROUP_ 322 ReSideRdrLeDetn58 1 : ReSideRdrLeDetn58RdrDetnAzi ReSideRdrLeDetn58RdrDetnChks ReSideRdrLeDetn58RdrDetnCntr ReSideRdrLeDetn58RdrDetnConf ReSideRdrLeDetn58RdrDetnElevn ReSideRdrLeDetn58RdrDetnPwr ReSideRdrLeDetn58RdrDetnRng ReSideRdrLeDetn58RdrDetnRngV ReSideRdrLeDetn58RdrDetnSts;
SIG_GROUP_ 322 ReSideRdrLeDetn59 1 : ReSideRdrLeDetn59RdrDetnAzi ReSideRdrLeDetn59RdrDetnChks ReSideRdrLeDetn59RdrDetnCntr ReSideRdrLeDetn59RdrDetnConf ReSideRdrLeDetn59RdrDetnElevn ReSideRdrLeDetn59RdrDetnPwr ReSideRdrLeDetn59RdrDetnRng ReSideRdrLeDetn59RdrDetnRngV ReSideRdrLeDetn59RdrDetnSts;
SIG_GROUP_ 322 ReSideRdrLeDetn60 1 : ReSideRdrLeDetn60RdrDetnAzi ReSideRdrLeDetn60RdrDetnChks ReSideRdrLeDetn60RdrDetnCntr ReSideRdrLeDetn60RdrDetnConf ReSideRdrLeDetn60RdrDetnElevn ReSideRdrLeDetn60RdrDetnPwr ReSideRdrLeDetn60RdrDetnRng ReSideRdrLeDetn60RdrDetnRngV ReSideRdrLeDetn60RdrDetnSts;
SIG_GROUP_ 324 ReSideRdrLeDetn61 1 : ReSideRdrLeDetn61RdrDetnAzi ReSideRdrLeDetn61RdrDetnChks ReSideRdrLeDetn61RdrDetnCntr ReSideRdrLeDetn61RdrDetnConf ReSideRdrLeDetn61RdrDetnElevn ReSideRdrLeDetn61RdrDetnPwr ReSideRdrLeDetn61RdrDetnRng ReSideRdrLeDetn61RdrDetnRngV ReSideRdrLeDetn61RdrDetnSts;
SIG_GROUP_ 324 ReSideRdrLeDetn62 1 : ReSideRdrLeDetn62RdrDetnAzi ReSideRdrLeDetn62RdrDetnChks ReSideRdrLeDetn62RdrDetnCntr ReSideRdrLeDetn62RdrDetnConf ReSideRdrLeDetn62RdrDetnElevn ReSideRdrLeDetn62RdrDetnPwr ReSideRdrLeDetn62RdrDetnRng ReSideRdrLeDetn62RdrDetnRngV ReSideRdrLeDetn62RdrDetnSts;
SIG_GROUP_ 324 ReSideRdrLeDetn63 1 : ReSideRdrLeDetn63RdrDetnAzi ReSideRdrLeDetn63RdrDetnChks ReSideRdrLeDetn63RdrDetnCntr ReSideRdrLeDetn63RdrDetnConf ReSideRdrLeDetn63RdrDetnElevn ReSideRdrLeDetn63RdrDetnPwr ReSideRdrLeDetn63RdrDetnRng ReSideRdrLeDetn63RdrDetnRngV ReSideRdrLeDetn63RdrDetnSts;
SIG_GROUP_ 324 ReSideRdrLeDetn64 1 : ReSideRdrLeDetn64RdrDetnAzi ReSideRdrLeDetn64RdrDetnChks ReSideRdrLeDetn64RdrDetnCntr ReSideRdrLeDetn64RdrDetnConf ReSideRdrLeDetn64RdrDetnElevn ReSideRdrLeDetn64RdrDetnPwr ReSideRdrLeDetn64RdrDetnRng ReSideRdrLeDetn64RdrDetnRngV ReSideRdrLeDetn64RdrDetnSts;
SIG_GROUP_ 324 ReSideRdrLeDetn65 1 : ReSideRdrLeDetn65RdrDetnAzi ReSideRdrLeDetn65RdrDetnChks ReSideRdrLeDetn65RdrDetnCntr ReSideRdrLeDetn65RdrDetnConf ReSideRdrLeDetn65RdrDetnElevn ReSideRdrLeDetn65RdrDetnPwr ReSideRdrLeDetn65RdrDetnRng ReSideRdrLeDetn65RdrDetnRngV ReSideRdrLeDetn65RdrDetnSts;
SIG_GROUP_ 324 ReSideRdrLeDetn66 1 : ReSideRdrLeDetn66RdrDetnAzi ReSideRdrLeDetn66RdrDetnChks ReSideRdrLeDetn66RdrDetnCntr ReSideRdrLeDetn66RdrDetnConf ReSideRdrLeDetn66RdrDetnElevn ReSideRdrLeDetn66RdrDetnPwr ReSideRdrLeDetn66RdrDetnRng ReSideRdrLeDetn66RdrDetnRngV ReSideRdrLeDetn66RdrDetnSts;
SIG_GROUP_ 326 ReSideRdrLeDetn67 1 : ReSideRdrLeDetn67RdrDetnAzi ReSideRdrLeDetn67RdrDetnChks ReSideRdrLeDetn67RdrDetnCntr ReSideRdrLeDetn67RdrDetnConf ReSideRdrLeDetn67RdrDetnElevn ReSideRdrLeDetn67RdrDetnPwr ReSideRdrLeDetn67RdrDetnRng ReSideRdrLeDetn67RdrDetnRngV ReSideRdrLeDetn67RdrDetnSts;
SIG_GROUP_ 326 ReSideRdrLeDetn68 1 : ReSideRdrLeDetn68RdrDetnAzi ReSideRdrLeDetn68RdrDetnChks ReSideRdrLeDetn68RdrDetnCntr ReSideRdrLeDetn68RdrDetnConf ReSideRdrLeDetn68RdrDetnElevn ReSideRdrLeDetn68RdrDetnPwr ReSideRdrLeDetn68RdrDetnRng ReSideRdrLeDetn68RdrDetnRngV ReSideRdrLeDetn68RdrDetnSts;
SIG_GROUP_ 326 ReSideRdrLeDetn69 1 : ReSideRdrLeDetn69RdrDetnAzi ReSideRdrLeDetn69RdrDetnChks ReSideRdrLeDetn69RdrDetnCntr ReSideRdrLeDetn69RdrDetnConf ReSideRdrLeDetn69RdrDetnElevn ReSideRdrLeDetn69RdrDetnPwr ReSideRdrLeDetn69RdrDetnRng ReSideRdrLeDetn69RdrDetnRngV ReSideRdrLeDetn69RdrDetnSts;
SIG_GROUP_ 326 ReSideRdrLeDetn70 1 : ReSideRdrLeDetn70RdrDetnAzi ReSideRdrLeDetn70RdrDetnChks ReSideRdrLeDetn70RdrDetnCntr ReSideRdrLeDetn70RdrDetnConf ReSideRdrLeDetn70RdrDetnElevn ReSideRdrLeDetn70RdrDetnPwr ReSideRdrLeDetn70RdrDetnRng ReSideRdrLeDetn70RdrDetnRngV ReSideRdrLeDetn70RdrDetnSts;
SIG_GROUP_ 326 ReSideRdrLeDetn71 1 : ReSideRdrLeDetn71RdrDetnAzi ReSideRdrLeDetn71RdrDetnChks ReSideRdrLeDetn71RdrDetnCntr ReSideRdrLeDetn71RdrDetnConf ReSideRdrLeDetn71RdrDetnElevn ReSideRdrLeDetn71RdrDetnPwr ReSideRdrLeDetn71RdrDetnRng ReSideRdrLeDetn71RdrDetnRngV ReSideRdrLeDetn71RdrDetnSts;
SIG_GROUP_ 326 ReSideRdrLeDetn72 1 : ReSideRdrLeDetn72RdrDetnAzi ReSideRdrLeDetn72RdrDetnChks ReSideRdrLeDetn72RdrDetnCntr ReSideRdrLeDetn72RdrDetnConf ReSideRdrLeDetn72RdrDetnElevn ReSideRdrLeDetn72RdrDetnPwr ReSideRdrLeDetn72RdrDetnRng ReSideRdrLeDetn72RdrDetnRngV ReSideRdrLeDetn72RdrDetnSts;
SIG_GROUP_ 328 ReSideRdrLeDetn73 1 : ReSideRdrLeDetn73RdrDetnAzi ReSideRdrLeDetn73RdrDetnChks ReSideRdrLeDetn73RdrDetnCntr ReSideRdrLeDetn73RdrDetnConf ReSideRdrLeDetn73RdrDetnElevn ReSideRdrLeDetn73RdrDetnPwr ReSideRdrLeDetn73RdrDetnRng ReSideRdrLeDetn73RdrDetnRngV ReSideRdrLeDetn73RdrDetnSts;
SIG_GROUP_ 328 ReSideRdrLeDetn74 1 : ReSideRdrLeDetn74RdrDetnAzi ReSideRdrLeDetn74RdrDetnChks ReSideRdrLeDetn74RdrDetnCntr ReSideRdrLeDetn74RdrDetnConf ReSideRdrLeDetn74RdrDetnElevn ReSideRdrLeDetn74RdrDetnPwr ReSideRdrLeDetn74RdrDetnRng ReSideRdrLeDetn74RdrDetnRngV ReSideRdrLeDetn74RdrDetnSts;
SIG_GROUP_ 328 ReSideRdrLeDetn75 1 : ReSideRdrLeDetn75RdrDetnAzi ReSideRdrLeDetn75RdrDetnChks ReSideRdrLeDetn75RdrDetnCntr ReSideRdrLeDetn75RdrDetnConf ReSideRdrLeDetn75RdrDetnElevn ReSideRdrLeDetn75RdrDetnPwr ReSideRdrLeDetn75RdrDetnRng ReSideRdrLeDetn75RdrDetnRngV ReSideRdrLeDetn75RdrDetnSts;
SIG_GROUP_ 328 ReSideRdrLeDetn76 1 : ReSideRdrLeDetn76RdrDetnAzi ReSideRdrLeDetn76RdrDetnChks ReSideRdrLeDetn76RdrDetnCntr ReSideRdrLeDetn76RdrDetnConf ReSideRdrLeDetn76RdrDetnElevn ReSideRdrLeDetn76RdrDetnPwr ReSideRdrLeDetn76RdrDetnRng ReSideRdrLeDetn76RdrDetnRngV ReSideRdrLeDetn76RdrDetnSts;
SIG_GROUP_ 328 ReSideRdrLeDetn77 1 : ReSideRdrLeDetn77RdrDetnAzi ReSideRdrLeDetn77RdrDetnChks ReSideRdrLeDetn77RdrDetnCntr ReSideRdrLeDetn77RdrDetnConf ReSideRdrLeDetn77RdrDetnElevn ReSideRdrLeDetn77RdrDetnPwr ReSideRdrLeDetn77RdrDetnRng ReSideRdrLeDetn77RdrDetnRngV ReSideRdrLeDetn77RdrDetnSts;
SIG_GROUP_ 328 ReSideRdrLeDetn78 1 : ReSideRdrLeDetn78RdrDetnAzi ReSideRdrLeDetn78RdrDetnChks ReSideRdrLeDetn78RdrDetnCntr ReSideRdrLeDetn78RdrDetnConf ReSideRdrLeDetn78RdrDetnElevn ReSideRdrLeDetn78RdrDetnPwr ReSideRdrLeDetn78RdrDetnRng ReSideRdrLeDetn78RdrDetnRngV ReSideRdrLeDetn78RdrDetnSts;
SIG_GROUP_ 330 ReSideRdrLeDetn79 1 : ReSideRdrLeDetn79RdrDetnAzi ReSideRdrLeDetn79RdrDetnChks ReSideRdrLeDetn79RdrDetnCntr ReSideRdrLeDetn79RdrDetnConf ReSideRdrLeDetn79RdrDetnElevn ReSideRdrLeDetn79RdrDetnPwr ReSideRdrLeDetn79RdrDetnRng ReSideRdrLeDetn79RdrDetnRngV ReSideRdrLeDetn79RdrDetnSts;
SIG_GROUP_ 330 ReSideRdrLeDetn80 1 : ReSideRdrLeDetn80RdrDetnAzi ReSideRdrLeDetn80RdrDetnChks ReSideRdrLeDetn80RdrDetnCntr ReSideRdrLeDetn80RdrDetnConf ReSideRdrLeDetn80RdrDetnElevn ReSideRdrLeDetn80RdrDetnPwr ReSideRdrLeDetn80RdrDetnRng ReSideRdrLeDetn80RdrDetnRngV ReSideRdrLeDetn80RdrDetnSts;
SIG_GROUP_ 330 ReSideRdrLeDetn81 1 : ReSideRdrLeDetn81RdrDetnAzi ReSideRdrLeDetn81RdrDetnChks ReSideRdrLeDetn81RdrDetnCntr ReSideRdrLeDetn81RdrDetnConf ReSideRdrLeDetn81RdrDetnElevn ReSideRdrLeDetn81RdrDetnPwr ReSideRdrLeDetn81RdrDetnRng ReSideRdrLeDetn81RdrDetnRngV ReSideRdrLeDetn81RdrDetnSts;
SIG_GROUP_ 330 ReSideRdrLeDetn82 1 : ReSideRdrLeDetn82RdrDetnAzi ReSideRdrLeDetn82RdrDetnChks ReSideRdrLeDetn82RdrDetnCntr ReSideRdrLeDetn82RdrDetnConf ReSideRdrLeDetn82RdrDetnElevn ReSideRdrLeDetn82RdrDetnPwr ReSideRdrLeDetn82RdrDetnRng ReSideRdrLeDetn82RdrDetnRngV ReSideRdrLeDetn82RdrDetnSts;
SIG_GROUP_ 330 ReSideRdrLeDetn83 1 : ReSideRdrLeDetn83RdrDetnAzi ReSideRdrLeDetn83RdrDetnChks ReSideRdrLeDetn83RdrDetnCntr ReSideRdrLeDetn83RdrDetnConf ReSideRdrLeDetn83RdrDetnElevn ReSideRdrLeDetn83RdrDetnPwr ReSideRdrLeDetn83RdrDetnRng ReSideRdrLeDetn83RdrDetnRngV ReSideRdrLeDetn83RdrDetnSts;
SIG_GROUP_ 330 ReSideRdrLeDetn84 1 : ReSideRdrLeDetn84RdrDetnAzi ReSideRdrLeDetn84RdrDetnChks ReSideRdrLeDetn84RdrDetnCntr ReSideRdrLeDetn84RdrDetnConf ReSideRdrLeDetn84RdrDetnElevn ReSideRdrLeDetn84RdrDetnPwr ReSideRdrLeDetn84RdrDetnRng ReSideRdrLeDetn84RdrDetnRngV ReSideRdrLeDetn84RdrDetnSts;
