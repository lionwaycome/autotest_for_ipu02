// *************************************************************************** *
// *                                                                           *
// *                      Mentor Graphics Corporation                          *
// *                          All rights reserved                              *
// *                                                                           *
// *************************************************************************** *
// *                                                                           *
// * Description:         CANDB File                                           *
// * Generated at:        2020-04-14 13:14:03                                  *
// * System:              SDB20010                                             *
// * Variant:             EX11_AVP                                             *
// * Network:             SafetyCANFD3                                         *
// *                                                                           *
// *************************************************************************** *
// *                                                                           *
// *             THIS CONFIGURATION MIGHT CONTAIN SOME ERRORS                  *
// *              IF THE INPUT MODEL WAS NOT PROPERLY FORMED!                  *
// *                    Do Not Use this File directly!                         *
// *                                                                           *
// *************************************************************************** *
VERSION "SafetyCANFD3"

NS_ :

BS_:

BU_:  ASDM ETC PAS SODL SODR

BO_ 355 SODRSafetyCANFD3Frame26: 64 SODR
 SG_ ReSideRdrRiObj4_UB : 291|1@0+ (1,0) [0|1] "" ASDM,PAS
 SG_ ReSideRdrRiObj4Heading : 287|12@0+ (0.1,-180.0) [-180.0|180.0] "Deg" ASDM,PAS
 SG_ ReSideRdrRiObj4ObjBoxCenterLat : 23|9@0+ (0.1,-25.0) [-25.0|25.0] "m" ASDM,PAS
 SG_ ReSideRdrRiObj4ObjBoxCenterLgt : 30|9@0+ (0.1,-25.0) [-25.0|25.0] "m" ASDM,PAS
 SG_ ReSideRdrRiObj4ObservationHist : 63|32@0+ (1.0,0.0) [0.0|4294967295.0] "Unitless" ASDM,PAS
 SG_ ReSideRdrRiObj4RdrObjAx : 7|8@0- (0.1,0.0) [-12.8|12.700000000000001] "m/s^2" ASDM,PAS
 SG_ ReSideRdrRiObj4RdrObjAy : 15|8@0- (0.1,0.0) [-12.8|12.700000000000001] "m/s^2" ASDM,PAS
 SG_ ReSideRdrRiObj4RdrObjBoxLength : 37|9@0+ (0.1,0.0) [0.0|50.0] "m" ASDM,PAS
 SG_ ReSideRdrRiObj4RdrObjBoxWidth : 44|9@0+ (0.1,0.0) [0.0|50.0] "m" ASDM,PAS
 SG_ ReSideRdrRiObj4RdrObjChks : 95|8@0+ (1.0,0.0) [0.0|255.0] "Unitless" ASDM,PAS
 SG_ ReSideRdrRiObj4RdrObjCntr : 103|4@0+ (1.0,0.0) [0.0|15.0] "Unitless" ASDM,PAS
 SG_ ReSideRdrRiObj4RdrObjCoastCnt : 279|5@0+ (1.0,0.0) [0.0|31.0] "Unitless" ASDM,PAS
 SG_ ReSideRdrRiObj4RdrObjConf : 99|4@0+ (7.0,0.0) [0.0|105.0] "%" ASDM,PAS
 SG_ ReSideRdrRiObj4RdrObjDx : 191|13@0+ (0.05,-200.0) [-200.0|200.0] "m" ASDM,PAS
 SG_ ReSideRdrRiObj4RdrObjDxStdDe : 111|8@0+ (0.05,0.0) [0.0|12.700000000000001] "m" ASDM,PAS
 SG_ ReSideRdrRiObj4RdrObjDy : 119|13@0+ (0.05,-200.0) [-200.0|200.0] "m" ASDM,PAS
 SG_ ReSideRdrRiObj4RdrObjDyStdDe : 183|8@0+ (0.05,0.0) [0.0|12.700000000000001] "m" ASDM,PAS
 SG_ ReSideRdrRiObj4RdrObjElevnConf : 223|4@0+ (7.0,0.0) [0.0|105.0] "%" ASDM,PAS
 SG_ ReSideRdrRiObj4RdrObjElevnSts : 153|2@0+ (1,0) [0|3] "" ASDM,PAS
 SG_ ReSideRdrRiObj4RdrObjID : 167|8@0+ (1.0,0.0) [0.0|255.0] "Unitless" ASDM,PAS
 SG_ ReSideRdrRiObj4RdrObjIsInFreeSpace : 192|1@0+ (1,0) [0|1] "" ASDM,PAS
 SG_ ReSideRdrRiObj4RdrObjMirrProblty : 219|4@0+ (7.0,0.0) [0.0|105.0] "%" ASDM,PAS
 SG_ ReSideRdrRiObj4RdrObjMtnPat : 122|3@0+ (1,0) [0|7] "" ASDM,PAS
 SG_ ReSideRdrRiObj4RdrObjNotRealProblty : 231|4@0+ (7.0,0.0) [0.0|105.0] "%" ASDM,PAS
 SG_ ReSideRdrRiObj4RdrObjStatyCnt : 239|7@0+ (1.0,0.0) [0.0|127.0] "Unitless" ASDM,PAS
 SG_ ReSideRdrRiObj4RdrObjTiAlv : 247|7@0+ (1.0,0.0) [0.0|127.0] "Unitless" ASDM,PAS
 SG_ ReSideRdrRiObj4RdrObjTrackSts : 194|2@0+ (1,0) [0|3] "" ASDM,PAS
 SG_ ReSideRdrRiObj4RdrObjTyp : 51|4@0+ (1,0) [0|15] "" ASDM,PAS
 SG_ ReSideRdrRiObj4RdrObjTypConfBike : 175|4@0+ (7.0,0.0) [0.0|105.0] "%" ASDM,PAS
 SG_ ReSideRdrRiObj4RdrObjTypConfPed : 171|4@0+ (7.0,0.0) [0.0|105.0] "%" ASDM,PAS
 SG_ ReSideRdrRiObj4RdrObjTypConfVeh : 227|4@0+ (7.0,0.0) [0.0|105.0] "%" ASDM,PAS
 SG_ ReSideRdrRiObj4RdrObjVx : 255|14@0+ (0.02,-128.0) [-128.0|128.0] "m/s" ASDM,PAS
 SG_ ReSideRdrRiObj4RdrObjVxStdDe : 271|6@0+ (0.05,0.0) [0.0|2.0] "m/s" ASDM,PAS
 SG_ ReSideRdrRiObj4RdrObjVy : 207|14@0+ (0.02,-128.0) [-128.0|128.0] "m/s" ASDM,PAS
 SG_ ReSideRdrRiObj4RdrObjVyStdDe : 159|6@0+ (0.05,0.0) [0.0|2.0] "m/s" ASDM,PAS
 SG_ ReSideRdrRiObj4RelVx : 135|12@0+ (0.02,-35.6) [-35.6|35.6] "m/s" ASDM,PAS
 SG_ ReSideRdrRiObj4RelVy : 139|12@0+ (0.02,-35.6) [-35.6|35.6] "m/s" ASDM,PAS

BO_ 357 SODRSafetyCANFD3Frame27: 64 SODR
 SG_ ReSideRdrRiObj5_UB : 291|1@0+ (1,0) [0|1] "" ASDM,PAS
 SG_ ReSideRdrRiObj5Heading : 287|12@0+ (0.1,-180.0) [-180.0|180.0] "Deg" ASDM,PAS
 SG_ ReSideRdrRiObj5ObjBoxCenterLat : 23|9@0+ (0.1,-25.0) [-25.0|25.0] "m" ASDM,PAS
 SG_ ReSideRdrRiObj5ObjBoxCenterLgt : 30|9@0+ (0.1,-25.0) [-25.0|25.0] "m" ASDM,PAS
 SG_ ReSideRdrRiObj5ObservationHist : 63|32@0+ (1.0,0.0) [0.0|4294967295.0] "Unitless" ASDM,PAS
 SG_ ReSideRdrRiObj5RdrObjAx : 7|8@0- (0.1,0.0) [-12.8|12.700000000000001] "m/s^2" ASDM,PAS
 SG_ ReSideRdrRiObj5RdrObjAy : 15|8@0- (0.1,0.0) [-12.8|12.700000000000001] "m/s^2" ASDM,PAS
 SG_ ReSideRdrRiObj5RdrObjBoxLength : 37|9@0+ (0.1,0.0) [0.0|50.0] "m" ASDM,PAS
 SG_ ReSideRdrRiObj5RdrObjBoxWidth : 44|9@0+ (0.1,0.0) [0.0|50.0] "m" ASDM,PAS
 SG_ ReSideRdrRiObj5RdrObjChks : 95|8@0+ (1.0,0.0) [0.0|255.0] "Unitless" ASDM,PAS
 SG_ ReSideRdrRiObj5RdrObjCntr : 103|4@0+ (1.0,0.0) [0.0|15.0] "Unitless" ASDM,PAS
 SG_ ReSideRdrRiObj5RdrObjCoastCnt : 279|5@0+ (1.0,0.0) [0.0|31.0] "Unitless" ASDM,PAS
 SG_ ReSideRdrRiObj5RdrObjConf : 99|4@0+ (7.0,0.0) [0.0|105.0] "%" ASDM,PAS
 SG_ ReSideRdrRiObj5RdrObjDx : 191|13@0+ (0.05,-200.0) [-200.0|200.0] "m" ASDM,PAS
 SG_ ReSideRdrRiObj5RdrObjDxStdDe : 111|8@0+ (0.05,0.0) [0.0|12.700000000000001] "m" ASDM,PAS
 SG_ ReSideRdrRiObj5RdrObjDy : 119|13@0+ (0.05,-200.0) [-200.0|200.0] "m" ASDM,PAS
 SG_ ReSideRdrRiObj5RdrObjDyStdDe : 183|8@0+ (0.05,0.0) [0.0|12.700000000000001] "m" ASDM,PAS
 SG_ ReSideRdrRiObj5RdrObjElevnConf : 223|4@0+ (7.0,0.0) [0.0|105.0] "%" ASDM,PAS
 SG_ ReSideRdrRiObj5RdrObjElevnSts : 153|2@0+ (1,0) [0|3] "" ASDM,PAS
 SG_ ReSideRdrRiObj5RdrObjID : 167|8@0+ (1.0,0.0) [0.0|255.0] "Unitless" ASDM,PAS
 SG_ ReSideRdrRiObj5RdrObjIsInFreeSpace : 192|1@0+ (1,0) [0|1] "" ASDM,PAS
 SG_ ReSideRdrRiObj5RdrObjMirrProblty : 219|4@0+ (7.0,0.0) [0.0|105.0] "%" ASDM,PAS
 SG_ ReSideRdrRiObj5RdrObjMtnPat : 122|3@0+ (1,0) [0|7] "" ASDM,PAS
 SG_ ReSideRdrRiObj5RdrObjNotRealProblty : 231|4@0+ (7.0,0.0) [0.0|105.0] "%" ASDM,PAS
 SG_ ReSideRdrRiObj5RdrObjStatyCnt : 239|7@0+ (1.0,0.0) [0.0|127.0] "Unitless" ASDM,PAS
 SG_ ReSideRdrRiObj5RdrObjTiAlv : 247|7@0+ (1.0,0.0) [0.0|127.0] "Unitless" ASDM,PAS
 SG_ ReSideRdrRiObj5RdrObjTrackSts : 194|2@0+ (1,0) [0|3] "" ASDM,PAS
 SG_ ReSideRdrRiObj5RdrObjTyp : 51|4@0+ (1,0) [0|15] "" ASDM,PAS
 SG_ ReSideRdrRiObj5RdrObjTypConfBike : 175|4@0+ (7.0,0.0) [0.0|105.0] "%" ASDM,PAS
 SG_ ReSideRdrRiObj5RdrObjTypConfPed : 171|4@0+ (7.0,0.0) [0.0|105.0] "%" ASDM,PAS
 SG_ ReSideRdrRiObj5RdrObjTypConfVeh : 227|4@0+ (7.0,0.0) [0.0|105.0] "%" ASDM,PAS
 SG_ ReSideRdrRiObj5RdrObjVx : 255|14@0+ (0.02,-128.0) [-128.0|128.0] "m/s" ASDM,PAS
 SG_ ReSideRdrRiObj5RdrObjVxStdDe : 271|6@0+ (0.05,0.0) [0.0|2.0] "m/s" ASDM,PAS
 SG_ ReSideRdrRiObj5RdrObjVy : 207|14@0+ (0.02,-128.0) [-128.0|128.0] "m/s" ASDM,PAS
 SG_ ReSideRdrRiObj5RdrObjVyStdDe : 159|6@0+ (0.05,0.0) [0.0|2.0] "m/s" ASDM,PAS
 SG_ ReSideRdrRiObj5RelVx : 135|12@0+ (0.02,-35.6) [-35.6|35.6] "m/s" ASDM,PAS
 SG_ ReSideRdrRiObj5RelVy : 139|12@0+ (0.02,-35.6) [-35.6|35.6] "m/s" ASDM,PAS

BO_ 359 SODRSafetyCANFD3Frame28: 64 SODR
 SG_ ReSideRdrRiObj6_UB : 291|1@0+ (1,0) [0|1] "" ASDM,PAS
 SG_ ReSideRdrRiObj6Heading : 287|12@0+ (0.1,-180.0) [-180.0|180.0] "Deg" ASDM,PAS
 SG_ ReSideRdrRiObj6ObjBoxCenterLat : 23|9@0+ (0.1,-25.0) [-25.0|25.0] "m" ASDM,PAS
 SG_ ReSideRdrRiObj6ObjBoxCenterLgt : 30|9@0+ (0.1,-25.0) [-25.0|25.0] "m" ASDM,PAS
 SG_ ReSideRdrRiObj6ObservationHist : 63|32@0+ (1.0,0.0) [0.0|4294967295.0] "Unitless" ASDM,PAS
 SG_ ReSideRdrRiObj6RdrObjAx : 7|8@0- (0.1,0.0) [-12.8|12.700000000000001] "m/s^2" ASDM,PAS
 SG_ ReSideRdrRiObj6RdrObjAy : 15|8@0- (0.1,0.0) [-12.8|12.700000000000001] "m/s^2" ASDM,PAS
 SG_ ReSideRdrRiObj6RdrObjBoxLength : 37|9@0+ (0.1,0.0) [0.0|50.0] "m" ASDM,PAS
 SG_ ReSideRdrRiObj6RdrObjBoxWidth : 44|9@0+ (0.1,0.0) [0.0|50.0] "m" ASDM,PAS
 SG_ ReSideRdrRiObj6RdrObjChks : 95|8@0+ (1.0,0.0) [0.0|255.0] "Unitless" ASDM,PAS
 SG_ ReSideRdrRiObj6RdrObjCntr : 103|4@0+ (1.0,0.0) [0.0|15.0] "Unitless" ASDM,PAS
 SG_ ReSideRdrRiObj6RdrObjCoastCnt : 279|5@0+ (1.0,0.0) [0.0|31.0] "Unitless" ASDM,PAS
 SG_ ReSideRdrRiObj6RdrObjConf : 99|4@0+ (7.0,0.0) [0.0|105.0] "%" ASDM,PAS
 SG_ ReSideRdrRiObj6RdrObjDx : 191|13@0+ (0.05,-200.0) [-200.0|200.0] "m" ASDM,PAS
 SG_ ReSideRdrRiObj6RdrObjDxStdDe : 111|8@0+ (0.05,0.0) [0.0|12.700000000000001] "m" ASDM,PAS
 SG_ ReSideRdrRiObj6RdrObjDy : 119|13@0+ (0.05,-200.0) [-200.0|200.0] "m" ASDM,PAS
 SG_ ReSideRdrRiObj6RdrObjDyStdDe : 183|8@0+ (0.05,0.0) [0.0|12.700000000000001] "m" ASDM,PAS
 SG_ ReSideRdrRiObj6RdrObjElevnConf : 223|4@0+ (7.0,0.0) [0.0|105.0] "%" ASDM,PAS
 SG_ ReSideRdrRiObj6RdrObjElevnSts : 153|2@0+ (1,0) [0|3] "" ASDM,PAS
 SG_ ReSideRdrRiObj6RdrObjID : 167|8@0+ (1.0,0.0) [0.0|255.0] "Unitless" ASDM,PAS
 SG_ ReSideRdrRiObj6RdrObjIsInFreeSpace : 192|1@0+ (1,0) [0|1] "" ASDM,PAS
 SG_ ReSideRdrRiObj6RdrObjMirrProblty : 219|4@0+ (7.0,0.0) [0.0|105.0] "%" ASDM,PAS
 SG_ ReSideRdrRiObj6RdrObjMtnPat : 122|3@0+ (1,0) [0|7] "" ASDM,PAS
 SG_ ReSideRdrRiObj6RdrObjNotRealProblty : 231|4@0+ (7.0,0.0) [0.0|105.0] "%" ASDM,PAS
 SG_ ReSideRdrRiObj6RdrObjStatyCnt : 239|7@0+ (1.0,0.0) [0.0|127.0] "Unitless" ASDM,PAS
 SG_ ReSideRdrRiObj6RdrObjTiAlv : 247|7@0+ (1.0,0.0) [0.0|127.0] "Unitless" ASDM,PAS
 SG_ ReSideRdrRiObj6RdrObjTrackSts : 194|2@0+ (1,0) [0|3] "" ASDM,PAS
 SG_ ReSideRdrRiObj6RdrObjTyp : 51|4@0+ (1,0) [0|15] "" ASDM,PAS
 SG_ ReSideRdrRiObj6RdrObjTypConfBike : 175|4@0+ (7.0,0.0) [0.0|105.0] "%" ASDM,PAS
 SG_ ReSideRdrRiObj6RdrObjTypConfPed : 171|4@0+ (7.0,0.0) [0.0|105.0] "%" ASDM,PAS
 SG_ ReSideRdrRiObj6RdrObjTypConfVeh : 227|4@0+ (7.0,0.0) [0.0|105.0] "%" ASDM,PAS
 SG_ ReSideRdrRiObj6RdrObjVx : 255|14@0+ (0.02,-128.0) [-128.0|128.0] "m/s" ASDM,PAS
 SG_ ReSideRdrRiObj6RdrObjVxStdDe : 271|6@0+ (0.05,0.0) [0.0|2.0] "m/s" ASDM,PAS
 SG_ ReSideRdrRiObj6RdrObjVy : 207|14@0+ (0.02,-128.0) [-128.0|128.0] "m/s" ASDM,PAS
 SG_ ReSideRdrRiObj6RdrObjVyStdDe : 159|6@0+ (0.05,0.0) [0.0|2.0] "m/s" ASDM,PAS
 SG_ ReSideRdrRiObj6RelVx : 135|12@0+ (0.02,-35.6) [-35.6|35.6] "m/s" ASDM,PAS
 SG_ ReSideRdrRiObj6RelVy : 139|12@0+ (0.02,-35.6) [-35.6|35.6] "m/s" ASDM,PAS

BO_ 361 SODRSafetyCANFD3Frame29: 64 SODR
 SG_ ReSideRdrRiObj7_UB : 291|1@0+ (1,0) [0|1] "" ASDM,PAS
 SG_ ReSideRdrRiObj7Heading : 287|12@0+ (0.1,-180.0) [-180.0|180.0] "Deg" ASDM,PAS
 SG_ ReSideRdrRiObj7ObjBoxCenterLat : 23|9@0+ (0.1,-25.0) [-25.0|25.0] "m" ASDM,PAS
 SG_ ReSideRdrRiObj7ObjBoxCenterLgt : 30|9@0+ (0.1,-25.0) [-25.0|25.0] "m" ASDM,PAS
 SG_ ReSideRdrRiObj7ObservationHist : 63|32@0+ (1.0,0.0) [0.0|4294967295.0] "Unitless" ASDM,PAS
 SG_ ReSideRdrRiObj7RdrObjAx : 7|8@0- (0.1,0.0) [-12.8|12.700000000000001] "m/s^2" ASDM,PAS
 SG_ ReSideRdrRiObj7RdrObjAy : 15|8@0- (0.1,0.0) [-12.8|12.700000000000001] "m/s^2" ASDM,PAS
 SG_ ReSideRdrRiObj7RdrObjBoxLength : 37|9@0+ (0.1,0.0) [0.0|50.0] "m" ASDM,PAS
 SG_ ReSideRdrRiObj7RdrObjBoxWidth : 44|9@0+ (0.1,0.0) [0.0|50.0] "m" ASDM,PAS
 SG_ ReSideRdrRiObj7RdrObjChks : 95|8@0+ (1.0,0.0) [0.0|255.0] "Unitless" ASDM,PAS
 SG_ ReSideRdrRiObj7RdrObjCntr : 103|4@0+ (1.0,0.0) [0.0|15.0] "Unitless" ASDM,PAS
 SG_ ReSideRdrRiObj7RdrObjCoastCnt : 279|5@0+ (1.0,0.0) [0.0|31.0] "Unitless" ASDM,PAS
 SG_ ReSideRdrRiObj7RdrObjConf : 99|4@0+ (7.0,0.0) [0.0|105.0] "%" ASDM,PAS
 SG_ ReSideRdrRiObj7RdrObjDx : 191|13@0+ (0.05,-200.0) [-200.0|200.0] "m" ASDM,PAS
 SG_ ReSideRdrRiObj7RdrObjDxStdDe : 111|8@0+ (0.05,0.0) [0.0|12.700000000000001] "m" ASDM,PAS
 SG_ ReSideRdrRiObj7RdrObjDy : 119|13@0+ (0.05,-200.0) [-200.0|200.0] "m" ASDM,PAS
 SG_ ReSideRdrRiObj7RdrObjDyStdDe : 183|8@0+ (0.05,0.0) [0.0|12.700000000000001] "m" ASDM,PAS
 SG_ ReSideRdrRiObj7RdrObjElevnConf : 223|4@0+ (7.0,0.0) [0.0|105.0] "%" ASDM,PAS
 SG_ ReSideRdrRiObj7RdrObjElevnSts : 153|2@0+ (1,0) [0|3] "" ASDM,PAS
 SG_ ReSideRdrRiObj7RdrObjID : 167|8@0+ (1.0,0.0) [0.0|255.0] "Unitless" ASDM,PAS
 SG_ ReSideRdrRiObj7RdrObjIsInFreeSpace : 192|1@0+ (1,0) [0|1] "" ASDM,PAS
 SG_ ReSideRdrRiObj7RdrObjMirrProblty : 219|4@0+ (7.0,0.0) [0.0|105.0] "%" ASDM,PAS
 SG_ ReSideRdrRiObj7RdrObjMtnPat : 122|3@0+ (1,0) [0|7] "" ASDM,PAS
 SG_ ReSideRdrRiObj7RdrObjNotRealProblty : 231|4@0+ (7.0,0.0) [0.0|105.0] "%" ASDM,PAS
 SG_ ReSideRdrRiObj7RdrObjStatyCnt : 239|7@0+ (1.0,0.0) [0.0|127.0] "Unitless" ASDM,PAS
 SG_ ReSideRdrRiObj7RdrObjTiAlv : 247|7@0+ (1.0,0.0) [0.0|127.0] "Unitless" ASDM,PAS
 SG_ ReSideRdrRiObj7RdrObjTrackSts : 194|2@0+ (1,0) [0|3] "" ASDM,PAS
 SG_ ReSideRdrRiObj7RdrObjTyp : 51|4@0+ (1,0) [0|15] "" ASDM,PAS
 SG_ ReSideRdrRiObj7RdrObjTypConfBike : 175|4@0+ (7.0,0.0) [0.0|105.0] "%" ASDM,PAS
 SG_ ReSideRdrRiObj7RdrObjTypConfPed : 171|4@0+ (7.0,0.0) [0.0|105.0] "%" ASDM,PAS
 SG_ ReSideRdrRiObj7RdrObjTypConfVeh : 227|4@0+ (7.0,0.0) [0.0|105.0] "%" ASDM,PAS
 SG_ ReSideRdrRiObj7RdrObjVx : 255|14@0+ (0.02,-128.0) [-128.0|128.0] "m/s" ASDM,PAS
 SG_ ReSideRdrRiObj7RdrObjVxStdDe : 271|6@0+ (0.05,0.0) [0.0|2.0] "m/s" ASDM,PAS
 SG_ ReSideRdrRiObj7RdrObjVy : 207|14@0+ (0.02,-128.0) [-128.0|128.0] "m/s" ASDM,PAS
 SG_ ReSideRdrRiObj7RdrObjVyStdDe : 159|6@0+ (0.05,0.0) [0.0|2.0] "m/s" ASDM,PAS
 SG_ ReSideRdrRiObj7RelVx : 135|12@0+ (0.02,-35.6) [-35.6|35.6] "m/s" ASDM,PAS
 SG_ ReSideRdrRiObj7RelVy : 139|12@0+ (0.02,-35.6) [-35.6|35.6] "m/s" ASDM,PAS

BO_ 363 SODRSafetyCANFD3Frame30: 64 SODR
 SG_ ReSideRdrRiObj8_UB : 291|1@0+ (1,0) [0|1] "" ASDM,PAS
 SG_ ReSideRdrRiObj8Heading : 287|12@0+ (0.1,-180.0) [-180.0|180.0] "Deg" ASDM,PAS
 SG_ ReSideRdrRiObj8ObjBoxCenterLat : 23|9@0+ (0.1,-25.0) [-25.0|25.0] "m" ASDM,PAS
 SG_ ReSideRdrRiObj8ObjBoxCenterLgt : 30|9@0+ (0.1,-25.0) [-25.0|25.0] "m" ASDM,PAS
 SG_ ReSideRdrRiObj8ObservationHist : 63|32@0+ (1.0,0.0) [0.0|4294967295.0] "Unitless" ASDM,PAS
 SG_ ReSideRdrRiObj8RdrObjAx : 7|8@0- (0.1,0.0) [-12.8|12.700000000000001] "m/s^2" ASDM,PAS
 SG_ ReSideRdrRiObj8RdrObjAy : 15|8@0- (0.1,0.0) [-12.8|12.700000000000001] "m/s^2" ASDM,PAS
 SG_ ReSideRdrRiObj8RdrObjBoxLength : 37|9@0+ (0.1,0.0) [0.0|50.0] "m" ASDM,PAS
 SG_ ReSideRdrRiObj8RdrObjBoxWidth : 44|9@0+ (0.1,0.0) [0.0|50.0] "m" ASDM,PAS
 SG_ ReSideRdrRiObj8RdrObjChks : 95|8@0+ (1.0,0.0) [0.0|255.0] "Unitless" ASDM,PAS
 SG_ ReSideRdrRiObj8RdrObjCntr : 103|4@0+ (1.0,0.0) [0.0|15.0] "Unitless" ASDM,PAS
 SG_ ReSideRdrRiObj8RdrObjCoastCnt : 279|5@0+ (1.0,0.0) [0.0|31.0] "Unitless" ASDM,PAS
 SG_ ReSideRdrRiObj8RdrObjConf : 99|4@0+ (7.0,0.0) [0.0|105.0] "%" ASDM,PAS
 SG_ ReSideRdrRiObj8RdrObjDx : 191|13@0+ (0.05,-200.0) [-200.0|200.0] "m" ASDM,PAS
 SG_ ReSideRdrRiObj8RdrObjDxStdDe : 111|8@0+ (0.05,0.0) [0.0|12.700000000000001] "m" ASDM,PAS
 SG_ ReSideRdrRiObj8RdrObjDy : 119|13@0+ (0.05,-200.0) [-200.0|200.0] "m" ASDM,PAS
 SG_ ReSideRdrRiObj8RdrObjDyStdDe : 183|8@0+ (0.05,0.0) [0.0|12.700000000000001] "m" ASDM,PAS
 SG_ ReSideRdrRiObj8RdrObjElevnConf : 223|4@0+ (7.0,0.0) [0.0|105.0] "%" ASDM,PAS
 SG_ ReSideRdrRiObj8RdrObjElevnSts : 153|2@0+ (1,0) [0|3] "" ASDM,PAS
 SG_ ReSideRdrRiObj8RdrObjID : 167|8@0+ (1.0,0.0) [0.0|255.0] "Unitless" ASDM,PAS
 SG_ ReSideRdrRiObj8RdrObjIsInFreeSpace : 192|1@0+ (1,0) [0|1] "" ASDM,PAS
 SG_ ReSideRdrRiObj8RdrObjMirrProblty : 219|4@0+ (7.0,0.0) [0.0|105.0] "%" ASDM,PAS
 SG_ ReSideRdrRiObj8RdrObjMtnPat : 122|3@0+ (1,0) [0|7] "" ASDM,PAS
 SG_ ReSideRdrRiObj8RdrObjNotRealProblty : 231|4@0+ (7.0,0.0) [0.0|105.0] "%" ASDM,PAS
 SG_ ReSideRdrRiObj8RdrObjStatyCnt : 239|7@0+ (1.0,0.0) [0.0|127.0] "Unitless" ASDM,PAS
 SG_ ReSideRdrRiObj8RdrObjTiAlv : 247|7@0+ (1.0,0.0) [0.0|127.0] "Unitless" ASDM,PAS
 SG_ ReSideRdrRiObj8RdrObjTrackSts : 194|2@0+ (1,0) [0|3] "" ASDM,PAS
 SG_ ReSideRdrRiObj8RdrObjTyp : 51|4@0+ (1,0) [0|15] "" ASDM,PAS
 SG_ ReSideRdrRiObj8RdrObjTypConfBike : 175|4@0+ (7.0,0.0) [0.0|105.0] "%" ASDM,PAS
 SG_ ReSideRdrRiObj8RdrObjTypConfPed : 171|4@0+ (7.0,0.0) [0.0|105.0] "%" ASDM,PAS
 SG_ ReSideRdrRiObj8RdrObjTypConfVeh : 227|4@0+ (7.0,0.0) [0.0|105.0] "%" ASDM,PAS
 SG_ ReSideRdrRiObj8RdrObjVx : 255|14@0+ (0.02,-128.0) [-128.0|128.0] "m/s" ASDM,PAS
 SG_ ReSideRdrRiObj8RdrObjVxStdDe : 271|6@0+ (0.05,0.0) [0.0|2.0] "m/s" ASDM,PAS
 SG_ ReSideRdrRiObj8RdrObjVy : 207|14@0+ (0.02,-128.0) [-128.0|128.0] "m/s" ASDM,PAS
 SG_ ReSideRdrRiObj8RdrObjVyStdDe : 159|6@0+ (0.05,0.0) [0.0|2.0] "m/s" ASDM,PAS
 SG_ ReSideRdrRiObj8RelVx : 135|12@0+ (0.02,-35.6) [-35.6|35.6] "m/s" ASDM,PAS
 SG_ ReSideRdrRiObj8RelVy : 139|12@0+ (0.02,-35.6) [-35.6|35.6] "m/s" ASDM,PAS

BO_ 365 SODRSafetyCANFD3Frame31: 64 SODR
 SG_ ReSideRdrRiObj9_UB : 291|1@0+ (1,0) [0|1] "" ASDM,PAS
 SG_ ReSideRdrRiObj9Heading : 287|12@0+ (0.1,-180.0) [-180.0|180.0] "Deg" ASDM,PAS
 SG_ ReSideRdrRiObj9ObjBoxCenterLat : 23|9@0+ (0.1,-25.0) [-25.0|25.0] "m" ASDM,PAS
 SG_ ReSideRdrRiObj9ObjBoxCenterLgt : 30|9@0+ (0.1,-25.0) [-25.0|25.0] "m" ASDM,PAS
 SG_ ReSideRdrRiObj9ObservationHist : 63|32@0+ (1.0,0.0) [0.0|4294967295.0] "Unitless" ASDM,PAS
 SG_ ReSideRdrRiObj9RdrObjAx : 7|8@0- (0.1,0.0) [-12.8|12.700000000000001] "m/s^2" ASDM,PAS
 SG_ ReSideRdrRiObj9RdrObjAy : 15|8@0- (0.1,0.0) [-12.8|12.700000000000001] "m/s^2" ASDM,PAS
 SG_ ReSideRdrRiObj9RdrObjBoxLength : 37|9@0+ (0.1,0.0) [0.0|50.0] "m" ASDM,PAS
 SG_ ReSideRdrRiObj9RdrObjBoxWidth : 44|9@0+ (0.1,0.0) [0.0|50.0] "m" ASDM,PAS
 SG_ ReSideRdrRiObj9RdrObjChks : 95|8@0+ (1.0,0.0) [0.0|255.0] "Unitless" ASDM,PAS
 SG_ ReSideRdrRiObj9RdrObjCntr : 103|4@0+ (1.0,0.0) [0.0|15.0] "Unitless" ASDM,PAS
 SG_ ReSideRdrRiObj9RdrObjCoastCnt : 279|5@0+ (1.0,0.0) [0.0|31.0] "Unitless" ASDM,PAS
 SG_ ReSideRdrRiObj9RdrObjConf : 99|4@0+ (7.0,0.0) [0.0|105.0] "%" ASDM,PAS
 SG_ ReSideRdrRiObj9RdrObjDx : 191|13@0+ (0.05,-200.0) [-200.0|200.0] "m" ASDM,PAS
 SG_ ReSideRdrRiObj9RdrObjDxStdDe : 111|8@0+ (0.05,0.0) [0.0|12.700000000000001] "m" ASDM,PAS
 SG_ ReSideRdrRiObj9RdrObjDy : 119|13@0+ (0.05,-200.0) [-200.0|200.0] "m" ASDM,PAS
 SG_ ReSideRdrRiObj9RdrObjDyStdDe : 183|8@0+ (0.05,0.0) [0.0|12.700000000000001] "m" ASDM,PAS
 SG_ ReSideRdrRiObj9RdrObjElevnConf : 223|4@0+ (7.0,0.0) [0.0|105.0] "%" ASDM,PAS
 SG_ ReSideRdrRiObj9RdrObjElevnSts : 153|2@0+ (1,0) [0|3] "" ASDM,PAS
 SG_ ReSideRdrRiObj9RdrObjID : 167|8@0+ (1.0,0.0) [0.0|255.0] "Unitless" ASDM,PAS
 SG_ ReSideRdrRiObj9RdrObjIsInFreeSpace : 192|1@0+ (1,0) [0|1] "" ASDM,PAS
 SG_ ReSideRdrRiObj9RdrObjMirrProblty : 219|4@0+ (7.0,0.0) [0.0|105.0] "%" ASDM,PAS
 SG_ ReSideRdrRiObj9RdrObjMtnPat : 122|3@0+ (1,0) [0|7] "" ASDM,PAS
 SG_ ReSideRdrRiObj9RdrObjNotRealProblty : 231|4@0+ (7.0,0.0) [0.0|105.0] "%" ASDM,PAS
 SG_ ReSideRdrRiObj9RdrObjStatyCnt : 239|7@0+ (1.0,0.0) [0.0|127.0] "Unitless" ASDM,PAS
 SG_ ReSideRdrRiObj9RdrObjTiAlv : 247|7@0+ (1.0,0.0) [0.0|127.0] "Unitless" ASDM,PAS
 SG_ ReSideRdrRiObj9RdrObjTrackSts : 194|2@0+ (1,0) [0|3] "" ASDM,PAS
 SG_ ReSideRdrRiObj9RdrObjTyp : 51|4@0+ (1,0) [0|15] "" ASDM,PAS
 SG_ ReSideRdrRiObj9RdrObjTypConfBike : 175|4@0+ (7.0,0.0) [0.0|105.0] "%" ASDM,PAS
 SG_ ReSideRdrRiObj9RdrObjTypConfPed : 171|4@0+ (7.0,0.0) [0.0|105.0] "%" ASDM,PAS
 SG_ ReSideRdrRiObj9RdrObjTypConfVeh : 227|4@0+ (7.0,0.0) [0.0|105.0] "%" ASDM,PAS
 SG_ ReSideRdrRiObj9RdrObjVx : 255|14@0+ (0.02,-128.0) [-128.0|128.0] "m/s" ASDM,PAS
 SG_ ReSideRdrRiObj9RdrObjVxStdDe : 271|6@0+ (0.05,0.0) [0.0|2.0] "m/s" ASDM,PAS
 SG_ ReSideRdrRiObj9RdrObjVy : 207|14@0+ (0.02,-128.0) [-128.0|128.0] "m/s" ASDM,PAS
 SG_ ReSideRdrRiObj9RdrObjVyStdDe : 159|6@0+ (0.05,0.0) [0.0|2.0] "m/s" ASDM,PAS
 SG_ ReSideRdrRiObj9RelVx : 135|12@0+ (0.02,-35.6) [-35.6|35.6] "m/s" ASDM,PAS
 SG_ ReSideRdrRiObj9RelVy : 139|12@0+ (0.02,-35.6) [-35.6|35.6] "m/s" ASDM,PAS

BO_ 367 SODRSafetyCANFD3Frame32: 64 SODR
 SG_ ReSideRdrRiObj10_UB : 291|1@0+ (1,0) [0|1] "" ASDM,PAS
 SG_ ReSideRdrRiObj10Heading : 287|12@0+ (0.1,-180.0) [-180.0|180.0] "Deg" ASDM,PAS
 SG_ ReSideRdrRiObj10ObjBoxCenterLat : 23|9@0+ (0.1,-25.0) [-25.0|25.0] "m" ASDM,PAS
 SG_ ReSideRdrRiObj10ObjBoxCenterLgt : 30|9@0+ (0.1,-25.0) [-25.0|25.0] "m" ASDM,PAS
 SG_ ReSideRdrRiObj10ObservationHist : 63|32@0+ (1.0,0.0) [0.0|4294967295.0] "Unitless" ASDM,PAS
 SG_ ReSideRdrRiObj10RdrObjAx : 7|8@0- (0.1,0.0) [-12.8|12.700000000000001] "m/s^2" ASDM,PAS
 SG_ ReSideRdrRiObj10RdrObjAy : 15|8@0- (0.1,0.0) [-12.8|12.700000000000001] "m/s^2" ASDM,PAS
 SG_ ReSideRdrRiObj10RdrObjBoxLength : 37|9@0+ (0.1,0.0) [0.0|50.0] "m" ASDM,PAS
 SG_ ReSideRdrRiObj10RdrObjBoxWidth : 44|9@0+ (0.1,0.0) [0.0|50.0] "m" ASDM,PAS
 SG_ ReSideRdrRiObj10RdrObjChks : 95|8@0+ (1.0,0.0) [0.0|255.0] "Unitless" ASDM,PAS
 SG_ ReSideRdrRiObj10RdrObjCntr : 103|4@0+ (1.0,0.0) [0.0|15.0] "Unitless" ASDM,PAS
 SG_ ReSideRdrRiObj10RdrObjCoastCnt : 279|5@0+ (1.0,0.0) [0.0|31.0] "Unitless" ASDM,PAS
 SG_ ReSideRdrRiObj10RdrObjConf : 99|4@0+ (7.0,0.0) [0.0|105.0] "%" ASDM,PAS
 SG_ ReSideRdrRiObj10RdrObjDx : 191|13@0+ (0.05,-200.0) [-200.0|200.0] "m" ASDM,PAS
 SG_ ReSideRdrRiObj10RdrObjDxStdDe : 111|8@0+ (0.05,0.0) [0.0|12.700000000000001] "m" ASDM,PAS
 SG_ ReSideRdrRiObj10RdrObjDy : 119|13@0+ (0.05,-200.0) [-200.0|200.0] "m" ASDM,PAS
 SG_ ReSideRdrRiObj10RdrObjDyStdDe : 183|8@0+ (0.05,0.0) [0.0|12.700000000000001] "m" ASDM,PAS
 SG_ ReSideRdrRiObj10RdrObjElevnConf : 223|4@0+ (7.0,0.0) [0.0|105.0] "%" ASDM,PAS
 SG_ ReSideRdrRiObj10RdrObjElevnSts : 153|2@0+ (1,0) [0|3] "" ASDM,PAS
 SG_ ReSideRdrRiObj10RdrObjID : 167|8@0+ (1.0,0.0) [0.0|255.0] "Unitless" ASDM,PAS
 SG_ ReSideRdrRiObj10RdrObjIsInFreeSpace : 192|1@0+ (1,0) [0|1] "" ASDM,PAS
 SG_ ReSideRdrRiObj10RdrObjMirrProblty : 219|4@0+ (7.0,0.0) [0.0|105.0] "%" ASDM,PAS
 SG_ ReSideRdrRiObj10RdrObjMtnPat : 122|3@0+ (1,0) [0|7] "" ASDM,PAS
 SG_ ReSideRdrRiObj10RdrObjNotRealProblty : 231|4@0+ (7.0,0.0) [0.0|105.0] "%" ASDM,PAS
 SG_ ReSideRdrRiObj10RdrObjStatyCnt : 239|7@0+ (1.0,0.0) [0.0|127.0] "Unitless" ASDM,PAS
 SG_ ReSideRdrRiObj10RdrObjTiAlv : 247|7@0+ (1.0,0.0) [0.0|127.0] "Unitless" ASDM,PAS
 SG_ ReSideRdrRiObj10RdrObjTrackSts : 194|2@0+ (1,0) [0|3] "" ASDM,PAS
 SG_ ReSideRdrRiObj10RdrObjTyp : 51|4@0+ (1,0) [0|15] "" ASDM,PAS
 SG_ ReSideRdrRiObj10RdrObjTypConfBike : 175|4@0+ (7.0,0.0) [0.0|105.0] "%" ASDM,PAS
 SG_ ReSideRdrRiObj10RdrObjTypConfPed : 171|4@0+ (7.0,0.0) [0.0|105.0] "%" ASDM,PAS
 SG_ ReSideRdrRiObj10RdrObjTypConfVeh : 227|4@0+ (7.0,0.0) [0.0|105.0] "%" ASDM,PAS
 SG_ ReSideRdrRiObj10RdrObjVx : 255|14@0+ (0.02,-128.0) [-128.0|128.0] "m/s" ASDM,PAS
 SG_ ReSideRdrRiObj10RdrObjVxStdDe : 271|6@0+ (0.05,0.0) [0.0|2.0] "m/s" ASDM,PAS
 SG_ ReSideRdrRiObj10RdrObjVy : 207|14@0+ (0.02,-128.0) [-128.0|128.0] "m/s" ASDM,PAS
 SG_ ReSideRdrRiObj10RdrObjVyStdDe : 159|6@0+ (0.05,0.0) [0.0|2.0] "m/s" ASDM,PAS
 SG_ ReSideRdrRiObj10RelVx : 135|12@0+ (0.02,-35.6) [-35.6|35.6] "m/s" ASDM,PAS
 SG_ ReSideRdrRiObj10RelVy : 139|12@0+ (0.02,-35.6) [-35.6|35.6] "m/s" ASDM,PAS

BO_ 369 SODRSafetyCANFD3Frame33: 64 SODR
 SG_ ReSideRdrRiObj11_UB : 291|1@0+ (1,0) [0|1] "" ASDM,PAS
 SG_ ReSideRdrRiObj11Heading : 287|12@0+ (0.1,-180.0) [-180.0|180.0] "Deg" ASDM,PAS
 SG_ ReSideRdrRiObj11ObjBoxCenterLat : 23|9@0+ (0.1,-25.0) [-25.0|25.0] "m" ASDM,PAS
 SG_ ReSideRdrRiObj11ObjBoxCenterLgt : 30|9@0+ (0.1,-25.0) [-25.0|25.0] "m" ASDM,PAS
 SG_ ReSideRdrRiObj11ObservationHist : 63|32@0+ (1.0,0.0) [0.0|4294967295.0] "Unitless" ASDM,PAS
 SG_ ReSideRdrRiObj11RdrObjAx : 7|8@0- (0.1,0.0) [-12.8|12.700000000000001] "m/s^2" ASDM,PAS
 SG_ ReSideRdrRiObj11RdrObjAy : 15|8@0- (0.1,0.0) [-12.8|12.700000000000001] "m/s^2" ASDM,PAS
 SG_ ReSideRdrRiObj11RdrObjBoxLength : 37|9@0+ (0.1,0.0) [0.0|50.0] "m" ASDM,PAS
 SG_ ReSideRdrRiObj11RdrObjBoxWidth : 44|9@0+ (0.1,0.0) [0.0|50.0] "m" ASDM,PAS
 SG_ ReSideRdrRiObj11RdrObjChks : 95|8@0+ (1.0,0.0) [0.0|255.0] "Unitless" ASDM,PAS
 SG_ ReSideRdrRiObj11RdrObjCntr : 103|4@0+ (1.0,0.0) [0.0|15.0] "Unitless" ASDM,PAS
 SG_ ReSideRdrRiObj11RdrObjCoastCnt : 279|5@0+ (1.0,0.0) [0.0|31.0] "Unitless" ASDM,PAS
 SG_ ReSideRdrRiObj11RdrObjConf : 99|4@0+ (7.0,0.0) [0.0|105.0] "%" ASDM,PAS
 SG_ ReSideRdrRiObj11RdrObjDx : 191|13@0+ (0.05,-200.0) [-200.0|200.0] "m" ASDM,PAS
 SG_ ReSideRdrRiObj11RdrObjDxStdDe : 111|8@0+ (0.05,0.0) [0.0|12.700000000000001] "m" ASDM,PAS
 SG_ ReSideRdrRiObj11RdrObjDy : 119|13@0+ (0.05,-200.0) [-200.0|200.0] "m" ASDM,PAS
 SG_ ReSideRdrRiObj11RdrObjDyStdDe : 183|8@0+ (0.05,0.0) [0.0|12.700000000000001] "m" ASDM,PAS
 SG_ ReSideRdrRiObj11RdrObjElevnConf : 223|4@0+ (7.0,0.0) [0.0|105.0] "%" ASDM,PAS
 SG_ ReSideRdrRiObj11RdrObjElevnSts : 153|2@0+ (1,0) [0|3] "" ASDM,PAS
 SG_ ReSideRdrRiObj11RdrObjID : 167|8@0+ (1.0,0.0) [0.0|255.0] "Unitless" ASDM,PAS
 SG_ ReSideRdrRiObj11RdrObjIsInFreeSpace : 192|1@0+ (1,0) [0|1] "" ASDM,PAS
 SG_ ReSideRdrRiObj11RdrObjMirrProblty : 219|4@0+ (7.0,0.0) [0.0|105.0] "%" ASDM,PAS
 SG_ ReSideRdrRiObj11RdrObjMtnPat : 122|3@0+ (1,0) [0|7] "" ASDM,PAS
 SG_ ReSideRdrRiObj11RdrObjNotRealProblty : 231|4@0+ (7.0,0.0) [0.0|105.0] "%" ASDM,PAS
 SG_ ReSideRdrRiObj11RdrObjStatyCnt : 239|7@0+ (1.0,0.0) [0.0|127.0] "Unitless" ASDM,PAS
 SG_ ReSideRdrRiObj11RdrObjTiAlv : 247|7@0+ (1.0,0.0) [0.0|127.0] "Unitless" ASDM,PAS
 SG_ ReSideRdrRiObj11RdrObjTrackSts : 194|2@0+ (1,0) [0|3] "" ASDM,PAS
 SG_ ReSideRdrRiObj11RdrObjTyp : 51|4@0+ (1,0) [0|15] "" ASDM,PAS
 SG_ ReSideRdrRiObj11RdrObjTypConfBike : 175|4@0+ (7.0,0.0) [0.0|105.0] "%" ASDM,PAS
 SG_ ReSideRdrRiObj11RdrObjTypConfPed : 171|4@0+ (7.0,0.0) [0.0|105.0] "%" ASDM,PAS
 SG_ ReSideRdrRiObj11RdrObjTypConfVeh : 227|4@0+ (7.0,0.0) [0.0|105.0] "%" ASDM,PAS
 SG_ ReSideRdrRiObj11RdrObjVx : 255|14@0+ (0.02,-128.0) [-128.0|128.0] "m/s" ASDM,PAS
 SG_ ReSideRdrRiObj11RdrObjVxStdDe : 271|6@0+ (0.05,0.0) [0.0|2.0] "m/s" ASDM,PAS
 SG_ ReSideRdrRiObj11RdrObjVy : 207|14@0+ (0.02,-128.0) [-128.0|128.0] "m/s" ASDM,PAS
 SG_ ReSideRdrRiObj11RdrObjVyStdDe : 159|6@0+ (0.05,0.0) [0.0|2.0] "m/s" ASDM,PAS
 SG_ ReSideRdrRiObj11RelVx : 135|12@0+ (0.02,-35.6) [-35.6|35.6] "m/s" ASDM,PAS
 SG_ ReSideRdrRiObj11RelVy : 139|12@0+ (0.02,-35.6) [-35.6|35.6] "m/s" ASDM,PAS

BO_ 371 SODRSafetyCANFD3Frame34: 64 SODR
 SG_ ReSideRdrRiObj12_UB : 291|1@0+ (1,0) [0|1] "" ASDM,PAS
 SG_ ReSideRdrRiObj12Heading : 287|12@0+ (0.1,-180.0) [-180.0|180.0] "Deg" ASDM,PAS
 SG_ ReSideRdrRiObj12ObjBoxCenterLat : 23|9@0+ (0.1,-25.0) [-25.0|25.0] "m" ASDM,PAS
 SG_ ReSideRdrRiObj12ObjBoxCenterLgt : 30|9@0+ (0.1,-25.0) [-25.0|25.0] "m" ASDM,PAS
 SG_ ReSideRdrRiObj12ObservationHist : 63|32@0+ (1.0,0.0) [0.0|4294967295.0] "Unitless" ASDM,PAS
 SG_ ReSideRdrRiObj12RdrObjAx : 7|8@0- (0.1,0.0) [-12.8|12.700000000000001] "m/s^2" ASDM,PAS
 SG_ ReSideRdrRiObj12RdrObjAy : 15|8@0- (0.1,0.0) [-12.8|12.700000000000001] "m/s^2" ASDM,PAS
 SG_ ReSideRdrRiObj12RdrObjBoxLength : 37|9@0+ (0.1,0.0) [0.0|50.0] "m" ASDM,PAS
 SG_ ReSideRdrRiObj12RdrObjBoxWidth : 44|9@0+ (0.1,0.0) [0.0|50.0] "m" ASDM,PAS
 SG_ ReSideRdrRiObj12RdrObjChks : 95|8@0+ (1.0,0.0) [0.0|255.0] "Unitless" ASDM,PAS
 SG_ ReSideRdrRiObj12RdrObjCntr : 103|4@0+ (1.0,0.0) [0.0|15.0] "Unitless" ASDM,PAS
 SG_ ReSideRdrRiObj12RdrObjCoastCnt : 279|5@0+ (1.0,0.0) [0.0|31.0] "Unitless" ASDM,PAS
 SG_ ReSideRdrRiObj12RdrObjConf : 99|4@0+ (7.0,0.0) [0.0|105.0] "%" ASDM,PAS
 SG_ ReSideRdrRiObj12RdrObjDx : 191|13@0+ (0.05,-200.0) [-200.0|200.0] "m" ASDM,PAS
 SG_ ReSideRdrRiObj12RdrObjDxStdDe : 111|8@0+ (0.05,0.0) [0.0|12.700000000000001] "m" ASDM,PAS
 SG_ ReSideRdrRiObj12RdrObjDy : 119|13@0+ (0.05,-200.0) [-200.0|200.0] "m" ASDM,PAS
 SG_ ReSideRdrRiObj12RdrObjDyStdDe : 183|8@0+ (0.05,0.0) [0.0|12.700000000000001] "m" ASDM,PAS
 SG_ ReSideRdrRiObj12RdrObjElevnConf : 223|4@0+ (7.0,0.0) [0.0|105.0] "%" ASDM,PAS
 SG_ ReSideRdrRiObj12RdrObjElevnSts : 153|2@0+ (1,0) [0|3] "" ASDM,PAS
 SG_ ReSideRdrRiObj12RdrObjID : 167|8@0+ (1.0,0.0) [0.0|255.0] "Unitless" ASDM,PAS
 SG_ ReSideRdrRiObj12RdrObjIsInFreeSpace : 192|1@0+ (1,0) [0|1] "" ASDM,PAS
 SG_ ReSideRdrRiObj12RdrObjMirrProblty : 219|4@0+ (7.0,0.0) [0.0|105.0] "%" ASDM,PAS
 SG_ ReSideRdrRiObj12RdrObjMtnPat : 122|3@0+ (1,0) [0|7] "" ASDM,PAS
 SG_ ReSideRdrRiObj12RdrObjNotRealProblty : 231|4@0+ (7.0,0.0) [0.0|105.0] "%" ASDM,PAS
 SG_ ReSideRdrRiObj12RdrObjStatyCnt : 239|7@0+ (1.0,0.0) [0.0|127.0] "Unitless" ASDM,PAS
 SG_ ReSideRdrRiObj12RdrObjTiAlv : 247|7@0+ (1.0,0.0) [0.0|127.0] "Unitless" ASDM,PAS
 SG_ ReSideRdrRiObj12RdrObjTrackSts : 194|2@0+ (1,0) [0|3] "" ASDM,PAS
 SG_ ReSideRdrRiObj12RdrObjTyp : 51|4@0+ (1,0) [0|15] "" ASDM,PAS
 SG_ ReSideRdrRiObj12RdrObjTypConfBike : 175|4@0+ (7.0,0.0) [0.0|105.0] "%" ASDM,PAS
 SG_ ReSideRdrRiObj12RdrObjTypConfPed : 171|4@0+ (7.0,0.0) [0.0|105.0] "%" ASDM,PAS
 SG_ ReSideRdrRiObj12RdrObjTypConfVeh : 227|4@0+ (7.0,0.0) [0.0|105.0] "%" ASDM,PAS
 SG_ ReSideRdrRiObj12RdrObjVx : 255|14@0+ (0.02,-128.0) [-128.0|128.0] "m/s" ASDM,PAS
 SG_ ReSideRdrRiObj12RdrObjVxStdDe : 271|6@0+ (0.05,0.0) [0.0|2.0] "m/s" ASDM,PAS
 SG_ ReSideRdrRiObj12RdrObjVy : 207|14@0+ (0.02,-128.0) [-128.0|128.0] "m/s" ASDM,PAS
 SG_ ReSideRdrRiObj12RdrObjVyStdDe : 159|6@0+ (0.05,0.0) [0.0|2.0] "m/s" ASDM,PAS
 SG_ ReSideRdrRiObj12RelVx : 135|12@0+ (0.02,-35.6) [-35.6|35.6] "m/s" ASDM,PAS
 SG_ ReSideRdrRiObj12RelVy : 139|12@0+ (0.02,-35.6) [-35.6|35.6] "m/s" ASDM,PAS

BO_ 373 SODRSafetyCANFD3Frame35: 64 SODR
 SG_ ReSideRdrRiObj13_UB : 291|1@0+ (1,0) [0|1] "" ASDM,PAS
 SG_ ReSideRdrRiObj13Heading : 287|12@0+ (0.1,-180.0) [-180.0|180.0] "Deg" ASDM,PAS
 SG_ ReSideRdrRiObj13ObjBoxCenterLat : 23|9@0+ (0.1,-25.0) [-25.0|25.0] "m" ASDM,PAS
 SG_ ReSideRdrRiObj13ObjBoxCenterLgt : 30|9@0+ (0.1,-25.0) [-25.0|25.0] "m" ASDM,PAS
 SG_ ReSideRdrRiObj13ObservationHist : 63|32@0+ (1.0,0.0) [0.0|4294967295.0] "Unitless" ASDM,PAS
 SG_ ReSideRdrRiObj13RdrObjAx : 7|8@0- (0.1,0.0) [-12.8|12.700000000000001] "m/s^2" ASDM,PAS
 SG_ ReSideRdrRiObj13RdrObjAy : 15|8@0- (0.1,0.0) [-12.8|12.700000000000001] "m/s^2" ASDM,PAS
 SG_ ReSideRdrRiObj13RdrObjBoxLength : 37|9@0+ (0.1,0.0) [0.0|50.0] "m" ASDM,PAS
 SG_ ReSideRdrRiObj13RdrObjBoxWidth : 44|9@0+ (0.1,0.0) [0.0|50.0] "m" ASDM,PAS
 SG_ ReSideRdrRiObj13RdrObjChks : 95|8@0+ (1.0,0.0) [0.0|255.0] "Unitless" ASDM,PAS
 SG_ ReSideRdrRiObj13RdrObjCntr : 103|4@0+ (1.0,0.0) [0.0|15.0] "Unitless" ASDM,PAS
 SG_ ReSideRdrRiObj13RdrObjCoastCnt : 279|5@0+ (1.0,0.0) [0.0|31.0] "Unitless" ASDM,PAS
 SG_ ReSideRdrRiObj13RdrObjConf : 99|4@0+ (7.0,0.0) [0.0|105.0] "%" ASDM,PAS
 SG_ ReSideRdrRiObj13RdrObjDx : 191|13@0+ (0.05,-200.0) [-200.0|200.0] "m" ASDM,PAS
 SG_ ReSideRdrRiObj13RdrObjDxStdDe : 111|8@0+ (0.05,0.0) [0.0|12.700000000000001] "m" ASDM,PAS
 SG_ ReSideRdrRiObj13RdrObjDy : 119|13@0+ (0.05,-200.0) [-200.0|200.0] "m" ASDM,PAS
 SG_ ReSideRdrRiObj13RdrObjDyStdDe : 183|8@0+ (0.05,0.0) [0.0|12.700000000000001] "m" ASDM,PAS
 SG_ ReSideRdrRiObj13RdrObjElevnConf : 223|4@0+ (7.0,0.0) [0.0|105.0] "%" ASDM,PAS
 SG_ ReSideRdrRiObj13RdrObjElevnSts : 153|2@0+ (1,0) [0|3] "" ASDM,PAS
 SG_ ReSideRdrRiObj13RdrObjID : 167|8@0+ (1.0,0.0) [0.0|255.0] "Unitless" ASDM,PAS
 SG_ ReSideRdrRiObj13RdrObjIsInFreeSpace : 192|1@0+ (1,0) [0|1] "" ASDM,PAS
 SG_ ReSideRdrRiObj13RdrObjMirrProblty : 219|4@0+ (7.0,0.0) [0.0|105.0] "%" ASDM,PAS
 SG_ ReSideRdrRiObj13RdrObjMtnPat : 122|3@0+ (1,0) [0|7] "" ASDM,PAS
 SG_ ReSideRdrRiObj13RdrObjNotRealProblty : 231|4@0+ (7.0,0.0) [0.0|105.0] "%" ASDM,PAS
 SG_ ReSideRdrRiObj13RdrObjStatyCnt : 239|7@0+ (1.0,0.0) [0.0|127.0] "Unitless" ASDM,PAS
 SG_ ReSideRdrRiObj13RdrObjTiAlv : 247|7@0+ (1.0,0.0) [0.0|127.0] "Unitless" ASDM,PAS
 SG_ ReSideRdrRiObj13RdrObjTrackSts : 194|2@0+ (1,0) [0|3] "" ASDM,PAS
 SG_ ReSideRdrRiObj13RdrObjTyp : 51|4@0+ (1,0) [0|15] "" ASDM,PAS
 SG_ ReSideRdrRiObj13RdrObjTypConfBike : 175|4@0+ (7.0,0.0) [0.0|105.0] "%" ASDM,PAS
 SG_ ReSideRdrRiObj13RdrObjTypConfPed : 171|4@0+ (7.0,0.0) [0.0|105.0] "%" ASDM,PAS
 SG_ ReSideRdrRiObj13RdrObjTypConfVeh : 227|4@0+ (7.0,0.0) [0.0|105.0] "%" ASDM,PAS
 SG_ ReSideRdrRiObj13RdrObjVx : 255|14@0+ (0.02,-128.0) [-128.0|128.0] "m/s" ASDM,PAS
 SG_ ReSideRdrRiObj13RdrObjVxStdDe : 271|6@0+ (0.05,0.0) [0.0|2.0] "m/s" ASDM,PAS
 SG_ ReSideRdrRiObj13RdrObjVy : 207|14@0+ (0.02,-128.0) [-128.0|128.0] "m/s" ASDM,PAS
 SG_ ReSideRdrRiObj13RdrObjVyStdDe : 159|6@0+ (0.05,0.0) [0.0|2.0] "m/s" ASDM,PAS
 SG_ ReSideRdrRiObj13RelVx : 135|12@0+ (0.02,-35.6) [-35.6|35.6] "m/s" ASDM,PAS
 SG_ ReSideRdrRiObj13RelVy : 139|12@0+ (0.02,-35.6) [-35.6|35.6] "m/s" ASDM,PAS

BO_ 375 SODRSafetyCANFD3Frame36: 64 SODR
 SG_ ReSideRdrRiObj14_UB : 291|1@0+ (1,0) [0|1] "" ASDM,PAS
 SG_ ReSideRdrRiObj14Heading : 287|12@0+ (0.1,-180.0) [-180.0|180.0] "Deg" ASDM,PAS
 SG_ ReSideRdrRiObj14ObjBoxCenterLat : 23|9@0+ (0.1,-25.0) [-25.0|25.0] "m" ASDM,PAS
 SG_ ReSideRdrRiObj14ObjBoxCenterLgt : 30|9@0+ (0.1,-25.0) [-25.0|25.0] "m" ASDM,PAS
 SG_ ReSideRdrRiObj14ObservationHist : 63|32@0+ (1.0,0.0) [0.0|4294967295.0] "Unitless" ASDM,PAS
 SG_ ReSideRdrRiObj14RdrObjAx : 7|8@0- (0.1,0.0) [-12.8|12.700000000000001] "m/s^2" ASDM,PAS
 SG_ ReSideRdrRiObj14RdrObjAy : 15|8@0- (0.1,0.0) [-12.8|12.700000000000001] "m/s^2" ASDM,PAS
 SG_ ReSideRdrRiObj14RdrObjBoxLength : 37|9@0+ (0.1,0.0) [0.0|50.0] "m" ASDM,PAS
 SG_ ReSideRdrRiObj14RdrObjBoxWidth : 44|9@0+ (0.1,0.0) [0.0|50.0] "m" ASDM,PAS
 SG_ ReSideRdrRiObj14RdrObjChks : 95|8@0+ (1.0,0.0) [0.0|255.0] "Unitless" ASDM,PAS
 SG_ ReSideRdrRiObj14RdrObjCntr : 103|4@0+ (1.0,0.0) [0.0|15.0] "Unitless" ASDM,PAS
 SG_ ReSideRdrRiObj14RdrObjCoastCnt : 279|5@0+ (1.0,0.0) [0.0|31.0] "Unitless" ASDM,PAS
 SG_ ReSideRdrRiObj14RdrObjConf : 99|4@0+ (7.0,0.0) [0.0|105.0] "%" ASDM,PAS
 SG_ ReSideRdrRiObj14RdrObjDx : 191|13@0+ (0.05,-200.0) [-200.0|200.0] "m" ASDM,PAS
 SG_ ReSideRdrRiObj14RdrObjDxStdDe : 111|8@0+ (0.05,0.0) [0.0|12.700000000000001] "m" ASDM,PAS
 SG_ ReSideRdrRiObj14RdrObjDy : 119|13@0+ (0.05,-200.0) [-200.0|200.0] "m" ASDM,PAS
 SG_ ReSideRdrRiObj14RdrObjDyStdDe : 183|8@0+ (0.05,0.0) [0.0|12.700000000000001] "m" ASDM,PAS
 SG_ ReSideRdrRiObj14RdrObjElevnConf : 223|4@0+ (7.0,0.0) [0.0|105.0] "%" ASDM,PAS
 SG_ ReSideRdrRiObj14RdrObjElevnSts : 153|2@0+ (1,0) [0|3] "" ASDM,PAS
 SG_ ReSideRdrRiObj14RdrObjID : 167|8@0+ (1.0,0.0) [0.0|255.0] "Unitless" ASDM,PAS
 SG_ ReSideRdrRiObj14RdrObjIsInFreeSpace : 192|1@0+ (1,0) [0|1] "" ASDM,PAS
 SG_ ReSideRdrRiObj14RdrObjMirrProblty : 219|4@0+ (7.0,0.0) [0.0|105.0] "%" ASDM,PAS
 SG_ ReSideRdrRiObj14RdrObjMtnPat : 122|3@0+ (1,0) [0|7] "" ASDM,PAS
 SG_ ReSideRdrRiObj14RdrObjNotRealProblty : 231|4@0+ (7.0,0.0) [0.0|105.0] "%" ASDM,PAS
 SG_ ReSideRdrRiObj14RdrObjStatyCnt : 239|7@0+ (1.0,0.0) [0.0|127.0] "Unitless" ASDM,PAS
 SG_ ReSideRdrRiObj14RdrObjTiAlv : 247|7@0+ (1.0,0.0) [0.0|127.0] "Unitless" ASDM,PAS
 SG_ ReSideRdrRiObj14RdrObjTrackSts : 194|2@0+ (1,0) [0|3] "" ASDM,PAS
 SG_ ReSideRdrRiObj14RdrObjTyp : 51|4@0+ (1,0) [0|15] "" ASDM,PAS
 SG_ ReSideRdrRiObj14RdrObjTypConfBike : 175|4@0+ (7.0,0.0) [0.0|105.0] "%" ASDM,PAS
 SG_ ReSideRdrRiObj14RdrObjTypConfPed : 171|4@0+ (7.0,0.0) [0.0|105.0] "%" ASDM,PAS
 SG_ ReSideRdrRiObj14RdrObjTypConfVeh : 227|4@0+ (7.0,0.0) [0.0|105.0] "%" ASDM,PAS
 SG_ ReSideRdrRiObj14RdrObjVx : 255|14@0+ (0.02,-128.0) [-128.0|128.0] "m/s" ASDM,PAS
 SG_ ReSideRdrRiObj14RdrObjVxStdDe : 271|6@0+ (0.05,0.0) [0.0|2.0] "m/s" ASDM,PAS
 SG_ ReSideRdrRiObj14RdrObjVy : 207|14@0+ (0.02,-128.0) [-128.0|128.0] "m/s" ASDM,PAS
 SG_ ReSideRdrRiObj14RdrObjVyStdDe : 159|6@0+ (0.05,0.0) [0.0|2.0] "m/s" ASDM,PAS
 SG_ ReSideRdrRiObj14RelVx : 135|12@0+ (0.02,-35.6) [-35.6|35.6] "m/s" ASDM,PAS
 SG_ ReSideRdrRiObj14RelVy : 139|12@0+ (0.02,-35.6) [-35.6|35.6] "m/s" ASDM,PAS

BO_ 377 SODRSafetyCANFD3Frame37: 64 SODR
 SG_ ReSideRdrRiObj15_UB : 291|1@0+ (1,0) [0|1] "" ASDM,PAS
 SG_ ReSideRdrRiObj15Heading : 287|12@0+ (0.1,-180.0) [-180.0|180.0] "Deg" ASDM,PAS
 SG_ ReSideRdrRiObj15ObjBoxCenterLat : 23|9@0+ (0.1,-25.0) [-25.0|25.0] "m" ASDM,PAS
 SG_ ReSideRdrRiObj15ObjBoxCenterLgt : 30|9@0+ (0.1,-25.0) [-25.0|25.0] "m" ASDM,PAS
 SG_ ReSideRdrRiObj15ObservationHist : 63|32@0+ (1.0,0.0) [0.0|4294967295.0] "Unitless" ASDM,PAS
 SG_ ReSideRdrRiObj15RdrObjAx : 7|8@0- (0.1,0.0) [-12.8|12.700000000000001] "m/s^2" ASDM,PAS
 SG_ ReSideRdrRiObj15RdrObjAy : 15|8@0- (0.1,0.0) [-12.8|12.700000000000001] "m/s^2" ASDM,PAS
 SG_ ReSideRdrRiObj15RdrObjBoxLength : 37|9@0+ (0.1,0.0) [0.0|50.0] "m" ASDM,PAS
 SG_ ReSideRdrRiObj15RdrObjBoxWidth : 44|9@0+ (0.1,0.0) [0.0|50.0] "m" ASDM,PAS
 SG_ ReSideRdrRiObj15RdrObjChks : 95|8@0+ (1.0,0.0) [0.0|255.0] "Unitless" ASDM,PAS
 SG_ ReSideRdrRiObj15RdrObjCntr : 103|4@0+ (1.0,0.0) [0.0|15.0] "Unitless" ASDM,PAS
 SG_ ReSideRdrRiObj15RdrObjCoastCnt : 279|5@0+ (1.0,0.0) [0.0|31.0] "Unitless" ASDM,PAS
 SG_ ReSideRdrRiObj15RdrObjConf : 99|4@0+ (7.0,0.0) [0.0|105.0] "%" ASDM,PAS
 SG_ ReSideRdrRiObj15RdrObjDx : 191|13@0+ (0.05,-200.0) [-200.0|200.0] "m" ASDM,PAS
 SG_ ReSideRdrRiObj15RdrObjDxStdDe : 111|8@0+ (0.05,0.0) [0.0|12.700000000000001] "m" ASDM,PAS
 SG_ ReSideRdrRiObj15RdrObjDy : 119|13@0+ (0.05,-200.0) [-200.0|200.0] "m" ASDM,PAS
 SG_ ReSideRdrRiObj15RdrObjDyStdDe : 183|8@0+ (0.05,0.0) [0.0|12.700000000000001] "m" ASDM,PAS
 SG_ ReSideRdrRiObj15RdrObjElevnConf : 223|4@0+ (7.0,0.0) [0.0|105.0] "%" ASDM,PAS
 SG_ ReSideRdrRiObj15RdrObjElevnSts : 153|2@0+ (1,0) [0|3] "" ASDM,PAS
 SG_ ReSideRdrRiObj15RdrObjID : 167|8@0+ (1.0,0.0) [0.0|255.0] "Unitless" ASDM,PAS
 SG_ ReSideRdrRiObj15RdrObjIsInFreeSpace : 192|1@0+ (1,0) [0|1] "" ASDM,PAS
 SG_ ReSideRdrRiObj15RdrObjMirrProblty : 219|4@0+ (7.0,0.0) [0.0|105.0] "%" ASDM,PAS
 SG_ ReSideRdrRiObj15RdrObjMtnPat : 122|3@0+ (1,0) [0|7] "" ASDM,PAS
 SG_ ReSideRdrRiObj15RdrObjNotRealProblty : 231|4@0+ (7.0,0.0) [0.0|105.0] "%" ASDM,PAS
 SG_ ReSideRdrRiObj15RdrObjStatyCnt : 239|7@0+ (1.0,0.0) [0.0|127.0] "Unitless" ASDM,PAS
 SG_ ReSideRdrRiObj15RdrObjTiAlv : 247|7@0+ (1.0,0.0) [0.0|127.0] "Unitless" ASDM,PAS
 SG_ ReSideRdrRiObj15RdrObjTrackSts : 194|2@0+ (1,0) [0|3] "" ASDM,PAS
 SG_ ReSideRdrRiObj15RdrObjTyp : 51|4@0+ (1,0) [0|15] "" ASDM,PAS
 SG_ ReSideRdrRiObj15RdrObjTypConfBike : 175|4@0+ (7.0,0.0) [0.0|105.0] "%" ASDM,PAS
 SG_ ReSideRdrRiObj15RdrObjTypConfPed : 171|4@0+ (7.0,0.0) [0.0|105.0] "%" ASDM,PAS
 SG_ ReSideRdrRiObj15RdrObjTypConfVeh : 227|4@0+ (7.0,0.0) [0.0|105.0] "%" ASDM,PAS
 SG_ ReSideRdrRiObj15RdrObjVx : 255|14@0+ (0.02,-128.0) [-128.0|128.0] "m/s" ASDM,PAS
 SG_ ReSideRdrRiObj15RdrObjVxStdDe : 271|6@0+ (0.05,0.0) [0.0|2.0] "m/s" ASDM,PAS
 SG_ ReSideRdrRiObj15RdrObjVy : 207|14@0+ (0.02,-128.0) [-128.0|128.0] "m/s" ASDM,PAS
 SG_ ReSideRdrRiObj15RdrObjVyStdDe : 159|6@0+ (0.05,0.0) [0.0|2.0] "m/s" ASDM,PAS
 SG_ ReSideRdrRiObj15RelVx : 135|12@0+ (0.02,-35.6) [-35.6|35.6] "m/s" ASDM,PAS
 SG_ ReSideRdrRiObj15RelVy : 139|12@0+ (0.02,-35.6) [-35.6|35.6] "m/s" ASDM,PAS

BO_ 1283 SodrSafetyCanFD3NmFr: 8 SODR
 SG_ PNC16_SODR : 16|1@0+ (1,0) [0|0] "" SODL
 SG_ PNC17_SODR : 17|1@0+ (1,0) [0|0] "" SODL
 SG_ PNC18_SODR : 18|1@0+ (1,0) [0|0] "" SODL
 SG_ PNC19_SODR : 19|1@0+ (1,0) [0|0] "" SODL
 SG_ PNC20_SODR : 20|1@0+ (1,0) [0|0] "" SODL
 SG_ PNC21_SODR : 21|1@0+ (1,0) [0|0] "" SODL
 SG_ PNC22_SODR : 22|1@0+ (1,0) [0|0] "" SODL
 SG_ PNC23_SODR : 23|1@0+ (1,0) [0|0] "" SODL
 SG_ PNC24_SODR : 24|1@0+ (1,0) [0|0] "" SODL
 SG_ PNC25_SODR : 25|1@0+ (1,0) [0|0] "" SODL
 SG_ PNC26_SODR : 26|1@0+ (1,0) [0|0] "" SODL
 SG_ PNC27_SODR : 27|1@0+ (1,0) [0|0] "" SODL
 SG_ PNC28_SODR : 28|1@0+ (1,0) [0|0] "" SODL
 SG_ PNC29_SODR : 29|1@0+ (1,0) [0|0] "" SODL
 SG_ PNC30_SODR : 30|1@0+ (1,0) [0|0] "" SODL
 SG_ PNC31_SODR : 31|1@0+ (1,0) [0|0] "" SODL
 SG_ PNC32_SODR : 32|1@0+ (1,0) [0|0] "" SODL
 SG_ PNC33_SODR : 33|1@0+ (1,0) [0|0] "" SODL
 SG_ PNC34_SODR : 34|1@0+ (1,0) [0|0] "" SODL
 SG_ PNC35_SODR : 35|1@0+ (1,0) [0|0] "" SODL
 SG_ PNC36_SODR : 36|1@0+ (1,0) [0|0] "" SODL
 SG_ PNC37_SODR : 37|1@0+ (1,0) [0|0] "" SODL
 SG_ PNC38_SODR : 38|1@0+ (1,0) [0|0] "" SODL
 SG_ PNC39_SODR : 39|1@0+ (1,0) [0|0] "" SODL
 SG_ NM_PNI_SODR : 14|1@0+ (1,0) [0|0] "" SODL
 SG_ NM_AW_SODR : 12|1@0+ (1,0) [0|0] "" SODL
 SG_ NM_CS_SODR : 11|1@0+ (1,0) [0|0] "" SODL
 SG_ NM_RMR_SODR : 8|1@0+ (1,0) [0|0] "" SODL
 SG_ NM_NodeID_SODR : 7|8@0+ (1,0) [0|0] "" SODL

BO_ 1617 SodrToAsdmSafetyCanFD3DiagResFrame1: 64 SODR
 SG_ SodrToAsdmSafetyCanFD3DiagResNpdu : 7|512@0+ (1,0) [0|0] "" ASDM

BO_ 1412 SodrToEtcXcpFr01: 8 SODR

BO_ 1426 SodrToEtcXcpFr02: 8 SODR

CM_ SG_ 355 ReSideRdrRiObj4Heading "Refer to the data element description in ReSideRdrRiObj1 with the same data element name";
CM_ SG_ 355 ReSideRdrRiObj4ObjBoxCenterLat "Refer to the data element description in ReSideRdrRiObj1 with the same data element name";
CM_ SG_ 355 ReSideRdrRiObj4ObjBoxCenterLgt "Refer to the data element description in ReSideRdrRiObj1 with the same data element name";
CM_ SG_ 355 ReSideRdrRiObj4ObservationHist "Refer to the data element description in ReSideRdrRiObj1 with the same data element name";
CM_ SG_ 355 ReSideRdrRiObj4RdrObjAx "Refer to the data element description in ReSideRdrRiObj1 with the same data element name";
CM_ SG_ 355 ReSideRdrRiObj4RdrObjAy "Refer to the data element description in ReSideRdrRiObj1 with the same data element name";
CM_ SG_ 355 ReSideRdrRiObj4RdrObjBoxLength "Refer to the data element description in ReSideRdrRiObj1 with the same data element name";
CM_ SG_ 355 ReSideRdrRiObj4RdrObjBoxWidth "Refer to the data element description in ReSideRdrRiObj1 with the same data element name";
CM_ SG_ 355 ReSideRdrRiObj4RdrObjChks "Refer to the data element description in ReSideRdrRiObj1 with the same data element name";
CM_ SG_ 355 ReSideRdrRiObj4RdrObjCntr "Refer to the data element description in ReSideRdrRiObj1 with the same data element name";
CM_ SG_ 355 ReSideRdrRiObj4RdrObjCoastCnt "Refer to the data element description in ReSideRdrRiObj1 with the same data element name";
CM_ SG_ 355 ReSideRdrRiObj4RdrObjConf "Refer to the data element description in ReSideRdrRiObj1 with the same data element name";
CM_ SG_ 355 ReSideRdrRiObj4RdrObjDx "Refer to the data element description in ReSideRdrRiObj1 with the same data element name";
CM_ SG_ 355 ReSideRdrRiObj4RdrObjDxStdDe "Refer to the data element description in ReSideRdrRiObj1 with the same data element name";
CM_ SG_ 355 ReSideRdrRiObj4RdrObjDy "Refer to the data element description in ReSideRdrRiObj1 with the same data element name";
CM_ SG_ 355 ReSideRdrRiObj4RdrObjDyStdDe "Refer to the data element description in ReSideRdrRiObj1 with the same data element name";
CM_ SG_ 355 ReSideRdrRiObj4RdrObjElevnConf "Refer to the data element description in ReSideRdrRiObj1 with the same data element name";
CM_ SG_ 355 ReSideRdrRiObj4RdrObjElevnSts "Refer to the data element description in ReSideRdrRiObj1 with the same data element name";
CM_ SG_ 355 ReSideRdrRiObj4RdrObjID "Refer to the data element description in ReSideRdrRiObj1 with the same data element name";
CM_ SG_ 355 ReSideRdrRiObj4RdrObjIsInFreeSpace "Refer to the data element description in ReSideRdrRiObj1 with the same data element name";
CM_ SG_ 355 ReSideRdrRiObj4RdrObjMirrProblty "Refer to the data element description in ReSideRdrRiObj1 with the same data element name";
CM_ SG_ 355 ReSideRdrRiObj4RdrObjMtnPat "Refer to the data element description in ReSideRdrRiObj1 with the same data element name";
CM_ SG_ 355 ReSideRdrRiObj4RdrObjNotRealProblty "Refer to the data element description in ReSideRdrRiObj1 with the same data element name";
CM_ SG_ 355 ReSideRdrRiObj4RdrObjStatyCnt "Refer to the data element description in ReSideRdrRiObj1 with the same data element name";
CM_ SG_ 355 ReSideRdrRiObj4RdrObjTiAlv "Refer to the data element description in ReSideRdrRiObj1 with the same data element name";
CM_ SG_ 355 ReSideRdrRiObj4RdrObjTrackSts "Refer to the data element description in ReSideRdrRiObj1 with the same data element name";
CM_ SG_ 355 ReSideRdrRiObj4RdrObjTyp "Refer to the data element description in ReSideRdrRiObj1 with the same data element name";
CM_ SG_ 355 ReSideRdrRiObj4RdrObjTypConfBike "Refer to the data element description in ReSideRdrRiObj1 with the same data element name";
CM_ SG_ 355 ReSideRdrRiObj4RdrObjTypConfPed "Refer to the data element description in ReSideRdrRiObj1 with the same data element name";
CM_ SG_ 355 ReSideRdrRiObj4RdrObjTypConfVeh "Refer to the data element description in ReSideRdrRiObj1 with the same data element name";
CM_ SG_ 355 ReSideRdrRiObj4RdrObjVx "Refer to the data element description in ReSideRdrRiObj1 with the same data element name";
CM_ SG_ 355 ReSideRdrRiObj4RdrObjVxStdDe "Refer to the data element description in ReSideRdrRiObj1 with the same data element name";
CM_ SG_ 355 ReSideRdrRiObj4RdrObjVy "Refer to the data element description in ReSideRdrRiObj1 with the same data element name";
CM_ SG_ 355 ReSideRdrRiObj4RdrObjVyStdDe "Refer to the data element description in ReSideRdrRiObj1 with the same data element name";
CM_ SG_ 355 ReSideRdrRiObj4RelVx "Refer to the data element description in ReSideRdrRiObj1 with the same data element name";
CM_ SG_ 355 ReSideRdrRiObj4RelVy "Refer to the data element description in ReSideRdrRiObj1 with the same data element name";
CM_ SG_ 357 ReSideRdrRiObj5Heading "Refer to the data element description in ReSideRdrRiObj1 with the same data element name";
CM_ SG_ 357 ReSideRdrRiObj5ObjBoxCenterLat "Refer to the data element description in ReSideRdrRiObj1 with the same data element name";
CM_ SG_ 357 ReSideRdrRiObj5ObjBoxCenterLgt "Refer to the data element description in ReSideRdrRiObj1 with the same data element name";
CM_ SG_ 357 ReSideRdrRiObj5ObservationHist "Refer to the data element description in ReSideRdrRiObj1 with the same data element name";
CM_ SG_ 357 ReSideRdrRiObj5RdrObjAx "Refer to the data element description in ReSideRdrRiObj1 with the same data element name";
CM_ SG_ 357 ReSideRdrRiObj5RdrObjAy "Refer to the data element description in ReSideRdrRiObj1 with the same data element name";
CM_ SG_ 357 ReSideRdrRiObj5RdrObjBoxLength "Refer to the data element description in ReSideRdrRiObj1 with the same data element name";
CM_ SG_ 357 ReSideRdrRiObj5RdrObjBoxWidth "Refer to the data element description in ReSideRdrRiObj1 with the same data element name";
CM_ SG_ 357 ReSideRdrRiObj5RdrObjChks "Refer to the data element description in ReSideRdrRiObj1 with the same data element name";
CM_ SG_ 357 ReSideRdrRiObj5RdrObjCntr "Refer to the data element description in ReSideRdrRiObj1 with the same data element name";
CM_ SG_ 357 ReSideRdrRiObj5RdrObjCoastCnt "Refer to the data element description in ReSideRdrRiObj1 with the same data element name";
CM_ SG_ 357 ReSideRdrRiObj5RdrObjConf "Refer to the data element description in ReSideRdrRiObj1 with the same data element name";
CM_ SG_ 357 ReSideRdrRiObj5RdrObjDx "Refer to the data element description in ReSideRdrRiObj1 with the same data element name";
CM_ SG_ 357 ReSideRdrRiObj5RdrObjDxStdDe "Refer to the data element description in ReSideRdrRiObj1 with the same data element name";
CM_ SG_ 357 ReSideRdrRiObj5RdrObjDy "Refer to the data element description in ReSideRdrRiObj1 with the same data element name";
CM_ SG_ 357 ReSideRdrRiObj5RdrObjDyStdDe "Refer to the data element description in ReSideRdrRiObj1 with the same data element name";
CM_ SG_ 357 ReSideRdrRiObj5RdrObjElevnConf "Refer to the data element description in ReSideRdrRiObj1 with the same data element name";
CM_ SG_ 357 ReSideRdrRiObj5RdrObjElevnSts "Refer to the data element description in ReSideRdrRiObj1 with the same data element name";
CM_ SG_ 357 ReSideRdrRiObj5RdrObjID "Refer to the data element description in ReSideRdrRiObj1 with the same data element name";
CM_ SG_ 357 ReSideRdrRiObj5RdrObjIsInFreeSpace "Refer to the data element description in ReSideRdrRiObj1 with the same data element name";
CM_ SG_ 357 ReSideRdrRiObj5RdrObjMirrProblty "Refer to the data element description in ReSideRdrRiObj1 with the same data element name";
CM_ SG_ 357 ReSideRdrRiObj5RdrObjMtnPat "Refer to the data element description in ReSideRdrRiObj1 with the same data element name";
CM_ SG_ 357 ReSideRdrRiObj5RdrObjNotRealProblty "Refer to the data element description in ReSideRdrRiObj1 with the same data element name";
CM_ SG_ 357 ReSideRdrRiObj5RdrObjStatyCnt "Refer to the data element description in ReSideRdrRiObj1 with the same data element name";
CM_ SG_ 357 ReSideRdrRiObj5RdrObjTiAlv "Refer to the data element description in ReSideRdrRiObj1 with the same data element name";
CM_ SG_ 357 ReSideRdrRiObj5RdrObjTrackSts "Refer to the data element description in ReSideRdrRiObj1 with the same data element name";
CM_ SG_ 357 ReSideRdrRiObj5RdrObjTyp "Refer to the data element description in ReSideRdrRiObj1 with the same data element name";
CM_ SG_ 357 ReSideRdrRiObj5RdrObjTypConfBike "Refer to the data element description in ReSideRdrRiObj1 with the same data element name";
CM_ SG_ 357 ReSideRdrRiObj5RdrObjTypConfPed "Refer to the data element description in ReSideRdrRiObj1 with the same data element name";
CM_ SG_ 357 ReSideRdrRiObj5RdrObjTypConfVeh "Refer to the data element description in ReSideRdrRiObj1 with the same data element name";
CM_ SG_ 357 ReSideRdrRiObj5RdrObjVx "Refer to the data element description in ReSideRdrRiObj1 with the same data element name";
CM_ SG_ 357 ReSideRdrRiObj5RdrObjVxStdDe "Refer to the data element description in ReSideRdrRiObj1 with the same data element name";
CM_ SG_ 357 ReSideRdrRiObj5RdrObjVy "Refer to the data element description in ReSideRdrRiObj1 with the same data element name";
CM_ SG_ 357 ReSideRdrRiObj5RdrObjVyStdDe "Refer to the data element description in ReSideRdrRiObj1 with the same data element name";
CM_ SG_ 357 ReSideRdrRiObj5RelVx "Refer to the data element description in ReSideRdrRiObj1 with the same data element name";
CM_ SG_ 357 ReSideRdrRiObj5RelVy "Refer to the data element description in ReSideRdrRiObj1 with the same data element name";
CM_ SG_ 359 ReSideRdrRiObj6Heading "Refer to the data element description in ReSideRdrRiObj1 with the same data element name";
CM_ SG_ 359 ReSideRdrRiObj6ObjBoxCenterLat "Refer to the data element description in ReSideRdrRiObj1 with the same data element name";
CM_ SG_ 359 ReSideRdrRiObj6ObjBoxCenterLgt "Refer to the data element description in ReSideRdrRiObj1 with the same data element name";
CM_ SG_ 359 ReSideRdrRiObj6ObservationHist "Refer to the data element description in ReSideRdrRiObj1 with the same data element name";
CM_ SG_ 359 ReSideRdrRiObj6RdrObjAx "Refer to the data element description in ReSideRdrRiObj1 with the same data element name";
CM_ SG_ 359 ReSideRdrRiObj6RdrObjAy "Refer to the data element description in ReSideRdrRiObj1 with the same data element name";
CM_ SG_ 359 ReSideRdrRiObj6RdrObjBoxLength "Refer to the data element description in ReSideRdrRiObj1 with the same data element name";
CM_ SG_ 359 ReSideRdrRiObj6RdrObjBoxWidth "Refer to the data element description in ReSideRdrRiObj1 with the same data element name";
CM_ SG_ 359 ReSideRdrRiObj6RdrObjChks "Refer to the data element description in ReSideRdrRiObj1 with the same data element name";
CM_ SG_ 359 ReSideRdrRiObj6RdrObjCntr "Refer to the data element description in ReSideRdrRiObj1 with the same data element name";
CM_ SG_ 359 ReSideRdrRiObj6RdrObjCoastCnt "Refer to the data element description in ReSideRdrRiObj1 with the same data element name";
CM_ SG_ 359 ReSideRdrRiObj6RdrObjConf "Refer to the data element description in ReSideRdrRiObj1 with the same data element name";
CM_ SG_ 359 ReSideRdrRiObj6RdrObjDx "Refer to the data element description in ReSideRdrRiObj1 with the same data element name";
CM_ SG_ 359 ReSideRdrRiObj6RdrObjDxStdDe "Refer to the data element description in ReSideRdrRiObj1 with the same data element name";
CM_ SG_ 359 ReSideRdrRiObj6RdrObjDy "Refer to the data element description in ReSideRdrRiObj1 with the same data element name";
CM_ SG_ 359 ReSideRdrRiObj6RdrObjDyStdDe "Refer to the data element description in ReSideRdrRiObj1 with the same data element name";
CM_ SG_ 359 ReSideRdrRiObj6RdrObjElevnConf "Refer to the data element description in ReSideRdrRiObj1 with the same data element name";
CM_ SG_ 359 ReSideRdrRiObj6RdrObjElevnSts "Refer to the data element description in ReSideRdrRiObj1 with the same data element name";
CM_ SG_ 359 ReSideRdrRiObj6RdrObjID "Refer to the data element description in ReSideRdrRiObj1 with the same data element name";
CM_ SG_ 359 ReSideRdrRiObj6RdrObjIsInFreeSpace "Refer to the data element description in ReSideRdrRiObj1 with the same data element name";
CM_ SG_ 359 ReSideRdrRiObj6RdrObjMirrProblty "Refer to the data element description in ReSideRdrRiObj1 with the same data element name";
CM_ SG_ 359 ReSideRdrRiObj6RdrObjMtnPat "Refer to the data element description in ReSideRdrRiObj1 with the same data element name";
CM_ SG_ 359 ReSideRdrRiObj6RdrObjNotRealProblty "Refer to the data element description in ReSideRdrRiObj1 with the same data element name";
CM_ SG_ 359 ReSideRdrRiObj6RdrObjStatyCnt "Refer to the data element description in ReSideRdrRiObj1 with the same data element name";
CM_ SG_ 359 ReSideRdrRiObj6RdrObjTiAlv "Refer to the data element description in ReSideRdrRiObj1 with the same data element name";
CM_ SG_ 359 ReSideRdrRiObj6RdrObjTrackSts "Refer to the data element description in ReSideRdrRiObj1 with the same data element name";
CM_ SG_ 359 ReSideRdrRiObj6RdrObjTyp "Refer to the data element description in ReSideRdrRiObj1 with the same data element name";
CM_ SG_ 359 ReSideRdrRiObj6RdrObjTypConfBike "Refer to the data element description in ReSideRdrRiObj1 with the same data element name";
CM_ SG_ 359 ReSideRdrRiObj6RdrObjTypConfPed "Refer to the data element description in ReSideRdrRiObj1 with the same data element name";
CM_ SG_ 359 ReSideRdrRiObj6RdrObjTypConfVeh "Refer to the data element description in ReSideRdrRiObj1 with the same data element name";
CM_ SG_ 359 ReSideRdrRiObj6RdrObjVx "Refer to the data element description in ReSideRdrRiObj1 with the same data element name";
CM_ SG_ 359 ReSideRdrRiObj6RdrObjVxStdDe "Refer to the data element description in ReSideRdrRiObj1 with the same data element name";
CM_ SG_ 359 ReSideRdrRiObj6RdrObjVy "Refer to the data element description in ReSideRdrRiObj1 with the same data element name";
CM_ SG_ 359 ReSideRdrRiObj6RdrObjVyStdDe "Refer to the data element description in ReSideRdrRiObj1 with the same data element name";
CM_ SG_ 359 ReSideRdrRiObj6RelVx "Refer to the data element description in ReSideRdrRiObj1 with the same data element name";
CM_ SG_ 359 ReSideRdrRiObj6RelVy "Refer to the data element description in ReSideRdrRiObj1 with the same data element name";
CM_ SG_ 361 ReSideRdrRiObj7Heading "Refer to the data element description in ReSideRdrRiObj1 with the same data element name";
CM_ SG_ 361 ReSideRdrRiObj7ObjBoxCenterLat "Refer to the data element description in ReSideRdrRiObj1 with the same data element name";
CM_ SG_ 361 ReSideRdrRiObj7ObjBoxCenterLgt "Refer to the data element description in ReSideRdrRiObj1 with the same data element name";
CM_ SG_ 361 ReSideRdrRiObj7ObservationHist "Refer to the data element description in ReSideRdrRiObj1 with the same data element name";
CM_ SG_ 361 ReSideRdrRiObj7RdrObjAx "Refer to the data element description in ReSideRdrRiObj1 with the same data element name";
CM_ SG_ 361 ReSideRdrRiObj7RdrObjAy "Refer to the data element description in ReSideRdrRiObj1 with the same data element name";
CM_ SG_ 361 ReSideRdrRiObj7RdrObjBoxLength "Refer to the data element description in ReSideRdrRiObj1 with the same data element name";
CM_ SG_ 361 ReSideRdrRiObj7RdrObjBoxWidth "Refer to the data element description in ReSideRdrRiObj1 with the same data element name";
CM_ SG_ 361 ReSideRdrRiObj7RdrObjChks "Refer to the data element description in ReSideRdrRiObj1 with the same data element name";
CM_ SG_ 361 ReSideRdrRiObj7RdrObjCntr "Refer to the data element description in ReSideRdrRiObj1 with the same data element name";
CM_ SG_ 361 ReSideRdrRiObj7RdrObjCoastCnt "Refer to the data element description in ReSideRdrRiObj1 with the same data element name";
CM_ SG_ 361 ReSideRdrRiObj7RdrObjConf "Refer to the data element description in ReSideRdrRiObj1 with the same data element name";
CM_ SG_ 361 ReSideRdrRiObj7RdrObjDx "Refer to the data element description in ReSideRdrRiObj1 with the same data element name";
CM_ SG_ 361 ReSideRdrRiObj7RdrObjDxStdDe "Refer to the data element description in ReSideRdrRiObj1 with the same data element name";
CM_ SG_ 361 ReSideRdrRiObj7RdrObjDy "Refer to the data element description in ReSideRdrRiObj1 with the same data element name";
CM_ SG_ 361 ReSideRdrRiObj7RdrObjDyStdDe "Refer to the data element description in ReSideRdrRiObj1 with the same data element name";
CM_ SG_ 361 ReSideRdrRiObj7RdrObjElevnConf "Refer to the data element description in ReSideRdrRiObj1 with the same data element name";
CM_ SG_ 361 ReSideRdrRiObj7RdrObjElevnSts "Refer to the data element description in ReSideRdrRiObj1 with the same data element name";
CM_ SG_ 361 ReSideRdrRiObj7RdrObjID "Refer to the data element description in ReSideRdrRiObj1 with the same data element name";
CM_ SG_ 361 ReSideRdrRiObj7RdrObjIsInFreeSpace "Refer to the data element description in ReSideRdrRiObj1 with the same data element name";
CM_ SG_ 361 ReSideRdrRiObj7RdrObjMirrProblty "Refer to the data element description in ReSideRdrRiObj1 with the same data element name";
CM_ SG_ 361 ReSideRdrRiObj7RdrObjMtnPat "Refer to the data element description in ReSideRdrRiObj1 with the same data element name";
CM_ SG_ 361 ReSideRdrRiObj7RdrObjNotRealProblty "Refer to the data element description in ReSideRdrRiObj1 with the same data element name";
CM_ SG_ 361 ReSideRdrRiObj7RdrObjStatyCnt "Refer to the data element description in ReSideRdrRiObj1 with the same data element name";
CM_ SG_ 361 ReSideRdrRiObj7RdrObjTiAlv "Refer to the data element description in ReSideRdrRiObj1 with the same data element name";
CM_ SG_ 361 ReSideRdrRiObj7RdrObjTrackSts "Refer to the data element description in ReSideRdrRiObj1 with the same data element name";
CM_ SG_ 361 ReSideRdrRiObj7RdrObjTyp "Refer to the data element description in ReSideRdrRiObj1 with the same data element name";
CM_ SG_ 361 ReSideRdrRiObj7RdrObjTypConfBike "Refer to the data element description in ReSideRdrRiObj1 with the same data element name";
CM_ SG_ 361 ReSideRdrRiObj7RdrObjTypConfPed "Refer to the data element description in ReSideRdrRiObj1 with the same data element name";
CM_ SG_ 361 ReSideRdrRiObj7RdrObjTypConfVeh "Refer to the data element description in ReSideRdrRiObj1 with the same data element name";
CM_ SG_ 361 ReSideRdrRiObj7RdrObjVx "Refer to the data element description in ReSideRdrRiObj1 with the same data element name";
CM_ SG_ 361 ReSideRdrRiObj7RdrObjVxStdDe "Refer to the data element description in ReSideRdrRiObj1 with the same data element name";
CM_ SG_ 361 ReSideRdrRiObj7RdrObjVy "Refer to the data element description in ReSideRdrRiObj1 with the same data element name";
CM_ SG_ 361 ReSideRdrRiObj7RdrObjVyStdDe "Refer to the data element description in ReSideRdrRiObj1 with the same data element name";
CM_ SG_ 361 ReSideRdrRiObj7RelVx "Refer to the data element description in ReSideRdrRiObj1 with the same data element name";
CM_ SG_ 361 ReSideRdrRiObj7RelVy "Refer to the data element description in ReSideRdrRiObj1 with the same data element name";
CM_ SG_ 363 ReSideRdrRiObj8Heading "Refer to the data element description in ReSideRdrRiObj1 with the same data element name";
CM_ SG_ 363 ReSideRdrRiObj8ObjBoxCenterLat "Refer to the data element description in ReSideRdrRiObj1 with the same data element name";
CM_ SG_ 363 ReSideRdrRiObj8ObjBoxCenterLgt "Refer to the data element description in ReSideRdrRiObj1 with the same data element name";
CM_ SG_ 363 ReSideRdrRiObj8ObservationHist "Refer to the data element description in ReSideRdrRiObj1 with the same data element name";
CM_ SG_ 363 ReSideRdrRiObj8RdrObjAx "Refer to the data element description in ReSideRdrRiObj1 with the same data element name";
CM_ SG_ 363 ReSideRdrRiObj8RdrObjAy "Refer to the data element description in ReSideRdrRiObj1 with the same data element name";
CM_ SG_ 363 ReSideRdrRiObj8RdrObjBoxLength "Refer to the data element description in ReSideRdrRiObj1 with the same data element name";
CM_ SG_ 363 ReSideRdrRiObj8RdrObjBoxWidth "Refer to the data element description in ReSideRdrRiObj1 with the same data element name";
CM_ SG_ 363 ReSideRdrRiObj8RdrObjChks "Refer to the data element description in ReSideRdrRiObj1 with the same data element name";
CM_ SG_ 363 ReSideRdrRiObj8RdrObjCntr "Refer to the data element description in ReSideRdrRiObj1 with the same data element name";
CM_ SG_ 363 ReSideRdrRiObj8RdrObjCoastCnt "Refer to the data element description in ReSideRdrRiObj1 with the same data element name";
CM_ SG_ 363 ReSideRdrRiObj8RdrObjConf "Refer to the data element description in ReSideRdrRiObj1 with the same data element name";
CM_ SG_ 363 ReSideRdrRiObj8RdrObjDx "Refer to the data element description in ReSideRdrRiObj1 with the same data element name";
CM_ SG_ 363 ReSideRdrRiObj8RdrObjDxStdDe "Refer to the data element description in ReSideRdrRiObj1 with the same data element name";
CM_ SG_ 363 ReSideRdrRiObj8RdrObjDy "Refer to the data element description in ReSideRdrRiObj1 with the same data element name";
CM_ SG_ 363 ReSideRdrRiObj8RdrObjDyStdDe "Refer to the data element description in ReSideRdrRiObj1 with the same data element name";
CM_ SG_ 363 ReSideRdrRiObj8RdrObjElevnConf "Refer to the data element description in ReSideRdrRiObj1 with the same data element name";
CM_ SG_ 363 ReSideRdrRiObj8RdrObjElevnSts "Refer to the data element description in ReSideRdrRiObj1 with the same data element name";
CM_ SG_ 363 ReSideRdrRiObj8RdrObjID "Refer to the data element description in ReSideRdrRiObj1 with the same data element name";
CM_ SG_ 363 ReSideRdrRiObj8RdrObjIsInFreeSpace "Refer to the data element description in ReSideRdrRiObj1 with the same data element name";
CM_ SG_ 363 ReSideRdrRiObj8RdrObjMirrProblty "Refer to the data element description in ReSideRdrRiObj1 with the same data element name";
CM_ SG_ 363 ReSideRdrRiObj8RdrObjMtnPat "Refer to the data element description in ReSideRdrRiObj1 with the same data element name";
CM_ SG_ 363 ReSideRdrRiObj8RdrObjNotRealProblty "Refer to the data element description in ReSideRdrRiObj1 with the same data element name";
CM_ SG_ 363 ReSideRdrRiObj8RdrObjStatyCnt "Refer to the data element description in ReSideRdrRiObj1 with the same data element name";
CM_ SG_ 363 ReSideRdrRiObj8RdrObjTiAlv "Refer to the data element description in ReSideRdrRiObj1 with the same data element name";
CM_ SG_ 363 ReSideRdrRiObj8RdrObjTrackSts "Refer to the data element description in ReSideRdrRiObj1 with the same data element name";
CM_ SG_ 363 ReSideRdrRiObj8RdrObjTyp "Refer to the data element description in ReSideRdrRiObj1 with the same data element name";
CM_ SG_ 363 ReSideRdrRiObj8RdrObjTypConfBike "Refer to the data element description in ReSideRdrRiObj1 with the same data element name";
CM_ SG_ 363 ReSideRdrRiObj8RdrObjTypConfPed "Refer to the data element description in ReSideRdrRiObj1 with the same data element name";
CM_ SG_ 363 ReSideRdrRiObj8RdrObjTypConfVeh "Refer to the data element description in ReSideRdrRiObj1 with the same data element name";
CM_ SG_ 363 ReSideRdrRiObj8RdrObjVx "Refer to the data element description in ReSideRdrRiObj1 with the same data element name";
CM_ SG_ 363 ReSideRdrRiObj8RdrObjVxStdDe "Refer to the data element description in ReSideRdrRiObj1 with the same data element name";
CM_ SG_ 363 ReSideRdrRiObj8RdrObjVy "Refer to the data element description in ReSideRdrRiObj1 with the same data element name";
CM_ SG_ 363 ReSideRdrRiObj8RdrObjVyStdDe "Refer to the data element description in ReSideRdrRiObj1 with the same data element name";
CM_ SG_ 363 ReSideRdrRiObj8RelVx "Refer to the data element description in ReSideRdrRiObj1 with the same data element name";
CM_ SG_ 363 ReSideRdrRiObj8RelVy "Refer to the data element description in ReSideRdrRiObj1 with the same data element name";
CM_ SG_ 365 ReSideRdrRiObj9Heading "Refer to the data element description in ReSideRdrRiObj1 with the same data element name";
CM_ SG_ 365 ReSideRdrRiObj9ObjBoxCenterLat "Refer to the data element description in ReSideRdrRiObj1 with the same data element name";
CM_ SG_ 365 ReSideRdrRiObj9ObjBoxCenterLgt "Refer to the data element description in ReSideRdrRiObj1 with the same data element name";
CM_ SG_ 365 ReSideRdrRiObj9ObservationHist "Refer to the data element description in ReSideRdrRiObj1 with the same data element name";
CM_ SG_ 365 ReSideRdrRiObj9RdrObjAx "Refer to the data element description in ReSideRdrRiObj1 with the same data element name";
CM_ SG_ 365 ReSideRdrRiObj9RdrObjAy "Refer to the data element description in ReSideRdrRiObj1 with the same data element name";
CM_ SG_ 365 ReSideRdrRiObj9RdrObjBoxLength "Refer to the data element description in ReSideRdrRiObj1 with the same data element name";
CM_ SG_ 365 ReSideRdrRiObj9RdrObjBoxWidth "Refer to the data element description in ReSideRdrRiObj1 with the same data element name";
CM_ SG_ 365 ReSideRdrRiObj9RdrObjChks "Refer to the data element description in ReSideRdrRiObj1 with the same data element name";
CM_ SG_ 365 ReSideRdrRiObj9RdrObjCntr "Refer to the data element description in ReSideRdrRiObj1 with the same data element name";
CM_ SG_ 365 ReSideRdrRiObj9RdrObjCoastCnt "Refer to the data element description in ReSideRdrRiObj1 with the same data element name";
CM_ SG_ 365 ReSideRdrRiObj9RdrObjConf "Refer to the data element description in ReSideRdrRiObj1 with the same data element name";
CM_ SG_ 365 ReSideRdrRiObj9RdrObjDx "Refer to the data element description in ReSideRdrRiObj1 with the same data element name";
CM_ SG_ 365 ReSideRdrRiObj9RdrObjDxStdDe "Refer to the data element description in ReSideRdrRiObj1 with the same data element name";
CM_ SG_ 365 ReSideRdrRiObj9RdrObjDy "Refer to the data element description in ReSideRdrRiObj1 with the same data element name";
CM_ SG_ 365 ReSideRdrRiObj9RdrObjDyStdDe "Refer to the data element description in ReSideRdrRiObj1 with the same data element name";
CM_ SG_ 365 ReSideRdrRiObj9RdrObjElevnConf "Refer to the data element description in ReSideRdrRiObj1 with the same data element name";
CM_ SG_ 365 ReSideRdrRiObj9RdrObjElevnSts "Refer to the data element description in ReSideRdrRiObj1 with the same data element name";
CM_ SG_ 365 ReSideRdrRiObj9RdrObjID "Refer to the data element description in ReSideRdrRiObj1 with the same data element name";
CM_ SG_ 365 ReSideRdrRiObj9RdrObjIsInFreeSpace "Refer to the data element description in ReSideRdrRiObj1 with the same data element name";
CM_ SG_ 365 ReSideRdrRiObj9RdrObjMirrProblty "Refer to the data element description in ReSideRdrRiObj1 with the same data element name";
CM_ SG_ 365 ReSideRdrRiObj9RdrObjMtnPat "Refer to the data element description in ReSideRdrRiObj1 with the same data element name";
CM_ SG_ 365 ReSideRdrRiObj9RdrObjNotRealProblty "Refer to the data element description in ReSideRdrRiObj1 with the same data element name";
CM_ SG_ 365 ReSideRdrRiObj9RdrObjStatyCnt "Refer to the data element description in ReSideRdrRiObj1 with the same data element name";
CM_ SG_ 365 ReSideRdrRiObj9RdrObjTiAlv "Refer to the data element description in ReSideRdrRiObj1 with the same data element name";
CM_ SG_ 365 ReSideRdrRiObj9RdrObjTrackSts "Refer to the data element description in ReSideRdrRiObj1 with the same data element name";
CM_ SG_ 365 ReSideRdrRiObj9RdrObjTyp "Refer to the data element description in ReSideRdrRiObj1 with the same data element name";
CM_ SG_ 365 ReSideRdrRiObj9RdrObjTypConfBike "Refer to the data element description in ReSideRdrRiObj1 with the same data element name";
CM_ SG_ 365 ReSideRdrRiObj9RdrObjTypConfPed "Refer to the data element description in ReSideRdrRiObj1 with the same data element name";
CM_ SG_ 365 ReSideRdrRiObj9RdrObjTypConfVeh "Refer to the data element description in ReSideRdrRiObj1 with the same data element name";
CM_ SG_ 365 ReSideRdrRiObj9RdrObjVx "Refer to the data element description in ReSideRdrRiObj1 with the same data element name";
CM_ SG_ 365 ReSideRdrRiObj9RdrObjVxStdDe "Refer to the data element description in ReSideRdrRiObj1 with the same data element name";
CM_ SG_ 365 ReSideRdrRiObj9RdrObjVy "Refer to the data element description in ReSideRdrRiObj1 with the same data element name";
CM_ SG_ 365 ReSideRdrRiObj9RdrObjVyStdDe "Refer to the data element description in ReSideRdrRiObj1 with the same data element name";
CM_ SG_ 365 ReSideRdrRiObj9RelVx "Refer to the data element description in ReSideRdrRiObj1 with the same data element name";
CM_ SG_ 365 ReSideRdrRiObj9RelVy "Refer to the data element description in ReSideRdrRiObj1 with the same data element name";
CM_ SG_ 367 ReSideRdrRiObj10Heading "Refer to the data element description in ReSideRdrRiObj1 with the same data element name";
CM_ SG_ 367 ReSideRdrRiObj10ObjBoxCenterLat "Refer to the data element description in ReSideRdrRiObj1 with the same data element name";
CM_ SG_ 367 ReSideRdrRiObj10ObjBoxCenterLgt "Refer to the data element description in ReSideRdrRiObj1 with the same data element name";
CM_ SG_ 367 ReSideRdrRiObj10ObservationHist "Refer to the data element description in ReSideRdrRiObj1 with the same data element name";
CM_ SG_ 367 ReSideRdrRiObj10RdrObjAx "Refer to the data element description in ReSideRdrRiObj1 with the same data element name";
CM_ SG_ 367 ReSideRdrRiObj10RdrObjAy "Refer to the data element description in ReSideRdrRiObj1 with the same data element name";
CM_ SG_ 367 ReSideRdrRiObj10RdrObjBoxLength "Refer to the data element description in ReSideRdrRiObj1 with the same data element name";
CM_ SG_ 367 ReSideRdrRiObj10RdrObjBoxWidth "Refer to the data element description in ReSideRdrRiObj1 with the same data element name";
CM_ SG_ 367 ReSideRdrRiObj10RdrObjChks "Refer to the data element description in ReSideRdrRiObj1 with the same data element name";
CM_ SG_ 367 ReSideRdrRiObj10RdrObjCntr "Refer to the data element description in ReSideRdrRiObj1 with the same data element name";
CM_ SG_ 367 ReSideRdrRiObj10RdrObjCoastCnt "Refer to the data element description in ReSideRdrRiObj1 with the same data element name";
CM_ SG_ 367 ReSideRdrRiObj10RdrObjConf "Refer to the data element description in ReSideRdrRiObj1 with the same data element name";
CM_ SG_ 367 ReSideRdrRiObj10RdrObjDx "Refer to the data element description in ReSideRdrRiObj1 with the same data element name";
CM_ SG_ 367 ReSideRdrRiObj10RdrObjDxStdDe "Refer to the data element description in ReSideRdrRiObj1 with the same data element name";
CM_ SG_ 367 ReSideRdrRiObj10RdrObjDy "Refer to the data element description in ReSideRdrRiObj1 with the same data element name";
CM_ SG_ 367 ReSideRdrRiObj10RdrObjDyStdDe "Refer to the data element description in ReSideRdrRiObj1 with the same data element name";
CM_ SG_ 367 ReSideRdrRiObj10RdrObjElevnConf "Refer to the data element description in ReSideRdrRiObj1 with the same data element name";
CM_ SG_ 367 ReSideRdrRiObj10RdrObjElevnSts "Refer to the data element description in ReSideRdrRiObj1 with the same data element name";
CM_ SG_ 367 ReSideRdrRiObj10RdrObjID "Refer to the data element description in ReSideRdrRiObj1 with the same data element name";
CM_ SG_ 367 ReSideRdrRiObj10RdrObjIsInFreeSpace "Refer to the data element description in ReSideRdrRiObj1 with the same data element name";
CM_ SG_ 367 ReSideRdrRiObj10RdrObjMirrProblty "Refer to the data element description in ReSideRdrRiObj1 with the same data element name";
CM_ SG_ 367 ReSideRdrRiObj10RdrObjMtnPat "Refer to the data element description in ReSideRdrRiObj1 with the same data element name";
CM_ SG_ 367 ReSideRdrRiObj10RdrObjNotRealProblty "Refer to the data element description in ReSideRdrRiObj1 with the same data element name";
CM_ SG_ 367 ReSideRdrRiObj10RdrObjStatyCnt "Refer to the data element description in ReSideRdrRiObj1 with the same data element name";
CM_ SG_ 367 ReSideRdrRiObj10RdrObjTiAlv "Refer to the data element description in ReSideRdrRiObj1 with the same data element name";
CM_ SG_ 367 ReSideRdrRiObj10RdrObjTrackSts "Refer to the data element description in ReSideRdrRiObj1 with the same data element name";
CM_ SG_ 367 ReSideRdrRiObj10RdrObjTyp "Refer to the data element description in ReSideRdrRiObj1 with the same data element name";
CM_ SG_ 367 ReSideRdrRiObj10RdrObjTypConfBike "Refer to the data element description in ReSideRdrRiObj1 with the same data element name";
CM_ SG_ 367 ReSideRdrRiObj10RdrObjTypConfPed "Refer to the data element description in ReSideRdrRiObj1 with the same data element name";
CM_ SG_ 367 ReSideRdrRiObj10RdrObjTypConfVeh "Refer to the data element description in ReSideRdrRiObj1 with the same data element name";
CM_ SG_ 367 ReSideRdrRiObj10RdrObjVx "Refer to the data element description in ReSideRdrRiObj1 with the same data element name";
CM_ SG_ 367 ReSideRdrRiObj10RdrObjVxStdDe "Refer to the data element description in ReSideRdrRiObj1 with the same data element name";
CM_ SG_ 367 ReSideRdrRiObj10RdrObjVy "Refer to the data element description in ReSideRdrRiObj1 with the same data element name";
CM_ SG_ 367 ReSideRdrRiObj10RdrObjVyStdDe "Refer to the data element description in ReSideRdrRiObj1 with the same data element name";
CM_ SG_ 367 ReSideRdrRiObj10RelVx "Refer to the data element description in ReSideRdrRiObj1 with the same data element name";
CM_ SG_ 367 ReSideRdrRiObj10RelVy "Refer to the data element description in ReSideRdrRiObj1 with the same data element name";
CM_ SG_ 369 ReSideRdrRiObj11Heading "Refer to the data element description in ReSideRdrRiObj1 with the same data element name";
CM_ SG_ 369 ReSideRdrRiObj11ObjBoxCenterLat "Refer to the data element description in ReSideRdrRiObj1 with the same data element name";
CM_ SG_ 369 ReSideRdrRiObj11ObjBoxCenterLgt "Refer to the data element description in ReSideRdrRiObj1 with the same data element name";
CM_ SG_ 369 ReSideRdrRiObj11ObservationHist "Refer to the data element description in ReSideRdrRiObj1 with the same data element name";
CM_ SG_ 369 ReSideRdrRiObj11RdrObjAx "Refer to the data element description in ReSideRdrRiObj1 with the same data element name";
CM_ SG_ 369 ReSideRdrRiObj11RdrObjAy "Refer to the data element description in ReSideRdrRiObj1 with the same data element name";
CM_ SG_ 369 ReSideRdrRiObj11RdrObjBoxLength "Refer to the data element description in ReSideRdrRiObj1 with the same data element name";
CM_ SG_ 369 ReSideRdrRiObj11RdrObjBoxWidth "Refer to the data element description in ReSideRdrRiObj1 with the same data element name";
CM_ SG_ 369 ReSideRdrRiObj11RdrObjChks "Refer to the data element description in ReSideRdrRiObj1 with the same data element name";
CM_ SG_ 369 ReSideRdrRiObj11RdrObjCntr "Refer to the data element description in ReSideRdrRiObj1 with the same data element name";
CM_ SG_ 369 ReSideRdrRiObj11RdrObjCoastCnt "Refer to the data element description in ReSideRdrRiObj1 with the same data element name";
CM_ SG_ 369 ReSideRdrRiObj11RdrObjConf "Refer to the data element description in ReSideRdrRiObj1 with the same data element name";
CM_ SG_ 369 ReSideRdrRiObj11RdrObjDx "Refer to the data element description in ReSideRdrRiObj1 with the same data element name";
CM_ SG_ 369 ReSideRdrRiObj11RdrObjDxStdDe "Refer to the data element description in ReSideRdrRiObj1 with the same data element name";
CM_ SG_ 369 ReSideRdrRiObj11RdrObjDy "Refer to the data element description in ReSideRdrRiObj1 with the same data element name";
CM_ SG_ 369 ReSideRdrRiObj11RdrObjDyStdDe "Refer to the data element description in ReSideRdrRiObj1 with the same data element name";
CM_ SG_ 369 ReSideRdrRiObj11RdrObjElevnConf "Refer to the data element description in ReSideRdrRiObj1 with the same data element name";
CM_ SG_ 369 ReSideRdrRiObj11RdrObjElevnSts "Refer to the data element description in ReSideRdrRiObj1 with the same data element name";
CM_ SG_ 369 ReSideRdrRiObj11RdrObjID "Refer to the data element description in ReSideRdrRiObj1 with the same data element name";
CM_ SG_ 369 ReSideRdrRiObj11RdrObjIsInFreeSpace "Refer to the data element description in ReSideRdrRiObj1 with the same data element name";
CM_ SG_ 369 ReSideRdrRiObj11RdrObjMirrProblty "Refer to the data element description in ReSideRdrRiObj1 with the same data element name";
CM_ SG_ 369 ReSideRdrRiObj11RdrObjMtnPat "Refer to the data element description in ReSideRdrRiObj1 with the same data element name";
CM_ SG_ 369 ReSideRdrRiObj11RdrObjNotRealProblty "Refer to the data element description in ReSideRdrRiObj1 with the same data element name";
CM_ SG_ 369 ReSideRdrRiObj11RdrObjStatyCnt "Refer to the data element description in ReSideRdrRiObj1 with the same data element name";
CM_ SG_ 369 ReSideRdrRiObj11RdrObjTiAlv "Refer to the data element description in ReSideRdrRiObj1 with the same data element name";
CM_ SG_ 369 ReSideRdrRiObj11RdrObjTrackSts "Refer to the data element description in ReSideRdrRiObj1 with the same data element name";
CM_ SG_ 369 ReSideRdrRiObj11RdrObjTyp "Refer to the data element description in ReSideRdrRiObj1 with the same data element name";
CM_ SG_ 369 ReSideRdrRiObj11RdrObjTypConfBike "Refer to the data element description in ReSideRdrRiObj1 with the same data element name";
CM_ SG_ 369 ReSideRdrRiObj11RdrObjTypConfPed "Refer to the data element description in ReSideRdrRiObj1 with the same data element name";
CM_ SG_ 369 ReSideRdrRiObj11RdrObjTypConfVeh "Refer to the data element description in ReSideRdrRiObj1 with the same data element name";
CM_ SG_ 369 ReSideRdrRiObj11RdrObjVx "Refer to the data element description in ReSideRdrRiObj1 with the same data element name";
CM_ SG_ 369 ReSideRdrRiObj11RdrObjVxStdDe "Refer to the data element description in ReSideRdrRiObj1 with the same data element name";
CM_ SG_ 369 ReSideRdrRiObj11RdrObjVy "Refer to the data element description in ReSideRdrRiObj1 with the same data element name";
CM_ SG_ 369 ReSideRdrRiObj11RdrObjVyStdDe "Refer to the data element description in ReSideRdrRiObj1 with the same data element name";
CM_ SG_ 369 ReSideRdrRiObj11RelVx "Refer to the data element description in ReSideRdrRiObj1 with the same data element name";
CM_ SG_ 369 ReSideRdrRiObj11RelVy "Refer to the data element description in ReSideRdrRiObj1 with the same data element name";
CM_ SG_ 371 ReSideRdrRiObj12Heading "Refer to the data element description in ReSideRdrRiObj1 with the same data element name";
CM_ SG_ 371 ReSideRdrRiObj12ObjBoxCenterLat "Refer to the data element description in ReSideRdrRiObj1 with the same data element name";
CM_ SG_ 371 ReSideRdrRiObj12ObjBoxCenterLgt "Refer to the data element description in ReSideRdrRiObj1 with the same data element name";
CM_ SG_ 371 ReSideRdrRiObj12ObservationHist "Refer to the data element description in ReSideRdrRiObj1 with the same data element name";
CM_ SG_ 371 ReSideRdrRiObj12RdrObjAx "Refer to the data element description in ReSideRdrRiObj1 with the same data element name";
CM_ SG_ 371 ReSideRdrRiObj12RdrObjAy "Refer to the data element description in ReSideRdrRiObj1 with the same data element name";
CM_ SG_ 371 ReSideRdrRiObj12RdrObjBoxLength "Refer to the data element description in ReSideRdrRiObj1 with the same data element name";
CM_ SG_ 371 ReSideRdrRiObj12RdrObjBoxWidth "Refer to the data element description in ReSideRdrRiObj1 with the same data element name";
CM_ SG_ 371 ReSideRdrRiObj12RdrObjChks "Refer to the data element description in ReSideRdrRiObj1 with the same data element name";
CM_ SG_ 371 ReSideRdrRiObj12RdrObjCntr "Refer to the data element description in ReSideRdrRiObj1 with the same data element name";
CM_ SG_ 371 ReSideRdrRiObj12RdrObjCoastCnt "Refer to the data element description in ReSideRdrRiObj1 with the same data element name";
CM_ SG_ 371 ReSideRdrRiObj12RdrObjConf "Refer to the data element description in ReSideRdrRiObj1 with the same data element name";
CM_ SG_ 371 ReSideRdrRiObj12RdrObjDx "Refer to the data element description in ReSideRdrRiObj1 with the same data element name";
CM_ SG_ 371 ReSideRdrRiObj12RdrObjDxStdDe "Refer to the data element description in ReSideRdrRiObj1 with the same data element name";
CM_ SG_ 371 ReSideRdrRiObj12RdrObjDy "Refer to the data element description in ReSideRdrRiObj1 with the same data element name";
CM_ SG_ 371 ReSideRdrRiObj12RdrObjDyStdDe "Refer to the data element description in ReSideRdrRiObj1 with the same data element name";
CM_ SG_ 371 ReSideRdrRiObj12RdrObjElevnConf "Refer to the data element description in ReSideRdrRiObj1 with the same data element name";
CM_ SG_ 371 ReSideRdrRiObj12RdrObjElevnSts "Refer to the data element description in ReSideRdrRiObj1 with the same data element name";
CM_ SG_ 371 ReSideRdrRiObj12RdrObjID "Refer to the data element description in ReSideRdrRiObj1 with the same data element name";
CM_ SG_ 371 ReSideRdrRiObj12RdrObjIsInFreeSpace "Refer to the data element description in ReSideRdrRiObj1 with the same data element name";
CM_ SG_ 371 ReSideRdrRiObj12RdrObjMirrProblty "Refer to the data element description in ReSideRdrRiObj1 with the same data element name";
CM_ SG_ 371 ReSideRdrRiObj12RdrObjMtnPat "Refer to the data element description in ReSideRdrRiObj1 with the same data element name";
CM_ SG_ 371 ReSideRdrRiObj12RdrObjNotRealProblty "Refer to the data element description in ReSideRdrRiObj1 with the same data element name";
CM_ SG_ 371 ReSideRdrRiObj12RdrObjStatyCnt "Refer to the data element description in ReSideRdrRiObj1 with the same data element name";
CM_ SG_ 371 ReSideRdrRiObj12RdrObjTiAlv "Refer to the data element description in ReSideRdrRiObj1 with the same data element name";
CM_ SG_ 371 ReSideRdrRiObj12RdrObjTrackSts "Refer to the data element description in ReSideRdrRiObj1 with the same data element name";
CM_ SG_ 371 ReSideRdrRiObj12RdrObjTyp "Refer to the data element description in ReSideRdrRiObj1 with the same data element name";
CM_ SG_ 371 ReSideRdrRiObj12RdrObjTypConfBike "Refer to the data element description in ReSideRdrRiObj1 with the same data element name";
CM_ SG_ 371 ReSideRdrRiObj12RdrObjTypConfPed "Refer to the data element description in ReSideRdrRiObj1 with the same data element name";
CM_ SG_ 371 ReSideRdrRiObj12RdrObjTypConfVeh "Refer to the data element description in ReSideRdrRiObj1 with the same data element name";
CM_ SG_ 371 ReSideRdrRiObj12RdrObjVx "Refer to the data element description in ReSideRdrRiObj1 with the same data element name";
CM_ SG_ 371 ReSideRdrRiObj12RdrObjVxStdDe "Refer to the data element description in ReSideRdrRiObj1 with the same data element name";
CM_ SG_ 371 ReSideRdrRiObj12RdrObjVy "Refer to the data element description in ReSideRdrRiObj1 with the same data element name";
CM_ SG_ 371 ReSideRdrRiObj12RdrObjVyStdDe "Refer to the data element description in ReSideRdrRiObj1 with the same data element name";
CM_ SG_ 371 ReSideRdrRiObj12RelVx "Refer to the data element description in ReSideRdrRiObj1 with the same data element name";
CM_ SG_ 371 ReSideRdrRiObj12RelVy "Refer to the data element description in ReSideRdrRiObj1 with the same data element name";
CM_ SG_ 373 ReSideRdrRiObj13Heading "Refer to the data element description in ReSideRdrRiObj1 with the same data element name";
CM_ SG_ 373 ReSideRdrRiObj13ObjBoxCenterLat "Refer to the data element description in ReSideRdrRiObj1 with the same data element name";
CM_ SG_ 373 ReSideRdrRiObj13ObjBoxCenterLgt "Refer to the data element description in ReSideRdrRiObj1 with the same data element name";
CM_ SG_ 373 ReSideRdrRiObj13ObservationHist "Refer to the data element description in ReSideRdrRiObj1 with the same data element name";
CM_ SG_ 373 ReSideRdrRiObj13RdrObjAx "Refer to the data element description in ReSideRdrRiObj1 with the same data element name";
CM_ SG_ 373 ReSideRdrRiObj13RdrObjAy "Refer to the data element description in ReSideRdrRiObj1 with the same data element name";
CM_ SG_ 373 ReSideRdrRiObj13RdrObjBoxLength "Refer to the data element description in ReSideRdrRiObj1 with the same data element name";
CM_ SG_ 373 ReSideRdrRiObj13RdrObjBoxWidth "Refer to the data element description in ReSideRdrRiObj1 with the same data element name";
CM_ SG_ 373 ReSideRdrRiObj13RdrObjChks "Refer to the data element description in ReSideRdrRiObj1 with the same data element name";
CM_ SG_ 373 ReSideRdrRiObj13RdrObjCntr "Refer to the data element description in ReSideRdrRiObj1 with the same data element name";
CM_ SG_ 373 ReSideRdrRiObj13RdrObjCoastCnt "Refer to the data element description in ReSideRdrRiObj1 with the same data element name";
CM_ SG_ 373 ReSideRdrRiObj13RdrObjConf "Refer to the data element description in ReSideRdrRiObj1 with the same data element name";
CM_ SG_ 373 ReSideRdrRiObj13RdrObjDx "Refer to the data element description in ReSideRdrRiObj1 with the same data element name";
CM_ SG_ 373 ReSideRdrRiObj13RdrObjDxStdDe "Refer to the data element description in ReSideRdrRiObj1 with the same data element name";
CM_ SG_ 373 ReSideRdrRiObj13RdrObjDy "Refer to the data element description in ReSideRdrRiObj1 with the same data element name";
CM_ SG_ 373 ReSideRdrRiObj13RdrObjDyStdDe "Refer to the data element description in ReSideRdrRiObj1 with the same data element name";
CM_ SG_ 373 ReSideRdrRiObj13RdrObjElevnConf "Refer to the data element description in ReSideRdrRiObj1 with the same data element name";
CM_ SG_ 373 ReSideRdrRiObj13RdrObjElevnSts "Refer to the data element description in ReSideRdrRiObj1 with the same data element name";
CM_ SG_ 373 ReSideRdrRiObj13RdrObjID "Refer to the data element description in ReSideRdrRiObj1 with the same data element name";
CM_ SG_ 373 ReSideRdrRiObj13RdrObjIsInFreeSpace "Refer to the data element description in ReSideRdrRiObj1 with the same data element name";
CM_ SG_ 373 ReSideRdrRiObj13RdrObjMirrProblty "Refer to the data element description in ReSideRdrRiObj1 with the same data element name";
CM_ SG_ 373 ReSideRdrRiObj13RdrObjMtnPat "Refer to the data element description in ReSideRdrRiObj1 with the same data element name";
CM_ SG_ 373 ReSideRdrRiObj13RdrObjNotRealProblty "Refer to the data element description in ReSideRdrRiObj1 with the same data element name";
CM_ SG_ 373 ReSideRdrRiObj13RdrObjStatyCnt "Refer to the data element description in ReSideRdrRiObj1 with the same data element name";
CM_ SG_ 373 ReSideRdrRiObj13RdrObjTiAlv "Refer to the data element description in ReSideRdrRiObj1 with the same data element name";
CM_ SG_ 373 ReSideRdrRiObj13RdrObjTrackSts "Refer to the data element description in ReSideRdrRiObj1 with the same data element name";
CM_ SG_ 373 ReSideRdrRiObj13RdrObjTyp "Refer to the data element description in ReSideRdrRiObj1 with the same data element name";
CM_ SG_ 373 ReSideRdrRiObj13RdrObjTypConfBike "Refer to the data element description in ReSideRdrRiObj1 with the same data element name";
CM_ SG_ 373 ReSideRdrRiObj13RdrObjTypConfPed "Refer to the data element description in ReSideRdrRiObj1 with the same data element name";
CM_ SG_ 373 ReSideRdrRiObj13RdrObjTypConfVeh "Refer to the data element description in ReSideRdrRiObj1 with the same data element name";
CM_ SG_ 373 ReSideRdrRiObj13RdrObjVx "Refer to the data element description in ReSideRdrRiObj1 with the same data element name";
CM_ SG_ 373 ReSideRdrRiObj13RdrObjVxStdDe "Refer to the data element description in ReSideRdrRiObj1 with the same data element name";
CM_ SG_ 373 ReSideRdrRiObj13RdrObjVy "Refer to the data element description in ReSideRdrRiObj1 with the same data element name";
CM_ SG_ 373 ReSideRdrRiObj13RdrObjVyStdDe "Refer to the data element description in ReSideRdrRiObj1 with the same data element name";
CM_ SG_ 373 ReSideRdrRiObj13RelVx "Refer to the data element description in ReSideRdrRiObj1 with the same data element name";
CM_ SG_ 373 ReSideRdrRiObj13RelVy "Refer to the data element description in ReSideRdrRiObj1 with the same data element name";
CM_ SG_ 375 ReSideRdrRiObj14Heading "Refer to the data element description in ReSideRdrRiObj1 with the same data element name";
CM_ SG_ 375 ReSideRdrRiObj14ObjBoxCenterLat "Refer to the data element description in ReSideRdrRiObj1 with the same data element name";
CM_ SG_ 375 ReSideRdrRiObj14ObjBoxCenterLgt "Refer to the data element description in ReSideRdrRiObj1 with the same data element name";
CM_ SG_ 375 ReSideRdrRiObj14ObservationHist "Refer to the data element description in ReSideRdrRiObj1 with the same data element name";
CM_ SG_ 375 ReSideRdrRiObj14RdrObjAx "Refer to the data element description in ReSideRdrRiObj1 with the same data element name";
CM_ SG_ 375 ReSideRdrRiObj14RdrObjAy "Refer to the data element description in ReSideRdrRiObj1 with the same data element name";
CM_ SG_ 375 ReSideRdrRiObj14RdrObjBoxLength "Refer to the data element description in ReSideRdrRiObj1 with the same data element name";
CM_ SG_ 375 ReSideRdrRiObj14RdrObjBoxWidth "Refer to the data element description in ReSideRdrRiObj1 with the same data element name";
CM_ SG_ 375 ReSideRdrRiObj14RdrObjChks "Refer to the data element description in ReSideRdrRiObj1 with the same data element name";
CM_ SG_ 375 ReSideRdrRiObj14RdrObjCntr "Refer to the data element description in ReSideRdrRiObj1 with the same data element name";
CM_ SG_ 375 ReSideRdrRiObj14RdrObjCoastCnt "Refer to the data element description in ReSideRdrRiObj1 with the same data element name";
CM_ SG_ 375 ReSideRdrRiObj14RdrObjConf "Refer to the data element description in ReSideRdrRiObj1 with the same data element name";
CM_ SG_ 375 ReSideRdrRiObj14RdrObjDx "Refer to the data element description in ReSideRdrRiObj1 with the same data element name";
CM_ SG_ 375 ReSideRdrRiObj14RdrObjDxStdDe "Refer to the data element description in ReSideRdrRiObj1 with the same data element name";
CM_ SG_ 375 ReSideRdrRiObj14RdrObjDy "Refer to the data element description in ReSideRdrRiObj1 with the same data element name";
CM_ SG_ 375 ReSideRdrRiObj14RdrObjDyStdDe "Refer to the data element description in ReSideRdrRiObj1 with the same data element name";
CM_ SG_ 375 ReSideRdrRiObj14RdrObjElevnConf "Refer to the data element description in ReSideRdrRiObj1 with the same data element name";
CM_ SG_ 375 ReSideRdrRiObj14RdrObjElevnSts "Refer to the data element description in ReSideRdrRiObj1 with the same data element name";
CM_ SG_ 375 ReSideRdrRiObj14RdrObjID "Refer to the data element description in ReSideRdrRiObj1 with the same data element name";
CM_ SG_ 375 ReSideRdrRiObj14RdrObjIsInFreeSpace "Refer to the data element description in ReSideRdrRiObj1 with the same data element name";
CM_ SG_ 375 ReSideRdrRiObj14RdrObjMirrProblty "Refer to the data element description in ReSideRdrRiObj1 with the same data element name";
CM_ SG_ 375 ReSideRdrRiObj14RdrObjMtnPat "Refer to the data element description in ReSideRdrRiObj1 with the same data element name";
CM_ SG_ 375 ReSideRdrRiObj14RdrObjNotRealProblty "Refer to the data element description in ReSideRdrRiObj1 with the same data element name";
CM_ SG_ 375 ReSideRdrRiObj14RdrObjStatyCnt "Refer to the data element description in ReSideRdrRiObj1 with the same data element name";
CM_ SG_ 375 ReSideRdrRiObj14RdrObjTiAlv "Refer to the data element description in ReSideRdrRiObj1 with the same data element name";
CM_ SG_ 375 ReSideRdrRiObj14RdrObjTrackSts "Refer to the data element description in ReSideRdrRiObj1 with the same data element name";
CM_ SG_ 375 ReSideRdrRiObj14RdrObjTyp "Refer to the data element description in ReSideRdrRiObj1 with the same data element name";
CM_ SG_ 375 ReSideRdrRiObj14RdrObjTypConfBike "Refer to the data element description in ReSideRdrRiObj1 with the same data element name";
CM_ SG_ 375 ReSideRdrRiObj14RdrObjTypConfPed "Refer to the data element description in ReSideRdrRiObj1 with the same data element name";
CM_ SG_ 375 ReSideRdrRiObj14RdrObjTypConfVeh "Refer to the data element description in ReSideRdrRiObj1 with the same data element name";
CM_ SG_ 375 ReSideRdrRiObj14RdrObjVx "Refer to the data element description in ReSideRdrRiObj1 with the same data element name";
CM_ SG_ 375 ReSideRdrRiObj14RdrObjVxStdDe "Refer to the data element description in ReSideRdrRiObj1 with the same data element name";
CM_ SG_ 375 ReSideRdrRiObj14RdrObjVy "Refer to the data element description in ReSideRdrRiObj1 with the same data element name";
CM_ SG_ 375 ReSideRdrRiObj14RdrObjVyStdDe "Refer to the data element description in ReSideRdrRiObj1 with the same data element name";
CM_ SG_ 375 ReSideRdrRiObj14RelVx "Refer to the data element description in ReSideRdrRiObj1 with the same data element name";
CM_ SG_ 375 ReSideRdrRiObj14RelVy "Refer to the data element description in ReSideRdrRiObj1 with the same data element name";
CM_ SG_ 377 ReSideRdrRiObj15Heading "Refer to the data element description in ReSideRdrRiObj1 with the same data element name";
CM_ SG_ 377 ReSideRdrRiObj15ObjBoxCenterLat "Refer to the data element description in ReSideRdrRiObj1 with the same data element name";
CM_ SG_ 377 ReSideRdrRiObj15ObjBoxCenterLgt "Refer to the data element description in ReSideRdrRiObj1 with the same data element name";
CM_ SG_ 377 ReSideRdrRiObj15ObservationHist "Refer to the data element description in ReSideRdrRiObj1 with the same data element name";
CM_ SG_ 377 ReSideRdrRiObj15RdrObjAx "Refer to the data element description in ReSideRdrRiObj1 with the same data element name";
CM_ SG_ 377 ReSideRdrRiObj15RdrObjAy "Refer to the data element description in ReSideRdrRiObj1 with the same data element name";
CM_ SG_ 377 ReSideRdrRiObj15RdrObjBoxLength "Refer to the data element description in ReSideRdrRiObj1 with the same data element name";
CM_ SG_ 377 ReSideRdrRiObj15RdrObjBoxWidth "Refer to the data element description in ReSideRdrRiObj1 with the same data element name";
CM_ SG_ 377 ReSideRdrRiObj15RdrObjChks "Refer to the data element description in ReSideRdrRiObj1 with the same data element name";
CM_ SG_ 377 ReSideRdrRiObj15RdrObjCntr "Refer to the data element description in ReSideRdrRiObj1 with the same data element name";
CM_ SG_ 377 ReSideRdrRiObj15RdrObjCoastCnt "Refer to the data element description in ReSideRdrRiObj1 with the same data element name";
CM_ SG_ 377 ReSideRdrRiObj15RdrObjConf "Refer to the data element description in ReSideRdrRiObj1 with the same data element name";
CM_ SG_ 377 ReSideRdrRiObj15RdrObjDx "Refer to the data element description in ReSideRdrRiObj1 with the same data element name";
CM_ SG_ 377 ReSideRdrRiObj15RdrObjDxStdDe "Refer to the data element description in ReSideRdrRiObj1 with the same data element name";
CM_ SG_ 377 ReSideRdrRiObj15RdrObjDy "Refer to the data element description in ReSideRdrRiObj1 with the same data element name";
CM_ SG_ 377 ReSideRdrRiObj15RdrObjDyStdDe "Refer to the data element description in ReSideRdrRiObj1 with the same data element name";
CM_ SG_ 377 ReSideRdrRiObj15RdrObjElevnConf "Refer to the data element description in ReSideRdrRiObj1 with the same data element name";
CM_ SG_ 377 ReSideRdrRiObj15RdrObjElevnSts "Refer to the data element description in ReSideRdrRiObj1 with the same data element name";
CM_ SG_ 377 ReSideRdrRiObj15RdrObjID "Refer to the data element description in ReSideRdrRiObj1 with the same data element name";
CM_ SG_ 377 ReSideRdrRiObj15RdrObjIsInFreeSpace "Refer to the data element description in ReSideRdrRiObj1 with the same data element name";
CM_ SG_ 377 ReSideRdrRiObj15RdrObjMirrProblty "Refer to the data element description in ReSideRdrRiObj1 with the same data element name";
CM_ SG_ 377 ReSideRdrRiObj15RdrObjMtnPat "Refer to the data element description in ReSideRdrRiObj1 with the same data element name";
CM_ SG_ 377 ReSideRdrRiObj15RdrObjNotRealProblty "Refer to the data element description in ReSideRdrRiObj1 with the same data element name";
CM_ SG_ 377 ReSideRdrRiObj15RdrObjStatyCnt "Refer to the data element description in ReSideRdrRiObj1 with the same data element name";
CM_ SG_ 377 ReSideRdrRiObj15RdrObjTiAlv "Refer to the data element description in ReSideRdrRiObj1 with the same data element name";
CM_ SG_ 377 ReSideRdrRiObj15RdrObjTrackSts "Refer to the data element description in ReSideRdrRiObj1 with the same data element name";
CM_ SG_ 377 ReSideRdrRiObj15RdrObjTyp "Refer to the data element description in ReSideRdrRiObj1 with the same data element name";
CM_ SG_ 377 ReSideRdrRiObj15RdrObjTypConfBike "Refer to the data element description in ReSideRdrRiObj1 with the same data element name";
CM_ SG_ 377 ReSideRdrRiObj15RdrObjTypConfPed "Refer to the data element description in ReSideRdrRiObj1 with the same data element name";
CM_ SG_ 377 ReSideRdrRiObj15RdrObjTypConfVeh "Refer to the data element description in ReSideRdrRiObj1 with the same data element name";
CM_ SG_ 377 ReSideRdrRiObj15RdrObjVx "Refer to the data element description in ReSideRdrRiObj1 with the same data element name";
CM_ SG_ 377 ReSideRdrRiObj15RdrObjVxStdDe "Refer to the data element description in ReSideRdrRiObj1 with the same data element name";
CM_ SG_ 377 ReSideRdrRiObj15RdrObjVy "Refer to the data element description in ReSideRdrRiObj1 with the same data element name";
CM_ SG_ 377 ReSideRdrRiObj15RdrObjVyStdDe "Refer to the data element description in ReSideRdrRiObj1 with the same data element name";
CM_ SG_ 377 ReSideRdrRiObj15RelVx "Refer to the data element description in ReSideRdrRiObj1 with the same data element name";
CM_ SG_ 377 ReSideRdrRiObj15RelVy "Refer to the data element description in ReSideRdrRiObj1 with the same data element name";
BA_DEF_ BO_ "VFrameFormat" ENUM "StandardCAN","ExtendedCAN","reserved","J1939PG","reserved","reserved","reserved","reserved","reserved","reserved","reserved","reserved","reserved","reserved","StandardCAN_FD","ExtendedCAN_FD";
BA_DEF_ BO_ "CANFD_BRS" ENUM "0","1";
BA_DEF_ BO_ "GenMsgSendType" ENUM "cyclic", "spontaneous", "not-used", "not-used", "not-used", "cyclicAndSpontaneous", "not-used", "cyclicIfActive", "NoMsgSendType"; // [us]
BA_DEF_ BO_ "GenMsgCycleTime" INT 0 65536; // [ms]
BA_DEF_ BO_ "GenMsgStartDelayTime" INT 0 65536; // [ms]
BA_DEF_ BO_ "GenMsgDelayTime" INT 0 65536; // [ms]
BA_DEF_ SG_ "GenSigSendType" ENUM "Cyclic","OnWrite","OnWriteWithRepetition","OnChange","OnChangeWithRepetition","IfActive","IfActiveWithRepetition","NoSigSendType";
BA_DEF_ SG_ "GenSigStartValue" HEX 0 80000000;
BA_DEF_ BO_ "GenMsgILSupport" ENUM "No","Yes";
BA_DEF_ BO_ "NmAsrMessage" ENUM "No","Yes";
BA_DEF_ SG_ "GenSigFuncType" ENUM "NoFunction","n/a","n/a","n/a","n/a","n/a","n/a","n/a","n/a","n/a","n/a","n/a","n/a","n/a","n/a","CHK","CNTR","n/a","n/a","n/a","CNTR_AR_01","CRC_AR_01_BOTH","CRC_AR_01_ALT","CRC_AR_01_LOW","CRC_AR_01_NIBBLE","CNTR_AR_04","CRC_AR_04A","CNTR_AR_05","CRC_AR_05";
BA_DEF_ SG_ "GenSigDataID" STRING;

BA_DEF_DEF_ "VFrameFormat" "J1939PG";
BA_DEF_DEF_ "CANFD_BRS" "1";
BA_DEF_DEF_ "GenSigStartValue" 0;
BA_DEF_DEF_ "GenSigSendType" "NoSigSendType";
BA_DEF_DEF_ "GenMsgCycleTime" 0;
BA_DEF_DEF_ "GenMsgDelayTime" 0;
BA_DEF_DEF_ "GenMsgStartDelayTime" 0;
BA_DEF_DEF_ "GenMsgSendType" "NoMsgSendType";
BA_DEF_DEF_ "GenMsgILSupport" "Yes";
BA_DEF_DEF_ "NmAsrMessage" "No";
BA_DEF_DEF_ "GenSigFuncType" "NoFunction";
BA_DEF_DEF_ "GenSigDataID" "";
// Frame: SODRSafetyCANFD3Frame26
BA_ "VFrameFormat" BO_ 355 14;
BA_ "GenMsgSendType" BO_ 355 0;
BA_ "GenMsgCycleTime" BO_ 355 50.000;
BA_ "GenSigStartValue" SG_ 355 ReSideRdrRiObj4Heading 1800;
BA_ "GenSigSendType" SG_ 355 ReSideRdrRiObj4Heading 0;
BA_ "GenSigStartValue" SG_ 355 ReSideRdrRiObj4ObjBoxCenterLat 250;
BA_ "GenSigSendType" SG_ 355 ReSideRdrRiObj4ObjBoxCenterLat 0;
BA_ "GenSigStartValue" SG_ 355 ReSideRdrRiObj4ObjBoxCenterLgt 250;
BA_ "GenSigSendType" SG_ 355 ReSideRdrRiObj4ObjBoxCenterLgt 0;
BA_ "GenSigSendType" SG_ 355 ReSideRdrRiObj4ObservationHist 0;
BA_ "GenSigSendType" SG_ 355 ReSideRdrRiObj4RdrObjAx 0;
BA_ "GenSigSendType" SG_ 355 ReSideRdrRiObj4RdrObjAy 0;
BA_ "GenSigSendType" SG_ 355 ReSideRdrRiObj4RdrObjBoxLength 0;
BA_ "GenSigSendType" SG_ 355 ReSideRdrRiObj4RdrObjBoxWidth 0;
BA_ "GenSigSendType" SG_ 355 ReSideRdrRiObj4RdrObjChks 0;
BA_ "GenSigFuncType" SG_ 355 ReSideRdrRiObj4RdrObjChks 15;
BA_ "GenSigDataID" SG_ 355 ReSideRdrRiObj4RdrObjChks "0xAC4";
BA_ "GenSigSendType" SG_ 355 ReSideRdrRiObj4RdrObjCntr 0;
BA_ "GenSigFuncType" SG_ 355 ReSideRdrRiObj4RdrObjCntr 16;
BA_ "GenSigStartValue" SG_ 355 ReSideRdrRiObj4RdrObjCoastCnt 31;
BA_ "GenSigSendType" SG_ 355 ReSideRdrRiObj4RdrObjCoastCnt 0;
BA_ "GenSigSendType" SG_ 355 ReSideRdrRiObj4RdrObjConf 0;
BA_ "GenSigSendType" SG_ 355 ReSideRdrRiObj4RdrObjDx 0;
BA_ "GenSigSendType" SG_ 355 ReSideRdrRiObj4RdrObjDxStdDe 0;
BA_ "GenSigStartValue" SG_ 355 ReSideRdrRiObj4RdrObjDy 4000;
BA_ "GenSigSendType" SG_ 355 ReSideRdrRiObj4RdrObjDy 0;
BA_ "GenSigSendType" SG_ 355 ReSideRdrRiObj4RdrObjDyStdDe 0;
BA_ "GenSigSendType" SG_ 355 ReSideRdrRiObj4RdrObjElevnConf 0;
BA_ "GenSigSendType" SG_ 355 ReSideRdrRiObj4RdrObjElevnSts 0;
BA_ "GenSigSendType" SG_ 355 ReSideRdrRiObj4RdrObjID 0;
BA_ "GenSigStartValue" SG_ 355 ReSideRdrRiObj4RdrObjIsInFreeSpace 1;
BA_ "GenSigSendType" SG_ 355 ReSideRdrRiObj4RdrObjIsInFreeSpace 0;
BA_ "GenSigSendType" SG_ 355 ReSideRdrRiObj4RdrObjMirrProblty 0;
BA_ "GenSigStartValue" SG_ 355 ReSideRdrRiObj4RdrObjMtnPat 3;
BA_ "GenSigSendType" SG_ 355 ReSideRdrRiObj4RdrObjMtnPat 0;
BA_ "GenSigSendType" SG_ 355 ReSideRdrRiObj4RdrObjNotRealProblty 0;
BA_ "GenSigSendType" SG_ 355 ReSideRdrRiObj4RdrObjStatyCnt 0;
BA_ "GenSigSendType" SG_ 355 ReSideRdrRiObj4RdrObjTiAlv 0;
BA_ "GenSigSendType" SG_ 355 ReSideRdrRiObj4RdrObjTrackSts 0;
BA_ "GenSigSendType" SG_ 355 ReSideRdrRiObj4RdrObjTyp 0;
BA_ "GenSigSendType" SG_ 355 ReSideRdrRiObj4RdrObjTypConfBike 0;
BA_ "GenSigSendType" SG_ 355 ReSideRdrRiObj4RdrObjTypConfPed 0;
BA_ "GenSigSendType" SG_ 355 ReSideRdrRiObj4RdrObjTypConfVeh 0;
BA_ "GenSigStartValue" SG_ 355 ReSideRdrRiObj4RdrObjVx 6400;
BA_ "GenSigSendType" SG_ 355 ReSideRdrRiObj4RdrObjVx 0;
BA_ "GenSigSendType" SG_ 355 ReSideRdrRiObj4RdrObjVxStdDe 0;
BA_ "GenSigStartValue" SG_ 355 ReSideRdrRiObj4RdrObjVy 6400;
BA_ "GenSigSendType" SG_ 355 ReSideRdrRiObj4RdrObjVy 0;
BA_ "GenSigSendType" SG_ 355 ReSideRdrRiObj4RdrObjVyStdDe 0;
BA_ "GenSigStartValue" SG_ 355 ReSideRdrRiObj4RelVx 1780;
BA_ "GenSigSendType" SG_ 355 ReSideRdrRiObj4RelVx 0;
BA_ "GenSigStartValue" SG_ 355 ReSideRdrRiObj4RelVy 1780;
BA_ "GenSigSendType" SG_ 355 ReSideRdrRiObj4RelVy 0;
// Frame: SODRSafetyCANFD3Frame27
BA_ "VFrameFormat" BO_ 357 14;
BA_ "GenMsgSendType" BO_ 357 0;
BA_ "GenMsgCycleTime" BO_ 357 50.000;
BA_ "GenSigStartValue" SG_ 357 ReSideRdrRiObj5Heading 1800;
BA_ "GenSigSendType" SG_ 357 ReSideRdrRiObj5Heading 0;
BA_ "GenSigStartValue" SG_ 357 ReSideRdrRiObj5ObjBoxCenterLat 250;
BA_ "GenSigSendType" SG_ 357 ReSideRdrRiObj5ObjBoxCenterLat 0;
BA_ "GenSigStartValue" SG_ 357 ReSideRdrRiObj5ObjBoxCenterLgt 250;
BA_ "GenSigSendType" SG_ 357 ReSideRdrRiObj5ObjBoxCenterLgt 0;
BA_ "GenSigSendType" SG_ 357 ReSideRdrRiObj5ObservationHist 0;
BA_ "GenSigSendType" SG_ 357 ReSideRdrRiObj5RdrObjAx 0;
BA_ "GenSigSendType" SG_ 357 ReSideRdrRiObj5RdrObjAy 0;
BA_ "GenSigSendType" SG_ 357 ReSideRdrRiObj5RdrObjBoxLength 0;
BA_ "GenSigSendType" SG_ 357 ReSideRdrRiObj5RdrObjBoxWidth 0;
BA_ "GenSigSendType" SG_ 357 ReSideRdrRiObj5RdrObjChks 0;
BA_ "GenSigFuncType" SG_ 357 ReSideRdrRiObj5RdrObjChks 15;
BA_ "GenSigDataID" SG_ 357 ReSideRdrRiObj5RdrObjChks "0xAC5";
BA_ "GenSigSendType" SG_ 357 ReSideRdrRiObj5RdrObjCntr 0;
BA_ "GenSigFuncType" SG_ 357 ReSideRdrRiObj5RdrObjCntr 16;
BA_ "GenSigStartValue" SG_ 357 ReSideRdrRiObj5RdrObjCoastCnt 31;
BA_ "GenSigSendType" SG_ 357 ReSideRdrRiObj5RdrObjCoastCnt 0;
BA_ "GenSigSendType" SG_ 357 ReSideRdrRiObj5RdrObjConf 0;
BA_ "GenSigSendType" SG_ 357 ReSideRdrRiObj5RdrObjDx 0;
BA_ "GenSigSendType" SG_ 357 ReSideRdrRiObj5RdrObjDxStdDe 0;
BA_ "GenSigStartValue" SG_ 357 ReSideRdrRiObj5RdrObjDy 4000;
BA_ "GenSigSendType" SG_ 357 ReSideRdrRiObj5RdrObjDy 0;
BA_ "GenSigSendType" SG_ 357 ReSideRdrRiObj5RdrObjDyStdDe 0;
BA_ "GenSigSendType" SG_ 357 ReSideRdrRiObj5RdrObjElevnConf 0;
BA_ "GenSigSendType" SG_ 357 ReSideRdrRiObj5RdrObjElevnSts 0;
BA_ "GenSigSendType" SG_ 357 ReSideRdrRiObj5RdrObjID 0;
BA_ "GenSigStartValue" SG_ 357 ReSideRdrRiObj5RdrObjIsInFreeSpace 1;
BA_ "GenSigSendType" SG_ 357 ReSideRdrRiObj5RdrObjIsInFreeSpace 0;
BA_ "GenSigSendType" SG_ 357 ReSideRdrRiObj5RdrObjMirrProblty 0;
BA_ "GenSigStartValue" SG_ 357 ReSideRdrRiObj5RdrObjMtnPat 3;
BA_ "GenSigSendType" SG_ 357 ReSideRdrRiObj5RdrObjMtnPat 0;
BA_ "GenSigSendType" SG_ 357 ReSideRdrRiObj5RdrObjNotRealProblty 0;
BA_ "GenSigSendType" SG_ 357 ReSideRdrRiObj5RdrObjStatyCnt 0;
BA_ "GenSigSendType" SG_ 357 ReSideRdrRiObj5RdrObjTiAlv 0;
BA_ "GenSigSendType" SG_ 357 ReSideRdrRiObj5RdrObjTrackSts 0;
BA_ "GenSigSendType" SG_ 357 ReSideRdrRiObj5RdrObjTyp 0;
BA_ "GenSigSendType" SG_ 357 ReSideRdrRiObj5RdrObjTypConfBike 0;
BA_ "GenSigSendType" SG_ 357 ReSideRdrRiObj5RdrObjTypConfPed 0;
BA_ "GenSigSendType" SG_ 357 ReSideRdrRiObj5RdrObjTypConfVeh 0;
BA_ "GenSigStartValue" SG_ 357 ReSideRdrRiObj5RdrObjVx 6400;
BA_ "GenSigSendType" SG_ 357 ReSideRdrRiObj5RdrObjVx 0;
BA_ "GenSigSendType" SG_ 357 ReSideRdrRiObj5RdrObjVxStdDe 0;
BA_ "GenSigStartValue" SG_ 357 ReSideRdrRiObj5RdrObjVy 6400;
BA_ "GenSigSendType" SG_ 357 ReSideRdrRiObj5RdrObjVy 0;
BA_ "GenSigSendType" SG_ 357 ReSideRdrRiObj5RdrObjVyStdDe 0;
BA_ "GenSigStartValue" SG_ 357 ReSideRdrRiObj5RelVx 1780;
BA_ "GenSigSendType" SG_ 357 ReSideRdrRiObj5RelVx 0;
BA_ "GenSigStartValue" SG_ 357 ReSideRdrRiObj5RelVy 1780;
BA_ "GenSigSendType" SG_ 357 ReSideRdrRiObj5RelVy 0;
// Frame: SODRSafetyCANFD3Frame28
BA_ "VFrameFormat" BO_ 359 14;
BA_ "GenMsgSendType" BO_ 359 0;
BA_ "GenMsgCycleTime" BO_ 359 50.000;
BA_ "GenSigStartValue" SG_ 359 ReSideRdrRiObj6Heading 1800;
BA_ "GenSigSendType" SG_ 359 ReSideRdrRiObj6Heading 0;
BA_ "GenSigStartValue" SG_ 359 ReSideRdrRiObj6ObjBoxCenterLat 250;
BA_ "GenSigSendType" SG_ 359 ReSideRdrRiObj6ObjBoxCenterLat 0;
BA_ "GenSigStartValue" SG_ 359 ReSideRdrRiObj6ObjBoxCenterLgt 250;
BA_ "GenSigSendType" SG_ 359 ReSideRdrRiObj6ObjBoxCenterLgt 0;
BA_ "GenSigSendType" SG_ 359 ReSideRdrRiObj6ObservationHist 0;
BA_ "GenSigSendType" SG_ 359 ReSideRdrRiObj6RdrObjAx 0;
BA_ "GenSigSendType" SG_ 359 ReSideRdrRiObj6RdrObjAy 0;
BA_ "GenSigSendType" SG_ 359 ReSideRdrRiObj6RdrObjBoxLength 0;
BA_ "GenSigSendType" SG_ 359 ReSideRdrRiObj6RdrObjBoxWidth 0;
BA_ "GenSigSendType" SG_ 359 ReSideRdrRiObj6RdrObjChks 0;
BA_ "GenSigFuncType" SG_ 359 ReSideRdrRiObj6RdrObjChks 15;
BA_ "GenSigDataID" SG_ 359 ReSideRdrRiObj6RdrObjChks "0xAC6";
BA_ "GenSigSendType" SG_ 359 ReSideRdrRiObj6RdrObjCntr 0;
BA_ "GenSigFuncType" SG_ 359 ReSideRdrRiObj6RdrObjCntr 16;
BA_ "GenSigStartValue" SG_ 359 ReSideRdrRiObj6RdrObjCoastCnt 31;
BA_ "GenSigSendType" SG_ 359 ReSideRdrRiObj6RdrObjCoastCnt 0;
BA_ "GenSigSendType" SG_ 359 ReSideRdrRiObj6RdrObjConf 0;
BA_ "GenSigSendType" SG_ 359 ReSideRdrRiObj6RdrObjDx 0;
BA_ "GenSigSendType" SG_ 359 ReSideRdrRiObj6RdrObjDxStdDe 0;
BA_ "GenSigStartValue" SG_ 359 ReSideRdrRiObj6RdrObjDy 4000;
BA_ "GenSigSendType" SG_ 359 ReSideRdrRiObj6RdrObjDy 0;
BA_ "GenSigSendType" SG_ 359 ReSideRdrRiObj6RdrObjDyStdDe 0;
BA_ "GenSigSendType" SG_ 359 ReSideRdrRiObj6RdrObjElevnConf 0;
BA_ "GenSigSendType" SG_ 359 ReSideRdrRiObj6RdrObjElevnSts 0;
BA_ "GenSigSendType" SG_ 359 ReSideRdrRiObj6RdrObjID 0;
BA_ "GenSigStartValue" SG_ 359 ReSideRdrRiObj6RdrObjIsInFreeSpace 1;
BA_ "GenSigSendType" SG_ 359 ReSideRdrRiObj6RdrObjIsInFreeSpace 0;
BA_ "GenSigSendType" SG_ 359 ReSideRdrRiObj6RdrObjMirrProblty 0;
BA_ "GenSigStartValue" SG_ 359 ReSideRdrRiObj6RdrObjMtnPat 3;
BA_ "GenSigSendType" SG_ 359 ReSideRdrRiObj6RdrObjMtnPat 0;
BA_ "GenSigSendType" SG_ 359 ReSideRdrRiObj6RdrObjNotRealProblty 0;
BA_ "GenSigSendType" SG_ 359 ReSideRdrRiObj6RdrObjStatyCnt 0;
BA_ "GenSigSendType" SG_ 359 ReSideRdrRiObj6RdrObjTiAlv 0;
BA_ "GenSigSendType" SG_ 359 ReSideRdrRiObj6RdrObjTrackSts 0;
BA_ "GenSigSendType" SG_ 359 ReSideRdrRiObj6RdrObjTyp 0;
BA_ "GenSigSendType" SG_ 359 ReSideRdrRiObj6RdrObjTypConfBike 0;
BA_ "GenSigSendType" SG_ 359 ReSideRdrRiObj6RdrObjTypConfPed 0;
BA_ "GenSigSendType" SG_ 359 ReSideRdrRiObj6RdrObjTypConfVeh 0;
BA_ "GenSigStartValue" SG_ 359 ReSideRdrRiObj6RdrObjVx 6400;
BA_ "GenSigSendType" SG_ 359 ReSideRdrRiObj6RdrObjVx 0;
BA_ "GenSigSendType" SG_ 359 ReSideRdrRiObj6RdrObjVxStdDe 0;
BA_ "GenSigStartValue" SG_ 359 ReSideRdrRiObj6RdrObjVy 6400;
BA_ "GenSigSendType" SG_ 359 ReSideRdrRiObj6RdrObjVy 0;
BA_ "GenSigSendType" SG_ 359 ReSideRdrRiObj6RdrObjVyStdDe 0;
BA_ "GenSigStartValue" SG_ 359 ReSideRdrRiObj6RelVx 1780;
BA_ "GenSigSendType" SG_ 359 ReSideRdrRiObj6RelVx 0;
BA_ "GenSigStartValue" SG_ 359 ReSideRdrRiObj6RelVy 1780;
BA_ "GenSigSendType" SG_ 359 ReSideRdrRiObj6RelVy 0;
// Frame: SODRSafetyCANFD3Frame29
BA_ "VFrameFormat" BO_ 361 14;
BA_ "GenMsgSendType" BO_ 361 0;
BA_ "GenMsgCycleTime" BO_ 361 50.000;
BA_ "GenSigStartValue" SG_ 361 ReSideRdrRiObj7Heading 1800;
BA_ "GenSigSendType" SG_ 361 ReSideRdrRiObj7Heading 0;
BA_ "GenSigStartValue" SG_ 361 ReSideRdrRiObj7ObjBoxCenterLat 250;
BA_ "GenSigSendType" SG_ 361 ReSideRdrRiObj7ObjBoxCenterLat 0;
BA_ "GenSigStartValue" SG_ 361 ReSideRdrRiObj7ObjBoxCenterLgt 250;
BA_ "GenSigSendType" SG_ 361 ReSideRdrRiObj7ObjBoxCenterLgt 0;
BA_ "GenSigSendType" SG_ 361 ReSideRdrRiObj7ObservationHist 0;
BA_ "GenSigSendType" SG_ 361 ReSideRdrRiObj7RdrObjAx 0;
BA_ "GenSigSendType" SG_ 361 ReSideRdrRiObj7RdrObjAy 0;
BA_ "GenSigSendType" SG_ 361 ReSideRdrRiObj7RdrObjBoxLength 0;
BA_ "GenSigSendType" SG_ 361 ReSideRdrRiObj7RdrObjBoxWidth 0;
BA_ "GenSigSendType" SG_ 361 ReSideRdrRiObj7RdrObjChks 0;
BA_ "GenSigFuncType" SG_ 361 ReSideRdrRiObj7RdrObjChks 15;
BA_ "GenSigDataID" SG_ 361 ReSideRdrRiObj7RdrObjChks "0xAC7";
BA_ "GenSigSendType" SG_ 361 ReSideRdrRiObj7RdrObjCntr 0;
BA_ "GenSigFuncType" SG_ 361 ReSideRdrRiObj7RdrObjCntr 16;
BA_ "GenSigStartValue" SG_ 361 ReSideRdrRiObj7RdrObjCoastCnt 31;
BA_ "GenSigSendType" SG_ 361 ReSideRdrRiObj7RdrObjCoastCnt 0;
BA_ "GenSigSendType" SG_ 361 ReSideRdrRiObj7RdrObjConf 0;
BA_ "GenSigSendType" SG_ 361 ReSideRdrRiObj7RdrObjDx 0;
BA_ "GenSigSendType" SG_ 361 ReSideRdrRiObj7RdrObjDxStdDe 0;
BA_ "GenSigStartValue" SG_ 361 ReSideRdrRiObj7RdrObjDy 4000;
BA_ "GenSigSendType" SG_ 361 ReSideRdrRiObj7RdrObjDy 0;
BA_ "GenSigSendType" SG_ 361 ReSideRdrRiObj7RdrObjDyStdDe 0;
BA_ "GenSigSendType" SG_ 361 ReSideRdrRiObj7RdrObjElevnConf 0;
BA_ "GenSigSendType" SG_ 361 ReSideRdrRiObj7RdrObjElevnSts 0;
BA_ "GenSigSendType" SG_ 361 ReSideRdrRiObj7RdrObjID 0;
BA_ "GenSigStartValue" SG_ 361 ReSideRdrRiObj7RdrObjIsInFreeSpace 1;
BA_ "GenSigSendType" SG_ 361 ReSideRdrRiObj7RdrObjIsInFreeSpace 0;
BA_ "GenSigSendType" SG_ 361 ReSideRdrRiObj7RdrObjMirrProblty 0;
BA_ "GenSigStartValue" SG_ 361 ReSideRdrRiObj7RdrObjMtnPat 3;
BA_ "GenSigSendType" SG_ 361 ReSideRdrRiObj7RdrObjMtnPat 0;
BA_ "GenSigSendType" SG_ 361 ReSideRdrRiObj7RdrObjNotRealProblty 0;
BA_ "GenSigSendType" SG_ 361 ReSideRdrRiObj7RdrObjStatyCnt 0;
BA_ "GenSigSendType" SG_ 361 ReSideRdrRiObj7RdrObjTiAlv 0;
BA_ "GenSigSendType" SG_ 361 ReSideRdrRiObj7RdrObjTrackSts 0;
BA_ "GenSigSendType" SG_ 361 ReSideRdrRiObj7RdrObjTyp 0;
BA_ "GenSigSendType" SG_ 361 ReSideRdrRiObj7RdrObjTypConfBike 0;
BA_ "GenSigSendType" SG_ 361 ReSideRdrRiObj7RdrObjTypConfPed 0;
BA_ "GenSigSendType" SG_ 361 ReSideRdrRiObj7RdrObjTypConfVeh 0;
BA_ "GenSigStartValue" SG_ 361 ReSideRdrRiObj7RdrObjVx 6400;
BA_ "GenSigSendType" SG_ 361 ReSideRdrRiObj7RdrObjVx 0;
BA_ "GenSigSendType" SG_ 361 ReSideRdrRiObj7RdrObjVxStdDe 0;
BA_ "GenSigStartValue" SG_ 361 ReSideRdrRiObj7RdrObjVy 6400;
BA_ "GenSigSendType" SG_ 361 ReSideRdrRiObj7RdrObjVy 0;
BA_ "GenSigSendType" SG_ 361 ReSideRdrRiObj7RdrObjVyStdDe 0;
BA_ "GenSigStartValue" SG_ 361 ReSideRdrRiObj7RelVx 1780;
BA_ "GenSigSendType" SG_ 361 ReSideRdrRiObj7RelVx 0;
BA_ "GenSigStartValue" SG_ 361 ReSideRdrRiObj7RelVy 1780;
BA_ "GenSigSendType" SG_ 361 ReSideRdrRiObj7RelVy 0;
// Frame: SODRSafetyCANFD3Frame30
BA_ "VFrameFormat" BO_ 363 14;
BA_ "GenMsgSendType" BO_ 363 0;
BA_ "GenMsgCycleTime" BO_ 363 50.000;
BA_ "GenSigStartValue" SG_ 363 ReSideRdrRiObj8Heading 1800;
BA_ "GenSigSendType" SG_ 363 ReSideRdrRiObj8Heading 0;
BA_ "GenSigStartValue" SG_ 363 ReSideRdrRiObj8ObjBoxCenterLat 250;
BA_ "GenSigSendType" SG_ 363 ReSideRdrRiObj8ObjBoxCenterLat 0;
BA_ "GenSigStartValue" SG_ 363 ReSideRdrRiObj8ObjBoxCenterLgt 250;
BA_ "GenSigSendType" SG_ 363 ReSideRdrRiObj8ObjBoxCenterLgt 0;
BA_ "GenSigSendType" SG_ 363 ReSideRdrRiObj8ObservationHist 0;
BA_ "GenSigSendType" SG_ 363 ReSideRdrRiObj8RdrObjAx 0;
BA_ "GenSigSendType" SG_ 363 ReSideRdrRiObj8RdrObjAy 0;
BA_ "GenSigSendType" SG_ 363 ReSideRdrRiObj8RdrObjBoxLength 0;
BA_ "GenSigSendType" SG_ 363 ReSideRdrRiObj8RdrObjBoxWidth 0;
BA_ "GenSigSendType" SG_ 363 ReSideRdrRiObj8RdrObjChks 0;
BA_ "GenSigFuncType" SG_ 363 ReSideRdrRiObj8RdrObjChks 15;
BA_ "GenSigDataID" SG_ 363 ReSideRdrRiObj8RdrObjChks "0xAC8";
BA_ "GenSigSendType" SG_ 363 ReSideRdrRiObj8RdrObjCntr 0;
BA_ "GenSigFuncType" SG_ 363 ReSideRdrRiObj8RdrObjCntr 16;
BA_ "GenSigStartValue" SG_ 363 ReSideRdrRiObj8RdrObjCoastCnt 31;
BA_ "GenSigSendType" SG_ 363 ReSideRdrRiObj8RdrObjCoastCnt 0;
BA_ "GenSigSendType" SG_ 363 ReSideRdrRiObj8RdrObjConf 0;
BA_ "GenSigSendType" SG_ 363 ReSideRdrRiObj8RdrObjDx 0;
BA_ "GenSigSendType" SG_ 363 ReSideRdrRiObj8RdrObjDxStdDe 0;
BA_ "GenSigStartValue" SG_ 363 ReSideRdrRiObj8RdrObjDy 4000;
BA_ "GenSigSendType" SG_ 363 ReSideRdrRiObj8RdrObjDy 0;
BA_ "GenSigSendType" SG_ 363 ReSideRdrRiObj8RdrObjDyStdDe 0;
BA_ "GenSigSendType" SG_ 363 ReSideRdrRiObj8RdrObjElevnConf 0;
BA_ "GenSigSendType" SG_ 363 ReSideRdrRiObj8RdrObjElevnSts 0;
BA_ "GenSigSendType" SG_ 363 ReSideRdrRiObj8RdrObjID 0;
BA_ "GenSigStartValue" SG_ 363 ReSideRdrRiObj8RdrObjIsInFreeSpace 1;
BA_ "GenSigSendType" SG_ 363 ReSideRdrRiObj8RdrObjIsInFreeSpace 0;
BA_ "GenSigSendType" SG_ 363 ReSideRdrRiObj8RdrObjMirrProblty 0;
BA_ "GenSigStartValue" SG_ 363 ReSideRdrRiObj8RdrObjMtnPat 3;
BA_ "GenSigSendType" SG_ 363 ReSideRdrRiObj8RdrObjMtnPat 0;
BA_ "GenSigSendType" SG_ 363 ReSideRdrRiObj8RdrObjNotRealProblty 0;
BA_ "GenSigSendType" SG_ 363 ReSideRdrRiObj8RdrObjStatyCnt 0;
BA_ "GenSigSendType" SG_ 363 ReSideRdrRiObj8RdrObjTiAlv 0;
BA_ "GenSigSendType" SG_ 363 ReSideRdrRiObj8RdrObjTrackSts 0;
BA_ "GenSigSendType" SG_ 363 ReSideRdrRiObj8RdrObjTyp 0;
BA_ "GenSigSendType" SG_ 363 ReSideRdrRiObj8RdrObjTypConfBike 0;
BA_ "GenSigSendType" SG_ 363 ReSideRdrRiObj8RdrObjTypConfPed 0;
BA_ "GenSigSendType" SG_ 363 ReSideRdrRiObj8RdrObjTypConfVeh 0;
BA_ "GenSigStartValue" SG_ 363 ReSideRdrRiObj8RdrObjVx 6400;
BA_ "GenSigSendType" SG_ 363 ReSideRdrRiObj8RdrObjVx 0;
BA_ "GenSigSendType" SG_ 363 ReSideRdrRiObj8RdrObjVxStdDe 0;
BA_ "GenSigStartValue" SG_ 363 ReSideRdrRiObj8RdrObjVy 6400;
BA_ "GenSigSendType" SG_ 363 ReSideRdrRiObj8RdrObjVy 0;
BA_ "GenSigSendType" SG_ 363 ReSideRdrRiObj8RdrObjVyStdDe 0;
BA_ "GenSigStartValue" SG_ 363 ReSideRdrRiObj8RelVx 1780;
BA_ "GenSigSendType" SG_ 363 ReSideRdrRiObj8RelVx 0;
BA_ "GenSigStartValue" SG_ 363 ReSideRdrRiObj8RelVy 1780;
BA_ "GenSigSendType" SG_ 363 ReSideRdrRiObj8RelVy 0;
// Frame: SODRSafetyCANFD3Frame31
BA_ "VFrameFormat" BO_ 365 14;
BA_ "GenMsgSendType" BO_ 365 0;
BA_ "GenMsgCycleTime" BO_ 365 50.000;
BA_ "GenSigStartValue" SG_ 365 ReSideRdrRiObj9Heading 1800;
BA_ "GenSigSendType" SG_ 365 ReSideRdrRiObj9Heading 0;
BA_ "GenSigStartValue" SG_ 365 ReSideRdrRiObj9ObjBoxCenterLat 250;
BA_ "GenSigSendType" SG_ 365 ReSideRdrRiObj9ObjBoxCenterLat 0;
BA_ "GenSigStartValue" SG_ 365 ReSideRdrRiObj9ObjBoxCenterLgt 250;
BA_ "GenSigSendType" SG_ 365 ReSideRdrRiObj9ObjBoxCenterLgt 0;
BA_ "GenSigSendType" SG_ 365 ReSideRdrRiObj9ObservationHist 0;
BA_ "GenSigSendType" SG_ 365 ReSideRdrRiObj9RdrObjAx 0;
BA_ "GenSigSendType" SG_ 365 ReSideRdrRiObj9RdrObjAy 0;
BA_ "GenSigSendType" SG_ 365 ReSideRdrRiObj9RdrObjBoxLength 0;
BA_ "GenSigSendType" SG_ 365 ReSideRdrRiObj9RdrObjBoxWidth 0;
BA_ "GenSigSendType" SG_ 365 ReSideRdrRiObj9RdrObjChks 0;
BA_ "GenSigFuncType" SG_ 365 ReSideRdrRiObj9RdrObjChks 15;
BA_ "GenSigDataID" SG_ 365 ReSideRdrRiObj9RdrObjChks "0xAC9";
BA_ "GenSigSendType" SG_ 365 ReSideRdrRiObj9RdrObjCntr 0;
BA_ "GenSigFuncType" SG_ 365 ReSideRdrRiObj9RdrObjCntr 16;
BA_ "GenSigStartValue" SG_ 365 ReSideRdrRiObj9RdrObjCoastCnt 31;
BA_ "GenSigSendType" SG_ 365 ReSideRdrRiObj9RdrObjCoastCnt 0;
BA_ "GenSigSendType" SG_ 365 ReSideRdrRiObj9RdrObjConf 0;
BA_ "GenSigSendType" SG_ 365 ReSideRdrRiObj9RdrObjDx 0;
BA_ "GenSigSendType" SG_ 365 ReSideRdrRiObj9RdrObjDxStdDe 0;
BA_ "GenSigStartValue" SG_ 365 ReSideRdrRiObj9RdrObjDy 4000;
BA_ "GenSigSendType" SG_ 365 ReSideRdrRiObj9RdrObjDy 0;
BA_ "GenSigSendType" SG_ 365 ReSideRdrRiObj9RdrObjDyStdDe 0;
BA_ "GenSigSendType" SG_ 365 ReSideRdrRiObj9RdrObjElevnConf 0;
BA_ "GenSigSendType" SG_ 365 ReSideRdrRiObj9RdrObjElevnSts 0;
BA_ "GenSigSendType" SG_ 365 ReSideRdrRiObj9RdrObjID 0;
BA_ "GenSigStartValue" SG_ 365 ReSideRdrRiObj9RdrObjIsInFreeSpace 1;
BA_ "GenSigSendType" SG_ 365 ReSideRdrRiObj9RdrObjIsInFreeSpace 0;
BA_ "GenSigSendType" SG_ 365 ReSideRdrRiObj9RdrObjMirrProblty 0;
BA_ "GenSigStartValue" SG_ 365 ReSideRdrRiObj9RdrObjMtnPat 3;
BA_ "GenSigSendType" SG_ 365 ReSideRdrRiObj9RdrObjMtnPat 0;
BA_ "GenSigSendType" SG_ 365 ReSideRdrRiObj9RdrObjNotRealProblty 0;
BA_ "GenSigSendType" SG_ 365 ReSideRdrRiObj9RdrObjStatyCnt 0;
BA_ "GenSigSendType" SG_ 365 ReSideRdrRiObj9RdrObjTiAlv 0;
BA_ "GenSigSendType" SG_ 365 ReSideRdrRiObj9RdrObjTrackSts 0;
BA_ "GenSigSendType" SG_ 365 ReSideRdrRiObj9RdrObjTyp 0;
BA_ "GenSigSendType" SG_ 365 ReSideRdrRiObj9RdrObjTypConfBike 0;
BA_ "GenSigSendType" SG_ 365 ReSideRdrRiObj9RdrObjTypConfPed 0;
BA_ "GenSigSendType" SG_ 365 ReSideRdrRiObj9RdrObjTypConfVeh 0;
BA_ "GenSigStartValue" SG_ 365 ReSideRdrRiObj9RdrObjVx 6400;
BA_ "GenSigSendType" SG_ 365 ReSideRdrRiObj9RdrObjVx 0;
BA_ "GenSigSendType" SG_ 365 ReSideRdrRiObj9RdrObjVxStdDe 0;
BA_ "GenSigStartValue" SG_ 365 ReSideRdrRiObj9RdrObjVy 6400;
BA_ "GenSigSendType" SG_ 365 ReSideRdrRiObj9RdrObjVy 0;
BA_ "GenSigSendType" SG_ 365 ReSideRdrRiObj9RdrObjVyStdDe 0;
BA_ "GenSigStartValue" SG_ 365 ReSideRdrRiObj9RelVx 1780;
BA_ "GenSigSendType" SG_ 365 ReSideRdrRiObj9RelVx 0;
BA_ "GenSigStartValue" SG_ 365 ReSideRdrRiObj9RelVy 1780;
BA_ "GenSigSendType" SG_ 365 ReSideRdrRiObj9RelVy 0;
// Frame: SODRSafetyCANFD3Frame32
BA_ "VFrameFormat" BO_ 367 14;
BA_ "GenMsgSendType" BO_ 367 0;
BA_ "GenMsgCycleTime" BO_ 367 50.000;
BA_ "GenSigStartValue" SG_ 367 ReSideRdrRiObj10Heading 1800;
BA_ "GenSigSendType" SG_ 367 ReSideRdrRiObj10Heading 0;
BA_ "GenSigStartValue" SG_ 367 ReSideRdrRiObj10ObjBoxCenterLat 250;
BA_ "GenSigSendType" SG_ 367 ReSideRdrRiObj10ObjBoxCenterLat 0;
BA_ "GenSigStartValue" SG_ 367 ReSideRdrRiObj10ObjBoxCenterLgt 250;
BA_ "GenSigSendType" SG_ 367 ReSideRdrRiObj10ObjBoxCenterLgt 0;
BA_ "GenSigSendType" SG_ 367 ReSideRdrRiObj10ObservationHist 0;
BA_ "GenSigSendType" SG_ 367 ReSideRdrRiObj10RdrObjAx 0;
BA_ "GenSigSendType" SG_ 367 ReSideRdrRiObj10RdrObjAy 0;
BA_ "GenSigSendType" SG_ 367 ReSideRdrRiObj10RdrObjBoxLength 0;
BA_ "GenSigSendType" SG_ 367 ReSideRdrRiObj10RdrObjBoxWidth 0;
BA_ "GenSigSendType" SG_ 367 ReSideRdrRiObj10RdrObjChks 0;
BA_ "GenSigFuncType" SG_ 367 ReSideRdrRiObj10RdrObjChks 15;
BA_ "GenSigDataID" SG_ 367 ReSideRdrRiObj10RdrObjChks "0xACA";
BA_ "GenSigSendType" SG_ 367 ReSideRdrRiObj10RdrObjCntr 0;
BA_ "GenSigFuncType" SG_ 367 ReSideRdrRiObj10RdrObjCntr 16;
BA_ "GenSigStartValue" SG_ 367 ReSideRdrRiObj10RdrObjCoastCnt 31;
BA_ "GenSigSendType" SG_ 367 ReSideRdrRiObj10RdrObjCoastCnt 0;
BA_ "GenSigSendType" SG_ 367 ReSideRdrRiObj10RdrObjConf 0;
BA_ "GenSigSendType" SG_ 367 ReSideRdrRiObj10RdrObjDx 0;
BA_ "GenSigSendType" SG_ 367 ReSideRdrRiObj10RdrObjDxStdDe 0;
BA_ "GenSigStartValue" SG_ 367 ReSideRdrRiObj10RdrObjDy 4000;
BA_ "GenSigSendType" SG_ 367 ReSideRdrRiObj10RdrObjDy 0;
BA_ "GenSigSendType" SG_ 367 ReSideRdrRiObj10RdrObjDyStdDe 0;
BA_ "GenSigSendType" SG_ 367 ReSideRdrRiObj10RdrObjElevnConf 0;
BA_ "GenSigSendType" SG_ 367 ReSideRdrRiObj10RdrObjElevnSts 0;
BA_ "GenSigSendType" SG_ 367 ReSideRdrRiObj10RdrObjID 0;
BA_ "GenSigStartValue" SG_ 367 ReSideRdrRiObj10RdrObjIsInFreeSpace 1;
BA_ "GenSigSendType" SG_ 367 ReSideRdrRiObj10RdrObjIsInFreeSpace 0;
BA_ "GenSigSendType" SG_ 367 ReSideRdrRiObj10RdrObjMirrProblty 0;
BA_ "GenSigStartValue" SG_ 367 ReSideRdrRiObj10RdrObjMtnPat 3;
BA_ "GenSigSendType" SG_ 367 ReSideRdrRiObj10RdrObjMtnPat 0;
BA_ "GenSigSendType" SG_ 367 ReSideRdrRiObj10RdrObjNotRealProblty 0;
BA_ "GenSigSendType" SG_ 367 ReSideRdrRiObj10RdrObjStatyCnt 0;
BA_ "GenSigSendType" SG_ 367 ReSideRdrRiObj10RdrObjTiAlv 0;
BA_ "GenSigSendType" SG_ 367 ReSideRdrRiObj10RdrObjTrackSts 0;
BA_ "GenSigSendType" SG_ 367 ReSideRdrRiObj10RdrObjTyp 0;
BA_ "GenSigSendType" SG_ 367 ReSideRdrRiObj10RdrObjTypConfBike 0;
BA_ "GenSigSendType" SG_ 367 ReSideRdrRiObj10RdrObjTypConfPed 0;
BA_ "GenSigSendType" SG_ 367 ReSideRdrRiObj10RdrObjTypConfVeh 0;
BA_ "GenSigStartValue" SG_ 367 ReSideRdrRiObj10RdrObjVx 6400;
BA_ "GenSigSendType" SG_ 367 ReSideRdrRiObj10RdrObjVx 0;
BA_ "GenSigSendType" SG_ 367 ReSideRdrRiObj10RdrObjVxStdDe 0;
BA_ "GenSigStartValue" SG_ 367 ReSideRdrRiObj10RdrObjVy 6400;
BA_ "GenSigSendType" SG_ 367 ReSideRdrRiObj10RdrObjVy 0;
BA_ "GenSigSendType" SG_ 367 ReSideRdrRiObj10RdrObjVyStdDe 0;
BA_ "GenSigStartValue" SG_ 367 ReSideRdrRiObj10RelVx 1780;
BA_ "GenSigSendType" SG_ 367 ReSideRdrRiObj10RelVx 0;
BA_ "GenSigStartValue" SG_ 367 ReSideRdrRiObj10RelVy 1780;
BA_ "GenSigSendType" SG_ 367 ReSideRdrRiObj10RelVy 0;
// Frame: SODRSafetyCANFD3Frame33
BA_ "VFrameFormat" BO_ 369 14;
BA_ "GenMsgSendType" BO_ 369 0;
BA_ "GenMsgCycleTime" BO_ 369 50.000;
BA_ "GenSigStartValue" SG_ 369 ReSideRdrRiObj11Heading 1800;
BA_ "GenSigSendType" SG_ 369 ReSideRdrRiObj11Heading 0;
BA_ "GenSigStartValue" SG_ 369 ReSideRdrRiObj11ObjBoxCenterLat 250;
BA_ "GenSigSendType" SG_ 369 ReSideRdrRiObj11ObjBoxCenterLat 0;
BA_ "GenSigStartValue" SG_ 369 ReSideRdrRiObj11ObjBoxCenterLgt 250;
BA_ "GenSigSendType" SG_ 369 ReSideRdrRiObj11ObjBoxCenterLgt 0;
BA_ "GenSigSendType" SG_ 369 ReSideRdrRiObj11ObservationHist 0;
BA_ "GenSigSendType" SG_ 369 ReSideRdrRiObj11RdrObjAx 0;
BA_ "GenSigSendType" SG_ 369 ReSideRdrRiObj11RdrObjAy 0;
BA_ "GenSigSendType" SG_ 369 ReSideRdrRiObj11RdrObjBoxLength 0;
BA_ "GenSigSendType" SG_ 369 ReSideRdrRiObj11RdrObjBoxWidth 0;
BA_ "GenSigSendType" SG_ 369 ReSideRdrRiObj11RdrObjChks 0;
BA_ "GenSigFuncType" SG_ 369 ReSideRdrRiObj11RdrObjChks 15;
BA_ "GenSigDataID" SG_ 369 ReSideRdrRiObj11RdrObjChks "0xACB";
BA_ "GenSigSendType" SG_ 369 ReSideRdrRiObj11RdrObjCntr 0;
BA_ "GenSigFuncType" SG_ 369 ReSideRdrRiObj11RdrObjCntr 16;
BA_ "GenSigStartValue" SG_ 369 ReSideRdrRiObj11RdrObjCoastCnt 31;
BA_ "GenSigSendType" SG_ 369 ReSideRdrRiObj11RdrObjCoastCnt 0;
BA_ "GenSigSendType" SG_ 369 ReSideRdrRiObj11RdrObjConf 0;
BA_ "GenSigSendType" SG_ 369 ReSideRdrRiObj11RdrObjDx 0;
BA_ "GenSigSendType" SG_ 369 ReSideRdrRiObj11RdrObjDxStdDe 0;
BA_ "GenSigStartValue" SG_ 369 ReSideRdrRiObj11RdrObjDy 4000;
BA_ "GenSigSendType" SG_ 369 ReSideRdrRiObj11RdrObjDy 0;
BA_ "GenSigSendType" SG_ 369 ReSideRdrRiObj11RdrObjDyStdDe 0;
BA_ "GenSigSendType" SG_ 369 ReSideRdrRiObj11RdrObjElevnConf 0;
BA_ "GenSigSendType" SG_ 369 ReSideRdrRiObj11RdrObjElevnSts 0;
BA_ "GenSigSendType" SG_ 369 ReSideRdrRiObj11RdrObjID 0;
BA_ "GenSigStartValue" SG_ 369 ReSideRdrRiObj11RdrObjIsInFreeSpace 1;
BA_ "GenSigSendType" SG_ 369 ReSideRdrRiObj11RdrObjIsInFreeSpace 0;
BA_ "GenSigSendType" SG_ 369 ReSideRdrRiObj11RdrObjMirrProblty 0;
BA_ "GenSigStartValue" SG_ 369 ReSideRdrRiObj11RdrObjMtnPat 3;
BA_ "GenSigSendType" SG_ 369 ReSideRdrRiObj11RdrObjMtnPat 0;
BA_ "GenSigSendType" SG_ 369 ReSideRdrRiObj11RdrObjNotRealProblty 0;
BA_ "GenSigSendType" SG_ 369 ReSideRdrRiObj11RdrObjStatyCnt 0;
BA_ "GenSigSendType" SG_ 369 ReSideRdrRiObj11RdrObjTiAlv 0;
BA_ "GenSigSendType" SG_ 369 ReSideRdrRiObj11RdrObjTrackSts 0;
BA_ "GenSigSendType" SG_ 369 ReSideRdrRiObj11RdrObjTyp 0;
BA_ "GenSigSendType" SG_ 369 ReSideRdrRiObj11RdrObjTypConfBike 0;
BA_ "GenSigSendType" SG_ 369 ReSideRdrRiObj11RdrObjTypConfPed 0;
BA_ "GenSigSendType" SG_ 369 ReSideRdrRiObj11RdrObjTypConfVeh 0;
BA_ "GenSigStartValue" SG_ 369 ReSideRdrRiObj11RdrObjVx 6400;
BA_ "GenSigSendType" SG_ 369 ReSideRdrRiObj11RdrObjVx 0;
BA_ "GenSigSendType" SG_ 369 ReSideRdrRiObj11RdrObjVxStdDe 0;
BA_ "GenSigStartValue" SG_ 369 ReSideRdrRiObj11RdrObjVy 6400;
BA_ "GenSigSendType" SG_ 369 ReSideRdrRiObj11RdrObjVy 0;
BA_ "GenSigSendType" SG_ 369 ReSideRdrRiObj11RdrObjVyStdDe 0;
BA_ "GenSigStartValue" SG_ 369 ReSideRdrRiObj11RelVx 1780;
BA_ "GenSigSendType" SG_ 369 ReSideRdrRiObj11RelVx 0;
BA_ "GenSigStartValue" SG_ 369 ReSideRdrRiObj11RelVy 1780;
BA_ "GenSigSendType" SG_ 369 ReSideRdrRiObj11RelVy 0;
// Frame: SODRSafetyCANFD3Frame34
BA_ "VFrameFormat" BO_ 371 14;
BA_ "GenMsgSendType" BO_ 371 0;
BA_ "GenMsgCycleTime" BO_ 371 50.000;
BA_ "GenSigStartValue" SG_ 371 ReSideRdrRiObj12Heading 1800;
BA_ "GenSigSendType" SG_ 371 ReSideRdrRiObj12Heading 0;
BA_ "GenSigStartValue" SG_ 371 ReSideRdrRiObj12ObjBoxCenterLat 250;
BA_ "GenSigSendType" SG_ 371 ReSideRdrRiObj12ObjBoxCenterLat 0;
BA_ "GenSigStartValue" SG_ 371 ReSideRdrRiObj12ObjBoxCenterLgt 250;
BA_ "GenSigSendType" SG_ 371 ReSideRdrRiObj12ObjBoxCenterLgt 0;
BA_ "GenSigSendType" SG_ 371 ReSideRdrRiObj12ObservationHist 0;
BA_ "GenSigSendType" SG_ 371 ReSideRdrRiObj12RdrObjAx 0;
BA_ "GenSigSendType" SG_ 371 ReSideRdrRiObj12RdrObjAy 0;
BA_ "GenSigSendType" SG_ 371 ReSideRdrRiObj12RdrObjBoxLength 0;
BA_ "GenSigSendType" SG_ 371 ReSideRdrRiObj12RdrObjBoxWidth 0;
BA_ "GenSigSendType" SG_ 371 ReSideRdrRiObj12RdrObjChks 0;
BA_ "GenSigFuncType" SG_ 371 ReSideRdrRiObj12RdrObjChks 15;
BA_ "GenSigDataID" SG_ 371 ReSideRdrRiObj12RdrObjChks "0xACC";
BA_ "GenSigSendType" SG_ 371 ReSideRdrRiObj12RdrObjCntr 0;
BA_ "GenSigFuncType" SG_ 371 ReSideRdrRiObj12RdrObjCntr 16;
BA_ "GenSigStartValue" SG_ 371 ReSideRdrRiObj12RdrObjCoastCnt 31;
BA_ "GenSigSendType" SG_ 371 ReSideRdrRiObj12RdrObjCoastCnt 0;
BA_ "GenSigSendType" SG_ 371 ReSideRdrRiObj12RdrObjConf 0;
BA_ "GenSigSendType" SG_ 371 ReSideRdrRiObj12RdrObjDx 0;
BA_ "GenSigSendType" SG_ 371 ReSideRdrRiObj12RdrObjDxStdDe 0;
BA_ "GenSigStartValue" SG_ 371 ReSideRdrRiObj12RdrObjDy 4000;
BA_ "GenSigSendType" SG_ 371 ReSideRdrRiObj12RdrObjDy 0;
BA_ "GenSigSendType" SG_ 371 ReSideRdrRiObj12RdrObjDyStdDe 0;
BA_ "GenSigSendType" SG_ 371 ReSideRdrRiObj12RdrObjElevnConf 0;
BA_ "GenSigSendType" SG_ 371 ReSideRdrRiObj12RdrObjElevnSts 0;
BA_ "GenSigSendType" SG_ 371 ReSideRdrRiObj12RdrObjID 0;
BA_ "GenSigStartValue" SG_ 371 ReSideRdrRiObj12RdrObjIsInFreeSpace 1;
BA_ "GenSigSendType" SG_ 371 ReSideRdrRiObj12RdrObjIsInFreeSpace 0;
BA_ "GenSigSendType" SG_ 371 ReSideRdrRiObj12RdrObjMirrProblty 0;
BA_ "GenSigStartValue" SG_ 371 ReSideRdrRiObj12RdrObjMtnPat 3;
BA_ "GenSigSendType" SG_ 371 ReSideRdrRiObj12RdrObjMtnPat 0;
BA_ "GenSigSendType" SG_ 371 ReSideRdrRiObj12RdrObjNotRealProblty 0;
BA_ "GenSigSendType" SG_ 371 ReSideRdrRiObj12RdrObjStatyCnt 0;
BA_ "GenSigSendType" SG_ 371 ReSideRdrRiObj12RdrObjTiAlv 0;
BA_ "GenSigSendType" SG_ 371 ReSideRdrRiObj12RdrObjTrackSts 0;
BA_ "GenSigSendType" SG_ 371 ReSideRdrRiObj12RdrObjTyp 0;
BA_ "GenSigSendType" SG_ 371 ReSideRdrRiObj12RdrObjTypConfBike 0;
BA_ "GenSigSendType" SG_ 371 ReSideRdrRiObj12RdrObjTypConfPed 0;
BA_ "GenSigSendType" SG_ 371 ReSideRdrRiObj12RdrObjTypConfVeh 0;
BA_ "GenSigStartValue" SG_ 371 ReSideRdrRiObj12RdrObjVx 6400;
BA_ "GenSigSendType" SG_ 371 ReSideRdrRiObj12RdrObjVx 0;
BA_ "GenSigSendType" SG_ 371 ReSideRdrRiObj12RdrObjVxStdDe 0;
BA_ "GenSigStartValue" SG_ 371 ReSideRdrRiObj12RdrObjVy 6400;
BA_ "GenSigSendType" SG_ 371 ReSideRdrRiObj12RdrObjVy 0;
BA_ "GenSigSendType" SG_ 371 ReSideRdrRiObj12RdrObjVyStdDe 0;
BA_ "GenSigStartValue" SG_ 371 ReSideRdrRiObj12RelVx 1780;
BA_ "GenSigSendType" SG_ 371 ReSideRdrRiObj12RelVx 0;
BA_ "GenSigStartValue" SG_ 371 ReSideRdrRiObj12RelVy 1780;
BA_ "GenSigSendType" SG_ 371 ReSideRdrRiObj12RelVy 0;
// Frame: SODRSafetyCANFD3Frame35
BA_ "VFrameFormat" BO_ 373 14;
BA_ "GenMsgSendType" BO_ 373 0;
BA_ "GenMsgCycleTime" BO_ 373 50.000;
BA_ "GenSigStartValue" SG_ 373 ReSideRdrRiObj13Heading 1800;
BA_ "GenSigSendType" SG_ 373 ReSideRdrRiObj13Heading 0;
BA_ "GenSigStartValue" SG_ 373 ReSideRdrRiObj13ObjBoxCenterLat 250;
BA_ "GenSigSendType" SG_ 373 ReSideRdrRiObj13ObjBoxCenterLat 0;
BA_ "GenSigStartValue" SG_ 373 ReSideRdrRiObj13ObjBoxCenterLgt 250;
BA_ "GenSigSendType" SG_ 373 ReSideRdrRiObj13ObjBoxCenterLgt 0;
BA_ "GenSigSendType" SG_ 373 ReSideRdrRiObj13ObservationHist 0;
BA_ "GenSigSendType" SG_ 373 ReSideRdrRiObj13RdrObjAx 0;
BA_ "GenSigSendType" SG_ 373 ReSideRdrRiObj13RdrObjAy 0;
BA_ "GenSigSendType" SG_ 373 ReSideRdrRiObj13RdrObjBoxLength 0;
BA_ "GenSigSendType" SG_ 373 ReSideRdrRiObj13RdrObjBoxWidth 0;
BA_ "GenSigSendType" SG_ 373 ReSideRdrRiObj13RdrObjChks 0;
BA_ "GenSigFuncType" SG_ 373 ReSideRdrRiObj13RdrObjChks 15;
BA_ "GenSigDataID" SG_ 373 ReSideRdrRiObj13RdrObjChks "0xACD";
BA_ "GenSigSendType" SG_ 373 ReSideRdrRiObj13RdrObjCntr 0;
BA_ "GenSigFuncType" SG_ 373 ReSideRdrRiObj13RdrObjCntr 16;
BA_ "GenSigStartValue" SG_ 373 ReSideRdrRiObj13RdrObjCoastCnt 31;
BA_ "GenSigSendType" SG_ 373 ReSideRdrRiObj13RdrObjCoastCnt 0;
BA_ "GenSigSendType" SG_ 373 ReSideRdrRiObj13RdrObjConf 0;
BA_ "GenSigSendType" SG_ 373 ReSideRdrRiObj13RdrObjDx 0;
BA_ "GenSigSendType" SG_ 373 ReSideRdrRiObj13RdrObjDxStdDe 0;
BA_ "GenSigStartValue" SG_ 373 ReSideRdrRiObj13RdrObjDy 4000;
BA_ "GenSigSendType" SG_ 373 ReSideRdrRiObj13RdrObjDy 0;
BA_ "GenSigSendType" SG_ 373 ReSideRdrRiObj13RdrObjDyStdDe 0;
BA_ "GenSigSendType" SG_ 373 ReSideRdrRiObj13RdrObjElevnConf 0;
BA_ "GenSigSendType" SG_ 373 ReSideRdrRiObj13RdrObjElevnSts 0;
BA_ "GenSigSendType" SG_ 373 ReSideRdrRiObj13RdrObjID 0;
BA_ "GenSigStartValue" SG_ 373 ReSideRdrRiObj13RdrObjIsInFreeSpace 1;
BA_ "GenSigSendType" SG_ 373 ReSideRdrRiObj13RdrObjIsInFreeSpace 0;
BA_ "GenSigSendType" SG_ 373 ReSideRdrRiObj13RdrObjMirrProblty 0;
BA_ "GenSigStartValue" SG_ 373 ReSideRdrRiObj13RdrObjMtnPat 3;
BA_ "GenSigSendType" SG_ 373 ReSideRdrRiObj13RdrObjMtnPat 0;
BA_ "GenSigSendType" SG_ 373 ReSideRdrRiObj13RdrObjNotRealProblty 0;
BA_ "GenSigSendType" SG_ 373 ReSideRdrRiObj13RdrObjStatyCnt 0;
BA_ "GenSigSendType" SG_ 373 ReSideRdrRiObj13RdrObjTiAlv 0;
BA_ "GenSigSendType" SG_ 373 ReSideRdrRiObj13RdrObjTrackSts 0;
BA_ "GenSigSendType" SG_ 373 ReSideRdrRiObj13RdrObjTyp 0;
BA_ "GenSigSendType" SG_ 373 ReSideRdrRiObj13RdrObjTypConfBike 0;
BA_ "GenSigSendType" SG_ 373 ReSideRdrRiObj13RdrObjTypConfPed 0;
BA_ "GenSigSendType" SG_ 373 ReSideRdrRiObj13RdrObjTypConfVeh 0;
BA_ "GenSigStartValue" SG_ 373 ReSideRdrRiObj13RdrObjVx 6400;
BA_ "GenSigSendType" SG_ 373 ReSideRdrRiObj13RdrObjVx 0;
BA_ "GenSigSendType" SG_ 373 ReSideRdrRiObj13RdrObjVxStdDe 0;
BA_ "GenSigStartValue" SG_ 373 ReSideRdrRiObj13RdrObjVy 6400;
BA_ "GenSigSendType" SG_ 373 ReSideRdrRiObj13RdrObjVy 0;
BA_ "GenSigSendType" SG_ 373 ReSideRdrRiObj13RdrObjVyStdDe 0;
BA_ "GenSigStartValue" SG_ 373 ReSideRdrRiObj13RelVx 1780;
BA_ "GenSigSendType" SG_ 373 ReSideRdrRiObj13RelVx 0;
BA_ "GenSigStartValue" SG_ 373 ReSideRdrRiObj13RelVy 1780;
BA_ "GenSigSendType" SG_ 373 ReSideRdrRiObj13RelVy 0;
// Frame: SODRSafetyCANFD3Frame36
BA_ "VFrameFormat" BO_ 375 14;
BA_ "GenMsgSendType" BO_ 375 0;
BA_ "GenMsgCycleTime" BO_ 375 50.000;
BA_ "GenSigStartValue" SG_ 375 ReSideRdrRiObj14Heading 1800;
BA_ "GenSigSendType" SG_ 375 ReSideRdrRiObj14Heading 0;
BA_ "GenSigStartValue" SG_ 375 ReSideRdrRiObj14ObjBoxCenterLat 250;
BA_ "GenSigSendType" SG_ 375 ReSideRdrRiObj14ObjBoxCenterLat 0;
BA_ "GenSigStartValue" SG_ 375 ReSideRdrRiObj14ObjBoxCenterLgt 250;
BA_ "GenSigSendType" SG_ 375 ReSideRdrRiObj14ObjBoxCenterLgt 0;
BA_ "GenSigSendType" SG_ 375 ReSideRdrRiObj14ObservationHist 0;
BA_ "GenSigSendType" SG_ 375 ReSideRdrRiObj14RdrObjAx 0;
BA_ "GenSigSendType" SG_ 375 ReSideRdrRiObj14RdrObjAy 0;
BA_ "GenSigSendType" SG_ 375 ReSideRdrRiObj14RdrObjBoxLength 0;
BA_ "GenSigSendType" SG_ 375 ReSideRdrRiObj14RdrObjBoxWidth 0;
BA_ "GenSigSendType" SG_ 375 ReSideRdrRiObj14RdrObjChks 0;
BA_ "GenSigFuncType" SG_ 375 ReSideRdrRiObj14RdrObjChks 15;
BA_ "GenSigDataID" SG_ 375 ReSideRdrRiObj14RdrObjChks "0xACE";
BA_ "GenSigSendType" SG_ 375 ReSideRdrRiObj14RdrObjCntr 0;
BA_ "GenSigFuncType" SG_ 375 ReSideRdrRiObj14RdrObjCntr 16;
BA_ "GenSigStartValue" SG_ 375 ReSideRdrRiObj14RdrObjCoastCnt 31;
BA_ "GenSigSendType" SG_ 375 ReSideRdrRiObj14RdrObjCoastCnt 0;
BA_ "GenSigSendType" SG_ 375 ReSideRdrRiObj14RdrObjConf 0;
BA_ "GenSigSendType" SG_ 375 ReSideRdrRiObj14RdrObjDx 0;
BA_ "GenSigSendType" SG_ 375 ReSideRdrRiObj14RdrObjDxStdDe 0;
BA_ "GenSigStartValue" SG_ 375 ReSideRdrRiObj14RdrObjDy 4000;
BA_ "GenSigSendType" SG_ 375 ReSideRdrRiObj14RdrObjDy 0;
BA_ "GenSigSendType" SG_ 375 ReSideRdrRiObj14RdrObjDyStdDe 0;
BA_ "GenSigSendType" SG_ 375 ReSideRdrRiObj14RdrObjElevnConf 0;
BA_ "GenSigSendType" SG_ 375 ReSideRdrRiObj14RdrObjElevnSts 0;
BA_ "GenSigSendType" SG_ 375 ReSideRdrRiObj14RdrObjID 0;
BA_ "GenSigStartValue" SG_ 375 ReSideRdrRiObj14RdrObjIsInFreeSpace 1;
BA_ "GenSigSendType" SG_ 375 ReSideRdrRiObj14RdrObjIsInFreeSpace 0;
BA_ "GenSigSendType" SG_ 375 ReSideRdrRiObj14RdrObjMirrProblty 0;
BA_ "GenSigStartValue" SG_ 375 ReSideRdrRiObj14RdrObjMtnPat 3;
BA_ "GenSigSendType" SG_ 375 ReSideRdrRiObj14RdrObjMtnPat 0;
BA_ "GenSigSendType" SG_ 375 ReSideRdrRiObj14RdrObjNotRealProblty 0;
BA_ "GenSigSendType" SG_ 375 ReSideRdrRiObj14RdrObjStatyCnt 0;
BA_ "GenSigSendType" SG_ 375 ReSideRdrRiObj14RdrObjTiAlv 0;
BA_ "GenSigSendType" SG_ 375 ReSideRdrRiObj14RdrObjTrackSts 0;
BA_ "GenSigSendType" SG_ 375 ReSideRdrRiObj14RdrObjTyp 0;
BA_ "GenSigSendType" SG_ 375 ReSideRdrRiObj14RdrObjTypConfBike 0;
BA_ "GenSigSendType" SG_ 375 ReSideRdrRiObj14RdrObjTypConfPed 0;
BA_ "GenSigSendType" SG_ 375 ReSideRdrRiObj14RdrObjTypConfVeh 0;
BA_ "GenSigStartValue" SG_ 375 ReSideRdrRiObj14RdrObjVx 6400;
BA_ "GenSigSendType" SG_ 375 ReSideRdrRiObj14RdrObjVx 0;
BA_ "GenSigSendType" SG_ 375 ReSideRdrRiObj14RdrObjVxStdDe 0;
BA_ "GenSigStartValue" SG_ 375 ReSideRdrRiObj14RdrObjVy 6400;
BA_ "GenSigSendType" SG_ 375 ReSideRdrRiObj14RdrObjVy 0;
BA_ "GenSigSendType" SG_ 375 ReSideRdrRiObj14RdrObjVyStdDe 0;
BA_ "GenSigStartValue" SG_ 375 ReSideRdrRiObj14RelVx 1780;
BA_ "GenSigSendType" SG_ 375 ReSideRdrRiObj14RelVx 0;
BA_ "GenSigStartValue" SG_ 375 ReSideRdrRiObj14RelVy 1780;
BA_ "GenSigSendType" SG_ 375 ReSideRdrRiObj14RelVy 0;
// Frame: SODRSafetyCANFD3Frame37
BA_ "VFrameFormat" BO_ 377 14;
BA_ "GenMsgSendType" BO_ 377 0;
BA_ "GenMsgCycleTime" BO_ 377 50.000;
BA_ "GenSigStartValue" SG_ 377 ReSideRdrRiObj15Heading 1800;
BA_ "GenSigSendType" SG_ 377 ReSideRdrRiObj15Heading 0;
BA_ "GenSigStartValue" SG_ 377 ReSideRdrRiObj15ObjBoxCenterLat 250;
BA_ "GenSigSendType" SG_ 377 ReSideRdrRiObj15ObjBoxCenterLat 0;
BA_ "GenSigStartValue" SG_ 377 ReSideRdrRiObj15ObjBoxCenterLgt 250;
BA_ "GenSigSendType" SG_ 377 ReSideRdrRiObj15ObjBoxCenterLgt 0;
BA_ "GenSigSendType" SG_ 377 ReSideRdrRiObj15ObservationHist 0;
BA_ "GenSigSendType" SG_ 377 ReSideRdrRiObj15RdrObjAx 0;
BA_ "GenSigSendType" SG_ 377 ReSideRdrRiObj15RdrObjAy 0;
BA_ "GenSigSendType" SG_ 377 ReSideRdrRiObj15RdrObjBoxLength 0;
BA_ "GenSigSendType" SG_ 377 ReSideRdrRiObj15RdrObjBoxWidth 0;
BA_ "GenSigSendType" SG_ 377 ReSideRdrRiObj15RdrObjChks 0;
BA_ "GenSigFuncType" SG_ 377 ReSideRdrRiObj15RdrObjChks 15;
BA_ "GenSigDataID" SG_ 377 ReSideRdrRiObj15RdrObjChks "0xACF";
BA_ "GenSigSendType" SG_ 377 ReSideRdrRiObj15RdrObjCntr 0;
BA_ "GenSigFuncType" SG_ 377 ReSideRdrRiObj15RdrObjCntr 16;
BA_ "GenSigStartValue" SG_ 377 ReSideRdrRiObj15RdrObjCoastCnt 31;
BA_ "GenSigSendType" SG_ 377 ReSideRdrRiObj15RdrObjCoastCnt 0;
BA_ "GenSigSendType" SG_ 377 ReSideRdrRiObj15RdrObjConf 0;
BA_ "GenSigSendType" SG_ 377 ReSideRdrRiObj15RdrObjDx 0;
BA_ "GenSigSendType" SG_ 377 ReSideRdrRiObj15RdrObjDxStdDe 0;
BA_ "GenSigStartValue" SG_ 377 ReSideRdrRiObj15RdrObjDy 4000;
BA_ "GenSigSendType" SG_ 377 ReSideRdrRiObj15RdrObjDy 0;
BA_ "GenSigSendType" SG_ 377 ReSideRdrRiObj15RdrObjDyStdDe 0;
BA_ "GenSigSendType" SG_ 377 ReSideRdrRiObj15RdrObjElevnConf 0;
BA_ "GenSigSendType" SG_ 377 ReSideRdrRiObj15RdrObjElevnSts 0;
BA_ "GenSigSendType" SG_ 377 ReSideRdrRiObj15RdrObjID 0;
BA_ "GenSigStartValue" SG_ 377 ReSideRdrRiObj15RdrObjIsInFreeSpace 1;
BA_ "GenSigSendType" SG_ 377 ReSideRdrRiObj15RdrObjIsInFreeSpace 0;
BA_ "GenSigSendType" SG_ 377 ReSideRdrRiObj15RdrObjMirrProblty 0;
BA_ "GenSigStartValue" SG_ 377 ReSideRdrRiObj15RdrObjMtnPat 3;
BA_ "GenSigSendType" SG_ 377 ReSideRdrRiObj15RdrObjMtnPat 0;
BA_ "GenSigSendType" SG_ 377 ReSideRdrRiObj15RdrObjNotRealProblty 0;
BA_ "GenSigSendType" SG_ 377 ReSideRdrRiObj15RdrObjStatyCnt 0;
BA_ "GenSigSendType" SG_ 377 ReSideRdrRiObj15RdrObjTiAlv 0;
BA_ "GenSigSendType" SG_ 377 ReSideRdrRiObj15RdrObjTrackSts 0;
BA_ "GenSigSendType" SG_ 377 ReSideRdrRiObj15RdrObjTyp 0;
BA_ "GenSigSendType" SG_ 377 ReSideRdrRiObj15RdrObjTypConfBike 0;
BA_ "GenSigSendType" SG_ 377 ReSideRdrRiObj15RdrObjTypConfPed 0;
BA_ "GenSigSendType" SG_ 377 ReSideRdrRiObj15RdrObjTypConfVeh 0;
BA_ "GenSigStartValue" SG_ 377 ReSideRdrRiObj15RdrObjVx 6400;
BA_ "GenSigSendType" SG_ 377 ReSideRdrRiObj15RdrObjVx 0;
BA_ "GenSigSendType" SG_ 377 ReSideRdrRiObj15RdrObjVxStdDe 0;
BA_ "GenSigStartValue" SG_ 377 ReSideRdrRiObj15RdrObjVy 6400;
BA_ "GenSigSendType" SG_ 377 ReSideRdrRiObj15RdrObjVy 0;
BA_ "GenSigSendType" SG_ 377 ReSideRdrRiObj15RdrObjVyStdDe 0;
BA_ "GenSigStartValue" SG_ 377 ReSideRdrRiObj15RelVx 1780;
BA_ "GenSigSendType" SG_ 377 ReSideRdrRiObj15RelVx 0;
BA_ "GenSigStartValue" SG_ 377 ReSideRdrRiObj15RelVy 1780;
BA_ "GenSigSendType" SG_ 377 ReSideRdrRiObj15RelVy 0;
// Frame: SodrSafetyCanFD3NmFr
BA_ "VFrameFormat" BO_ 1283 14;
BA_ "GenMsgSendType" BO_ 1283 1;
BA_ "GenMsgDelayTime" BO_ 1283 20.000;
BA_ "GenMsgILSupport" BO_ 1283 0;
BA_ "NmAsrMessage" BO_ 1283 1;
// Frame: SodrToAsdmSafetyCanFD3DiagResFrame1
BA_ "VFrameFormat" BO_ 1617 14;
BA_ "GenMsgSendType" BO_ 1617 1;
BA_ "GenMsgDelayTime" BO_ 1617 5.000;
// Frame: SodrToEtcXcpFr01
BA_ "VFrameFormat" BO_ 1412 0;
BA_ "GenMsgSendType" BO_ 1412 1;
BA_ "GenMsgDelayTime" BO_ 1412 10.000;
// Frame: SodrToEtcXcpFr02
BA_ "VFrameFormat" BO_ 1426 0;
BA_ "GenMsgSendType" BO_ 1426 1;
BA_ "GenMsgDelayTime" BO_ 1426 10.000;
VAL_ 355 ReSideRdrRiObj4RdrObjElevnSts 0 "RdrObjElevnSts_Unknown" 1 "RdrObjElevnSts_OverRidable" 2 "RdrObjElevnSts_Rlv" 3 "RdrObjElevnSts_UnderRidable";
VAL_ 355 ReSideRdrRiObj4RdrObjIsInFreeSpace 0 "YesNo2_No" 1 "YesNo2_Yes";
VAL_ 355 ReSideRdrRiObj4RdrObjMtnPat 0 "RdrObjMtnPat_Ukwn" 1 "RdrObjMtnPat_Staty" 2 "RdrObjMtnPat_StatyFromMovg" 3 "RdrObjMtnPat_Movg" 4 "RdrObjMtnPat_Receding" 5 "RdrObjMtnPat_Oncoming" 6 "RdrObjMtnPat_CrossingFromLe" 7 "RdrObjMtnPat_CrossingFromRi";
VAL_ 355 ReSideRdrRiObj4RdrObjTrackSts 0 "RdrObjTrackSts_Invld" 1 "RdrObjTrackSts_Updated" 2 "RdrObjTrackSts_New" 3 "RdrObjTrackSts_Coasted";
VAL_ 355 ReSideRdrRiObj4RdrObjTyp 0 "RdrObjTyp_Ukwn" 1 "RdrObjTyp_Car" 2 "RdrObjTyp_MotorCycle" 3 "RdrObjTyp_Truck" 4 "RdrObjTyp_Ped" 5 "RdrObjTyp_ObstdVert1" 6 "RdrObjTyp_ObstdVert2" 7 "RdrObjTyp_Anim" 8 "RdrObjTyp_ObjGen" 9 "RdrObjTyp_Bicycle" 10 "RdrObjTyp_VehofUkwnClass" 11 "RdrObjTyp_Reserved";
VAL_ 357 ReSideRdrRiObj5RdrObjElevnSts 0 "RdrObjElevnSts_Unknown" 1 "RdrObjElevnSts_OverRidable" 2 "RdrObjElevnSts_Rlv" 3 "RdrObjElevnSts_UnderRidable";
VAL_ 357 ReSideRdrRiObj5RdrObjIsInFreeSpace 0 "YesNo2_No" 1 "YesNo2_Yes";
VAL_ 357 ReSideRdrRiObj5RdrObjMtnPat 0 "RdrObjMtnPat_Ukwn" 1 "RdrObjMtnPat_Staty" 2 "RdrObjMtnPat_StatyFromMovg" 3 "RdrObjMtnPat_Movg" 4 "RdrObjMtnPat_Receding" 5 "RdrObjMtnPat_Oncoming" 6 "RdrObjMtnPat_CrossingFromLe" 7 "RdrObjMtnPat_CrossingFromRi";
VAL_ 357 ReSideRdrRiObj5RdrObjTrackSts 0 "RdrObjTrackSts_Invld" 1 "RdrObjTrackSts_Updated" 2 "RdrObjTrackSts_New" 3 "RdrObjTrackSts_Coasted";
VAL_ 357 ReSideRdrRiObj5RdrObjTyp 0 "RdrObjTyp_Ukwn" 1 "RdrObjTyp_Car" 2 "RdrObjTyp_MotorCycle" 3 "RdrObjTyp_Truck" 4 "RdrObjTyp_Ped" 5 "RdrObjTyp_ObstdVert1" 6 "RdrObjTyp_ObstdVert2" 7 "RdrObjTyp_Anim" 8 "RdrObjTyp_ObjGen" 9 "RdrObjTyp_Bicycle" 10 "RdrObjTyp_VehofUkwnClass" 11 "RdrObjTyp_Reserved";
VAL_ 359 ReSideRdrRiObj6RdrObjElevnSts 0 "RdrObjElevnSts_Unknown" 1 "RdrObjElevnSts_OverRidable" 2 "RdrObjElevnSts_Rlv" 3 "RdrObjElevnSts_UnderRidable";
VAL_ 359 ReSideRdrRiObj6RdrObjIsInFreeSpace 0 "YesNo2_No" 1 "YesNo2_Yes";
VAL_ 359 ReSideRdrRiObj6RdrObjMtnPat 0 "RdrObjMtnPat_Ukwn" 1 "RdrObjMtnPat_Staty" 2 "RdrObjMtnPat_StatyFromMovg" 3 "RdrObjMtnPat_Movg" 4 "RdrObjMtnPat_Receding" 5 "RdrObjMtnPat_Oncoming" 6 "RdrObjMtnPat_CrossingFromLe" 7 "RdrObjMtnPat_CrossingFromRi";
VAL_ 359 ReSideRdrRiObj6RdrObjTrackSts 0 "RdrObjTrackSts_Invld" 1 "RdrObjTrackSts_Updated" 2 "RdrObjTrackSts_New" 3 "RdrObjTrackSts_Coasted";
VAL_ 359 ReSideRdrRiObj6RdrObjTyp 0 "RdrObjTyp_Ukwn" 1 "RdrObjTyp_Car" 2 "RdrObjTyp_MotorCycle" 3 "RdrObjTyp_Truck" 4 "RdrObjTyp_Ped" 5 "RdrObjTyp_ObstdVert1" 6 "RdrObjTyp_ObstdVert2" 7 "RdrObjTyp_Anim" 8 "RdrObjTyp_ObjGen" 9 "RdrObjTyp_Bicycle" 10 "RdrObjTyp_VehofUkwnClass" 11 "RdrObjTyp_Reserved";
VAL_ 361 ReSideRdrRiObj7RdrObjElevnSts 0 "RdrObjElevnSts_Unknown" 1 "RdrObjElevnSts_OverRidable" 2 "RdrObjElevnSts_Rlv" 3 "RdrObjElevnSts_UnderRidable";
VAL_ 361 ReSideRdrRiObj7RdrObjIsInFreeSpace 0 "YesNo2_No" 1 "YesNo2_Yes";
VAL_ 361 ReSideRdrRiObj7RdrObjMtnPat 0 "RdrObjMtnPat_Ukwn" 1 "RdrObjMtnPat_Staty" 2 "RdrObjMtnPat_StatyFromMovg" 3 "RdrObjMtnPat_Movg" 4 "RdrObjMtnPat_Receding" 5 "RdrObjMtnPat_Oncoming" 6 "RdrObjMtnPat_CrossingFromLe" 7 "RdrObjMtnPat_CrossingFromRi";
VAL_ 361 ReSideRdrRiObj7RdrObjTrackSts 0 "RdrObjTrackSts_Invld" 1 "RdrObjTrackSts_Updated" 2 "RdrObjTrackSts_New" 3 "RdrObjTrackSts_Coasted";
VAL_ 361 ReSideRdrRiObj7RdrObjTyp 0 "RdrObjTyp_Ukwn" 1 "RdrObjTyp_Car" 2 "RdrObjTyp_MotorCycle" 3 "RdrObjTyp_Truck" 4 "RdrObjTyp_Ped" 5 "RdrObjTyp_ObstdVert1" 6 "RdrObjTyp_ObstdVert2" 7 "RdrObjTyp_Anim" 8 "RdrObjTyp_ObjGen" 9 "RdrObjTyp_Bicycle" 10 "RdrObjTyp_VehofUkwnClass" 11 "RdrObjTyp_Reserved";
VAL_ 363 ReSideRdrRiObj8RdrObjElevnSts 0 "RdrObjElevnSts_Unknown" 1 "RdrObjElevnSts_OverRidable" 2 "RdrObjElevnSts_Rlv" 3 "RdrObjElevnSts_UnderRidable";
VAL_ 363 ReSideRdrRiObj8RdrObjIsInFreeSpace 0 "YesNo2_No" 1 "YesNo2_Yes";
VAL_ 363 ReSideRdrRiObj8RdrObjMtnPat 0 "RdrObjMtnPat_Ukwn" 1 "RdrObjMtnPat_Staty" 2 "RdrObjMtnPat_StatyFromMovg" 3 "RdrObjMtnPat_Movg" 4 "RdrObjMtnPat_Receding" 5 "RdrObjMtnPat_Oncoming" 6 "RdrObjMtnPat_CrossingFromLe" 7 "RdrObjMtnPat_CrossingFromRi";
VAL_ 363 ReSideRdrRiObj8RdrObjTrackSts 0 "RdrObjTrackSts_Invld" 1 "RdrObjTrackSts_Updated" 2 "RdrObjTrackSts_New" 3 "RdrObjTrackSts_Coasted";
VAL_ 363 ReSideRdrRiObj8RdrObjTyp 0 "RdrObjTyp_Ukwn" 1 "RdrObjTyp_Car" 2 "RdrObjTyp_MotorCycle" 3 "RdrObjTyp_Truck" 4 "RdrObjTyp_Ped" 5 "RdrObjTyp_ObstdVert1" 6 "RdrObjTyp_ObstdVert2" 7 "RdrObjTyp_Anim" 8 "RdrObjTyp_ObjGen" 9 "RdrObjTyp_Bicycle" 10 "RdrObjTyp_VehofUkwnClass" 11 "RdrObjTyp_Reserved";
VAL_ 365 ReSideRdrRiObj9RdrObjElevnSts 0 "RdrObjElevnSts_Unknown" 1 "RdrObjElevnSts_OverRidable" 2 "RdrObjElevnSts_Rlv" 3 "RdrObjElevnSts_UnderRidable";
VAL_ 365 ReSideRdrRiObj9RdrObjIsInFreeSpace 0 "YesNo2_No" 1 "YesNo2_Yes";
VAL_ 365 ReSideRdrRiObj9RdrObjMtnPat 0 "RdrObjMtnPat_Ukwn" 1 "RdrObjMtnPat_Staty" 2 "RdrObjMtnPat_StatyFromMovg" 3 "RdrObjMtnPat_Movg" 4 "RdrObjMtnPat_Receding" 5 "RdrObjMtnPat_Oncoming" 6 "RdrObjMtnPat_CrossingFromLe" 7 "RdrObjMtnPat_CrossingFromRi";
VAL_ 365 ReSideRdrRiObj9RdrObjTrackSts 0 "RdrObjTrackSts_Invld" 1 "RdrObjTrackSts_Updated" 2 "RdrObjTrackSts_New" 3 "RdrObjTrackSts_Coasted";
VAL_ 365 ReSideRdrRiObj9RdrObjTyp 0 "RdrObjTyp_Ukwn" 1 "RdrObjTyp_Car" 2 "RdrObjTyp_MotorCycle" 3 "RdrObjTyp_Truck" 4 "RdrObjTyp_Ped" 5 "RdrObjTyp_ObstdVert1" 6 "RdrObjTyp_ObstdVert2" 7 "RdrObjTyp_Anim" 8 "RdrObjTyp_ObjGen" 9 "RdrObjTyp_Bicycle" 10 "RdrObjTyp_VehofUkwnClass" 11 "RdrObjTyp_Reserved";
VAL_ 367 ReSideRdrRiObj10RdrObjElevnSts 0 "RdrObjElevnSts_Unknown" 1 "RdrObjElevnSts_OverRidable" 2 "RdrObjElevnSts_Rlv" 3 "RdrObjElevnSts_UnderRidable";
VAL_ 367 ReSideRdrRiObj10RdrObjIsInFreeSpace 0 "YesNo2_No" 1 "YesNo2_Yes";
VAL_ 367 ReSideRdrRiObj10RdrObjMtnPat 0 "RdrObjMtnPat_Ukwn" 1 "RdrObjMtnPat_Staty" 2 "RdrObjMtnPat_StatyFromMovg" 3 "RdrObjMtnPat_Movg" 4 "RdrObjMtnPat_Receding" 5 "RdrObjMtnPat_Oncoming" 6 "RdrObjMtnPat_CrossingFromLe" 7 "RdrObjMtnPat_CrossingFromRi";
VAL_ 367 ReSideRdrRiObj10RdrObjTrackSts 0 "RdrObjTrackSts_Invld" 1 "RdrObjTrackSts_Updated" 2 "RdrObjTrackSts_New" 3 "RdrObjTrackSts_Coasted";
VAL_ 367 ReSideRdrRiObj10RdrObjTyp 0 "RdrObjTyp_Ukwn" 1 "RdrObjTyp_Car" 2 "RdrObjTyp_MotorCycle" 3 "RdrObjTyp_Truck" 4 "RdrObjTyp_Ped" 5 "RdrObjTyp_ObstdVert1" 6 "RdrObjTyp_ObstdVert2" 7 "RdrObjTyp_Anim" 8 "RdrObjTyp_ObjGen" 9 "RdrObjTyp_Bicycle" 10 "RdrObjTyp_VehofUkwnClass" 11 "RdrObjTyp_Reserved";
VAL_ 369 ReSideRdrRiObj11RdrObjElevnSts 0 "RdrObjElevnSts_Unknown" 1 "RdrObjElevnSts_OverRidable" 2 "RdrObjElevnSts_Rlv" 3 "RdrObjElevnSts_UnderRidable";
VAL_ 369 ReSideRdrRiObj11RdrObjIsInFreeSpace 0 "YesNo2_No" 1 "YesNo2_Yes";
VAL_ 369 ReSideRdrRiObj11RdrObjMtnPat 0 "RdrObjMtnPat_Ukwn" 1 "RdrObjMtnPat_Staty" 2 "RdrObjMtnPat_StatyFromMovg" 3 "RdrObjMtnPat_Movg" 4 "RdrObjMtnPat_Receding" 5 "RdrObjMtnPat_Oncoming" 6 "RdrObjMtnPat_CrossingFromLe" 7 "RdrObjMtnPat_CrossingFromRi";
VAL_ 369 ReSideRdrRiObj11RdrObjTrackSts 0 "RdrObjTrackSts_Invld" 1 "RdrObjTrackSts_Updated" 2 "RdrObjTrackSts_New" 3 "RdrObjTrackSts_Coasted";
VAL_ 369 ReSideRdrRiObj11RdrObjTyp 0 "RdrObjTyp_Ukwn" 1 "RdrObjTyp_Car" 2 "RdrObjTyp_MotorCycle" 3 "RdrObjTyp_Truck" 4 "RdrObjTyp_Ped" 5 "RdrObjTyp_ObstdVert1" 6 "RdrObjTyp_ObstdVert2" 7 "RdrObjTyp_Anim" 8 "RdrObjTyp_ObjGen" 9 "RdrObjTyp_Bicycle" 10 "RdrObjTyp_VehofUkwnClass" 11 "RdrObjTyp_Reserved";
VAL_ 371 ReSideRdrRiObj12RdrObjElevnSts 0 "RdrObjElevnSts_Unknown" 1 "RdrObjElevnSts_OverRidable" 2 "RdrObjElevnSts_Rlv" 3 "RdrObjElevnSts_UnderRidable";
VAL_ 371 ReSideRdrRiObj12RdrObjIsInFreeSpace 0 "YesNo2_No" 1 "YesNo2_Yes";
VAL_ 371 ReSideRdrRiObj12RdrObjMtnPat 0 "RdrObjMtnPat_Ukwn" 1 "RdrObjMtnPat_Staty" 2 "RdrObjMtnPat_StatyFromMovg" 3 "RdrObjMtnPat_Movg" 4 "RdrObjMtnPat_Receding" 5 "RdrObjMtnPat_Oncoming" 6 "RdrObjMtnPat_CrossingFromLe" 7 "RdrObjMtnPat_CrossingFromRi";
VAL_ 371 ReSideRdrRiObj12RdrObjTrackSts 0 "RdrObjTrackSts_Invld" 1 "RdrObjTrackSts_Updated" 2 "RdrObjTrackSts_New" 3 "RdrObjTrackSts_Coasted";
VAL_ 371 ReSideRdrRiObj12RdrObjTyp 0 "RdrObjTyp_Ukwn" 1 "RdrObjTyp_Car" 2 "RdrObjTyp_MotorCycle" 3 "RdrObjTyp_Truck" 4 "RdrObjTyp_Ped" 5 "RdrObjTyp_ObstdVert1" 6 "RdrObjTyp_ObstdVert2" 7 "RdrObjTyp_Anim" 8 "RdrObjTyp_ObjGen" 9 "RdrObjTyp_Bicycle" 10 "RdrObjTyp_VehofUkwnClass" 11 "RdrObjTyp_Reserved";
VAL_ 373 ReSideRdrRiObj13RdrObjElevnSts 0 "RdrObjElevnSts_Unknown" 1 "RdrObjElevnSts_OverRidable" 2 "RdrObjElevnSts_Rlv" 3 "RdrObjElevnSts_UnderRidable";
VAL_ 373 ReSideRdrRiObj13RdrObjIsInFreeSpace 0 "YesNo2_No" 1 "YesNo2_Yes";
VAL_ 373 ReSideRdrRiObj13RdrObjMtnPat 0 "RdrObjMtnPat_Ukwn" 1 "RdrObjMtnPat_Staty" 2 "RdrObjMtnPat_StatyFromMovg" 3 "RdrObjMtnPat_Movg" 4 "RdrObjMtnPat_Receding" 5 "RdrObjMtnPat_Oncoming" 6 "RdrObjMtnPat_CrossingFromLe" 7 "RdrObjMtnPat_CrossingFromRi";
VAL_ 373 ReSideRdrRiObj13RdrObjTrackSts 0 "RdrObjTrackSts_Invld" 1 "RdrObjTrackSts_Updated" 2 "RdrObjTrackSts_New" 3 "RdrObjTrackSts_Coasted";
VAL_ 373 ReSideRdrRiObj13RdrObjTyp 0 "RdrObjTyp_Ukwn" 1 "RdrObjTyp_Car" 2 "RdrObjTyp_MotorCycle" 3 "RdrObjTyp_Truck" 4 "RdrObjTyp_Ped" 5 "RdrObjTyp_ObstdVert1" 6 "RdrObjTyp_ObstdVert2" 7 "RdrObjTyp_Anim" 8 "RdrObjTyp_ObjGen" 9 "RdrObjTyp_Bicycle" 10 "RdrObjTyp_VehofUkwnClass" 11 "RdrObjTyp_Reserved";
VAL_ 375 ReSideRdrRiObj14RdrObjElevnSts 0 "RdrObjElevnSts_Unknown" 1 "RdrObjElevnSts_OverRidable" 2 "RdrObjElevnSts_Rlv" 3 "RdrObjElevnSts_UnderRidable";
VAL_ 375 ReSideRdrRiObj14RdrObjIsInFreeSpace 0 "YesNo2_No" 1 "YesNo2_Yes";
VAL_ 375 ReSideRdrRiObj14RdrObjMtnPat 0 "RdrObjMtnPat_Ukwn" 1 "RdrObjMtnPat_Staty" 2 "RdrObjMtnPat_StatyFromMovg" 3 "RdrObjMtnPat_Movg" 4 "RdrObjMtnPat_Receding" 5 "RdrObjMtnPat_Oncoming" 6 "RdrObjMtnPat_CrossingFromLe" 7 "RdrObjMtnPat_CrossingFromRi";
VAL_ 375 ReSideRdrRiObj14RdrObjTrackSts 0 "RdrObjTrackSts_Invld" 1 "RdrObjTrackSts_Updated" 2 "RdrObjTrackSts_New" 3 "RdrObjTrackSts_Coasted";
VAL_ 375 ReSideRdrRiObj14RdrObjTyp 0 "RdrObjTyp_Ukwn" 1 "RdrObjTyp_Car" 2 "RdrObjTyp_MotorCycle" 3 "RdrObjTyp_Truck" 4 "RdrObjTyp_Ped" 5 "RdrObjTyp_ObstdVert1" 6 "RdrObjTyp_ObstdVert2" 7 "RdrObjTyp_Anim" 8 "RdrObjTyp_ObjGen" 9 "RdrObjTyp_Bicycle" 10 "RdrObjTyp_VehofUkwnClass" 11 "RdrObjTyp_Reserved";
VAL_ 377 ReSideRdrRiObj15RdrObjElevnSts 0 "RdrObjElevnSts_Unknown" 1 "RdrObjElevnSts_OverRidable" 2 "RdrObjElevnSts_Rlv" 3 "RdrObjElevnSts_UnderRidable";
VAL_ 377 ReSideRdrRiObj15RdrObjIsInFreeSpace 0 "YesNo2_No" 1 "YesNo2_Yes";
VAL_ 377 ReSideRdrRiObj15RdrObjMtnPat 0 "RdrObjMtnPat_Ukwn" 1 "RdrObjMtnPat_Staty" 2 "RdrObjMtnPat_StatyFromMovg" 3 "RdrObjMtnPat_Movg" 4 "RdrObjMtnPat_Receding" 5 "RdrObjMtnPat_Oncoming" 6 "RdrObjMtnPat_CrossingFromLe" 7 "RdrObjMtnPat_CrossingFromRi";
VAL_ 377 ReSideRdrRiObj15RdrObjTrackSts 0 "RdrObjTrackSts_Invld" 1 "RdrObjTrackSts_Updated" 2 "RdrObjTrackSts_New" 3 "RdrObjTrackSts_Coasted";
VAL_ 377 ReSideRdrRiObj15RdrObjTyp 0 "RdrObjTyp_Ukwn" 1 "RdrObjTyp_Car" 2 "RdrObjTyp_MotorCycle" 3 "RdrObjTyp_Truck" 4 "RdrObjTyp_Ped" 5 "RdrObjTyp_ObstdVert1" 6 "RdrObjTyp_ObstdVert2" 7 "RdrObjTyp_Anim" 8 "RdrObjTyp_ObjGen" 9 "RdrObjTyp_Bicycle" 10 "RdrObjTyp_VehofUkwnClass" 11 "RdrObjTyp_Reserved";
SIG_GROUP_ 367 ReSideRdrRiObj10 1 : ReSideRdrRiObj10Heading ReSideRdrRiObj10ObjBoxCenterLat ReSideRdrRiObj10ObjBoxCenterLgt ReSideRdrRiObj10ObservationHist ReSideRdrRiObj10RdrObjAx ReSideRdrRiObj10RdrObjAy ReSideRdrRiObj10RdrObjBoxLength ReSideRdrRiObj10RdrObjBoxWidth ReSideRdrRiObj10RdrObjChks ReSideRdrRiObj10RdrObjCntr ReSideRdrRiObj10RdrObjCoastCnt ReSideRdrRiObj10RdrObjConf ReSideRdrRiObj10RdrObjDx ReSideRdrRiObj10RdrObjDxStdDe ReSideRdrRiObj10RdrObjDy ReSideRdrRiObj10RdrObjDyStdDe ReSideRdrRiObj10RdrObjElevnConf ReSideRdrRiObj10RdrObjElevnSts ReSideRdrRiObj10RdrObjID ReSideRdrRiObj10RdrObjIsInFreeSpace ReSideRdrRiObj10RdrObjMirrProblty ReSideRdrRiObj10RdrObjMtnPat ReSideRdrRiObj10RdrObjNotRealProblty ReSideRdrRiObj10RdrObjStatyCnt ReSideRdrRiObj10RdrObjTiAlv ReSideRdrRiObj10RdrObjTrackSts ReSideRdrRiObj10RdrObjTyp ReSideRdrRiObj10RdrObjTypConfBike ReSideRdrRiObj10RdrObjTypConfPed ReSideRdrRiObj10RdrObjTypConfVeh ReSideRdrRiObj10RdrObjVx ReSideRdrRiObj10RdrObjVxStdDe ReSideRdrRiObj10RdrObjVy ReSideRdrRiObj10RdrObjVyStdDe ReSideRdrRiObj10RelVx ReSideRdrRiObj10RelVy;
SIG_GROUP_ 369 ReSideRdrRiObj11 1 : ReSideRdrRiObj11Heading ReSideRdrRiObj11ObjBoxCenterLat ReSideRdrRiObj11ObjBoxCenterLgt ReSideRdrRiObj11ObservationHist ReSideRdrRiObj11RdrObjAx ReSideRdrRiObj11RdrObjAy ReSideRdrRiObj11RdrObjBoxLength ReSideRdrRiObj11RdrObjBoxWidth ReSideRdrRiObj11RdrObjChks ReSideRdrRiObj11RdrObjCntr ReSideRdrRiObj11RdrObjCoastCnt ReSideRdrRiObj11RdrObjConf ReSideRdrRiObj11RdrObjDx ReSideRdrRiObj11RdrObjDxStdDe ReSideRdrRiObj11RdrObjDy ReSideRdrRiObj11RdrObjDyStdDe ReSideRdrRiObj11RdrObjElevnConf ReSideRdrRiObj11RdrObjElevnSts ReSideRdrRiObj11RdrObjID ReSideRdrRiObj11RdrObjIsInFreeSpace ReSideRdrRiObj11RdrObjMirrProblty ReSideRdrRiObj11RdrObjMtnPat ReSideRdrRiObj11RdrObjNotRealProblty ReSideRdrRiObj11RdrObjStatyCnt ReSideRdrRiObj11RdrObjTiAlv ReSideRdrRiObj11RdrObjTrackSts ReSideRdrRiObj11RdrObjTyp ReSideRdrRiObj11RdrObjTypConfBike ReSideRdrRiObj11RdrObjTypConfPed ReSideRdrRiObj11RdrObjTypConfVeh ReSideRdrRiObj11RdrObjVx ReSideRdrRiObj11RdrObjVxStdDe ReSideRdrRiObj11RdrObjVy ReSideRdrRiObj11RdrObjVyStdDe ReSideRdrRiObj11RelVx ReSideRdrRiObj11RelVy;
SIG_GROUP_ 371 ReSideRdrRiObj12 1 : ReSideRdrRiObj12Heading ReSideRdrRiObj12ObjBoxCenterLat ReSideRdrRiObj12ObjBoxCenterLgt ReSideRdrRiObj12ObservationHist ReSideRdrRiObj12RdrObjAx ReSideRdrRiObj12RdrObjAy ReSideRdrRiObj12RdrObjBoxLength ReSideRdrRiObj12RdrObjBoxWidth ReSideRdrRiObj12RdrObjChks ReSideRdrRiObj12RdrObjCntr ReSideRdrRiObj12RdrObjCoastCnt ReSideRdrRiObj12RdrObjConf ReSideRdrRiObj12RdrObjDx ReSideRdrRiObj12RdrObjDxStdDe ReSideRdrRiObj12RdrObjDy ReSideRdrRiObj12RdrObjDyStdDe ReSideRdrRiObj12RdrObjElevnConf ReSideRdrRiObj12RdrObjElevnSts ReSideRdrRiObj12RdrObjID ReSideRdrRiObj12RdrObjIsInFreeSpace ReSideRdrRiObj12RdrObjMirrProblty ReSideRdrRiObj12RdrObjMtnPat ReSideRdrRiObj12RdrObjNotRealProblty ReSideRdrRiObj12RdrObjStatyCnt ReSideRdrRiObj12RdrObjTiAlv ReSideRdrRiObj12RdrObjTrackSts ReSideRdrRiObj12RdrObjTyp ReSideRdrRiObj12RdrObjTypConfBike ReSideRdrRiObj12RdrObjTypConfPed ReSideRdrRiObj12RdrObjTypConfVeh ReSideRdrRiObj12RdrObjVx ReSideRdrRiObj12RdrObjVxStdDe ReSideRdrRiObj12RdrObjVy ReSideRdrRiObj12RdrObjVyStdDe ReSideRdrRiObj12RelVx ReSideRdrRiObj12RelVy;
SIG_GROUP_ 373 ReSideRdrRiObj13 1 : ReSideRdrRiObj13Heading ReSideRdrRiObj13ObjBoxCenterLat ReSideRdrRiObj13ObjBoxCenterLgt ReSideRdrRiObj13ObservationHist ReSideRdrRiObj13RdrObjAx ReSideRdrRiObj13RdrObjAy ReSideRdrRiObj13RdrObjBoxLength ReSideRdrRiObj13RdrObjBoxWidth ReSideRdrRiObj13RdrObjChks ReSideRdrRiObj13RdrObjCntr ReSideRdrRiObj13RdrObjCoastCnt ReSideRdrRiObj13RdrObjConf ReSideRdrRiObj13RdrObjDx ReSideRdrRiObj13RdrObjDxStdDe ReSideRdrRiObj13RdrObjDy ReSideRdrRiObj13RdrObjDyStdDe ReSideRdrRiObj13RdrObjElevnConf ReSideRdrRiObj13RdrObjElevnSts ReSideRdrRiObj13RdrObjID ReSideRdrRiObj13RdrObjIsInFreeSpace ReSideRdrRiObj13RdrObjMirrProblty ReSideRdrRiObj13RdrObjMtnPat ReSideRdrRiObj13RdrObjNotRealProblty ReSideRdrRiObj13RdrObjStatyCnt ReSideRdrRiObj13RdrObjTiAlv ReSideRdrRiObj13RdrObjTrackSts ReSideRdrRiObj13RdrObjTyp ReSideRdrRiObj13RdrObjTypConfBike ReSideRdrRiObj13RdrObjTypConfPed ReSideRdrRiObj13RdrObjTypConfVeh ReSideRdrRiObj13RdrObjVx ReSideRdrRiObj13RdrObjVxStdDe ReSideRdrRiObj13RdrObjVy ReSideRdrRiObj13RdrObjVyStdDe ReSideRdrRiObj13RelVx ReSideRdrRiObj13RelVy;
SIG_GROUP_ 375 ReSideRdrRiObj14 1 : ReSideRdrRiObj14Heading ReSideRdrRiObj14ObjBoxCenterLat ReSideRdrRiObj14ObjBoxCenterLgt ReSideRdrRiObj14ObservationHist ReSideRdrRiObj14RdrObjAx ReSideRdrRiObj14RdrObjAy ReSideRdrRiObj14RdrObjBoxLength ReSideRdrRiObj14RdrObjBoxWidth ReSideRdrRiObj14RdrObjChks ReSideRdrRiObj14RdrObjCntr ReSideRdrRiObj14RdrObjCoastCnt ReSideRdrRiObj14RdrObjConf ReSideRdrRiObj14RdrObjDx ReSideRdrRiObj14RdrObjDxStdDe ReSideRdrRiObj14RdrObjDy ReSideRdrRiObj14RdrObjDyStdDe ReSideRdrRiObj14RdrObjElevnConf ReSideRdrRiObj14RdrObjElevnSts ReSideRdrRiObj14RdrObjID ReSideRdrRiObj14RdrObjIsInFreeSpace ReSideRdrRiObj14RdrObjMirrProblty ReSideRdrRiObj14RdrObjMtnPat ReSideRdrRiObj14RdrObjNotRealProblty ReSideRdrRiObj14RdrObjStatyCnt ReSideRdrRiObj14RdrObjTiAlv ReSideRdrRiObj14RdrObjTrackSts ReSideRdrRiObj14RdrObjTyp ReSideRdrRiObj14RdrObjTypConfBike ReSideRdrRiObj14RdrObjTypConfPed ReSideRdrRiObj14RdrObjTypConfVeh ReSideRdrRiObj14RdrObjVx ReSideRdrRiObj14RdrObjVxStdDe ReSideRdrRiObj14RdrObjVy ReSideRdrRiObj14RdrObjVyStdDe ReSideRdrRiObj14RelVx ReSideRdrRiObj14RelVy;
SIG_GROUP_ 377 ReSideRdrRiObj15 1 : ReSideRdrRiObj15Heading ReSideRdrRiObj15ObjBoxCenterLat ReSideRdrRiObj15ObjBoxCenterLgt ReSideRdrRiObj15ObservationHist ReSideRdrRiObj15RdrObjAx ReSideRdrRiObj15RdrObjAy ReSideRdrRiObj15RdrObjBoxLength ReSideRdrRiObj15RdrObjBoxWidth ReSideRdrRiObj15RdrObjChks ReSideRdrRiObj15RdrObjCntr ReSideRdrRiObj15RdrObjCoastCnt ReSideRdrRiObj15RdrObjConf ReSideRdrRiObj15RdrObjDx ReSideRdrRiObj15RdrObjDxStdDe ReSideRdrRiObj15RdrObjDy ReSideRdrRiObj15RdrObjDyStdDe ReSideRdrRiObj15RdrObjElevnConf ReSideRdrRiObj15RdrObjElevnSts ReSideRdrRiObj15RdrObjID ReSideRdrRiObj15RdrObjIsInFreeSpace ReSideRdrRiObj15RdrObjMirrProblty ReSideRdrRiObj15RdrObjMtnPat ReSideRdrRiObj15RdrObjNotRealProblty ReSideRdrRiObj15RdrObjStatyCnt ReSideRdrRiObj15RdrObjTiAlv ReSideRdrRiObj15RdrObjTrackSts ReSideRdrRiObj15RdrObjTyp ReSideRdrRiObj15RdrObjTypConfBike ReSideRdrRiObj15RdrObjTypConfPed ReSideRdrRiObj15RdrObjTypConfVeh ReSideRdrRiObj15RdrObjVx ReSideRdrRiObj15RdrObjVxStdDe ReSideRdrRiObj15RdrObjVy ReSideRdrRiObj15RdrObjVyStdDe ReSideRdrRiObj15RelVx ReSideRdrRiObj15RelVy;
SIG_GROUP_ 355 ReSideRdrRiObj4 1 : ReSideRdrRiObj4Heading ReSideRdrRiObj4ObjBoxCenterLat ReSideRdrRiObj4ObjBoxCenterLgt ReSideRdrRiObj4ObservationHist ReSideRdrRiObj4RdrObjAx ReSideRdrRiObj4RdrObjAy ReSideRdrRiObj4RdrObjBoxLength ReSideRdrRiObj4RdrObjBoxWidth ReSideRdrRiObj4RdrObjChks ReSideRdrRiObj4RdrObjCntr ReSideRdrRiObj4RdrObjCoastCnt ReSideRdrRiObj4RdrObjConf ReSideRdrRiObj4RdrObjDx ReSideRdrRiObj4RdrObjDxStdDe ReSideRdrRiObj4RdrObjDy ReSideRdrRiObj4RdrObjDyStdDe ReSideRdrRiObj4RdrObjElevnConf ReSideRdrRiObj4RdrObjElevnSts ReSideRdrRiObj4RdrObjID ReSideRdrRiObj4RdrObjIsInFreeSpace ReSideRdrRiObj4RdrObjMirrProblty ReSideRdrRiObj4RdrObjMtnPat ReSideRdrRiObj4RdrObjNotRealProblty ReSideRdrRiObj4RdrObjStatyCnt ReSideRdrRiObj4RdrObjTiAlv ReSideRdrRiObj4RdrObjTrackSts ReSideRdrRiObj4RdrObjTyp ReSideRdrRiObj4RdrObjTypConfBike ReSideRdrRiObj4RdrObjTypConfPed ReSideRdrRiObj4RdrObjTypConfVeh ReSideRdrRiObj4RdrObjVx ReSideRdrRiObj4RdrObjVxStdDe ReSideRdrRiObj4RdrObjVy ReSideRdrRiObj4RdrObjVyStdDe ReSideRdrRiObj4RelVx ReSideRdrRiObj4RelVy;
SIG_GROUP_ 357 ReSideRdrRiObj5 1 : ReSideRdrRiObj5Heading ReSideRdrRiObj5ObjBoxCenterLat ReSideRdrRiObj5ObjBoxCenterLgt ReSideRdrRiObj5ObservationHist ReSideRdrRiObj5RdrObjAx ReSideRdrRiObj5RdrObjAy ReSideRdrRiObj5RdrObjBoxLength ReSideRdrRiObj5RdrObjBoxWidth ReSideRdrRiObj5RdrObjChks ReSideRdrRiObj5RdrObjCntr ReSideRdrRiObj5RdrObjCoastCnt ReSideRdrRiObj5RdrObjConf ReSideRdrRiObj5RdrObjDx ReSideRdrRiObj5RdrObjDxStdDe ReSideRdrRiObj5RdrObjDy ReSideRdrRiObj5RdrObjDyStdDe ReSideRdrRiObj5RdrObjElevnConf ReSideRdrRiObj5RdrObjElevnSts ReSideRdrRiObj5RdrObjID ReSideRdrRiObj5RdrObjIsInFreeSpace ReSideRdrRiObj5RdrObjMirrProblty ReSideRdrRiObj5RdrObjMtnPat ReSideRdrRiObj5RdrObjNotRealProblty ReSideRdrRiObj5RdrObjStatyCnt ReSideRdrRiObj5RdrObjTiAlv ReSideRdrRiObj5RdrObjTrackSts ReSideRdrRiObj5RdrObjTyp ReSideRdrRiObj5RdrObjTypConfBike ReSideRdrRiObj5RdrObjTypConfPed ReSideRdrRiObj5RdrObjTypConfVeh ReSideRdrRiObj5RdrObjVx ReSideRdrRiObj5RdrObjVxStdDe ReSideRdrRiObj5RdrObjVy ReSideRdrRiObj5RdrObjVyStdDe ReSideRdrRiObj5RelVx ReSideRdrRiObj5RelVy;
SIG_GROUP_ 359 ReSideRdrRiObj6 1 : ReSideRdrRiObj6Heading ReSideRdrRiObj6ObjBoxCenterLat ReSideRdrRiObj6ObjBoxCenterLgt ReSideRdrRiObj6ObservationHist ReSideRdrRiObj6RdrObjAx ReSideRdrRiObj6RdrObjAy ReSideRdrRiObj6RdrObjBoxLength ReSideRdrRiObj6RdrObjBoxWidth ReSideRdrRiObj6RdrObjChks ReSideRdrRiObj6RdrObjCntr ReSideRdrRiObj6RdrObjCoastCnt ReSideRdrRiObj6RdrObjConf ReSideRdrRiObj6RdrObjDx ReSideRdrRiObj6RdrObjDxStdDe ReSideRdrRiObj6RdrObjDy ReSideRdrRiObj6RdrObjDyStdDe ReSideRdrRiObj6RdrObjElevnConf ReSideRdrRiObj6RdrObjElevnSts ReSideRdrRiObj6RdrObjID ReSideRdrRiObj6RdrObjIsInFreeSpace ReSideRdrRiObj6RdrObjMirrProblty ReSideRdrRiObj6RdrObjMtnPat ReSideRdrRiObj6RdrObjNotRealProblty ReSideRdrRiObj6RdrObjStatyCnt ReSideRdrRiObj6RdrObjTiAlv ReSideRdrRiObj6RdrObjTrackSts ReSideRdrRiObj6RdrObjTyp ReSideRdrRiObj6RdrObjTypConfBike ReSideRdrRiObj6RdrObjTypConfPed ReSideRdrRiObj6RdrObjTypConfVeh ReSideRdrRiObj6RdrObjVx ReSideRdrRiObj6RdrObjVxStdDe ReSideRdrRiObj6RdrObjVy ReSideRdrRiObj6RdrObjVyStdDe ReSideRdrRiObj6RelVx ReSideRdrRiObj6RelVy;
SIG_GROUP_ 361 ReSideRdrRiObj7 1 : ReSideRdrRiObj7Heading ReSideRdrRiObj7ObjBoxCenterLat ReSideRdrRiObj7ObjBoxCenterLgt ReSideRdrRiObj7ObservationHist ReSideRdrRiObj7RdrObjAx ReSideRdrRiObj7RdrObjAy ReSideRdrRiObj7RdrObjBoxLength ReSideRdrRiObj7RdrObjBoxWidth ReSideRdrRiObj7RdrObjChks ReSideRdrRiObj7RdrObjCntr ReSideRdrRiObj7RdrObjCoastCnt ReSideRdrRiObj7RdrObjConf ReSideRdrRiObj7RdrObjDx ReSideRdrRiObj7RdrObjDxStdDe ReSideRdrRiObj7RdrObjDy ReSideRdrRiObj7RdrObjDyStdDe ReSideRdrRiObj7RdrObjElevnConf ReSideRdrRiObj7RdrObjElevnSts ReSideRdrRiObj7RdrObjID ReSideRdrRiObj7RdrObjIsInFreeSpace ReSideRdrRiObj7RdrObjMirrProblty ReSideRdrRiObj7RdrObjMtnPat ReSideRdrRiObj7RdrObjNotRealProblty ReSideRdrRiObj7RdrObjStatyCnt ReSideRdrRiObj7RdrObjTiAlv ReSideRdrRiObj7RdrObjTrackSts ReSideRdrRiObj7RdrObjTyp ReSideRdrRiObj7RdrObjTypConfBike ReSideRdrRiObj7RdrObjTypConfPed ReSideRdrRiObj7RdrObjTypConfVeh ReSideRdrRiObj7RdrObjVx ReSideRdrRiObj7RdrObjVxStdDe ReSideRdrRiObj7RdrObjVy ReSideRdrRiObj7RdrObjVyStdDe ReSideRdrRiObj7RelVx ReSideRdrRiObj7RelVy;
SIG_GROUP_ 363 ReSideRdrRiObj8 1 : ReSideRdrRiObj8Heading ReSideRdrRiObj8ObjBoxCenterLat ReSideRdrRiObj8ObjBoxCenterLgt ReSideRdrRiObj8ObservationHist ReSideRdrRiObj8RdrObjAx ReSideRdrRiObj8RdrObjAy ReSideRdrRiObj8RdrObjBoxLength ReSideRdrRiObj8RdrObjBoxWidth ReSideRdrRiObj8RdrObjChks ReSideRdrRiObj8RdrObjCntr ReSideRdrRiObj8RdrObjCoastCnt ReSideRdrRiObj8RdrObjConf ReSideRdrRiObj8RdrObjDx ReSideRdrRiObj8RdrObjDxStdDe ReSideRdrRiObj8RdrObjDy ReSideRdrRiObj8RdrObjDyStdDe ReSideRdrRiObj8RdrObjElevnConf ReSideRdrRiObj8RdrObjElevnSts ReSideRdrRiObj8RdrObjID ReSideRdrRiObj8RdrObjIsInFreeSpace ReSideRdrRiObj8RdrObjMirrProblty ReSideRdrRiObj8RdrObjMtnPat ReSideRdrRiObj8RdrObjNotRealProblty ReSideRdrRiObj8RdrObjStatyCnt ReSideRdrRiObj8RdrObjTiAlv ReSideRdrRiObj8RdrObjTrackSts ReSideRdrRiObj8RdrObjTyp ReSideRdrRiObj8RdrObjTypConfBike ReSideRdrRiObj8RdrObjTypConfPed ReSideRdrRiObj8RdrObjTypConfVeh ReSideRdrRiObj8RdrObjVx ReSideRdrRiObj8RdrObjVxStdDe ReSideRdrRiObj8RdrObjVy ReSideRdrRiObj8RdrObjVyStdDe ReSideRdrRiObj8RelVx ReSideRdrRiObj8RelVy;
SIG_GROUP_ 365 ReSideRdrRiObj9 1 : ReSideRdrRiObj9Heading ReSideRdrRiObj9ObjBoxCenterLat ReSideRdrRiObj9ObjBoxCenterLgt ReSideRdrRiObj9ObservationHist ReSideRdrRiObj9RdrObjAx ReSideRdrRiObj9RdrObjAy ReSideRdrRiObj9RdrObjBoxLength ReSideRdrRiObj9RdrObjBoxWidth ReSideRdrRiObj9RdrObjChks ReSideRdrRiObj9RdrObjCntr ReSideRdrRiObj9RdrObjCoastCnt ReSideRdrRiObj9RdrObjConf ReSideRdrRiObj9RdrObjDx ReSideRdrRiObj9RdrObjDxStdDe ReSideRdrRiObj9RdrObjDy ReSideRdrRiObj9RdrObjDyStdDe ReSideRdrRiObj9RdrObjElevnConf ReSideRdrRiObj9RdrObjElevnSts ReSideRdrRiObj9RdrObjID ReSideRdrRiObj9RdrObjIsInFreeSpace ReSideRdrRiObj9RdrObjMirrProblty ReSideRdrRiObj9RdrObjMtnPat ReSideRdrRiObj9RdrObjNotRealProblty ReSideRdrRiObj9RdrObjStatyCnt ReSideRdrRiObj9RdrObjTiAlv ReSideRdrRiObj9RdrObjTrackSts ReSideRdrRiObj9RdrObjTyp ReSideRdrRiObj9RdrObjTypConfBike ReSideRdrRiObj9RdrObjTypConfPed ReSideRdrRiObj9RdrObjTypConfVeh ReSideRdrRiObj9RdrObjVx ReSideRdrRiObj9RdrObjVxStdDe ReSideRdrRiObj9RdrObjVy ReSideRdrRiObj9RdrObjVyStdDe ReSideRdrRiObj9RelVx ReSideRdrRiObj9RelVy;
