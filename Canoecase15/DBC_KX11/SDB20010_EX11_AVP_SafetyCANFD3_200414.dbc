// *************************************************************************** *
// *                                                                           *
// *                      Mentor Graphics Corporation                          *
// *                          All rights reserved                              *
// *                                                                           *
// *************************************************************************** *
// *                                                                           *
// * Description:         CANDB File                                           *
// * Generated at:        2020-04-14 13:14:03                                  *
// * System:              SDB20010                                             *
// * Variant:             EX11_AVP                                             *
// * Network:             SafetyCANFD3                                         *
// *                                                                           *
// *************************************************************************** *
// *                                                                           *
// *             THIS CONFIGURATION MIGHT CONTAIN SOME ERRORS                  *
// *              IF THE INPUT MODEL WAS NOT PROPERLY FORMED!                  *
// *                    Do Not Use this File directly!                         *
// *                                                                           *
// *************************************************************************** *
VERSION "SafetyCANFD3"

NS_ :

BS_:

BU_:  ASDM ETC PAS SODL SODR

BO_ 319 SODRSafetyCANFD3Frame08: 64 SODR
 SG_ ReSideRdrRiDetn43_UB : 74|1@0+ (1,0) [0|1] "" ASDM,PAS
 SG_ ReSideRdrRiDetn43RdrDetnAzi : 31|11@0+ (0.1,-90.0) [-90.0|90.0] "Deg" ASDM,PAS
 SG_ ReSideRdrRiDetn43RdrDetnChks : 7|8@0+ (1.0,0.0) [0.0|255.0] "Unitless" ASDM,PAS
 SG_ ReSideRdrRiDetn43RdrDetnCntr : 15|4@0+ (1.0,0.0) [0.0|15.0] "Unitless" ASDM,PAS
 SG_ ReSideRdrRiDetn43RdrDetnConf : 71|7@0+ (1.0,0.0) [0.0|100.0] "%" ASDM,PAS
 SG_ ReSideRdrRiDetn43RdrDetnElevn : 79|5@0+ (1.0,-15.0) [-15.0|15.0] "Deg" ASDM,PAS
 SG_ ReSideRdrRiDetn43RdrDetnPwr : 8|9@0+ (0.1,0.0) [0.0|51.1] "dB" ASDM,PAS
 SG_ ReSideRdrRiDetn43RdrDetnRng : 55|14@0+ (0.02,-1.0) [-1.0|200.0] "m" ASDM,PAS
 SG_ ReSideRdrRiDetn43RdrDetnRngV : 36|13@0+ (0.02,-80.0) [-80.0|80.0] "m/s" ASDM,PAS
 SG_ ReSideRdrRiDetn43RdrDetnSts : 11|2@0+ (1,0) [0|3] "" ASDM,PAS
 SG_ ReSideRdrRiDetn44_UB : 154|1@0+ (1,0) [0|1] "" ASDM,PAS
 SG_ ReSideRdrRiDetn44RdrDetnAzi : 119|11@0+ (0.1,-90.0) [-90.0|90.0] "Deg" ASDM,PAS
 SG_ ReSideRdrRiDetn44RdrDetnChks : 87|8@0+ (1.0,0.0) [0.0|255.0] "Unitless" ASDM,PAS
 SG_ ReSideRdrRiDetn44RdrDetnCntr : 95|4@0+ (1.0,0.0) [0.0|15.0] "Unitless" ASDM,PAS
 SG_ ReSideRdrRiDetn44RdrDetnConf : 111|7@0+ (1.0,0.0) [0.0|100.0] "%" ASDM,PAS
 SG_ ReSideRdrRiDetn44RdrDetnElevn : 159|5@0+ (1.0,-15.0) [-15.0|15.0] "Deg" ASDM,PAS
 SG_ ReSideRdrRiDetn44RdrDetnPwr : 89|9@0+ (0.1,0.0) [0.0|51.1] "dB" ASDM,PAS
 SG_ ReSideRdrRiDetn44RdrDetnRng : 143|14@0+ (0.02,-1.0) [-1.0|200.0] "m" ASDM,PAS
 SG_ ReSideRdrRiDetn44RdrDetnRngV : 124|13@0+ (0.02,-80.0) [-80.0|80.0] "m/s" ASDM,PAS
 SG_ ReSideRdrRiDetn44RdrDetnSts : 91|2@0+ (1,0) [0|3] "" ASDM,PAS
 SG_ ReSideRdrRiDetn45_UB : 234|1@0+ (1,0) [0|1] "" ASDM,PAS
 SG_ ReSideRdrRiDetn45RdrDetnAzi : 199|11@0+ (0.1,-90.0) [-90.0|90.0] "Deg" ASDM,PAS
 SG_ ReSideRdrRiDetn45RdrDetnChks : 167|8@0+ (1.0,0.0) [0.0|255.0] "Unitless" ASDM,PAS
 SG_ ReSideRdrRiDetn45RdrDetnCntr : 175|4@0+ (1.0,0.0) [0.0|15.0] "Unitless" ASDM,PAS
 SG_ ReSideRdrRiDetn45RdrDetnConf : 191|7@0+ (1.0,0.0) [0.0|100.0] "%" ASDM,PAS
 SG_ ReSideRdrRiDetn45RdrDetnElevn : 239|5@0+ (1.0,-15.0) [-15.0|15.0] "Deg" ASDM,PAS
 SG_ ReSideRdrRiDetn45RdrDetnPwr : 169|9@0+ (0.1,0.0) [0.0|51.1] "dB" ASDM,PAS
 SG_ ReSideRdrRiDetn45RdrDetnRng : 223|14@0+ (0.02,-1.0) [-1.0|200.0] "m" ASDM,PAS
 SG_ ReSideRdrRiDetn45RdrDetnRngV : 204|13@0+ (0.02,-80.0) [-80.0|80.0] "m/s" ASDM,PAS
 SG_ ReSideRdrRiDetn45RdrDetnSts : 171|2@0+ (1,0) [0|3] "" ASDM,PAS
 SG_ ReSideRdrRiDetn46_UB : 314|1@0+ (1,0) [0|1] "" ASDM,PAS
 SG_ ReSideRdrRiDetn46RdrDetnAzi : 287|11@0+ (0.1,-90.0) [-90.0|90.0] "Deg" ASDM,PAS
 SG_ ReSideRdrRiDetn46RdrDetnChks : 247|8@0+ (1.0,0.0) [0.0|255.0] "Unitless" ASDM,PAS
 SG_ ReSideRdrRiDetn46RdrDetnCntr : 255|4@0+ (1.0,0.0) [0.0|15.0] "Unitless" ASDM,PAS
 SG_ ReSideRdrRiDetn46RdrDetnConf : 311|7@0+ (1.0,0.0) [0.0|100.0] "%" ASDM,PAS
 SG_ ReSideRdrRiDetn46RdrDetnElevn : 319|5@0+ (1.0,-15.0) [-15.0|15.0] "Deg" ASDM,PAS
 SG_ ReSideRdrRiDetn46RdrDetnPwr : 249|9@0+ (0.1,0.0) [0.0|51.1] "dB" ASDM,PAS
 SG_ ReSideRdrRiDetn46RdrDetnRng : 271|14@0+ (0.02,-1.0) [-1.0|200.0] "m" ASDM,PAS
 SG_ ReSideRdrRiDetn46RdrDetnRngV : 292|13@0+ (0.02,-80.0) [-80.0|80.0] "m/s" ASDM,PAS
 SG_ ReSideRdrRiDetn46RdrDetnSts : 251|2@0+ (1,0) [0|3] "" ASDM,PAS
 SG_ ReSideRdrRiDetn47_UB : 394|1@0+ (1,0) [0|1] "" ASDM,PAS
 SG_ ReSideRdrRiDetn47RdrDetnAzi : 351|11@0+ (0.1,-90.0) [-90.0|90.0] "Deg" ASDM,PAS
 SG_ ReSideRdrRiDetn47RdrDetnChks : 327|8@0+ (1.0,0.0) [0.0|255.0] "Unitless" ASDM,PAS
 SG_ ReSideRdrRiDetn47RdrDetnCntr : 335|4@0+ (1.0,0.0) [0.0|15.0] "Unitless" ASDM,PAS
 SG_ ReSideRdrRiDetn47RdrDetnConf : 391|7@0+ (1.0,0.0) [0.0|100.0] "%" ASDM,PAS
 SG_ ReSideRdrRiDetn47RdrDetnElevn : 399|5@0+ (1.0,-15.0) [-15.0|15.0] "Deg" ASDM,PAS
 SG_ ReSideRdrRiDetn47RdrDetnPwr : 329|9@0+ (0.1,0.0) [0.0|51.1] "dB" ASDM,PAS
 SG_ ReSideRdrRiDetn47RdrDetnRng : 375|14@0+ (0.02,-1.0) [-1.0|200.0] "m" ASDM,PAS
 SG_ ReSideRdrRiDetn47RdrDetnRngV : 356|13@0+ (0.02,-80.0) [-80.0|80.0] "m/s" ASDM,PAS
 SG_ ReSideRdrRiDetn47RdrDetnSts : 331|2@0+ (1,0) [0|3] "" ASDM,PAS
 SG_ ReSideRdrRiDetn48_UB : 474|1@0+ (1,0) [0|1] "" ASDM,PAS
 SG_ ReSideRdrRiDetn48RdrDetnAzi : 447|11@0+ (0.1,-90.0) [-90.0|90.0] "Deg" ASDM,PAS
 SG_ ReSideRdrRiDetn48RdrDetnChks : 407|8@0+ (1.0,0.0) [0.0|255.0] "Unitless" ASDM,PAS
 SG_ ReSideRdrRiDetn48RdrDetnCntr : 415|4@0+ (1.0,0.0) [0.0|15.0] "Unitless" ASDM,PAS
 SG_ ReSideRdrRiDetn48RdrDetnConf : 471|7@0+ (1.0,0.0) [0.0|100.0] "%" ASDM,PAS
 SG_ ReSideRdrRiDetn48RdrDetnElevn : 479|5@0+ (1.0,-15.0) [-15.0|15.0] "Deg" ASDM,PAS
 SG_ ReSideRdrRiDetn48RdrDetnPwr : 409|9@0+ (0.1,0.0) [0.0|51.1] "dB" ASDM,PAS
 SG_ ReSideRdrRiDetn48RdrDetnRng : 431|14@0+ (0.02,-1.0) [-1.0|200.0] "m" ASDM,PAS
 SG_ ReSideRdrRiDetn48RdrDetnRngV : 452|13@0+ (0.02,-80.0) [-80.0|80.0] "m/s" ASDM,PAS
 SG_ ReSideRdrRiDetn48RdrDetnSts : 411|2@0+ (1,0) [0|3] "" ASDM,PAS

BO_ 321 SODRSafetyCANFD3Frame09: 64 SODR
 SG_ ReSideRdrRiDetn49_UB : 74|1@0+ (1,0) [0|1] "" ASDM,PAS
 SG_ ReSideRdrRiDetn49RdrDetnAzi : 31|11@0+ (0.1,-90.0) [-90.0|90.0] "Deg" ASDM,PAS
 SG_ ReSideRdrRiDetn49RdrDetnChks : 7|8@0+ (1.0,0.0) [0.0|255.0] "Unitless" ASDM,PAS
 SG_ ReSideRdrRiDetn49RdrDetnCntr : 15|4@0+ (1.0,0.0) [0.0|15.0] "Unitless" ASDM,PAS
 SG_ ReSideRdrRiDetn49RdrDetnConf : 71|7@0+ (1.0,0.0) [0.0|100.0] "%" ASDM,PAS
 SG_ ReSideRdrRiDetn49RdrDetnElevn : 79|5@0+ (1.0,-15.0) [-15.0|15.0] "Deg" ASDM,PAS
 SG_ ReSideRdrRiDetn49RdrDetnPwr : 8|9@0+ (0.1,0.0) [0.0|51.1] "dB" ASDM,PAS
 SG_ ReSideRdrRiDetn49RdrDetnRng : 55|14@0+ (0.02,-1.0) [-1.0|200.0] "m" ASDM,PAS
 SG_ ReSideRdrRiDetn49RdrDetnRngV : 36|13@0+ (0.02,-80.0) [-80.0|80.0] "m/s" ASDM,PAS
 SG_ ReSideRdrRiDetn49RdrDetnSts : 11|2@0+ (1,0) [0|3] "" ASDM,PAS
 SG_ ReSideRdrRiDetn50_UB : 154|1@0+ (1,0) [0|1] "" ASDM,PAS
 SG_ ReSideRdrRiDetn50RdrDetnAzi : 119|11@0+ (0.1,-90.0) [-90.0|90.0] "Deg" ASDM,PAS
 SG_ ReSideRdrRiDetn50RdrDetnChks : 87|8@0+ (1.0,0.0) [0.0|255.0] "Unitless" ASDM,PAS
 SG_ ReSideRdrRiDetn50RdrDetnCntr : 95|4@0+ (1.0,0.0) [0.0|15.0] "Unitless" ASDM,PAS
 SG_ ReSideRdrRiDetn50RdrDetnConf : 111|7@0+ (1.0,0.0) [0.0|100.0] "%" ASDM,PAS
 SG_ ReSideRdrRiDetn50RdrDetnElevn : 159|5@0+ (1.0,-15.0) [-15.0|15.0] "Deg" ASDM,PAS
 SG_ ReSideRdrRiDetn50RdrDetnPwr : 89|9@0+ (0.1,0.0) [0.0|51.1] "dB" ASDM,PAS
 SG_ ReSideRdrRiDetn50RdrDetnRng : 143|14@0+ (0.02,-1.0) [-1.0|200.0] "m" ASDM,PAS
 SG_ ReSideRdrRiDetn50RdrDetnRngV : 124|13@0+ (0.02,-80.0) [-80.0|80.0] "m/s" ASDM,PAS
 SG_ ReSideRdrRiDetn50RdrDetnSts : 91|2@0+ (1,0) [0|3] "" ASDM,PAS
 SG_ ReSideRdrRiDetn51_UB : 234|1@0+ (1,0) [0|1] "" ASDM,PAS
 SG_ ReSideRdrRiDetn51RdrDetnAzi : 199|11@0+ (0.1,-90.0) [-90.0|90.0] "Deg" ASDM,PAS
 SG_ ReSideRdrRiDetn51RdrDetnChks : 167|8@0+ (1.0,0.0) [0.0|255.0] "Unitless" ASDM,PAS
 SG_ ReSideRdrRiDetn51RdrDetnCntr : 175|4@0+ (1.0,0.0) [0.0|15.0] "Unitless" ASDM,PAS
 SG_ ReSideRdrRiDetn51RdrDetnConf : 191|7@0+ (1.0,0.0) [0.0|100.0] "%" ASDM,PAS
 SG_ ReSideRdrRiDetn51RdrDetnElevn : 239|5@0+ (1.0,-15.0) [-15.0|15.0] "Deg" ASDM,PAS
 SG_ ReSideRdrRiDetn51RdrDetnPwr : 169|9@0+ (0.1,0.0) [0.0|51.1] "dB" ASDM,PAS
 SG_ ReSideRdrRiDetn51RdrDetnRng : 223|14@0+ (0.02,-1.0) [-1.0|200.0] "m" ASDM,PAS
 SG_ ReSideRdrRiDetn51RdrDetnRngV : 204|13@0+ (0.02,-80.0) [-80.0|80.0] "m/s" ASDM,PAS
 SG_ ReSideRdrRiDetn51RdrDetnSts : 171|2@0+ (1,0) [0|3] "" ASDM,PAS
 SG_ ReSideRdrRiDetn52_UB : 314|1@0+ (1,0) [0|1] "" ASDM,PAS
 SG_ ReSideRdrRiDetn52RdrDetnAzi : 287|11@0+ (0.1,-90.0) [-90.0|90.0] "Deg" ASDM,PAS
 SG_ ReSideRdrRiDetn52RdrDetnChks : 247|8@0+ (1.0,0.0) [0.0|255.0] "Unitless" ASDM,PAS
 SG_ ReSideRdrRiDetn52RdrDetnCntr : 255|4@0+ (1.0,0.0) [0.0|15.0] "Unitless" ASDM,PAS
 SG_ ReSideRdrRiDetn52RdrDetnConf : 311|7@0+ (1.0,0.0) [0.0|100.0] "%" ASDM,PAS
 SG_ ReSideRdrRiDetn52RdrDetnElevn : 319|5@0+ (1.0,-15.0) [-15.0|15.0] "Deg" ASDM,PAS
 SG_ ReSideRdrRiDetn52RdrDetnPwr : 249|9@0+ (0.1,0.0) [0.0|51.1] "dB" ASDM,PAS
 SG_ ReSideRdrRiDetn52RdrDetnRng : 271|14@0+ (0.02,-1.0) [-1.0|200.0] "m" ASDM,PAS
 SG_ ReSideRdrRiDetn52RdrDetnRngV : 292|13@0+ (0.02,-80.0) [-80.0|80.0] "m/s" ASDM,PAS
 SG_ ReSideRdrRiDetn52RdrDetnSts : 251|2@0+ (1,0) [0|3] "" ASDM,PAS
 SG_ ReSideRdrRiDetn53_UB : 394|1@0+ (1,0) [0|1] "" ASDM,PAS
 SG_ ReSideRdrRiDetn53RdrDetnAzi : 351|11@0+ (0.1,-90.0) [-90.0|90.0] "Deg" ASDM,PAS
 SG_ ReSideRdrRiDetn53RdrDetnChks : 327|8@0+ (1.0,0.0) [0.0|255.0] "Unitless" ASDM,PAS
 SG_ ReSideRdrRiDetn53RdrDetnCntr : 335|4@0+ (1.0,0.0) [0.0|15.0] "Unitless" ASDM,PAS
 SG_ ReSideRdrRiDetn53RdrDetnConf : 391|7@0+ (1.0,0.0) [0.0|100.0] "%" ASDM,PAS
 SG_ ReSideRdrRiDetn53RdrDetnElevn : 399|5@0+ (1.0,-15.0) [-15.0|15.0] "Deg" ASDM,PAS
 SG_ ReSideRdrRiDetn53RdrDetnPwr : 329|9@0+ (0.1,0.0) [0.0|51.1] "dB" ASDM,PAS
 SG_ ReSideRdrRiDetn53RdrDetnRng : 375|14@0+ (0.02,-1.0) [-1.0|200.0] "m" ASDM,PAS
 SG_ ReSideRdrRiDetn53RdrDetnRngV : 356|13@0+ (0.02,-80.0) [-80.0|80.0] "m/s" ASDM,PAS
 SG_ ReSideRdrRiDetn53RdrDetnSts : 331|2@0+ (1,0) [0|3] "" ASDM,PAS
 SG_ ReSideRdrRiDetn54_UB : 474|1@0+ (1,0) [0|1] "" ASDM,PAS
 SG_ ReSideRdrRiDetn54RdrDetnAzi : 447|11@0+ (0.1,-90.0) [-90.0|90.0] "Deg" ASDM,PAS
 SG_ ReSideRdrRiDetn54RdrDetnChks : 407|8@0+ (1.0,0.0) [0.0|255.0] "Unitless" ASDM,PAS
 SG_ ReSideRdrRiDetn54RdrDetnCntr : 415|4@0+ (1.0,0.0) [0.0|15.0] "Unitless" ASDM,PAS
 SG_ ReSideRdrRiDetn54RdrDetnConf : 471|7@0+ (1.0,0.0) [0.0|100.0] "%" ASDM,PAS
 SG_ ReSideRdrRiDetn54RdrDetnElevn : 479|5@0+ (1.0,-15.0) [-15.0|15.0] "Deg" ASDM,PAS
 SG_ ReSideRdrRiDetn54RdrDetnPwr : 409|9@0+ (0.1,0.0) [0.0|51.1] "dB" ASDM,PAS
 SG_ ReSideRdrRiDetn54RdrDetnRng : 431|14@0+ (0.02,-1.0) [-1.0|200.0] "m" ASDM,PAS
 SG_ ReSideRdrRiDetn54RdrDetnRngV : 452|13@0+ (0.02,-80.0) [-80.0|80.0] "m/s" ASDM,PAS
 SG_ ReSideRdrRiDetn54RdrDetnSts : 411|2@0+ (1,0) [0|3] "" ASDM,PAS

BO_ 323 SODRSafetyCANFD3Frame10: 64 SODR
 SG_ ReSideRdrRiDetn55_UB : 74|1@0+ (1,0) [0|1] "" ASDM,PAS
 SG_ ReSideRdrRiDetn55RdrDetnAzi : 31|11@0+ (0.1,-90.0) [-90.0|90.0] "Deg" ASDM,PAS
 SG_ ReSideRdrRiDetn55RdrDetnChks : 7|8@0+ (1.0,0.0) [0.0|255.0] "Unitless" ASDM,PAS
 SG_ ReSideRdrRiDetn55RdrDetnCntr : 15|4@0+ (1.0,0.0) [0.0|15.0] "Unitless" ASDM,PAS
 SG_ ReSideRdrRiDetn55RdrDetnConf : 71|7@0+ (1.0,0.0) [0.0|100.0] "%" ASDM,PAS
 SG_ ReSideRdrRiDetn55RdrDetnElevn : 79|5@0+ (1.0,-15.0) [-15.0|15.0] "Deg" ASDM,PAS
 SG_ ReSideRdrRiDetn55RdrDetnPwr : 8|9@0+ (0.1,0.0) [0.0|51.1] "dB" ASDM,PAS
 SG_ ReSideRdrRiDetn55RdrDetnRng : 55|14@0+ (0.02,-1.0) [-1.0|200.0] "m" ASDM,PAS
 SG_ ReSideRdrRiDetn55RdrDetnRngV : 36|13@0+ (0.02,-80.0) [-80.0|80.0] "m/s" ASDM,PAS
 SG_ ReSideRdrRiDetn55RdrDetnSts : 11|2@0+ (1,0) [0|3] "" ASDM,PAS
 SG_ ReSideRdrRiDetn56_UB : 154|1@0+ (1,0) [0|1] "" ASDM,PAS
 SG_ ReSideRdrRiDetn56RdrDetnAzi : 119|11@0+ (0.1,-90.0) [-90.0|90.0] "Deg" ASDM,PAS
 SG_ ReSideRdrRiDetn56RdrDetnChks : 87|8@0+ (1.0,0.0) [0.0|255.0] "Unitless" ASDM,PAS
 SG_ ReSideRdrRiDetn56RdrDetnCntr : 95|4@0+ (1.0,0.0) [0.0|15.0] "Unitless" ASDM,PAS
 SG_ ReSideRdrRiDetn56RdrDetnConf : 111|7@0+ (1.0,0.0) [0.0|100.0] "%" ASDM,PAS
 SG_ ReSideRdrRiDetn56RdrDetnElevn : 159|5@0+ (1.0,-15.0) [-15.0|15.0] "Deg" ASDM,PAS
 SG_ ReSideRdrRiDetn56RdrDetnPwr : 89|9@0+ (0.1,0.0) [0.0|51.1] "dB" ASDM,PAS
 SG_ ReSideRdrRiDetn56RdrDetnRng : 143|14@0+ (0.02,-1.0) [-1.0|200.0] "m" ASDM,PAS
 SG_ ReSideRdrRiDetn56RdrDetnRngV : 124|13@0+ (0.02,-80.0) [-80.0|80.0] "m/s" ASDM,PAS
 SG_ ReSideRdrRiDetn56RdrDetnSts : 91|2@0+ (1,0) [0|3] "" ASDM,PAS
 SG_ ReSideRdrRiDetn57_UB : 234|1@0+ (1,0) [0|1] "" ASDM,PAS
 SG_ ReSideRdrRiDetn57RdrDetnAzi : 199|11@0+ (0.1,-90.0) [-90.0|90.0] "Deg" ASDM,PAS
 SG_ ReSideRdrRiDetn57RdrDetnChks : 167|8@0+ (1.0,0.0) [0.0|255.0] "Unitless" ASDM,PAS
 SG_ ReSideRdrRiDetn57RdrDetnCntr : 175|4@0+ (1.0,0.0) [0.0|15.0] "Unitless" ASDM,PAS
 SG_ ReSideRdrRiDetn57RdrDetnConf : 191|7@0+ (1.0,0.0) [0.0|100.0] "%" ASDM,PAS
 SG_ ReSideRdrRiDetn57RdrDetnElevn : 239|5@0+ (1.0,-15.0) [-15.0|15.0] "Deg" ASDM,PAS
 SG_ ReSideRdrRiDetn57RdrDetnPwr : 169|9@0+ (0.1,0.0) [0.0|51.1] "dB" ASDM,PAS
 SG_ ReSideRdrRiDetn57RdrDetnRng : 223|14@0+ (0.02,-1.0) [-1.0|200.0] "m" ASDM,PAS
 SG_ ReSideRdrRiDetn57RdrDetnRngV : 204|13@0+ (0.02,-80.0) [-80.0|80.0] "m/s" ASDM,PAS
 SG_ ReSideRdrRiDetn57RdrDetnSts : 171|2@0+ (1,0) [0|3] "" ASDM,PAS
 SG_ ReSideRdrRiDetn58_UB : 314|1@0+ (1,0) [0|1] "" ASDM,PAS
 SG_ ReSideRdrRiDetn58RdrDetnAzi : 287|11@0+ (0.1,-90.0) [-90.0|90.0] "Deg" ASDM,PAS
 SG_ ReSideRdrRiDetn58RdrDetnChks : 247|8@0+ (1.0,0.0) [0.0|255.0] "Unitless" ASDM,PAS
 SG_ ReSideRdrRiDetn58RdrDetnCntr : 255|4@0+ (1.0,0.0) [0.0|15.0] "Unitless" ASDM,PAS
 SG_ ReSideRdrRiDetn58RdrDetnConf : 311|7@0+ (1.0,0.0) [0.0|100.0] "%" ASDM,PAS
 SG_ ReSideRdrRiDetn58RdrDetnElevn : 319|5@0+ (1.0,-15.0) [-15.0|15.0] "Deg" ASDM,PAS
 SG_ ReSideRdrRiDetn58RdrDetnPwr : 249|9@0+ (0.1,0.0) [0.0|51.1] "dB" ASDM,PAS
 SG_ ReSideRdrRiDetn58RdrDetnRng : 271|14@0+ (0.02,-1.0) [-1.0|200.0] "m" ASDM,PAS
 SG_ ReSideRdrRiDetn58RdrDetnRngV : 292|13@0+ (0.02,-80.0) [-80.0|80.0] "m/s" ASDM,PAS
 SG_ ReSideRdrRiDetn58RdrDetnSts : 251|2@0+ (1,0) [0|3] "" ASDM,PAS
 SG_ ReSideRdrRiDetn59_UB : 394|1@0+ (1,0) [0|1] "" ASDM,PAS
 SG_ ReSideRdrRiDetn59RdrDetnAzi : 351|11@0+ (0.1,-90.0) [-90.0|90.0] "Deg" ASDM,PAS
 SG_ ReSideRdrRiDetn59RdrDetnChks : 327|8@0+ (1.0,0.0) [0.0|255.0] "Unitless" ASDM,PAS
 SG_ ReSideRdrRiDetn59RdrDetnCntr : 335|4@0+ (1.0,0.0) [0.0|15.0] "Unitless" ASDM,PAS
 SG_ ReSideRdrRiDetn59RdrDetnConf : 391|7@0+ (1.0,0.0) [0.0|100.0] "%" ASDM,PAS
 SG_ ReSideRdrRiDetn59RdrDetnElevn : 399|5@0+ (1.0,-15.0) [-15.0|15.0] "Deg" ASDM,PAS
 SG_ ReSideRdrRiDetn59RdrDetnPwr : 329|9@0+ (0.1,0.0) [0.0|51.1] "dB" ASDM,PAS
 SG_ ReSideRdrRiDetn59RdrDetnRng : 375|14@0+ (0.02,-1.0) [-1.0|200.0] "m" ASDM,PAS
 SG_ ReSideRdrRiDetn59RdrDetnRngV : 356|13@0+ (0.02,-80.0) [-80.0|80.0] "m/s" ASDM,PAS
 SG_ ReSideRdrRiDetn59RdrDetnSts : 331|2@0+ (1,0) [0|3] "" ASDM,PAS
 SG_ ReSideRdrRiDetn60_UB : 474|1@0+ (1,0) [0|1] "" ASDM,PAS
 SG_ ReSideRdrRiDetn60RdrDetnAzi : 447|11@0+ (0.1,-90.0) [-90.0|90.0] "Deg" ASDM,PAS
 SG_ ReSideRdrRiDetn60RdrDetnChks : 407|8@0+ (1.0,0.0) [0.0|255.0] "Unitless" ASDM,PAS
 SG_ ReSideRdrRiDetn60RdrDetnCntr : 415|4@0+ (1.0,0.0) [0.0|15.0] "Unitless" ASDM,PAS
 SG_ ReSideRdrRiDetn60RdrDetnConf : 471|7@0+ (1.0,0.0) [0.0|100.0] "%" ASDM,PAS
 SG_ ReSideRdrRiDetn60RdrDetnElevn : 479|5@0+ (1.0,-15.0) [-15.0|15.0] "Deg" ASDM,PAS
 SG_ ReSideRdrRiDetn60RdrDetnPwr : 409|9@0+ (0.1,0.0) [0.0|51.1] "dB" ASDM,PAS
 SG_ ReSideRdrRiDetn60RdrDetnRng : 431|14@0+ (0.02,-1.0) [-1.0|200.0] "m" ASDM,PAS
 SG_ ReSideRdrRiDetn60RdrDetnRngV : 452|13@0+ (0.02,-80.0) [-80.0|80.0] "m/s" ASDM,PAS
 SG_ ReSideRdrRiDetn60RdrDetnSts : 411|2@0+ (1,0) [0|3] "" ASDM,PAS

BO_ 325 SODRSafetyCANFD3Frame11: 64 SODR
 SG_ ReSideRdrRiDetn61_UB : 74|1@0+ (1,0) [0|1] "" ASDM,PAS
 SG_ ReSideRdrRiDetn61RdrDetnAzi : 31|11@0+ (0.1,-90.0) [-90.0|90.0] "Deg" ASDM,PAS
 SG_ ReSideRdrRiDetn61RdrDetnChks : 7|8@0+ (1.0,0.0) [0.0|255.0] "Unitless" ASDM,PAS
 SG_ ReSideRdrRiDetn61RdrDetnCntr : 15|4@0+ (1.0,0.0) [0.0|15.0] "Unitless" ASDM,PAS
 SG_ ReSideRdrRiDetn61RdrDetnConf : 71|7@0+ (1.0,0.0) [0.0|100.0] "%" ASDM,PAS
 SG_ ReSideRdrRiDetn61RdrDetnElevn : 79|5@0+ (1.0,-15.0) [-15.0|15.0] "Deg" ASDM,PAS
 SG_ ReSideRdrRiDetn61RdrDetnPwr : 8|9@0+ (0.1,0.0) [0.0|51.1] "dB" ASDM,PAS
 SG_ ReSideRdrRiDetn61RdrDetnRng : 55|14@0+ (0.02,-1.0) [-1.0|200.0] "m" ASDM,PAS
 SG_ ReSideRdrRiDetn61RdrDetnRngV : 36|13@0+ (0.02,-80.0) [-80.0|80.0] "m/s" ASDM,PAS
 SG_ ReSideRdrRiDetn61RdrDetnSts : 11|2@0+ (1,0) [0|3] "" ASDM,PAS
 SG_ ReSideRdrRiDetn62_UB : 154|1@0+ (1,0) [0|1] "" ASDM,PAS
 SG_ ReSideRdrRiDetn62RdrDetnAzi : 119|11@0+ (0.1,-90.0) [-90.0|90.0] "Deg" ASDM,PAS
 SG_ ReSideRdrRiDetn62RdrDetnChks : 87|8@0+ (1.0,0.0) [0.0|255.0] "Unitless" ASDM,PAS
 SG_ ReSideRdrRiDetn62RdrDetnCntr : 95|4@0+ (1.0,0.0) [0.0|15.0] "Unitless" ASDM,PAS
 SG_ ReSideRdrRiDetn62RdrDetnConf : 111|7@0+ (1.0,0.0) [0.0|100.0] "%" ASDM,PAS
 SG_ ReSideRdrRiDetn62RdrDetnElevn : 159|5@0+ (1.0,-15.0) [-15.0|15.0] "Deg" ASDM,PAS
 SG_ ReSideRdrRiDetn62RdrDetnPwr : 89|9@0+ (0.1,0.0) [0.0|51.1] "dB" ASDM,PAS
 SG_ ReSideRdrRiDetn62RdrDetnRng : 143|14@0+ (0.02,-1.0) [-1.0|200.0] "m" ASDM,PAS
 SG_ ReSideRdrRiDetn62RdrDetnRngV : 124|13@0+ (0.02,-80.0) [-80.0|80.0] "m/s" ASDM,PAS
 SG_ ReSideRdrRiDetn62RdrDetnSts : 91|2@0+ (1,0) [0|3] "" ASDM,PAS
 SG_ ReSideRdrRiDetn63_UB : 234|1@0+ (1,0) [0|1] "" ASDM,PAS
 SG_ ReSideRdrRiDetn63RdrDetnAzi : 199|11@0+ (0.1,-90.0) [-90.0|90.0] "Deg" ASDM,PAS
 SG_ ReSideRdrRiDetn63RdrDetnChks : 167|8@0+ (1.0,0.0) [0.0|255.0] "Unitless" ASDM,PAS
 SG_ ReSideRdrRiDetn63RdrDetnCntr : 175|4@0+ (1.0,0.0) [0.0|15.0] "Unitless" ASDM,PAS
 SG_ ReSideRdrRiDetn63RdrDetnConf : 191|7@0+ (1.0,0.0) [0.0|100.0] "%" ASDM,PAS
 SG_ ReSideRdrRiDetn63RdrDetnElevn : 239|5@0+ (1.0,-15.0) [-15.0|15.0] "Deg" ASDM,PAS
 SG_ ReSideRdrRiDetn63RdrDetnPwr : 169|9@0+ (0.1,0.0) [0.0|51.1] "dB" ASDM,PAS
 SG_ ReSideRdrRiDetn63RdrDetnRng : 223|14@0+ (0.02,-1.0) [-1.0|200.0] "m" ASDM,PAS
 SG_ ReSideRdrRiDetn63RdrDetnRngV : 204|13@0+ (0.02,-80.0) [-80.0|80.0] "m/s" ASDM,PAS
 SG_ ReSideRdrRiDetn63RdrDetnSts : 171|2@0+ (1,0) [0|3] "" ASDM,PAS
 SG_ ReSideRdrRiDetn64_UB : 314|1@0+ (1,0) [0|1] "" ASDM,PAS
 SG_ ReSideRdrRiDetn64RdrDetnAzi : 287|11@0+ (0.1,-90.0) [-90.0|90.0] "Deg" ASDM,PAS
 SG_ ReSideRdrRiDetn64RdrDetnChks : 247|8@0+ (1.0,0.0) [0.0|255.0] "Unitless" ASDM,PAS
 SG_ ReSideRdrRiDetn64RdrDetnCntr : 255|4@0+ (1.0,0.0) [0.0|15.0] "Unitless" ASDM,PAS
 SG_ ReSideRdrRiDetn64RdrDetnConf : 311|7@0+ (1.0,0.0) [0.0|100.0] "%" ASDM,PAS
 SG_ ReSideRdrRiDetn64RdrDetnElevn : 319|5@0+ (1.0,-15.0) [-15.0|15.0] "Deg" ASDM,PAS
 SG_ ReSideRdrRiDetn64RdrDetnPwr : 249|9@0+ (0.1,0.0) [0.0|51.1] "dB" ASDM,PAS
 SG_ ReSideRdrRiDetn64RdrDetnRng : 271|14@0+ (0.02,-1.0) [-1.0|200.0] "m" ASDM,PAS
 SG_ ReSideRdrRiDetn64RdrDetnRngV : 292|13@0+ (0.02,-80.0) [-80.0|80.0] "m/s" ASDM,PAS
 SG_ ReSideRdrRiDetn64RdrDetnSts : 251|2@0+ (1,0) [0|3] "" ASDM,PAS
 SG_ ReSideRdrRiDetn65_UB : 394|1@0+ (1,0) [0|1] "" ASDM,PAS
 SG_ ReSideRdrRiDetn65RdrDetnAzi : 351|11@0+ (0.1,-90.0) [-90.0|90.0] "Deg" ASDM,PAS
 SG_ ReSideRdrRiDetn65RdrDetnChks : 327|8@0+ (1.0,0.0) [0.0|255.0] "Unitless" ASDM,PAS
 SG_ ReSideRdrRiDetn65RdrDetnCntr : 335|4@0+ (1.0,0.0) [0.0|15.0] "Unitless" ASDM,PAS
 SG_ ReSideRdrRiDetn65RdrDetnConf : 391|7@0+ (1.0,0.0) [0.0|100.0] "%" ASDM,PAS
 SG_ ReSideRdrRiDetn65RdrDetnElevn : 399|5@0+ (1.0,-15.0) [-15.0|15.0] "Deg" ASDM,PAS
 SG_ ReSideRdrRiDetn65RdrDetnPwr : 329|9@0+ (0.1,0.0) [0.0|51.1] "dB" ASDM,PAS
 SG_ ReSideRdrRiDetn65RdrDetnRng : 375|14@0+ (0.02,-1.0) [-1.0|200.0] "m" ASDM,PAS
 SG_ ReSideRdrRiDetn65RdrDetnRngV : 356|13@0+ (0.02,-80.0) [-80.0|80.0] "m/s" ASDM,PAS
 SG_ ReSideRdrRiDetn65RdrDetnSts : 331|2@0+ (1,0) [0|3] "" ASDM,PAS
 SG_ ReSideRdrRiDetn66_UB : 474|1@0+ (1,0) [0|1] "" ASDM,PAS
 SG_ ReSideRdrRiDetn66RdrDetnAzi : 447|11@0+ (0.1,-90.0) [-90.0|90.0] "Deg" ASDM,PAS
 SG_ ReSideRdrRiDetn66RdrDetnChks : 407|8@0+ (1.0,0.0) [0.0|255.0] "Unitless" ASDM,PAS
 SG_ ReSideRdrRiDetn66RdrDetnCntr : 415|4@0+ (1.0,0.0) [0.0|15.0] "Unitless" ASDM,PAS
 SG_ ReSideRdrRiDetn66RdrDetnConf : 471|7@0+ (1.0,0.0) [0.0|100.0] "%" ASDM,PAS
 SG_ ReSideRdrRiDetn66RdrDetnElevn : 479|5@0+ (1.0,-15.0) [-15.0|15.0] "Deg" ASDM,PAS
 SG_ ReSideRdrRiDetn66RdrDetnPwr : 409|9@0+ (0.1,0.0) [0.0|51.1] "dB" ASDM,PAS
 SG_ ReSideRdrRiDetn66RdrDetnRng : 431|14@0+ (0.02,-1.0) [-1.0|200.0] "m" ASDM,PAS
 SG_ ReSideRdrRiDetn66RdrDetnRngV : 452|13@0+ (0.02,-80.0) [-80.0|80.0] "m/s" ASDM,PAS
 SG_ ReSideRdrRiDetn66RdrDetnSts : 411|2@0+ (1,0) [0|3] "" ASDM,PAS

BO_ 327 SODRSafetyCANFD3Frame12: 64 SODR
 SG_ ReSideRdrRiDetn67_UB : 74|1@0+ (1,0) [0|1] "" ASDM,PAS
 SG_ ReSideRdrRiDetn67RdrDetnAzi : 31|11@0+ (0.1,-90.0) [-90.0|90.0] "Deg" ASDM,PAS
 SG_ ReSideRdrRiDetn67RdrDetnChks : 7|8@0+ (1.0,0.0) [0.0|255.0] "Unitless" ASDM,PAS
 SG_ ReSideRdrRiDetn67RdrDetnCntr : 15|4@0+ (1.0,0.0) [0.0|15.0] "Unitless" ASDM,PAS
 SG_ ReSideRdrRiDetn67RdrDetnConf : 71|7@0+ (1.0,0.0) [0.0|100.0] "%" ASDM,PAS
 SG_ ReSideRdrRiDetn67RdrDetnElevn : 79|5@0+ (1.0,-15.0) [-15.0|15.0] "Deg" ASDM,PAS
 SG_ ReSideRdrRiDetn67RdrDetnPwr : 8|9@0+ (0.1,0.0) [0.0|51.1] "dB" ASDM,PAS
 SG_ ReSideRdrRiDetn67RdrDetnRng : 55|14@0+ (0.02,-1.0) [-1.0|200.0] "m" ASDM,PAS
 SG_ ReSideRdrRiDetn67RdrDetnRngV : 36|13@0+ (0.02,-80.0) [-80.0|80.0] "m/s" ASDM,PAS
 SG_ ReSideRdrRiDetn67RdrDetnSts : 11|2@0+ (1,0) [0|3] "" ASDM,PAS
 SG_ ReSideRdrRiDetn68_UB : 154|1@0+ (1,0) [0|1] "" ASDM,PAS
 SG_ ReSideRdrRiDetn68RdrDetnAzi : 119|11@0+ (0.1,-90.0) [-90.0|90.0] "Deg" ASDM,PAS
 SG_ ReSideRdrRiDetn68RdrDetnChks : 87|8@0+ (1.0,0.0) [0.0|255.0] "Unitless" ASDM,PAS
 SG_ ReSideRdrRiDetn68RdrDetnCntr : 95|4@0+ (1.0,0.0) [0.0|15.0] "Unitless" ASDM,PAS
 SG_ ReSideRdrRiDetn68RdrDetnConf : 111|7@0+ (1.0,0.0) [0.0|100.0] "%" ASDM,PAS
 SG_ ReSideRdrRiDetn68RdrDetnElevn : 159|5@0+ (1.0,-15.0) [-15.0|15.0] "Deg" ASDM,PAS
 SG_ ReSideRdrRiDetn68RdrDetnPwr : 89|9@0+ (0.1,0.0) [0.0|51.1] "dB" ASDM,PAS
 SG_ ReSideRdrRiDetn68RdrDetnRng : 143|14@0+ (0.02,-1.0) [-1.0|200.0] "m" ASDM,PAS
 SG_ ReSideRdrRiDetn68RdrDetnRngV : 124|13@0+ (0.02,-80.0) [-80.0|80.0] "m/s" ASDM,PAS
 SG_ ReSideRdrRiDetn68RdrDetnSts : 91|2@0+ (1,0) [0|3] "" ASDM,PAS
 SG_ ReSideRdrRiDetn69_UB : 234|1@0+ (1,0) [0|1] "" ASDM,PAS
 SG_ ReSideRdrRiDetn69RdrDetnAzi : 199|11@0+ (0.1,-90.0) [-90.0|90.0] "Deg" ASDM,PAS
 SG_ ReSideRdrRiDetn69RdrDetnChks : 167|8@0+ (1.0,0.0) [0.0|255.0] "Unitless" ASDM,PAS
 SG_ ReSideRdrRiDetn69RdrDetnCntr : 175|4@0+ (1.0,0.0) [0.0|15.0] "Unitless" ASDM,PAS
 SG_ ReSideRdrRiDetn69RdrDetnConf : 191|7@0+ (1.0,0.0) [0.0|100.0] "%" ASDM,PAS
 SG_ ReSideRdrRiDetn69RdrDetnElevn : 239|5@0+ (1.0,-15.0) [-15.0|15.0] "Deg" ASDM,PAS
 SG_ ReSideRdrRiDetn69RdrDetnPwr : 169|9@0+ (0.1,0.0) [0.0|51.1] "dB" ASDM,PAS
 SG_ ReSideRdrRiDetn69RdrDetnRng : 223|14@0+ (0.02,-1.0) [-1.0|200.0] "m" ASDM,PAS
 SG_ ReSideRdrRiDetn69RdrDetnRngV : 204|13@0+ (0.02,-80.0) [-80.0|80.0] "m/s" ASDM,PAS
 SG_ ReSideRdrRiDetn69RdrDetnSts : 171|2@0+ (1,0) [0|3] "" ASDM,PAS
 SG_ ReSideRdrRiDetn70_UB : 314|1@0+ (1,0) [0|1] "" ASDM,PAS
 SG_ ReSideRdrRiDetn70RdrDetnAzi : 287|11@0+ (0.1,-90.0) [-90.0|90.0] "Deg" ASDM,PAS
 SG_ ReSideRdrRiDetn70RdrDetnChks : 247|8@0+ (1.0,0.0) [0.0|255.0] "Unitless" ASDM,PAS
 SG_ ReSideRdrRiDetn70RdrDetnCntr : 255|4@0+ (1.0,0.0) [0.0|15.0] "Unitless" ASDM,PAS
 SG_ ReSideRdrRiDetn70RdrDetnConf : 311|7@0+ (1.0,0.0) [0.0|100.0] "%" ASDM,PAS
 SG_ ReSideRdrRiDetn70RdrDetnElevn : 319|5@0+ (1.0,-15.0) [-15.0|15.0] "Deg" ASDM,PAS
 SG_ ReSideRdrRiDetn70RdrDetnPwr : 249|9@0+ (0.1,0.0) [0.0|51.1] "dB" ASDM,PAS
 SG_ ReSideRdrRiDetn70RdrDetnRng : 271|14@0+ (0.02,-1.0) [-1.0|200.0] "m" ASDM,PAS
 SG_ ReSideRdrRiDetn70RdrDetnRngV : 292|13@0+ (0.02,-80.0) [-80.0|80.0] "m/s" ASDM,PAS
 SG_ ReSideRdrRiDetn70RdrDetnSts : 251|2@0+ (1,0) [0|3] "" ASDM,PAS
 SG_ ReSideRdrRiDetn71_UB : 394|1@0+ (1,0) [0|1] "" ASDM,PAS
 SG_ ReSideRdrRiDetn71RdrDetnAzi : 351|11@0+ (0.1,-90.0) [-90.0|90.0] "Deg" ASDM,PAS
 SG_ ReSideRdrRiDetn71RdrDetnChks : 327|8@0+ (1.0,0.0) [0.0|255.0] "Unitless" ASDM,PAS
 SG_ ReSideRdrRiDetn71RdrDetnCntr : 335|4@0+ (1.0,0.0) [0.0|15.0] "Unitless" ASDM,PAS
 SG_ ReSideRdrRiDetn71RdrDetnConf : 391|7@0+ (1.0,0.0) [0.0|100.0] "%" ASDM,PAS
 SG_ ReSideRdrRiDetn71RdrDetnElevn : 399|5@0+ (1.0,-15.0) [-15.0|15.0] "Deg" ASDM,PAS
 SG_ ReSideRdrRiDetn71RdrDetnPwr : 329|9@0+ (0.1,0.0) [0.0|51.1] "dB" ASDM,PAS
 SG_ ReSideRdrRiDetn71RdrDetnRng : 375|14@0+ (0.02,-1.0) [-1.0|200.0] "m" ASDM,PAS
 SG_ ReSideRdrRiDetn71RdrDetnRngV : 356|13@0+ (0.02,-80.0) [-80.0|80.0] "m/s" ASDM,PAS
 SG_ ReSideRdrRiDetn71RdrDetnSts : 331|2@0+ (1,0) [0|3] "" ASDM,PAS
 SG_ ReSideRdrRiDetn72_UB : 474|1@0+ (1,0) [0|1] "" ASDM,PAS
 SG_ ReSideRdrRiDetn72RdrDetnAzi : 447|11@0+ (0.1,-90.0) [-90.0|90.0] "Deg" ASDM,PAS
 SG_ ReSideRdrRiDetn72RdrDetnChks : 407|8@0+ (1.0,0.0) [0.0|255.0] "Unitless" ASDM,PAS
 SG_ ReSideRdrRiDetn72RdrDetnCntr : 415|4@0+ (1.0,0.0) [0.0|15.0] "Unitless" ASDM,PAS
 SG_ ReSideRdrRiDetn72RdrDetnConf : 471|7@0+ (1.0,0.0) [0.0|100.0] "%" ASDM,PAS
 SG_ ReSideRdrRiDetn72RdrDetnElevn : 479|5@0+ (1.0,-15.0) [-15.0|15.0] "Deg" ASDM,PAS
 SG_ ReSideRdrRiDetn72RdrDetnPwr : 409|9@0+ (0.1,0.0) [0.0|51.1] "dB" ASDM,PAS
 SG_ ReSideRdrRiDetn72RdrDetnRng : 431|14@0+ (0.02,-1.0) [-1.0|200.0] "m" ASDM,PAS
 SG_ ReSideRdrRiDetn72RdrDetnRngV : 452|13@0+ (0.02,-80.0) [-80.0|80.0] "m/s" ASDM,PAS
 SG_ ReSideRdrRiDetn72RdrDetnSts : 411|2@0+ (1,0) [0|3] "" ASDM,PAS

BO_ 329 SODRSafetyCANFD3Frame13: 64 SODR
 SG_ ReSideRdrRiDetn73_UB : 74|1@0+ (1,0) [0|1] "" ASDM,PAS
 SG_ ReSideRdrRiDetn73RdrDetnAzi : 31|11@0+ (0.1,-90.0) [-90.0|90.0] "Deg" ASDM,PAS
 SG_ ReSideRdrRiDetn73RdrDetnChks : 7|8@0+ (1.0,0.0) [0.0|255.0] "Unitless" ASDM,PAS
 SG_ ReSideRdrRiDetn73RdrDetnCntr : 15|4@0+ (1.0,0.0) [0.0|15.0] "Unitless" ASDM,PAS
 SG_ ReSideRdrRiDetn73RdrDetnConf : 71|7@0+ (1.0,0.0) [0.0|100.0] "%" ASDM,PAS
 SG_ ReSideRdrRiDetn73RdrDetnElevn : 79|5@0+ (1.0,-15.0) [-15.0|15.0] "Deg" ASDM,PAS
 SG_ ReSideRdrRiDetn73RdrDetnPwr : 8|9@0+ (0.1,0.0) [0.0|51.1] "dB" ASDM,PAS
 SG_ ReSideRdrRiDetn73RdrDetnRng : 55|14@0+ (0.02,-1.0) [-1.0|200.0] "m" ASDM,PAS
 SG_ ReSideRdrRiDetn73RdrDetnRngV : 36|13@0+ (0.02,-80.0) [-80.0|80.0] "m/s" ASDM,PAS
 SG_ ReSideRdrRiDetn73RdrDetnSts : 11|2@0+ (1,0) [0|3] "" ASDM,PAS
 SG_ ReSideRdrRiDetn74_UB : 154|1@0+ (1,0) [0|1] "" ASDM,PAS
 SG_ ReSideRdrRiDetn74RdrDetnAzi : 119|11@0+ (0.1,-90.0) [-90.0|90.0] "Deg" ASDM,PAS
 SG_ ReSideRdrRiDetn74RdrDetnChks : 87|8@0+ (1.0,0.0) [0.0|255.0] "Unitless" ASDM,PAS
 SG_ ReSideRdrRiDetn74RdrDetnCntr : 95|4@0+ (1.0,0.0) [0.0|15.0] "Unitless" ASDM,PAS
 SG_ ReSideRdrRiDetn74RdrDetnConf : 111|7@0+ (1.0,0.0) [0.0|100.0] "%" ASDM,PAS
 SG_ ReSideRdrRiDetn74RdrDetnElevn : 159|5@0+ (1.0,-15.0) [-15.0|15.0] "Deg" ASDM,PAS
 SG_ ReSideRdrRiDetn74RdrDetnPwr : 89|9@0+ (0.1,0.0) [0.0|51.1] "dB" ASDM,PAS
 SG_ ReSideRdrRiDetn74RdrDetnRng : 143|14@0+ (0.02,-1.0) [-1.0|200.0] "m" ASDM,PAS
 SG_ ReSideRdrRiDetn74RdrDetnRngV : 124|13@0+ (0.02,-80.0) [-80.0|80.0] "m/s" ASDM,PAS
 SG_ ReSideRdrRiDetn74RdrDetnSts : 91|2@0+ (1,0) [0|3] "" ASDM,PAS
 SG_ ReSideRdrRiDetn75_UB : 234|1@0+ (1,0) [0|1] "" ASDM,PAS
 SG_ ReSideRdrRiDetn75RdrDetnAzi : 199|11@0+ (0.1,-90.0) [-90.0|90.0] "Deg" ASDM,PAS
 SG_ ReSideRdrRiDetn75RdrDetnChks : 167|8@0+ (1.0,0.0) [0.0|255.0] "Unitless" ASDM,PAS
 SG_ ReSideRdrRiDetn75RdrDetnCntr : 175|4@0+ (1.0,0.0) [0.0|15.0] "Unitless" ASDM,PAS
 SG_ ReSideRdrRiDetn75RdrDetnConf : 191|7@0+ (1.0,0.0) [0.0|100.0] "%" ASDM,PAS
 SG_ ReSideRdrRiDetn75RdrDetnElevn : 239|5@0+ (1.0,-15.0) [-15.0|15.0] "Deg" ASDM,PAS
 SG_ ReSideRdrRiDetn75RdrDetnPwr : 169|9@0+ (0.1,0.0) [0.0|51.1] "dB" ASDM,PAS
 SG_ ReSideRdrRiDetn75RdrDetnRng : 223|14@0+ (0.02,-1.0) [-1.0|200.0] "m" ASDM,PAS
 SG_ ReSideRdrRiDetn75RdrDetnRngV : 204|13@0+ (0.02,-80.0) [-80.0|80.0] "m/s" ASDM,PAS
 SG_ ReSideRdrRiDetn75RdrDetnSts : 171|2@0+ (1,0) [0|3] "" ASDM,PAS
 SG_ ReSideRdrRiDetn76_UB : 314|1@0+ (1,0) [0|1] "" ASDM,PAS
 SG_ ReSideRdrRiDetn76RdrDetnAzi : 287|11@0+ (0.1,-90.0) [-90.0|90.0] "Deg" ASDM,PAS
 SG_ ReSideRdrRiDetn76RdrDetnChks : 247|8@0+ (1.0,0.0) [0.0|255.0] "Unitless" ASDM,PAS
 SG_ ReSideRdrRiDetn76RdrDetnCntr : 255|4@0+ (1.0,0.0) [0.0|15.0] "Unitless" ASDM,PAS
 SG_ ReSideRdrRiDetn76RdrDetnConf : 311|7@0+ (1.0,0.0) [0.0|100.0] "%" ASDM,PAS
 SG_ ReSideRdrRiDetn76RdrDetnElevn : 319|5@0+ (1.0,-15.0) [-15.0|15.0] "Deg" ASDM,PAS
 SG_ ReSideRdrRiDetn76RdrDetnPwr : 249|9@0+ (0.1,0.0) [0.0|51.1] "dB" ASDM,PAS
 SG_ ReSideRdrRiDetn76RdrDetnRng : 271|14@0+ (0.02,-1.0) [-1.0|200.0] "m" ASDM,PAS
 SG_ ReSideRdrRiDetn76RdrDetnRngV : 292|13@0+ (0.02,-80.0) [-80.0|80.0] "m/s" ASDM,PAS
 SG_ ReSideRdrRiDetn76RdrDetnSts : 251|2@0+ (1,0) [0|3] "" ASDM,PAS
 SG_ ReSideRdrRiDetn77_UB : 394|1@0+ (1,0) [0|1] "" ASDM,PAS
 SG_ ReSideRdrRiDetn77RdrDetnAzi : 351|11@0+ (0.1,-90.0) [-90.0|90.0] "Deg" ASDM,PAS
 SG_ ReSideRdrRiDetn77RdrDetnChks : 327|8@0+ (1.0,0.0) [0.0|255.0] "Unitless" ASDM,PAS
 SG_ ReSideRdrRiDetn77RdrDetnCntr : 335|4@0+ (1.0,0.0) [0.0|15.0] "Unitless" ASDM,PAS
 SG_ ReSideRdrRiDetn77RdrDetnConf : 391|7@0+ (1.0,0.0) [0.0|100.0] "%" ASDM,PAS
 SG_ ReSideRdrRiDetn77RdrDetnElevn : 399|5@0+ (1.0,-15.0) [-15.0|15.0] "Deg" ASDM,PAS
 SG_ ReSideRdrRiDetn77RdrDetnPwr : 329|9@0+ (0.1,0.0) [0.0|51.1] "dB" ASDM,PAS
 SG_ ReSideRdrRiDetn77RdrDetnRng : 375|14@0+ (0.02,-1.0) [-1.0|200.0] "m" ASDM,PAS
 SG_ ReSideRdrRiDetn77RdrDetnRngV : 356|13@0+ (0.02,-80.0) [-80.0|80.0] "m/s" ASDM,PAS
 SG_ ReSideRdrRiDetn77RdrDetnSts : 331|2@0+ (1,0) [0|3] "" ASDM,PAS
 SG_ ReSideRdrRiDetn78_UB : 474|1@0+ (1,0) [0|1] "" ASDM,PAS
 SG_ ReSideRdrRiDetn78RdrDetnAzi : 447|11@0+ (0.1,-90.0) [-90.0|90.0] "Deg" ASDM,PAS
 SG_ ReSideRdrRiDetn78RdrDetnChks : 407|8@0+ (1.0,0.0) [0.0|255.0] "Unitless" ASDM,PAS
 SG_ ReSideRdrRiDetn78RdrDetnCntr : 415|4@0+ (1.0,0.0) [0.0|15.0] "Unitless" ASDM,PAS
 SG_ ReSideRdrRiDetn78RdrDetnConf : 471|7@0+ (1.0,0.0) [0.0|100.0] "%" ASDM,PAS
 SG_ ReSideRdrRiDetn78RdrDetnElevn : 479|5@0+ (1.0,-15.0) [-15.0|15.0] "Deg" ASDM,PAS
 SG_ ReSideRdrRiDetn78RdrDetnPwr : 409|9@0+ (0.1,0.0) [0.0|51.1] "dB" ASDM,PAS
 SG_ ReSideRdrRiDetn78RdrDetnRng : 431|14@0+ (0.02,-1.0) [-1.0|200.0] "m" ASDM,PAS
 SG_ ReSideRdrRiDetn78RdrDetnRngV : 452|13@0+ (0.02,-80.0) [-80.0|80.0] "m/s" ASDM,PAS
 SG_ ReSideRdrRiDetn78RdrDetnSts : 411|2@0+ (1,0) [0|3] "" ASDM,PAS

BO_ 331 SODRSafetyCANFD3Frame14: 64 SODR
 SG_ ReSideRdrRiDetn79_UB : 74|1@0+ (1,0) [0|1] "" ASDM,PAS
 SG_ ReSideRdrRiDetn79RdrDetnAzi : 31|11@0+ (0.1,-90.0) [-90.0|90.0] "Deg" ASDM,PAS
 SG_ ReSideRdrRiDetn79RdrDetnChks : 7|8@0+ (1.0,0.0) [0.0|255.0] "Unitless" ASDM,PAS
 SG_ ReSideRdrRiDetn79RdrDetnCntr : 15|4@0+ (1.0,0.0) [0.0|15.0] "Unitless" ASDM,PAS
 SG_ ReSideRdrRiDetn79RdrDetnConf : 71|7@0+ (1.0,0.0) [0.0|100.0] "%" ASDM,PAS
 SG_ ReSideRdrRiDetn79RdrDetnElevn : 79|5@0+ (1.0,-15.0) [-15.0|15.0] "Deg" ASDM,PAS
 SG_ ReSideRdrRiDetn79RdrDetnPwr : 8|9@0+ (0.1,0.0) [0.0|51.1] "dB" ASDM,PAS
 SG_ ReSideRdrRiDetn79RdrDetnRng : 55|14@0+ (0.02,-1.0) [-1.0|200.0] "m" ASDM,PAS
 SG_ ReSideRdrRiDetn79RdrDetnRngV : 36|13@0+ (0.02,-80.0) [-80.0|80.0] "m/s" ASDM,PAS
 SG_ ReSideRdrRiDetn79RdrDetnSts : 11|2@0+ (1,0) [0|3] "" ASDM,PAS
 SG_ ReSideRdrRiDetn80_UB : 154|1@0+ (1,0) [0|1] "" ASDM,PAS
 SG_ ReSideRdrRiDetn80RdrDetnAzi : 119|11@0+ (0.1,-90.0) [-90.0|90.0] "Deg" ASDM,PAS
 SG_ ReSideRdrRiDetn80RdrDetnChks : 87|8@0+ (1.0,0.0) [0.0|255.0] "Unitless" ASDM,PAS
 SG_ ReSideRdrRiDetn80RdrDetnCntr : 95|4@0+ (1.0,0.0) [0.0|15.0] "Unitless" ASDM,PAS
 SG_ ReSideRdrRiDetn80RdrDetnConf : 111|7@0+ (1.0,0.0) [0.0|100.0] "%" ASDM,PAS
 SG_ ReSideRdrRiDetn80RdrDetnElevn : 159|5@0+ (1.0,-15.0) [-15.0|15.0] "Deg" ASDM,PAS
 SG_ ReSideRdrRiDetn80RdrDetnPwr : 89|9@0+ (0.1,0.0) [0.0|51.1] "dB" ASDM,PAS
 SG_ ReSideRdrRiDetn80RdrDetnRng : 143|14@0+ (0.02,-1.0) [-1.0|200.0] "m" ASDM,PAS
 SG_ ReSideRdrRiDetn80RdrDetnRngV : 124|13@0+ (0.02,-80.0) [-80.0|80.0] "m/s" ASDM,PAS
 SG_ ReSideRdrRiDetn80RdrDetnSts : 91|2@0+ (1,0) [0|3] "" ASDM,PAS
 SG_ ReSideRdrRiDetn81_UB : 234|1@0+ (1,0) [0|1] "" ASDM,PAS
 SG_ ReSideRdrRiDetn81RdrDetnAzi : 199|11@0+ (0.1,-90.0) [-90.0|90.0] "Deg" ASDM,PAS
 SG_ ReSideRdrRiDetn81RdrDetnChks : 167|8@0+ (1.0,0.0) [0.0|255.0] "Unitless" ASDM,PAS
 SG_ ReSideRdrRiDetn81RdrDetnCntr : 175|4@0+ (1.0,0.0) [0.0|15.0] "Unitless" ASDM,PAS
 SG_ ReSideRdrRiDetn81RdrDetnConf : 191|7@0+ (1.0,0.0) [0.0|100.0] "%" ASDM,PAS
 SG_ ReSideRdrRiDetn81RdrDetnElevn : 239|5@0+ (1.0,-15.0) [-15.0|15.0] "Deg" ASDM,PAS
 SG_ ReSideRdrRiDetn81RdrDetnPwr : 169|9@0+ (0.1,0.0) [0.0|51.1] "dB" ASDM,PAS
 SG_ ReSideRdrRiDetn81RdrDetnRng : 223|14@0+ (0.02,-1.0) [-1.0|200.0] "m" ASDM,PAS
 SG_ ReSideRdrRiDetn81RdrDetnRngV : 204|13@0+ (0.02,-80.0) [-80.0|80.0] "m/s" ASDM,PAS
 SG_ ReSideRdrRiDetn81RdrDetnSts : 171|2@0+ (1,0) [0|3] "" ASDM,PAS
 SG_ ReSideRdrRiDetn82_UB : 314|1@0+ (1,0) [0|1] "" ASDM,PAS
 SG_ ReSideRdrRiDetn82RdrDetnAzi : 287|11@0+ (0.1,-90.0) [-90.0|90.0] "Deg" ASDM,PAS
 SG_ ReSideRdrRiDetn82RdrDetnChks : 247|8@0+ (1.0,0.0) [0.0|255.0] "Unitless" ASDM,PAS
 SG_ ReSideRdrRiDetn82RdrDetnCntr : 255|4@0+ (1.0,0.0) [0.0|15.0] "Unitless" ASDM,PAS
 SG_ ReSideRdrRiDetn82RdrDetnConf : 311|7@0+ (1.0,0.0) [0.0|100.0] "%" ASDM,PAS
 SG_ ReSideRdrRiDetn82RdrDetnElevn : 319|5@0+ (1.0,-15.0) [-15.0|15.0] "Deg" ASDM,PAS
 SG_ ReSideRdrRiDetn82RdrDetnPwr : 249|9@0+ (0.1,0.0) [0.0|51.1] "dB" ASDM,PAS
 SG_ ReSideRdrRiDetn82RdrDetnRng : 271|14@0+ (0.02,-1.0) [-1.0|200.0] "m" ASDM,PAS
 SG_ ReSideRdrRiDetn82RdrDetnRngV : 292|13@0+ (0.02,-80.0) [-80.0|80.0] "m/s" ASDM,PAS
 SG_ ReSideRdrRiDetn82RdrDetnSts : 251|2@0+ (1,0) [0|3] "" ASDM,PAS
 SG_ ReSideRdrRiDetn83_UB : 394|1@0+ (1,0) [0|1] "" ASDM,PAS
 SG_ ReSideRdrRiDetn83RdrDetnAzi : 351|11@0+ (0.1,-90.0) [-90.0|90.0] "Deg" ASDM,PAS
 SG_ ReSideRdrRiDetn83RdrDetnChks : 327|8@0+ (1.0,0.0) [0.0|255.0] "Unitless" ASDM,PAS
 SG_ ReSideRdrRiDetn83RdrDetnCntr : 335|4@0+ (1.0,0.0) [0.0|15.0] "Unitless" ASDM,PAS
 SG_ ReSideRdrRiDetn83RdrDetnConf : 391|7@0+ (1.0,0.0) [0.0|100.0] "%" ASDM,PAS
 SG_ ReSideRdrRiDetn83RdrDetnElevn : 399|5@0+ (1.0,-15.0) [-15.0|15.0] "Deg" ASDM,PAS
 SG_ ReSideRdrRiDetn83RdrDetnPwr : 329|9@0+ (0.1,0.0) [0.0|51.1] "dB" ASDM,PAS
 SG_ ReSideRdrRiDetn83RdrDetnRng : 375|14@0+ (0.02,-1.0) [-1.0|200.0] "m" ASDM,PAS
 SG_ ReSideRdrRiDetn83RdrDetnRngV : 356|13@0+ (0.02,-80.0) [-80.0|80.0] "m/s" ASDM,PAS
 SG_ ReSideRdrRiDetn83RdrDetnSts : 331|2@0+ (1,0) [0|3] "" ASDM,PAS
 SG_ ReSideRdrRiDetn84_UB : 474|1@0+ (1,0) [0|1] "" ASDM,PAS
 SG_ ReSideRdrRiDetn84RdrDetnAzi : 447|11@0+ (0.1,-90.0) [-90.0|90.0] "Deg" ASDM,PAS
 SG_ ReSideRdrRiDetn84RdrDetnChks : 407|8@0+ (1.0,0.0) [0.0|255.0] "Unitless" ASDM,PAS
 SG_ ReSideRdrRiDetn84RdrDetnCntr : 415|4@0+ (1.0,0.0) [0.0|15.0] "Unitless" ASDM,PAS
 SG_ ReSideRdrRiDetn84RdrDetnConf : 471|7@0+ (1.0,0.0) [0.0|100.0] "%" ASDM,PAS
 SG_ ReSideRdrRiDetn84RdrDetnElevn : 479|5@0+ (1.0,-15.0) [-15.0|15.0] "Deg" ASDM,PAS
 SG_ ReSideRdrRiDetn84RdrDetnPwr : 409|9@0+ (0.1,0.0) [0.0|51.1] "dB" ASDM,PAS
 SG_ ReSideRdrRiDetn84RdrDetnRng : 431|14@0+ (0.02,-1.0) [-1.0|200.0] "m" ASDM,PAS
 SG_ ReSideRdrRiDetn84RdrDetnRngV : 452|13@0+ (0.02,-80.0) [-80.0|80.0] "m/s" ASDM,PAS
 SG_ ReSideRdrRiDetn84RdrDetnSts : 411|2@0+ (1,0) [0|3] "" ASDM,PAS

BO_ 333 SODRSafetyCANFD3Frame15: 64 SODR
 SG_ ReSideRdrRiDetn85_UB : 74|1@0+ (1,0) [0|1] "" ASDM,PAS
 SG_ ReSideRdrRiDetn85RdrDetnAzi : 31|11@0+ (0.1,-90.0) [-90.0|90.0] "Deg" ASDM,PAS
 SG_ ReSideRdrRiDetn85RdrDetnChks : 7|8@0+ (1.0,0.0) [0.0|255.0] "Unitless" ASDM,PAS
 SG_ ReSideRdrRiDetn85RdrDetnCntr : 15|4@0+ (1.0,0.0) [0.0|15.0] "Unitless" ASDM,PAS
 SG_ ReSideRdrRiDetn85RdrDetnConf : 71|7@0+ (1.0,0.0) [0.0|100.0] "%" ASDM,PAS
 SG_ ReSideRdrRiDetn85RdrDetnElevn : 79|5@0+ (1.0,-15.0) [-15.0|15.0] "Deg" ASDM,PAS
 SG_ ReSideRdrRiDetn85RdrDetnPwr : 8|9@0+ (0.1,0.0) [0.0|51.1] "dB" ASDM,PAS
 SG_ ReSideRdrRiDetn85RdrDetnRng : 55|14@0+ (0.02,-1.0) [-1.0|200.0] "m" ASDM,PAS
 SG_ ReSideRdrRiDetn85RdrDetnRngV : 36|13@0+ (0.02,-80.0) [-80.0|80.0] "m/s" ASDM,PAS
 SG_ ReSideRdrRiDetn85RdrDetnSts : 11|2@0+ (1,0) [0|3] "" ASDM,PAS
 SG_ ReSideRdrRiDetn86_UB : 154|1@0+ (1,0) [0|1] "" ASDM,PAS
 SG_ ReSideRdrRiDetn86RdrDetnAzi : 119|11@0+ (0.1,-90.0) [-90.0|90.0] "Deg" ASDM,PAS
 SG_ ReSideRdrRiDetn86RdrDetnChks : 87|8@0+ (1.0,0.0) [0.0|255.0] "Unitless" ASDM,PAS
 SG_ ReSideRdrRiDetn86RdrDetnCntr : 95|4@0+ (1.0,0.0) [0.0|15.0] "Unitless" ASDM,PAS
 SG_ ReSideRdrRiDetn86RdrDetnConf : 111|7@0+ (1.0,0.0) [0.0|100.0] "%" ASDM,PAS
 SG_ ReSideRdrRiDetn86RdrDetnElevn : 159|5@0+ (1.0,-15.0) [-15.0|15.0] "Deg" ASDM,PAS
 SG_ ReSideRdrRiDetn86RdrDetnPwr : 89|9@0+ (0.1,0.0) [0.0|51.1] "dB" ASDM,PAS
 SG_ ReSideRdrRiDetn86RdrDetnRng : 143|14@0+ (0.02,-1.0) [-1.0|200.0] "m" ASDM,PAS
 SG_ ReSideRdrRiDetn86RdrDetnRngV : 124|13@0+ (0.02,-80.0) [-80.0|80.0] "m/s" ASDM,PAS
 SG_ ReSideRdrRiDetn86RdrDetnSts : 91|2@0+ (1,0) [0|3] "" ASDM,PAS
 SG_ ReSideRdrRiDetn87_UB : 234|1@0+ (1,0) [0|1] "" ASDM,PAS
 SG_ ReSideRdrRiDetn87RdrDetnAzi : 199|11@0+ (0.1,-90.0) [-90.0|90.0] "Deg" ASDM,PAS
 SG_ ReSideRdrRiDetn87RdrDetnChks : 167|8@0+ (1.0,0.0) [0.0|255.0] "Unitless" ASDM,PAS
 SG_ ReSideRdrRiDetn87RdrDetnCntr : 175|4@0+ (1.0,0.0) [0.0|15.0] "Unitless" ASDM,PAS
 SG_ ReSideRdrRiDetn87RdrDetnConf : 191|7@0+ (1.0,0.0) [0.0|100.0] "%" ASDM,PAS
 SG_ ReSideRdrRiDetn87RdrDetnElevn : 239|5@0+ (1.0,-15.0) [-15.0|15.0] "Deg" ASDM,PAS
 SG_ ReSideRdrRiDetn87RdrDetnPwr : 169|9@0+ (0.1,0.0) [0.0|51.1] "dB" ASDM,PAS
 SG_ ReSideRdrRiDetn87RdrDetnRng : 223|14@0+ (0.02,-1.0) [-1.0|200.0] "m" ASDM,PAS
 SG_ ReSideRdrRiDetn87RdrDetnRngV : 204|13@0+ (0.02,-80.0) [-80.0|80.0] "m/s" ASDM,PAS
 SG_ ReSideRdrRiDetn87RdrDetnSts : 171|2@0+ (1,0) [0|3] "" ASDM,PAS
 SG_ ReSideRdrRiDetn88_UB : 314|1@0+ (1,0) [0|1] "" ASDM,PAS
 SG_ ReSideRdrRiDetn88RdrDetnAzi : 287|11@0+ (0.1,-90.0) [-90.0|90.0] "Deg" ASDM,PAS
 SG_ ReSideRdrRiDetn88RdrDetnChks : 247|8@0+ (1.0,0.0) [0.0|255.0] "Unitless" ASDM,PAS
 SG_ ReSideRdrRiDetn88RdrDetnCntr : 255|4@0+ (1.0,0.0) [0.0|15.0] "Unitless" ASDM,PAS
 SG_ ReSideRdrRiDetn88RdrDetnConf : 311|7@0+ (1.0,0.0) [0.0|100.0] "%" ASDM,PAS
 SG_ ReSideRdrRiDetn88RdrDetnElevn : 319|5@0+ (1.0,-15.0) [-15.0|15.0] "Deg" ASDM,PAS
 SG_ ReSideRdrRiDetn88RdrDetnPwr : 249|9@0+ (0.1,0.0) [0.0|51.1] "dB" ASDM,PAS
 SG_ ReSideRdrRiDetn88RdrDetnRng : 271|14@0+ (0.02,-1.0) [-1.0|200.0] "m" ASDM,PAS
 SG_ ReSideRdrRiDetn88RdrDetnRngV : 292|13@0+ (0.02,-80.0) [-80.0|80.0] "m/s" ASDM,PAS
 SG_ ReSideRdrRiDetn88RdrDetnSts : 251|2@0+ (1,0) [0|3] "" ASDM,PAS
 SG_ ReSideRdrRiDetn89_UB : 394|1@0+ (1,0) [0|1] "" ASDM,PAS
 SG_ ReSideRdrRiDetn89RdrDetnAzi : 351|11@0+ (0.1,-90.0) [-90.0|90.0] "Deg" ASDM,PAS
 SG_ ReSideRdrRiDetn89RdrDetnChks : 327|8@0+ (1.0,0.0) [0.0|255.0] "Unitless" ASDM,PAS
 SG_ ReSideRdrRiDetn89RdrDetnCntr : 335|4@0+ (1.0,0.0) [0.0|15.0] "Unitless" ASDM,PAS
 SG_ ReSideRdrRiDetn89RdrDetnConf : 391|7@0+ (1.0,0.0) [0.0|100.0] "%" ASDM,PAS
 SG_ ReSideRdrRiDetn89RdrDetnElevn : 399|5@0+ (1.0,-15.0) [-15.0|15.0] "Deg" ASDM,PAS
 SG_ ReSideRdrRiDetn89RdrDetnPwr : 329|9@0+ (0.1,0.0) [0.0|51.1] "dB" ASDM,PAS
 SG_ ReSideRdrRiDetn89RdrDetnRng : 375|14@0+ (0.02,-1.0) [-1.0|200.0] "m" ASDM,PAS
 SG_ ReSideRdrRiDetn89RdrDetnRngV : 356|13@0+ (0.02,-80.0) [-80.0|80.0] "m/s" ASDM,PAS
 SG_ ReSideRdrRiDetn89RdrDetnSts : 331|2@0+ (1,0) [0|3] "" ASDM,PAS
 SG_ ReSideRdrRiDetn90_UB : 474|1@0+ (1,0) [0|1] "" ASDM,PAS
 SG_ ReSideRdrRiDetn90RdrDetnAzi : 447|11@0+ (0.1,-90.0) [-90.0|90.0] "Deg" ASDM,PAS
 SG_ ReSideRdrRiDetn90RdrDetnChks : 407|8@0+ (1.0,0.0) [0.0|255.0] "Unitless" ASDM,PAS
 SG_ ReSideRdrRiDetn90RdrDetnCntr : 415|4@0+ (1.0,0.0) [0.0|15.0] "Unitless" ASDM,PAS
 SG_ ReSideRdrRiDetn90RdrDetnConf : 471|7@0+ (1.0,0.0) [0.0|100.0] "%" ASDM,PAS
 SG_ ReSideRdrRiDetn90RdrDetnElevn : 479|5@0+ (1.0,-15.0) [-15.0|15.0] "Deg" ASDM,PAS
 SG_ ReSideRdrRiDetn90RdrDetnPwr : 409|9@0+ (0.1,0.0) [0.0|51.1] "dB" ASDM,PAS
 SG_ ReSideRdrRiDetn90RdrDetnRng : 431|14@0+ (0.02,-1.0) [-1.0|200.0] "m" ASDM,PAS
 SG_ ReSideRdrRiDetn90RdrDetnRngV : 452|13@0+ (0.02,-80.0) [-80.0|80.0] "m/s" ASDM,PAS
 SG_ ReSideRdrRiDetn90RdrDetnSts : 411|2@0+ (1,0) [0|3] "" ASDM,PAS

CM_ SG_ 319 ReSideRdrRiDetn43RdrDetnAzi "Refer to the data element description in ReSideRdrRiDetn1 with the same data element name";
CM_ SG_ 319 ReSideRdrRiDetn43RdrDetnChks "Refer to the data element description in ReSideRdrRiDetn1 with the same data element name";
CM_ SG_ 319 ReSideRdrRiDetn43RdrDetnCntr "Refer to the data element description in ReSideRdrRiDetn1 with the same data element name";
CM_ SG_ 319 ReSideRdrRiDetn43RdrDetnConf "Refer to the data element description in ReSideRdrRiDetn1 with the same data element name";
CM_ SG_ 319 ReSideRdrRiDetn43RdrDetnElevn "Refer to the data element description in ReSideRdrRiDetn1 with the same data element name";
CM_ SG_ 319 ReSideRdrRiDetn43RdrDetnPwr "Refer to the data element description in ReSideRdrRiDetn1 with the same data element name";
CM_ SG_ 319 ReSideRdrRiDetn43RdrDetnRng "Refer to the data element description in ReSideRdrRiDetn1 with the same data element name";
CM_ SG_ 319 ReSideRdrRiDetn43RdrDetnRngV "Range Velocity";
CM_ SG_ 319 ReSideRdrRiDetn43RdrDetnSts "Refer to the data element description in ReSideRdrRiDetn1 with the same data element name";
CM_ SG_ 319 ReSideRdrRiDetn44RdrDetnAzi "Refer to the data element description in ReSideRdrRiDetn1 with the same data element name";
CM_ SG_ 319 ReSideRdrRiDetn44RdrDetnChks "Refer to the data element description in ReSideRdrRiDetn1 with the same data element name";
CM_ SG_ 319 ReSideRdrRiDetn44RdrDetnCntr "Refer to the data element description in ReSideRdrRiDetn1 with the same data element name";
CM_ SG_ 319 ReSideRdrRiDetn44RdrDetnConf "Refer to the data element description in ReSideRdrRiDetn1 with the same data element name";
CM_ SG_ 319 ReSideRdrRiDetn44RdrDetnElevn "Refer to the data element description in ReSideRdrRiDetn1 with the same data element name";
CM_ SG_ 319 ReSideRdrRiDetn44RdrDetnPwr "Refer to the data element description in ReSideRdrRiDetn1 with the same data element name";
CM_ SG_ 319 ReSideRdrRiDetn44RdrDetnRng "Refer to the data element description in ReSideRdrRiDetn1 with the same data element name";
CM_ SG_ 319 ReSideRdrRiDetn44RdrDetnRngV "Range Velocity";
CM_ SG_ 319 ReSideRdrRiDetn44RdrDetnSts "Refer to the data element description in ReSideRdrRiDetn1 with the same data element name";
CM_ SG_ 319 ReSideRdrRiDetn45RdrDetnAzi "Refer to the data element description in ReSideRdrRiDetn1 with the same data element name";
CM_ SG_ 319 ReSideRdrRiDetn45RdrDetnChks "Refer to the data element description in ReSideRdrRiDetn1 with the same data element name";
CM_ SG_ 319 ReSideRdrRiDetn45RdrDetnCntr "Refer to the data element description in ReSideRdrRiDetn1 with the same data element name";
CM_ SG_ 319 ReSideRdrRiDetn45RdrDetnConf "Refer to the data element description in ReSideRdrRiDetn1 with the same data element name";
CM_ SG_ 319 ReSideRdrRiDetn45RdrDetnElevn "Refer to the data element description in ReSideRdrRiDetn1 with the same data element name";
CM_ SG_ 319 ReSideRdrRiDetn45RdrDetnPwr "Refer to the data element description in ReSideRdrRiDetn1 with the same data element name";
CM_ SG_ 319 ReSideRdrRiDetn45RdrDetnRng "Refer to the data element description in ReSideRdrRiDetn1 with the same data element name";
CM_ SG_ 319 ReSideRdrRiDetn45RdrDetnRngV "Range Velocity";
CM_ SG_ 319 ReSideRdrRiDetn45RdrDetnSts "Refer to the data element description in ReSideRdrRiDetn1 with the same data element name";
CM_ SG_ 319 ReSideRdrRiDetn46RdrDetnAzi "Refer to the data element description in ReSideRdrRiDetn1 with the same data element name";
CM_ SG_ 319 ReSideRdrRiDetn46RdrDetnChks "Refer to the data element description in ReSideRdrRiDetn1 with the same data element name";
CM_ SG_ 319 ReSideRdrRiDetn46RdrDetnCntr "Refer to the data element description in ReSideRdrRiDetn1 with the same data element name";
CM_ SG_ 319 ReSideRdrRiDetn46RdrDetnConf "Refer to the data element description in ReSideRdrRiDetn1 with the same data element name";
CM_ SG_ 319 ReSideRdrRiDetn46RdrDetnElevn "Refer to the data element description in ReSideRdrRiDetn1 with the same data element name";
CM_ SG_ 319 ReSideRdrRiDetn46RdrDetnPwr "Refer to the data element description in ReSideRdrRiDetn1 with the same data element name";
CM_ SG_ 319 ReSideRdrRiDetn46RdrDetnRng "Refer to the data element description in ReSideRdrRiDetn1 with the same data element name";
CM_ SG_ 319 ReSideRdrRiDetn46RdrDetnRngV "Range Velocity";
CM_ SG_ 319 ReSideRdrRiDetn46RdrDetnSts "Refer to the data element description in ReSideRdrRiDetn1 with the same data element name";
CM_ SG_ 319 ReSideRdrRiDetn47RdrDetnAzi "Refer to the data element description in ReSideRdrRiDetn1 with the same data element name";
CM_ SG_ 319 ReSideRdrRiDetn47RdrDetnChks "Refer to the data element description in ReSideRdrRiDetn1 with the same data element name";
CM_ SG_ 319 ReSideRdrRiDetn47RdrDetnCntr "Refer to the data element description in ReSideRdrRiDetn1 with the same data element name";
CM_ SG_ 319 ReSideRdrRiDetn47RdrDetnConf "Refer to the data element description in ReSideRdrRiDetn1 with the same data element name";
CM_ SG_ 319 ReSideRdrRiDetn47RdrDetnElevn "Refer to the data element description in ReSideRdrRiDetn1 with the same data element name";
CM_ SG_ 319 ReSideRdrRiDetn47RdrDetnPwr "Refer to the data element description in ReSideRdrRiDetn1 with the same data element name";
CM_ SG_ 319 ReSideRdrRiDetn47RdrDetnRng "Refer to the data element description in ReSideRdrRiDetn1 with the same data element name";
CM_ SG_ 319 ReSideRdrRiDetn47RdrDetnRngV "Range Velocity";
CM_ SG_ 319 ReSideRdrRiDetn47RdrDetnSts "Refer to the data element description in ReSideRdrRiDetn1 with the same data element name";
CM_ SG_ 319 ReSideRdrRiDetn48RdrDetnAzi "Refer to the data element description in ReSideRdrRiDetn1 with the same data element name";
CM_ SG_ 319 ReSideRdrRiDetn48RdrDetnChks "Refer to the data element description in ReSideRdrRiDetn1 with the same data element name";
CM_ SG_ 319 ReSideRdrRiDetn48RdrDetnCntr "Refer to the data element description in ReSideRdrRiDetn1 with the same data element name";
CM_ SG_ 319 ReSideRdrRiDetn48RdrDetnConf "Refer to the data element description in ReSideRdrRiDetn1 with the same data element name";
CM_ SG_ 319 ReSideRdrRiDetn48RdrDetnElevn "Refer to the data element description in ReSideRdrRiDetn1 with the same data element name";
CM_ SG_ 319 ReSideRdrRiDetn48RdrDetnPwr "Refer to the data element description in ReSideRdrRiDetn1 with the same data element name";
CM_ SG_ 319 ReSideRdrRiDetn48RdrDetnRng "Refer to the data element description in ReSideRdrRiDetn1 with the same data element name";
CM_ SG_ 319 ReSideRdrRiDetn48RdrDetnRngV "Range Velocity";
CM_ SG_ 319 ReSideRdrRiDetn48RdrDetnSts "Refer to the data element description in ReSideRdrRiDetn1 with the same data element name";
CM_ SG_ 321 ReSideRdrRiDetn49RdrDetnAzi "Refer to the data element description in ReSideRdrRiDetn1 with the same data element name";
CM_ SG_ 321 ReSideRdrRiDetn49RdrDetnChks "Refer to the data element description in ReSideRdrRiDetn1 with the same data element name";
CM_ SG_ 321 ReSideRdrRiDetn49RdrDetnCntr "Refer to the data element description in ReSideRdrRiDetn1 with the same data element name";
CM_ SG_ 321 ReSideRdrRiDetn49RdrDetnConf "Refer to the data element description in ReSideRdrRiDetn1 with the same data element name";
CM_ SG_ 321 ReSideRdrRiDetn49RdrDetnElevn "Refer to the data element description in ReSideRdrRiDetn1 with the same data element name";
CM_ SG_ 321 ReSideRdrRiDetn49RdrDetnPwr "Refer to the data element description in ReSideRdrRiDetn1 with the same data element name";
CM_ SG_ 321 ReSideRdrRiDetn49RdrDetnRng "Refer to the data element description in ReSideRdrRiDetn1 with the same data element name";
CM_ SG_ 321 ReSideRdrRiDetn49RdrDetnRngV "Range Velocity";
CM_ SG_ 321 ReSideRdrRiDetn49RdrDetnSts "Refer to the data element description in ReSideRdrRiDetn1 with the same data element name";
CM_ SG_ 321 ReSideRdrRiDetn50RdrDetnAzi "Refer to the data element description in ReSideRdrRiDetn1 with the same data element name";
CM_ SG_ 321 ReSideRdrRiDetn50RdrDetnChks "Refer to the data element description in ReSideRdrRiDetn1 with the same data element name";
CM_ SG_ 321 ReSideRdrRiDetn50RdrDetnCntr "Refer to the data element description in ReSideRdrRiDetn1 with the same data element name";
CM_ SG_ 321 ReSideRdrRiDetn50RdrDetnConf "Refer to the data element description in ReSideRdrRiDetn1 with the same data element name";
CM_ SG_ 321 ReSideRdrRiDetn50RdrDetnElevn "Refer to the data element description in ReSideRdrRiDetn1 with the same data element name";
CM_ SG_ 321 ReSideRdrRiDetn50RdrDetnPwr "Refer to the data element description in ReSideRdrRiDetn1 with the same data element name";
CM_ SG_ 321 ReSideRdrRiDetn50RdrDetnRng "Refer to the data element description in ReSideRdrRiDetn1 with the same data element name";
CM_ SG_ 321 ReSideRdrRiDetn50RdrDetnRngV "Range Velocity";
CM_ SG_ 321 ReSideRdrRiDetn50RdrDetnSts "Refer to the data element description in ReSideRdrRiDetn1 with the same data element name";
CM_ SG_ 321 ReSideRdrRiDetn51RdrDetnAzi "Refer to the data element description in ReSideRdrRiDetn1 with the same data element name";
CM_ SG_ 321 ReSideRdrRiDetn51RdrDetnChks "Refer to the data element description in ReSideRdrRiDetn1 with the same data element name";
CM_ SG_ 321 ReSideRdrRiDetn51RdrDetnCntr "Refer to the data element description in ReSideRdrRiDetn1 with the same data element name";
CM_ SG_ 321 ReSideRdrRiDetn51RdrDetnConf "Refer to the data element description in ReSideRdrRiDetn1 with the same data element name";
CM_ SG_ 321 ReSideRdrRiDetn51RdrDetnElevn "Refer to the data element description in ReSideRdrRiDetn1 with the same data element name";
CM_ SG_ 321 ReSideRdrRiDetn51RdrDetnPwr "Refer to the data element description in ReSideRdrRiDetn1 with the same data element name";
CM_ SG_ 321 ReSideRdrRiDetn51RdrDetnRng "Refer to the data element description in ReSideRdrRiDetn1 with the same data element name";
CM_ SG_ 321 ReSideRdrRiDetn51RdrDetnRngV "Range Velocity";
CM_ SG_ 321 ReSideRdrRiDetn51RdrDetnSts "Refer to the data element description in ReSideRdrRiDetn1 with the same data element name";
CM_ SG_ 321 ReSideRdrRiDetn52RdrDetnAzi "Refer to the data element description in ReSideRdrRiDetn1 with the same data element name";
CM_ SG_ 321 ReSideRdrRiDetn52RdrDetnChks "Refer to the data element description in ReSideRdrRiDetn1 with the same data element name";
CM_ SG_ 321 ReSideRdrRiDetn52RdrDetnCntr "Refer to the data element description in ReSideRdrRiDetn1 with the same data element name";
CM_ SG_ 321 ReSideRdrRiDetn52RdrDetnConf "Refer to the data element description in ReSideRdrRiDetn1 with the same data element name";
CM_ SG_ 321 ReSideRdrRiDetn52RdrDetnElevn "Refer to the data element description in ReSideRdrRiDetn1 with the same data element name";
CM_ SG_ 321 ReSideRdrRiDetn52RdrDetnPwr "Refer to the data element description in ReSideRdrRiDetn1 with the same data element name";
CM_ SG_ 321 ReSideRdrRiDetn52RdrDetnRng "Refer to the data element description in ReSideRdrRiDetn1 with the same data element name";
CM_ SG_ 321 ReSideRdrRiDetn52RdrDetnRngV "Range Velocity";
CM_ SG_ 321 ReSideRdrRiDetn52RdrDetnSts "Refer to the data element description in ReSideRdrRiDetn1 with the same data element name";
CM_ SG_ 321 ReSideRdrRiDetn53RdrDetnAzi "Refer to the data element description in ReSideRdrRiDetn1 with the same data element name";
CM_ SG_ 321 ReSideRdrRiDetn53RdrDetnChks "Refer to the data element description in ReSideRdrRiDetn1 with the same data element name";
CM_ SG_ 321 ReSideRdrRiDetn53RdrDetnCntr "Refer to the data element description in ReSideRdrRiDetn1 with the same data element name";
CM_ SG_ 321 ReSideRdrRiDetn53RdrDetnConf "Refer to the data element description in ReSideRdrRiDetn1 with the same data element name";
CM_ SG_ 321 ReSideRdrRiDetn53RdrDetnElevn "Refer to the data element description in ReSideRdrRiDetn1 with the same data element name";
CM_ SG_ 321 ReSideRdrRiDetn53RdrDetnPwr "Refer to the data element description in ReSideRdrRiDetn1 with the same data element name";
CM_ SG_ 321 ReSideRdrRiDetn53RdrDetnRng "Refer to the data element description in ReSideRdrRiDetn1 with the same data element name";
CM_ SG_ 321 ReSideRdrRiDetn53RdrDetnRngV "Range Velocity";
CM_ SG_ 321 ReSideRdrRiDetn53RdrDetnSts "Refer to the data element description in ReSideRdrRiDetn1 with the same data element name";
CM_ SG_ 321 ReSideRdrRiDetn54RdrDetnAzi "Refer to the data element description in ReSideRdrRiDetn1 with the same data element name";
CM_ SG_ 321 ReSideRdrRiDetn54RdrDetnChks "Refer to the data element description in ReSideRdrRiDetn1 with the same data element name";
CM_ SG_ 321 ReSideRdrRiDetn54RdrDetnCntr "Refer to the data element description in ReSideRdrRiDetn1 with the same data element name";
CM_ SG_ 321 ReSideRdrRiDetn54RdrDetnConf "Refer to the data element description in ReSideRdrRiDetn1 with the same data element name";
CM_ SG_ 321 ReSideRdrRiDetn54RdrDetnElevn "Refer to the data element description in ReSideRdrRiDetn1 with the same data element name";
CM_ SG_ 321 ReSideRdrRiDetn54RdrDetnPwr "Refer to the data element description in ReSideRdrRiDetn1 with the same data element name";
CM_ SG_ 321 ReSideRdrRiDetn54RdrDetnRng "Refer to the data element description in ReSideRdrRiDetn1 with the same data element name";
CM_ SG_ 321 ReSideRdrRiDetn54RdrDetnRngV "Range Velocity";
CM_ SG_ 321 ReSideRdrRiDetn54RdrDetnSts "Refer to the data element description in ReSideRdrRiDetn1 with the same data element name";
CM_ SG_ 323 ReSideRdrRiDetn55RdrDetnAzi "Refer to the data element description in ReSideRdrRiDetn1 with the same data element name";
CM_ SG_ 323 ReSideRdrRiDetn55RdrDetnChks "Refer to the data element description in ReSideRdrRiDetn1 with the same data element name";
CM_ SG_ 323 ReSideRdrRiDetn55RdrDetnCntr "Refer to the data element description in ReSideRdrRiDetn1 with the same data element name";
CM_ SG_ 323 ReSideRdrRiDetn55RdrDetnConf "Refer to the data element description in ReSideRdrRiDetn1 with the same data element name";
CM_ SG_ 323 ReSideRdrRiDetn55RdrDetnElevn "Refer to the data element description in ReSideRdrRiDetn1 with the same data element name";
CM_ SG_ 323 ReSideRdrRiDetn55RdrDetnPwr "Refer to the data element description in ReSideRdrRiDetn1 with the same data element name";
CM_ SG_ 323 ReSideRdrRiDetn55RdrDetnRng "Refer to the data element description in ReSideRdrRiDetn1 with the same data element name";
CM_ SG_ 323 ReSideRdrRiDetn55RdrDetnRngV "Range Velocity";
CM_ SG_ 323 ReSideRdrRiDetn55RdrDetnSts "Refer to the data element description in ReSideRdrRiDetn1 with the same data element name";
CM_ SG_ 323 ReSideRdrRiDetn56RdrDetnAzi "Refer to the data element description in ReSideRdrRiDetn1 with the same data element name";
CM_ SG_ 323 ReSideRdrRiDetn56RdrDetnChks "Refer to the data element description in ReSideRdrRiDetn1 with the same data element name";
CM_ SG_ 323 ReSideRdrRiDetn56RdrDetnCntr "Refer to the data element description in ReSideRdrRiDetn1 with the same data element name";
CM_ SG_ 323 ReSideRdrRiDetn56RdrDetnConf "Refer to the data element description in ReSideRdrRiDetn1 with the same data element name";
CM_ SG_ 323 ReSideRdrRiDetn56RdrDetnElevn "Refer to the data element description in ReSideRdrRiDetn1 with the same data element name";
CM_ SG_ 323 ReSideRdrRiDetn56RdrDetnPwr "Refer to the data element description in ReSideRdrRiDetn1 with the same data element name";
CM_ SG_ 323 ReSideRdrRiDetn56RdrDetnRng "Refer to the data element description in ReSideRdrRiDetn1 with the same data element name";
CM_ SG_ 323 ReSideRdrRiDetn56RdrDetnRngV "Range Velocity";
CM_ SG_ 323 ReSideRdrRiDetn56RdrDetnSts "Refer to the data element description in ReSideRdrRiDetn1 with the same data element name";
CM_ SG_ 323 ReSideRdrRiDetn57RdrDetnAzi "Refer to the data element description in ReSideRdrRiDetn1 with the same data element name";
CM_ SG_ 323 ReSideRdrRiDetn57RdrDetnChks "Refer to the data element description in ReSideRdrRiDetn1 with the same data element name";
CM_ SG_ 323 ReSideRdrRiDetn57RdrDetnCntr "Refer to the data element description in ReSideRdrRiDetn1 with the same data element name";
CM_ SG_ 323 ReSideRdrRiDetn57RdrDetnConf "Refer to the data element description in ReSideRdrRiDetn1 with the same data element name";
CM_ SG_ 323 ReSideRdrRiDetn57RdrDetnElevn "Refer to the data element description in ReSideRdrRiDetn1 with the same data element name";
CM_ SG_ 323 ReSideRdrRiDetn57RdrDetnPwr "Refer to the data element description in ReSideRdrRiDetn1 with the same data element name";
CM_ SG_ 323 ReSideRdrRiDetn57RdrDetnRng "Refer to the data element description in ReSideRdrRiDetn1 with the same data element name";
CM_ SG_ 323 ReSideRdrRiDetn57RdrDetnRngV "Range Velocity";
CM_ SG_ 323 ReSideRdrRiDetn57RdrDetnSts "Refer to the data element description in ReSideRdrRiDetn1 with the same data element name";
CM_ SG_ 323 ReSideRdrRiDetn58RdrDetnAzi "Refer to the data element description in ReSideRdrRiDetn1 with the same data element name";
CM_ SG_ 323 ReSideRdrRiDetn58RdrDetnChks "Refer to the data element description in ReSideRdrRiDetn1 with the same data element name";
CM_ SG_ 323 ReSideRdrRiDetn58RdrDetnCntr "Refer to the data element description in ReSideRdrRiDetn1 with the same data element name";
CM_ SG_ 323 ReSideRdrRiDetn58RdrDetnConf "Refer to the data element description in ReSideRdrRiDetn1 with the same data element name";
CM_ SG_ 323 ReSideRdrRiDetn58RdrDetnElevn "Refer to the data element description in ReSideRdrRiDetn1 with the same data element name";
CM_ SG_ 323 ReSideRdrRiDetn58RdrDetnPwr "Refer to the data element description in ReSideRdrRiDetn1 with the same data element name";
CM_ SG_ 323 ReSideRdrRiDetn58RdrDetnRng "Refer to the data element description in ReSideRdrRiDetn1 with the same data element name";
CM_ SG_ 323 ReSideRdrRiDetn58RdrDetnRngV "Range Velocity";
CM_ SG_ 323 ReSideRdrRiDetn58RdrDetnSts "Refer to the data element description in ReSideRdrRiDetn1 with the same data element name";
CM_ SG_ 323 ReSideRdrRiDetn59RdrDetnAzi "Refer to the data element description in ReSideRdrRiDetn1 with the same data element name";
CM_ SG_ 323 ReSideRdrRiDetn59RdrDetnChks "Refer to the data element description in ReSideRdrRiDetn1 with the same data element name";
CM_ SG_ 323 ReSideRdrRiDetn59RdrDetnCntr "Refer to the data element description in ReSideRdrRiDetn1 with the same data element name";
CM_ SG_ 323 ReSideRdrRiDetn59RdrDetnConf "Refer to the data element description in ReSideRdrRiDetn1 with the same data element name";
CM_ SG_ 323 ReSideRdrRiDetn59RdrDetnElevn "Refer to the data element description in ReSideRdrRiDetn1 with the same data element name";
CM_ SG_ 323 ReSideRdrRiDetn59RdrDetnPwr "Refer to the data element description in ReSideRdrRiDetn1 with the same data element name";
CM_ SG_ 323 ReSideRdrRiDetn59RdrDetnRng "Refer to the data element description in ReSideRdrRiDetn1 with the same data element name";
CM_ SG_ 323 ReSideRdrRiDetn59RdrDetnRngV "Range Velocity";
CM_ SG_ 323 ReSideRdrRiDetn59RdrDetnSts "Refer to the data element description in ReSideRdrRiDetn1 with the same data element name";
CM_ SG_ 323 ReSideRdrRiDetn60RdrDetnAzi "Refer to the data element description in ReSideRdrRiDetn1 with the same data element name";
CM_ SG_ 323 ReSideRdrRiDetn60RdrDetnChks "Refer to the data element description in ReSideRdrRiDetn1 with the same data element name";
CM_ SG_ 323 ReSideRdrRiDetn60RdrDetnCntr "Refer to the data element description in ReSideRdrRiDetn1 with the same data element name";
CM_ SG_ 323 ReSideRdrRiDetn60RdrDetnConf "Refer to the data element description in ReSideRdrRiDetn1 with the same data element name";
CM_ SG_ 323 ReSideRdrRiDetn60RdrDetnElevn "Refer to the data element description in ReSideRdrRiDetn1 with the same data element name";
CM_ SG_ 323 ReSideRdrRiDetn60RdrDetnPwr "Refer to the data element description in ReSideRdrRiDetn1 with the same data element name";
CM_ SG_ 323 ReSideRdrRiDetn60RdrDetnRng "Refer to the data element description in ReSideRdrRiDetn1 with the same data element name";
CM_ SG_ 323 ReSideRdrRiDetn60RdrDetnRngV "Range Velocity";
CM_ SG_ 323 ReSideRdrRiDetn60RdrDetnSts "Refer to the data element description in ReSideRdrRiDetn1 with the same data element name";
CM_ SG_ 325 ReSideRdrRiDetn61RdrDetnAzi "Refer to the data element description in ReSideRdrRiDetn1 with the same data element name";
CM_ SG_ 325 ReSideRdrRiDetn61RdrDetnChks "Refer to the data element description in ReSideRdrRiDetn1 with the same data element name";
CM_ SG_ 325 ReSideRdrRiDetn61RdrDetnCntr "Refer to the data element description in ReSideRdrRiDetn1 with the same data element name";
CM_ SG_ 325 ReSideRdrRiDetn61RdrDetnConf "Refer to the data element description in ReSideRdrRiDetn1 with the same data element name";
CM_ SG_ 325 ReSideRdrRiDetn61RdrDetnElevn "Refer to the data element description in ReSideRdrRiDetn1 with the same data element name";
CM_ SG_ 325 ReSideRdrRiDetn61RdrDetnPwr "Refer to the data element description in ReSideRdrRiDetn1 with the same data element name";
CM_ SG_ 325 ReSideRdrRiDetn61RdrDetnRng "Refer to the data element description in ReSideRdrRiDetn1 with the same data element name";
CM_ SG_ 325 ReSideRdrRiDetn61RdrDetnRngV "Range Velocity";
CM_ SG_ 325 ReSideRdrRiDetn61RdrDetnSts "Refer to the data element description in ReSideRdrRiDetn1 with the same data element name";
CM_ SG_ 325 ReSideRdrRiDetn62RdrDetnAzi "Refer to the data element description in ReSideRdrRiDetn1 with the same data element name";
CM_ SG_ 325 ReSideRdrRiDetn62RdrDetnChks "Refer to the data element description in ReSideRdrRiDetn1 with the same data element name";
CM_ SG_ 325 ReSideRdrRiDetn62RdrDetnCntr "Refer to the data element description in ReSideRdrRiDetn1 with the same data element name";
CM_ SG_ 325 ReSideRdrRiDetn62RdrDetnConf "Refer to the data element description in ReSideRdrRiDetn1 with the same data element name";
CM_ SG_ 325 ReSideRdrRiDetn62RdrDetnElevn "Refer to the data element description in ReSideRdrRiDetn1 with the same data element name";
CM_ SG_ 325 ReSideRdrRiDetn62RdrDetnPwr "Refer to the data element description in ReSideRdrRiDetn1 with the same data element name";
CM_ SG_ 325 ReSideRdrRiDetn62RdrDetnRng "Refer to the data element description in ReSideRdrRiDetn1 with the same data element name";
CM_ SG_ 325 ReSideRdrRiDetn62RdrDetnRngV "Range Velocity";
CM_ SG_ 325 ReSideRdrRiDetn62RdrDetnSts "Refer to the data element description in ReSideRdrRiDetn1 with the same data element name";
CM_ SG_ 325 ReSideRdrRiDetn63RdrDetnAzi "Refer to the data element description in ReSideRdrRiDetn1 with the same data element name";
CM_ SG_ 325 ReSideRdrRiDetn63RdrDetnChks "Refer to the data element description in ReSideRdrRiDetn1 with the same data element name";
CM_ SG_ 325 ReSideRdrRiDetn63RdrDetnCntr "Refer to the data element description in ReSideRdrRiDetn1 with the same data element name";
CM_ SG_ 325 ReSideRdrRiDetn63RdrDetnConf "Refer to the data element description in ReSideRdrRiDetn1 with the same data element name";
CM_ SG_ 325 ReSideRdrRiDetn63RdrDetnElevn "Refer to the data element description in ReSideRdrRiDetn1 with the same data element name";
CM_ SG_ 325 ReSideRdrRiDetn63RdrDetnPwr "Refer to the data element description in ReSideRdrRiDetn1 with the same data element name";
CM_ SG_ 325 ReSideRdrRiDetn63RdrDetnRng "Refer to the data element description in ReSideRdrRiDetn1 with the same data element name";
CM_ SG_ 325 ReSideRdrRiDetn63RdrDetnRngV "Range Velocity";
CM_ SG_ 325 ReSideRdrRiDetn63RdrDetnSts "Refer to the data element description in ReSideRdrRiDetn1 with the same data element name";
CM_ SG_ 325 ReSideRdrRiDetn64RdrDetnAzi "Refer to the data element description in ReSideRdrRiDetn1 with the same data element name";
CM_ SG_ 325 ReSideRdrRiDetn64RdrDetnChks "Refer to the data element description in ReSideRdrRiDetn1 with the same data element name";
CM_ SG_ 325 ReSideRdrRiDetn64RdrDetnCntr "Refer to the data element description in ReSideRdrRiDetn1 with the same data element name";
CM_ SG_ 325 ReSideRdrRiDetn64RdrDetnConf "Refer to the data element description in ReSideRdrRiDetn1 with the same data element name";
CM_ SG_ 325 ReSideRdrRiDetn64RdrDetnElevn "Refer to the data element description in ReSideRdrRiDetn1 with the same data element name";
CM_ SG_ 325 ReSideRdrRiDetn64RdrDetnPwr "Refer to the data element description in ReSideRdrRiDetn1 with the same data element name";
CM_ SG_ 325 ReSideRdrRiDetn64RdrDetnRng "Refer to the data element description in ReSideRdrRiDetn1 with the same data element name";
CM_ SG_ 325 ReSideRdrRiDetn64RdrDetnRngV "Range Velocity";
CM_ SG_ 325 ReSideRdrRiDetn64RdrDetnSts "Refer to the data element description in ReSideRdrRiDetn1 with the same data element name";
CM_ SG_ 325 ReSideRdrRiDetn65RdrDetnAzi "Refer to the data element description in ReSideRdrRiDetn1 with the same data element name";
CM_ SG_ 325 ReSideRdrRiDetn65RdrDetnChks "Refer to the data element description in ReSideRdrRiDetn1 with the same data element name";
CM_ SG_ 325 ReSideRdrRiDetn65RdrDetnCntr "Refer to the data element description in ReSideRdrRiDetn1 with the same data element name";
CM_ SG_ 325 ReSideRdrRiDetn65RdrDetnConf "Refer to the data element description in ReSideRdrRiDetn1 with the same data element name";
CM_ SG_ 325 ReSideRdrRiDetn65RdrDetnElevn "Refer to the data element description in ReSideRdrRiDetn1 with the same data element name";
CM_ SG_ 325 ReSideRdrRiDetn65RdrDetnPwr "Refer to the data element description in ReSideRdrRiDetn1 with the same data element name";
CM_ SG_ 325 ReSideRdrRiDetn65RdrDetnRng "Refer to the data element description in ReSideRdrRiDetn1 with the same data element name";
CM_ SG_ 325 ReSideRdrRiDetn65RdrDetnRngV "Range Velocity";
CM_ SG_ 325 ReSideRdrRiDetn65RdrDetnSts "Refer to the data element description in ReSideRdrRiDetn1 with the same data element name";
CM_ SG_ 325 ReSideRdrRiDetn66RdrDetnAzi "Refer to the data element description in ReSideRdrRiDetn1 with the same data element name";
CM_ SG_ 325 ReSideRdrRiDetn66RdrDetnChks "Refer to the data element description in ReSideRdrRiDetn1 with the same data element name";
CM_ SG_ 325 ReSideRdrRiDetn66RdrDetnCntr "Refer to the data element description in ReSideRdrRiDetn1 with the same data element name";
CM_ SG_ 325 ReSideRdrRiDetn66RdrDetnConf "Refer to the data element description in ReSideRdrRiDetn1 with the same data element name";
CM_ SG_ 325 ReSideRdrRiDetn66RdrDetnElevn "Refer to the data element description in ReSideRdrRiDetn1 with the same data element name";
CM_ SG_ 325 ReSideRdrRiDetn66RdrDetnPwr "Refer to the data element description in ReSideRdrRiDetn1 with the same data element name";
CM_ SG_ 325 ReSideRdrRiDetn66RdrDetnRng "Refer to the data element description in ReSideRdrRiDetn1 with the same data element name";
CM_ SG_ 325 ReSideRdrRiDetn66RdrDetnRngV "Range Velocity";
CM_ SG_ 325 ReSideRdrRiDetn66RdrDetnSts "Refer to the data element description in ReSideRdrRiDetn1 with the same data element name";
CM_ SG_ 327 ReSideRdrRiDetn67RdrDetnAzi "Refer to the data element description in ReSideRdrRiDetn1 with the same data element name";
CM_ SG_ 327 ReSideRdrRiDetn67RdrDetnChks "Refer to the data element description in ReSideRdrRiDetn1 with the same data element name";
CM_ SG_ 327 ReSideRdrRiDetn67RdrDetnCntr "Refer to the data element description in ReSideRdrRiDetn1 with the same data element name";
CM_ SG_ 327 ReSideRdrRiDetn67RdrDetnConf "Refer to the data element description in ReSideRdrRiDetn1 with the same data element name";
CM_ SG_ 327 ReSideRdrRiDetn67RdrDetnElevn "Refer to the data element description in ReSideRdrRiDetn1 with the same data element name";
CM_ SG_ 327 ReSideRdrRiDetn67RdrDetnPwr "Refer to the data element description in ReSideRdrRiDetn1 with the same data element name";
CM_ SG_ 327 ReSideRdrRiDetn67RdrDetnRng "Refer to the data element description in ReSideRdrRiDetn1 with the same data element name";
CM_ SG_ 327 ReSideRdrRiDetn67RdrDetnRngV "Range Velocity";
CM_ SG_ 327 ReSideRdrRiDetn67RdrDetnSts "Refer to the data element description in ReSideRdrRiDetn1 with the same data element name";
CM_ SG_ 327 ReSideRdrRiDetn68RdrDetnAzi "Refer to the data element description in ReSideRdrRiDetn1 with the same data element name";
CM_ SG_ 327 ReSideRdrRiDetn68RdrDetnChks "Refer to the data element description in ReSideRdrRiDetn1 with the same data element name";
CM_ SG_ 327 ReSideRdrRiDetn68RdrDetnCntr "Refer to the data element description in ReSideRdrRiDetn1 with the same data element name";
CM_ SG_ 327 ReSideRdrRiDetn68RdrDetnConf "Refer to the data element description in ReSideRdrRiDetn1 with the same data element name";
CM_ SG_ 327 ReSideRdrRiDetn68RdrDetnElevn "Refer to the data element description in ReSideRdrRiDetn1 with the same data element name";
CM_ SG_ 327 ReSideRdrRiDetn68RdrDetnPwr "Refer to the data element description in ReSideRdrRiDetn1 with the same data element name";
CM_ SG_ 327 ReSideRdrRiDetn68RdrDetnRng "Refer to the data element description in ReSideRdrRiDetn1 with the same data element name";
CM_ SG_ 327 ReSideRdrRiDetn68RdrDetnRngV "Range Velocity";
CM_ SG_ 327 ReSideRdrRiDetn68RdrDetnSts "Refer to the data element description in ReSideRdrRiDetn1 with the same data element name";
CM_ SG_ 327 ReSideRdrRiDetn69RdrDetnAzi "Refer to the data element description in ReSideRdrRiDetn1 with the same data element name";
CM_ SG_ 327 ReSideRdrRiDetn69RdrDetnChks "Refer to the data element description in ReSideRdrRiDetn1 with the same data element name";
CM_ SG_ 327 ReSideRdrRiDetn69RdrDetnCntr "Refer to the data element description in ReSideRdrRiDetn1 with the same data element name";
CM_ SG_ 327 ReSideRdrRiDetn69RdrDetnConf "Refer to the data element description in ReSideRdrRiDetn1 with the same data element name";
CM_ SG_ 327 ReSideRdrRiDetn69RdrDetnElevn "Refer to the data element description in ReSideRdrRiDetn1 with the same data element name";
CM_ SG_ 327 ReSideRdrRiDetn69RdrDetnPwr "Refer to the data element description in ReSideRdrRiDetn1 with the same data element name";
CM_ SG_ 327 ReSideRdrRiDetn69RdrDetnRng "Refer to the data element description in ReSideRdrRiDetn1 with the same data element name";
CM_ SG_ 327 ReSideRdrRiDetn69RdrDetnRngV "Range Velocity";
CM_ SG_ 327 ReSideRdrRiDetn69RdrDetnSts "Refer to the data element description in ReSideRdrRiDetn1 with the same data element name";
CM_ SG_ 327 ReSideRdrRiDetn70RdrDetnAzi "Refer to the data element description in ReSideRdrRiDetn1 with the same data element name";
CM_ SG_ 327 ReSideRdrRiDetn70RdrDetnChks "Refer to the data element description in ReSideRdrRiDetn1 with the same data element name";
CM_ SG_ 327 ReSideRdrRiDetn70RdrDetnCntr "Refer to the data element description in ReSideRdrRiDetn1 with the same data element name";
CM_ SG_ 327 ReSideRdrRiDetn70RdrDetnConf "Refer to the data element description in ReSideRdrRiDetn1 with the same data element name";
CM_ SG_ 327 ReSideRdrRiDetn70RdrDetnElevn "Refer to the data element description in ReSideRdrRiDetn1 with the same data element name";
CM_ SG_ 327 ReSideRdrRiDetn70RdrDetnPwr "Refer to the data element description in ReSideRdrRiDetn1 with the same data element name";
CM_ SG_ 327 ReSideRdrRiDetn70RdrDetnRng "Refer to the data element description in ReSideRdrRiDetn1 with the same data element name";
CM_ SG_ 327 ReSideRdrRiDetn70RdrDetnRngV "Range Velocity";
CM_ SG_ 327 ReSideRdrRiDetn70RdrDetnSts "Refer to the data element description in ReSideRdrRiDetn1 with the same data element name";
CM_ SG_ 327 ReSideRdrRiDetn71RdrDetnAzi "Refer to the data element description in ReSideRdrRiDetn1 with the same data element name";
CM_ SG_ 327 ReSideRdrRiDetn71RdrDetnChks "Refer to the data element description in ReSideRdrRiDetn1 with the same data element name";
CM_ SG_ 327 ReSideRdrRiDetn71RdrDetnCntr "Refer to the data element description in ReSideRdrRiDetn1 with the same data element name";
CM_ SG_ 327 ReSideRdrRiDetn71RdrDetnConf "Refer to the data element description in ReSideRdrRiDetn1 with the same data element name";
CM_ SG_ 327 ReSideRdrRiDetn71RdrDetnElevn "Refer to the data element description in ReSideRdrRiDetn1 with the same data element name";
CM_ SG_ 327 ReSideRdrRiDetn71RdrDetnPwr "Refer to the data element description in ReSideRdrRiDetn1 with the same data element name";
CM_ SG_ 327 ReSideRdrRiDetn71RdrDetnRng "Refer to the data element description in ReSideRdrRiDetn1 with the same data element name";
CM_ SG_ 327 ReSideRdrRiDetn71RdrDetnRngV "Range Velocity";
CM_ SG_ 327 ReSideRdrRiDetn71RdrDetnSts "Refer to the data element description in ReSideRdrRiDetn1 with the same data element name";
CM_ SG_ 327 ReSideRdrRiDetn72RdrDetnAzi "Refer to the data element description in ReSideRdrRiDetn1 with the same data element name";
CM_ SG_ 327 ReSideRdrRiDetn72RdrDetnChks "Refer to the data element description in ReSideRdrRiDetn1 with the same data element name";
CM_ SG_ 327 ReSideRdrRiDetn72RdrDetnCntr "Refer to the data element description in ReSideRdrRiDetn1 with the same data element name";
CM_ SG_ 327 ReSideRdrRiDetn72RdrDetnConf "Refer to the data element description in ReSideRdrRiDetn1 with the same data element name";
CM_ SG_ 327 ReSideRdrRiDetn72RdrDetnElevn "Refer to the data element description in ReSideRdrRiDetn1 with the same data element name";
CM_ SG_ 327 ReSideRdrRiDetn72RdrDetnPwr "Refer to the data element description in ReSideRdrRiDetn1 with the same data element name";
CM_ SG_ 327 ReSideRdrRiDetn72RdrDetnRng "Refer to the data element description in ReSideRdrRiDetn1 with the same data element name";
CM_ SG_ 327 ReSideRdrRiDetn72RdrDetnRngV "Range Velocity";
CM_ SG_ 327 ReSideRdrRiDetn72RdrDetnSts "Refer to the data element description in ReSideRdrRiDetn1 with the same data element name";
CM_ SG_ 329 ReSideRdrRiDetn73RdrDetnAzi "Refer to the data element description in ReSideRdrRiDetn1 with the same data element name";
CM_ SG_ 329 ReSideRdrRiDetn73RdrDetnChks "Refer to the data element description in ReSideRdrRiDetn1 with the same data element name";
CM_ SG_ 329 ReSideRdrRiDetn73RdrDetnCntr "Refer to the data element description in ReSideRdrRiDetn1 with the same data element name";
CM_ SG_ 329 ReSideRdrRiDetn73RdrDetnConf "Refer to the data element description in ReSideRdrRiDetn1 with the same data element name";
CM_ SG_ 329 ReSideRdrRiDetn73RdrDetnElevn "Refer to the data element description in ReSideRdrRiDetn1 with the same data element name";
CM_ SG_ 329 ReSideRdrRiDetn73RdrDetnPwr "Refer to the data element description in ReSideRdrRiDetn1 with the same data element name";
CM_ SG_ 329 ReSideRdrRiDetn73RdrDetnRng "Refer to the data element description in ReSideRdrRiDetn1 with the same data element name";
CM_ SG_ 329 ReSideRdrRiDetn73RdrDetnRngV "Range Velocity";
CM_ SG_ 329 ReSideRdrRiDetn73RdrDetnSts "Refer to the data element description in ReSideRdrRiDetn1 with the same data element name";
CM_ SG_ 329 ReSideRdrRiDetn74RdrDetnAzi "Refer to the data element description in ReSideRdrRiDetn1 with the same data element name";
CM_ SG_ 329 ReSideRdrRiDetn74RdrDetnChks "Refer to the data element description in ReSideRdrRiDetn1 with the same data element name";
CM_ SG_ 329 ReSideRdrRiDetn74RdrDetnCntr "Refer to the data element description in ReSideRdrRiDetn1 with the same data element name";
CM_ SG_ 329 ReSideRdrRiDetn74RdrDetnConf "Refer to the data element description in ReSideRdrRiDetn1 with the same data element name";
CM_ SG_ 329 ReSideRdrRiDetn74RdrDetnElevn "Refer to the data element description in ReSideRdrRiDetn1 with the same data element name";
CM_ SG_ 329 ReSideRdrRiDetn74RdrDetnPwr "Refer to the data element description in ReSideRdrRiDetn1 with the same data element name";
CM_ SG_ 329 ReSideRdrRiDetn74RdrDetnRng "Refer to the data element description in ReSideRdrRiDetn1 with the same data element name";
CM_ SG_ 329 ReSideRdrRiDetn74RdrDetnRngV "Range Velocity";
CM_ SG_ 329 ReSideRdrRiDetn74RdrDetnSts "Refer to the data element description in ReSideRdrRiDetn1 with the same data element name";
CM_ SG_ 329 ReSideRdrRiDetn75RdrDetnAzi "Refer to the data element description in ReSideRdrRiDetn1 with the same data element name";
CM_ SG_ 329 ReSideRdrRiDetn75RdrDetnChks "Refer to the data element description in ReSideRdrRiDetn1 with the same data element name";
CM_ SG_ 329 ReSideRdrRiDetn75RdrDetnCntr "Refer to the data element description in ReSideRdrRiDetn1 with the same data element name";
CM_ SG_ 329 ReSideRdrRiDetn75RdrDetnConf "Refer to the data element description in ReSideRdrRiDetn1 with the same data element name";
CM_ SG_ 329 ReSideRdrRiDetn75RdrDetnElevn "Refer to the data element description in ReSideRdrRiDetn1 with the same data element name";
CM_ SG_ 329 ReSideRdrRiDetn75RdrDetnPwr "Refer to the data element description in ReSideRdrRiDetn1 with the same data element name";
CM_ SG_ 329 ReSideRdrRiDetn75RdrDetnRng "Refer to the data element description in ReSideRdrRiDetn1 with the same data element name";
CM_ SG_ 329 ReSideRdrRiDetn75RdrDetnRngV "Range Velocity";
CM_ SG_ 329 ReSideRdrRiDetn75RdrDetnSts "Refer to the data element description in ReSideRdrRiDetn1 with the same data element name";
CM_ SG_ 329 ReSideRdrRiDetn76RdrDetnAzi "Refer to the data element description in ReSideRdrRiDetn1 with the same data element name";
CM_ SG_ 329 ReSideRdrRiDetn76RdrDetnChks "Refer to the data element description in ReSideRdrRiDetn1 with the same data element name";
CM_ SG_ 329 ReSideRdrRiDetn76RdrDetnCntr "Refer to the data element description in ReSideRdrRiDetn1 with the same data element name";
CM_ SG_ 329 ReSideRdrRiDetn76RdrDetnConf "Refer to the data element description in ReSideRdrRiDetn1 with the same data element name";
CM_ SG_ 329 ReSideRdrRiDetn76RdrDetnElevn "Refer to the data element description in ReSideRdrRiDetn1 with the same data element name";
CM_ SG_ 329 ReSideRdrRiDetn76RdrDetnPwr "Refer to the data element description in ReSideRdrRiDetn1 with the same data element name";
CM_ SG_ 329 ReSideRdrRiDetn76RdrDetnRng "Refer to the data element description in ReSideRdrRiDetn1 with the same data element name";
CM_ SG_ 329 ReSideRdrRiDetn76RdrDetnRngV "Range Velocity";
CM_ SG_ 329 ReSideRdrRiDetn76RdrDetnSts "Refer to the data element description in ReSideRdrRiDetn1 with the same data element name";
CM_ SG_ 329 ReSideRdrRiDetn77RdrDetnAzi "Refer to the data element description in ReSideRdrRiDetn1 with the same data element name";
CM_ SG_ 329 ReSideRdrRiDetn77RdrDetnChks "Refer to the data element description in ReSideRdrRiDetn1 with the same data element name";
CM_ SG_ 329 ReSideRdrRiDetn77RdrDetnCntr "Refer to the data element description in ReSideRdrRiDetn1 with the same data element name";
CM_ SG_ 329 ReSideRdrRiDetn77RdrDetnConf "Refer to the data element description in ReSideRdrRiDetn1 with the same data element name";
CM_ SG_ 329 ReSideRdrRiDetn77RdrDetnElevn "Refer to the data element description in ReSideRdrRiDetn1 with the same data element name";
CM_ SG_ 329 ReSideRdrRiDetn77RdrDetnPwr "Refer to the data element description in ReSideRdrRiDetn1 with the same data element name";
CM_ SG_ 329 ReSideRdrRiDetn77RdrDetnRng "Refer to the data element description in ReSideRdrRiDetn1 with the same data element name";
CM_ SG_ 329 ReSideRdrRiDetn77RdrDetnRngV "Range Velocity";
CM_ SG_ 329 ReSideRdrRiDetn77RdrDetnSts "Refer to the data element description in ReSideRdrRiDetn1 with the same data element name";
CM_ SG_ 329 ReSideRdrRiDetn78RdrDetnAzi "Refer to the data element description in ReSideRdrRiDetn1 with the same data element name";
CM_ SG_ 329 ReSideRdrRiDetn78RdrDetnChks "Refer to the data element description in ReSideRdrRiDetn1 with the same data element name";
CM_ SG_ 329 ReSideRdrRiDetn78RdrDetnCntr "Refer to the data element description in ReSideRdrRiDetn1 with the same data element name";
CM_ SG_ 329 ReSideRdrRiDetn78RdrDetnConf "Refer to the data element description in ReSideRdrRiDetn1 with the same data element name";
CM_ SG_ 329 ReSideRdrRiDetn78RdrDetnElevn "Refer to the data element description in ReSideRdrRiDetn1 with the same data element name";
CM_ SG_ 329 ReSideRdrRiDetn78RdrDetnPwr "Refer to the data element description in ReSideRdrRiDetn1 with the same data element name";
CM_ SG_ 329 ReSideRdrRiDetn78RdrDetnRng "Refer to the data element description in ReSideRdrRiDetn1 with the same data element name";
CM_ SG_ 329 ReSideRdrRiDetn78RdrDetnRngV "Range Velocity";
CM_ SG_ 329 ReSideRdrRiDetn78RdrDetnSts "Refer to the data element description in ReSideRdrRiDetn1 with the same data element name";
CM_ SG_ 331 ReSideRdrRiDetn79RdrDetnAzi "Refer to the data element description in ReSideRdrRiDetn1 with the same data element name";
CM_ SG_ 331 ReSideRdrRiDetn79RdrDetnChks "Refer to the data element description in ReSideRdrRiDetn1 with the same data element name";
CM_ SG_ 331 ReSideRdrRiDetn79RdrDetnCntr "Refer to the data element description in ReSideRdrRiDetn1 with the same data element name";
CM_ SG_ 331 ReSideRdrRiDetn79RdrDetnConf "Refer to the data element description in ReSideRdrRiDetn1 with the same data element name";
CM_ SG_ 331 ReSideRdrRiDetn79RdrDetnElevn "Refer to the data element description in ReSideRdrRiDetn1 with the same data element name";
CM_ SG_ 331 ReSideRdrRiDetn79RdrDetnPwr "Refer to the data element description in ReSideRdrRiDetn1 with the same data element name";
CM_ SG_ 331 ReSideRdrRiDetn79RdrDetnRng "Refer to the data element description in ReSideRdrRiDetn1 with the same data element name";
CM_ SG_ 331 ReSideRdrRiDetn79RdrDetnRngV "Range Velocity";
CM_ SG_ 331 ReSideRdrRiDetn79RdrDetnSts "Refer to the data element description in ReSideRdrRiDetn1 with the same data element name";
CM_ SG_ 331 ReSideRdrRiDetn80RdrDetnAzi "Refer to the data element description in ReSideRdrRiDetn1 with the same data element name";
CM_ SG_ 331 ReSideRdrRiDetn80RdrDetnChks "Refer to the data element description in ReSideRdrRiDetn1 with the same data element name";
CM_ SG_ 331 ReSideRdrRiDetn80RdrDetnCntr "Refer to the data element description in ReSideRdrRiDetn1 with the same data element name";
CM_ SG_ 331 ReSideRdrRiDetn80RdrDetnConf "Refer to the data element description in ReSideRdrRiDetn1 with the same data element name";
CM_ SG_ 331 ReSideRdrRiDetn80RdrDetnElevn "Refer to the data element description in ReSideRdrRiDetn1 with the same data element name";
CM_ SG_ 331 ReSideRdrRiDetn80RdrDetnPwr "Refer to the data element description in ReSideRdrRiDetn1 with the same data element name";
CM_ SG_ 331 ReSideRdrRiDetn80RdrDetnRng "Refer to the data element description in ReSideRdrRiDetn1 with the same data element name";
CM_ SG_ 331 ReSideRdrRiDetn80RdrDetnRngV "Range Velocity";
CM_ SG_ 331 ReSideRdrRiDetn80RdrDetnSts "Refer to the data element description in ReSideRdrRiDetn1 with the same data element name";
CM_ SG_ 331 ReSideRdrRiDetn81RdrDetnAzi "Refer to the data element description in ReSideRdrRiDetn1 with the same data element name";
CM_ SG_ 331 ReSideRdrRiDetn81RdrDetnChks "Refer to the data element description in ReSideRdrRiDetn1 with the same data element name";
CM_ SG_ 331 ReSideRdrRiDetn81RdrDetnCntr "Refer to the data element description in ReSideRdrRiDetn1 with the same data element name";
CM_ SG_ 331 ReSideRdrRiDetn81RdrDetnConf "Refer to the data element description in ReSideRdrRiDetn1 with the same data element name";
CM_ SG_ 331 ReSideRdrRiDetn81RdrDetnElevn "Refer to the data element description in ReSideRdrRiDetn1 with the same data element name";
CM_ SG_ 331 ReSideRdrRiDetn81RdrDetnPwr "Refer to the data element description in ReSideRdrRiDetn1 with the same data element name";
CM_ SG_ 331 ReSideRdrRiDetn81RdrDetnRng "Refer to the data element description in ReSideRdrRiDetn1 with the same data element name";
CM_ SG_ 331 ReSideRdrRiDetn81RdrDetnRngV "Range Velocity";
CM_ SG_ 331 ReSideRdrRiDetn81RdrDetnSts "Refer to the data element description in ReSideRdrRiDetn1 with the same data element name";
CM_ SG_ 331 ReSideRdrRiDetn82RdrDetnAzi "Refer to the data element description in ReSideRdrRiDetn1 with the same data element name";
CM_ SG_ 331 ReSideRdrRiDetn82RdrDetnChks "Refer to the data element description in ReSideRdrRiDetn1 with the same data element name";
CM_ SG_ 331 ReSideRdrRiDetn82RdrDetnCntr "Refer to the data element description in ReSideRdrRiDetn1 with the same data element name";
CM_ SG_ 331 ReSideRdrRiDetn82RdrDetnConf "Refer to the data element description in ReSideRdrRiDetn1 with the same data element name";
CM_ SG_ 331 ReSideRdrRiDetn82RdrDetnElevn "Refer to the data element description in ReSideRdrRiDetn1 with the same data element name";
CM_ SG_ 331 ReSideRdrRiDetn82RdrDetnPwr "Refer to the data element description in ReSideRdrRiDetn1 with the same data element name";
CM_ SG_ 331 ReSideRdrRiDetn82RdrDetnRng "Refer to the data element description in ReSideRdrRiDetn1 with the same data element name";
CM_ SG_ 331 ReSideRdrRiDetn82RdrDetnRngV "Range Velocity";
CM_ SG_ 331 ReSideRdrRiDetn82RdrDetnSts "Refer to the data element description in ReSideRdrRiDetn1 with the same data element name";
CM_ SG_ 331 ReSideRdrRiDetn83RdrDetnAzi "Refer to the data element description in ReSideRdrRiDetn1 with the same data element name";
CM_ SG_ 331 ReSideRdrRiDetn83RdrDetnChks "Refer to the data element description in ReSideRdrRiDetn1 with the same data element name";
CM_ SG_ 331 ReSideRdrRiDetn83RdrDetnCntr "Refer to the data element description in ReSideRdrRiDetn1 with the same data element name";
CM_ SG_ 331 ReSideRdrRiDetn83RdrDetnConf "Refer to the data element description in ReSideRdrRiDetn1 with the same data element name";
CM_ SG_ 331 ReSideRdrRiDetn83RdrDetnElevn "Refer to the data element description in ReSideRdrRiDetn1 with the same data element name";
CM_ SG_ 331 ReSideRdrRiDetn83RdrDetnPwr "Refer to the data element description in ReSideRdrRiDetn1 with the same data element name";
CM_ SG_ 331 ReSideRdrRiDetn83RdrDetnRng "Refer to the data element description in ReSideRdrRiDetn1 with the same data element name";
CM_ SG_ 331 ReSideRdrRiDetn83RdrDetnRngV "Range Velocity";
CM_ SG_ 331 ReSideRdrRiDetn83RdrDetnSts "Refer to the data element description in ReSideRdrRiDetn1 with the same data element name";
CM_ SG_ 331 ReSideRdrRiDetn84RdrDetnAzi "Refer to the data element description in ReSideRdrRiDetn1 with the same data element name";
CM_ SG_ 331 ReSideRdrRiDetn84RdrDetnChks "Refer to the data element description in ReSideRdrRiDetn1 with the same data element name";
CM_ SG_ 331 ReSideRdrRiDetn84RdrDetnCntr "Refer to the data element description in ReSideRdrRiDetn1 with the same data element name";
CM_ SG_ 331 ReSideRdrRiDetn84RdrDetnConf "Refer to the data element description in ReSideRdrRiDetn1 with the same data element name";
CM_ SG_ 331 ReSideRdrRiDetn84RdrDetnElevn "Refer to the data element description in ReSideRdrRiDetn1 with the same data element name";
CM_ SG_ 331 ReSideRdrRiDetn84RdrDetnPwr "Refer to the data element description in ReSideRdrRiDetn1 with the same data element name";
CM_ SG_ 331 ReSideRdrRiDetn84RdrDetnRng "Refer to the data element description in ReSideRdrRiDetn1 with the same data element name";
CM_ SG_ 331 ReSideRdrRiDetn84RdrDetnRngV "Range Velocity";
CM_ SG_ 331 ReSideRdrRiDetn84RdrDetnSts "Refer to the data element description in ReSideRdrRiDetn1 with the same data element name";
CM_ SG_ 333 ReSideRdrRiDetn85RdrDetnAzi "Refer to the data element description in ReSideRdrRiDetn1 with the same data element name";
CM_ SG_ 333 ReSideRdrRiDetn85RdrDetnChks "Refer to the data element description in ReSideRdrRiDetn1 with the same data element name";
CM_ SG_ 333 ReSideRdrRiDetn85RdrDetnCntr "Refer to the data element description in ReSideRdrRiDetn1 with the same data element name";
CM_ SG_ 333 ReSideRdrRiDetn85RdrDetnConf "Refer to the data element description in ReSideRdrRiDetn1 with the same data element name";
CM_ SG_ 333 ReSideRdrRiDetn85RdrDetnElevn "Refer to the data element description in ReSideRdrRiDetn1 with the same data element name";
CM_ SG_ 333 ReSideRdrRiDetn85RdrDetnPwr "Refer to the data element description in ReSideRdrRiDetn1 with the same data element name";
CM_ SG_ 333 ReSideRdrRiDetn85RdrDetnRng "Refer to the data element description in ReSideRdrRiDetn1 with the same data element name";
CM_ SG_ 333 ReSideRdrRiDetn85RdrDetnRngV "Range Velocity";
CM_ SG_ 333 ReSideRdrRiDetn85RdrDetnSts "Refer to the data element description in ReSideRdrRiDetn1 with the same data element name";
CM_ SG_ 333 ReSideRdrRiDetn86RdrDetnAzi "Refer to the data element description in ReSideRdrRiDetn1 with the same data element name";
CM_ SG_ 333 ReSideRdrRiDetn86RdrDetnChks "Refer to the data element description in ReSideRdrRiDetn1 with the same data element name";
CM_ SG_ 333 ReSideRdrRiDetn86RdrDetnCntr "Refer to the data element description in ReSideRdrRiDetn1 with the same data element name";
CM_ SG_ 333 ReSideRdrRiDetn86RdrDetnConf "Refer to the data element description in ReSideRdrRiDetn1 with the same data element name";
CM_ SG_ 333 ReSideRdrRiDetn86RdrDetnElevn "Refer to the data element description in ReSideRdrRiDetn1 with the same data element name";
CM_ SG_ 333 ReSideRdrRiDetn86RdrDetnPwr "Refer to the data element description in ReSideRdrRiDetn1 with the same data element name";
CM_ SG_ 333 ReSideRdrRiDetn86RdrDetnRng "Refer to the data element description in ReSideRdrRiDetn1 with the same data element name";
CM_ SG_ 333 ReSideRdrRiDetn86RdrDetnRngV "Range Velocity";
CM_ SG_ 333 ReSideRdrRiDetn86RdrDetnSts "Refer to the data element description in ReSideRdrRiDetn1 with the same data element name";
CM_ SG_ 333 ReSideRdrRiDetn87RdrDetnAzi "Refer to the data element description in ReSideRdrRiDetn1 with the same data element name";
CM_ SG_ 333 ReSideRdrRiDetn87RdrDetnChks "Refer to the data element description in ReSideRdrRiDetn1 with the same data element name";
CM_ SG_ 333 ReSideRdrRiDetn87RdrDetnCntr "Refer to the data element description in ReSideRdrRiDetn1 with the same data element name";
CM_ SG_ 333 ReSideRdrRiDetn87RdrDetnConf "Refer to the data element description in ReSideRdrRiDetn1 with the same data element name";
CM_ SG_ 333 ReSideRdrRiDetn87RdrDetnElevn "Refer to the data element description in ReSideRdrRiDetn1 with the same data element name";
CM_ SG_ 333 ReSideRdrRiDetn87RdrDetnPwr "Refer to the data element description in ReSideRdrRiDetn1 with the same data element name";
CM_ SG_ 333 ReSideRdrRiDetn87RdrDetnRng "Refer to the data element description in ReSideRdrRiDetn1 with the same data element name";
CM_ SG_ 333 ReSideRdrRiDetn87RdrDetnRngV "Range Velocity";
CM_ SG_ 333 ReSideRdrRiDetn87RdrDetnSts "Refer to the data element description in ReSideRdrRiDetn1 with the same data element name";
CM_ SG_ 333 ReSideRdrRiDetn88RdrDetnAzi "Refer to the data element description in ReSideRdrRiDetn1 with the same data element name";
CM_ SG_ 333 ReSideRdrRiDetn88RdrDetnChks "Refer to the data element description in ReSideRdrRiDetn1 with the same data element name";
CM_ SG_ 333 ReSideRdrRiDetn88RdrDetnCntr "Refer to the data element description in ReSideRdrRiDetn1 with the same data element name";
CM_ SG_ 333 ReSideRdrRiDetn88RdrDetnConf "Refer to the data element description in ReSideRdrRiDetn1 with the same data element name";
CM_ SG_ 333 ReSideRdrRiDetn88RdrDetnElevn "Refer to the data element description in ReSideRdrRiDetn1 with the same data element name";
CM_ SG_ 333 ReSideRdrRiDetn88RdrDetnPwr "Refer to the data element description in ReSideRdrRiDetn1 with the same data element name";
CM_ SG_ 333 ReSideRdrRiDetn88RdrDetnRng "Refer to the data element description in ReSideRdrRiDetn1 with the same data element name";
CM_ SG_ 333 ReSideRdrRiDetn88RdrDetnRngV "Range Velocity";
CM_ SG_ 333 ReSideRdrRiDetn88RdrDetnSts "Refer to the data element description in ReSideRdrRiDetn1 with the same data element name";
CM_ SG_ 333 ReSideRdrRiDetn89RdrDetnAzi "Refer to the data element description in ReSideRdrRiDetn1 with the same data element name";
CM_ SG_ 333 ReSideRdrRiDetn89RdrDetnChks "Refer to the data element description in ReSideRdrRiDetn1 with the same data element name";
CM_ SG_ 333 ReSideRdrRiDetn89RdrDetnCntr "Refer to the data element description in ReSideRdrRiDetn1 with the same data element name";
CM_ SG_ 333 ReSideRdrRiDetn89RdrDetnConf "Refer to the data element description in ReSideRdrRiDetn1 with the same data element name";
CM_ SG_ 333 ReSideRdrRiDetn89RdrDetnElevn "Refer to the data element description in ReSideRdrRiDetn1 with the same data element name";
CM_ SG_ 333 ReSideRdrRiDetn89RdrDetnPwr "Refer to the data element description in ReSideRdrRiDetn1 with the same data element name";
CM_ SG_ 333 ReSideRdrRiDetn89RdrDetnRng "Refer to the data element description in ReSideRdrRiDetn1 with the same data element name";
CM_ SG_ 333 ReSideRdrRiDetn89RdrDetnRngV "Range Velocity";
CM_ SG_ 333 ReSideRdrRiDetn89RdrDetnSts "Refer to the data element description in ReSideRdrRiDetn1 with the same data element name";
CM_ SG_ 333 ReSideRdrRiDetn90RdrDetnAzi "Refer to the data element description in ReSideRdrRiDetn1 with the same data element name";
CM_ SG_ 333 ReSideRdrRiDetn90RdrDetnChks "Refer to the data element description in ReSideRdrRiDetn1 with the same data element name";
CM_ SG_ 333 ReSideRdrRiDetn90RdrDetnCntr "Refer to the data element description in ReSideRdrRiDetn1 with the same data element name";
CM_ SG_ 333 ReSideRdrRiDetn90RdrDetnConf "Refer to the data element description in ReSideRdrRiDetn1 with the same data element name";
CM_ SG_ 333 ReSideRdrRiDetn90RdrDetnElevn "Refer to the data element description in ReSideRdrRiDetn1 with the same data element name";
CM_ SG_ 333 ReSideRdrRiDetn90RdrDetnPwr "Refer to the data element description in ReSideRdrRiDetn1 with the same data element name";
CM_ SG_ 333 ReSideRdrRiDetn90RdrDetnRng "Refer to the data element description in ReSideRdrRiDetn1 with the same data element name";
CM_ SG_ 333 ReSideRdrRiDetn90RdrDetnRngV "Range Velocity";
CM_ SG_ 333 ReSideRdrRiDetn90RdrDetnSts "Refer to the data element description in ReSideRdrRiDetn1 with the same data element name";
BA_DEF_ BO_ "VFrameFormat" ENUM "StandardCAN","ExtendedCAN","reserved","J1939PG","reserved","reserved","reserved","reserved","reserved","reserved","reserved","reserved","reserved","reserved","StandardCAN_FD","ExtendedCAN_FD";
BA_DEF_ BO_ "CANFD_BRS" ENUM "0","1";
BA_DEF_ BO_ "GenMsgSendType" ENUM "cyclic", "spontaneous", "not-used", "not-used", "not-used", "cyclicAndSpontaneous", "not-used", "cyclicIfActive", "NoMsgSendType"; // [us]
BA_DEF_ BO_ "GenMsgCycleTime" INT 0 65536; // [ms]
BA_DEF_ BO_ "GenMsgStartDelayTime" INT 0 65536; // [ms]
BA_DEF_ BO_ "GenMsgDelayTime" INT 0 65536; // [ms]
BA_DEF_ SG_ "GenSigSendType" ENUM "Cyclic","OnWrite","OnWriteWithRepetition","OnChange","OnChangeWithRepetition","IfActive","IfActiveWithRepetition","NoSigSendType";
BA_DEF_ SG_ "GenSigStartValue" HEX 0 80000000;
BA_DEF_ BO_ "GenMsgILSupport" ENUM "No","Yes";
BA_DEF_ BO_ "NmAsrMessage" ENUM "No","Yes";
BA_DEF_ SG_ "GenSigFuncType" ENUM "NoFunction","n/a","n/a","n/a","n/a","n/a","n/a","n/a","n/a","n/a","n/a","n/a","n/a","n/a","n/a","CHK","CNTR","n/a","n/a","n/a","CNTR_AR_01","CRC_AR_01_BOTH","CRC_AR_01_ALT","CRC_AR_01_LOW","CRC_AR_01_NIBBLE","CNTR_AR_04","CRC_AR_04A","CNTR_AR_05","CRC_AR_05";
BA_DEF_ SG_ "GenSigDataID" STRING;

BA_DEF_DEF_ "VFrameFormat" "J1939PG";
BA_DEF_DEF_ "CANFD_BRS" "1";
BA_DEF_DEF_ "GenSigStartValue" 0;
BA_DEF_DEF_ "GenSigSendType" "NoSigSendType";
BA_DEF_DEF_ "GenMsgCycleTime" 0;
BA_DEF_DEF_ "GenMsgDelayTime" 0;
BA_DEF_DEF_ "GenMsgStartDelayTime" 0;
BA_DEF_DEF_ "GenMsgSendType" "NoMsgSendType";
BA_DEF_DEF_ "GenMsgILSupport" "Yes";
BA_DEF_DEF_ "NmAsrMessage" "No";
BA_DEF_DEF_ "GenSigFuncType" "NoFunction";
BA_DEF_DEF_ "GenSigDataID" "";
// Frame: SODRSafetyCANFD3Frame08
BA_ "VFrameFormat" BO_ 319 14;
BA_ "GenMsgSendType" BO_ 319 0;
BA_ "GenMsgCycleTime" BO_ 319 50.000;
BA_ "GenSigStartValue" SG_ 319 ReSideRdrRiDetn43RdrDetnAzi 900;
BA_ "GenSigSendType" SG_ 319 ReSideRdrRiDetn43RdrDetnAzi 0;
BA_ "GenSigSendType" SG_ 319 ReSideRdrRiDetn43RdrDetnChks 0;
BA_ "GenSigFuncType" SG_ 319 ReSideRdrRiDetn43RdrDetnChks 15;
BA_ "GenSigDataID" SG_ 319 ReSideRdrRiDetn43RdrDetnChks "0xA6B";
BA_ "GenSigSendType" SG_ 319 ReSideRdrRiDetn43RdrDetnCntr 0;
BA_ "GenSigFuncType" SG_ 319 ReSideRdrRiDetn43RdrDetnCntr 16;
BA_ "GenSigSendType" SG_ 319 ReSideRdrRiDetn43RdrDetnConf 0;
BA_ "GenSigStartValue" SG_ 319 ReSideRdrRiDetn43RdrDetnElevn 15;
BA_ "GenSigSendType" SG_ 319 ReSideRdrRiDetn43RdrDetnElevn 0;
BA_ "GenSigSendType" SG_ 319 ReSideRdrRiDetn43RdrDetnPwr 0;
BA_ "GenSigStartValue" SG_ 319 ReSideRdrRiDetn43RdrDetnRng 10050;
BA_ "GenSigSendType" SG_ 319 ReSideRdrRiDetn43RdrDetnRng 0;
BA_ "GenSigStartValue" SG_ 319 ReSideRdrRiDetn43RdrDetnRngV 4000;
BA_ "GenSigSendType" SG_ 319 ReSideRdrRiDetn43RdrDetnRngV 0;
BA_ "GenSigStartValue" SG_ 319 ReSideRdrRiDetn43RdrDetnSts 3;
BA_ "GenSigSendType" SG_ 319 ReSideRdrRiDetn43RdrDetnSts 0;
BA_ "GenSigStartValue" SG_ 319 ReSideRdrRiDetn44RdrDetnAzi 900;
BA_ "GenSigSendType" SG_ 319 ReSideRdrRiDetn44RdrDetnAzi 0;
BA_ "GenSigSendType" SG_ 319 ReSideRdrRiDetn44RdrDetnChks 0;
BA_ "GenSigFuncType" SG_ 319 ReSideRdrRiDetn44RdrDetnChks 15;
BA_ "GenSigDataID" SG_ 319 ReSideRdrRiDetn44RdrDetnChks "0xA6C";
BA_ "GenSigSendType" SG_ 319 ReSideRdrRiDetn44RdrDetnCntr 0;
BA_ "GenSigFuncType" SG_ 319 ReSideRdrRiDetn44RdrDetnCntr 16;
BA_ "GenSigSendType" SG_ 319 ReSideRdrRiDetn44RdrDetnConf 0;
BA_ "GenSigStartValue" SG_ 319 ReSideRdrRiDetn44RdrDetnElevn 15;
BA_ "GenSigSendType" SG_ 319 ReSideRdrRiDetn44RdrDetnElevn 0;
BA_ "GenSigSendType" SG_ 319 ReSideRdrRiDetn44RdrDetnPwr 0;
BA_ "GenSigStartValue" SG_ 319 ReSideRdrRiDetn44RdrDetnRng 10050;
BA_ "GenSigSendType" SG_ 319 ReSideRdrRiDetn44RdrDetnRng 0;
BA_ "GenSigStartValue" SG_ 319 ReSideRdrRiDetn44RdrDetnRngV 4000;
BA_ "GenSigSendType" SG_ 319 ReSideRdrRiDetn44RdrDetnRngV 0;
BA_ "GenSigStartValue" SG_ 319 ReSideRdrRiDetn44RdrDetnSts 3;
BA_ "GenSigSendType" SG_ 319 ReSideRdrRiDetn44RdrDetnSts 0;
BA_ "GenSigStartValue" SG_ 319 ReSideRdrRiDetn45RdrDetnAzi 900;
BA_ "GenSigSendType" SG_ 319 ReSideRdrRiDetn45RdrDetnAzi 0;
BA_ "GenSigSendType" SG_ 319 ReSideRdrRiDetn45RdrDetnChks 0;
BA_ "GenSigFuncType" SG_ 319 ReSideRdrRiDetn45RdrDetnChks 15;
BA_ "GenSigDataID" SG_ 319 ReSideRdrRiDetn45RdrDetnChks "0xA6D";
BA_ "GenSigSendType" SG_ 319 ReSideRdrRiDetn45RdrDetnCntr 0;
BA_ "GenSigFuncType" SG_ 319 ReSideRdrRiDetn45RdrDetnCntr 16;
BA_ "GenSigSendType" SG_ 319 ReSideRdrRiDetn45RdrDetnConf 0;
BA_ "GenSigStartValue" SG_ 319 ReSideRdrRiDetn45RdrDetnElevn 15;
BA_ "GenSigSendType" SG_ 319 ReSideRdrRiDetn45RdrDetnElevn 0;
BA_ "GenSigSendType" SG_ 319 ReSideRdrRiDetn45RdrDetnPwr 0;
BA_ "GenSigStartValue" SG_ 319 ReSideRdrRiDetn45RdrDetnRng 10050;
BA_ "GenSigSendType" SG_ 319 ReSideRdrRiDetn45RdrDetnRng 0;
BA_ "GenSigStartValue" SG_ 319 ReSideRdrRiDetn45RdrDetnRngV 4000;
BA_ "GenSigSendType" SG_ 319 ReSideRdrRiDetn45RdrDetnRngV 0;
BA_ "GenSigStartValue" SG_ 319 ReSideRdrRiDetn45RdrDetnSts 3;
BA_ "GenSigSendType" SG_ 319 ReSideRdrRiDetn45RdrDetnSts 0;
BA_ "GenSigStartValue" SG_ 319 ReSideRdrRiDetn46RdrDetnAzi 900;
BA_ "GenSigSendType" SG_ 319 ReSideRdrRiDetn46RdrDetnAzi 0;
BA_ "GenSigSendType" SG_ 319 ReSideRdrRiDetn46RdrDetnChks 0;
BA_ "GenSigFuncType" SG_ 319 ReSideRdrRiDetn46RdrDetnChks 15;
BA_ "GenSigDataID" SG_ 319 ReSideRdrRiDetn46RdrDetnChks "0xA6E";
BA_ "GenSigSendType" SG_ 319 ReSideRdrRiDetn46RdrDetnCntr 0;
BA_ "GenSigFuncType" SG_ 319 ReSideRdrRiDetn46RdrDetnCntr 16;
BA_ "GenSigSendType" SG_ 319 ReSideRdrRiDetn46RdrDetnConf 0;
BA_ "GenSigStartValue" SG_ 319 ReSideRdrRiDetn46RdrDetnElevn 15;
BA_ "GenSigSendType" SG_ 319 ReSideRdrRiDetn46RdrDetnElevn 0;
BA_ "GenSigSendType" SG_ 319 ReSideRdrRiDetn46RdrDetnPwr 0;
BA_ "GenSigStartValue" SG_ 319 ReSideRdrRiDetn46RdrDetnRng 10050;
BA_ "GenSigSendType" SG_ 319 ReSideRdrRiDetn46RdrDetnRng 0;
BA_ "GenSigStartValue" SG_ 319 ReSideRdrRiDetn46RdrDetnRngV 4000;
BA_ "GenSigSendType" SG_ 319 ReSideRdrRiDetn46RdrDetnRngV 0;
BA_ "GenSigStartValue" SG_ 319 ReSideRdrRiDetn46RdrDetnSts 3;
BA_ "GenSigSendType" SG_ 319 ReSideRdrRiDetn46RdrDetnSts 0;
BA_ "GenSigStartValue" SG_ 319 ReSideRdrRiDetn47RdrDetnAzi 900;
BA_ "GenSigSendType" SG_ 319 ReSideRdrRiDetn47RdrDetnAzi 0;
BA_ "GenSigSendType" SG_ 319 ReSideRdrRiDetn47RdrDetnChks 0;
BA_ "GenSigFuncType" SG_ 319 ReSideRdrRiDetn47RdrDetnChks 15;
BA_ "GenSigDataID" SG_ 319 ReSideRdrRiDetn47RdrDetnChks "0xA6F";
BA_ "GenSigSendType" SG_ 319 ReSideRdrRiDetn47RdrDetnCntr 0;
BA_ "GenSigFuncType" SG_ 319 ReSideRdrRiDetn47RdrDetnCntr 16;
BA_ "GenSigSendType" SG_ 319 ReSideRdrRiDetn47RdrDetnConf 0;
BA_ "GenSigStartValue" SG_ 319 ReSideRdrRiDetn47RdrDetnElevn 15;
BA_ "GenSigSendType" SG_ 319 ReSideRdrRiDetn47RdrDetnElevn 0;
BA_ "GenSigSendType" SG_ 319 ReSideRdrRiDetn47RdrDetnPwr 0;
BA_ "GenSigStartValue" SG_ 319 ReSideRdrRiDetn47RdrDetnRng 10050;
BA_ "GenSigSendType" SG_ 319 ReSideRdrRiDetn47RdrDetnRng 0;
BA_ "GenSigStartValue" SG_ 319 ReSideRdrRiDetn47RdrDetnRngV 4000;
BA_ "GenSigSendType" SG_ 319 ReSideRdrRiDetn47RdrDetnRngV 0;
BA_ "GenSigStartValue" SG_ 319 ReSideRdrRiDetn47RdrDetnSts 3;
BA_ "GenSigSendType" SG_ 319 ReSideRdrRiDetn47RdrDetnSts 0;
BA_ "GenSigStartValue" SG_ 319 ReSideRdrRiDetn48RdrDetnAzi 900;
BA_ "GenSigSendType" SG_ 319 ReSideRdrRiDetn48RdrDetnAzi 0;
BA_ "GenSigSendType" SG_ 319 ReSideRdrRiDetn48RdrDetnChks 0;
BA_ "GenSigFuncType" SG_ 319 ReSideRdrRiDetn48RdrDetnChks 15;
BA_ "GenSigDataID" SG_ 319 ReSideRdrRiDetn48RdrDetnChks "0xA70";
BA_ "GenSigSendType" SG_ 319 ReSideRdrRiDetn48RdrDetnCntr 0;
BA_ "GenSigFuncType" SG_ 319 ReSideRdrRiDetn48RdrDetnCntr 16;
BA_ "GenSigSendType" SG_ 319 ReSideRdrRiDetn48RdrDetnConf 0;
BA_ "GenSigStartValue" SG_ 319 ReSideRdrRiDetn48RdrDetnElevn 15;
BA_ "GenSigSendType" SG_ 319 ReSideRdrRiDetn48RdrDetnElevn 0;
BA_ "GenSigSendType" SG_ 319 ReSideRdrRiDetn48RdrDetnPwr 0;
BA_ "GenSigStartValue" SG_ 319 ReSideRdrRiDetn48RdrDetnRng 10050;
BA_ "GenSigSendType" SG_ 319 ReSideRdrRiDetn48RdrDetnRng 0;
BA_ "GenSigStartValue" SG_ 319 ReSideRdrRiDetn48RdrDetnRngV 4000;
BA_ "GenSigSendType" SG_ 319 ReSideRdrRiDetn48RdrDetnRngV 0;
BA_ "GenSigStartValue" SG_ 319 ReSideRdrRiDetn48RdrDetnSts 3;
BA_ "GenSigSendType" SG_ 319 ReSideRdrRiDetn48RdrDetnSts 0;
// Frame: SODRSafetyCANFD3Frame09
BA_ "VFrameFormat" BO_ 321 14;
BA_ "GenMsgSendType" BO_ 321 0;
BA_ "GenMsgCycleTime" BO_ 321 50.000;
BA_ "GenSigStartValue" SG_ 321 ReSideRdrRiDetn49RdrDetnAzi 900;
BA_ "GenSigSendType" SG_ 321 ReSideRdrRiDetn49RdrDetnAzi 0;
BA_ "GenSigSendType" SG_ 321 ReSideRdrRiDetn49RdrDetnChks 0;
BA_ "GenSigFuncType" SG_ 321 ReSideRdrRiDetn49RdrDetnChks 15;
BA_ "GenSigDataID" SG_ 321 ReSideRdrRiDetn49RdrDetnChks "0xA71";
BA_ "GenSigSendType" SG_ 321 ReSideRdrRiDetn49RdrDetnCntr 0;
BA_ "GenSigFuncType" SG_ 321 ReSideRdrRiDetn49RdrDetnCntr 16;
BA_ "GenSigSendType" SG_ 321 ReSideRdrRiDetn49RdrDetnConf 0;
BA_ "GenSigStartValue" SG_ 321 ReSideRdrRiDetn49RdrDetnElevn 15;
BA_ "GenSigSendType" SG_ 321 ReSideRdrRiDetn49RdrDetnElevn 0;
BA_ "GenSigSendType" SG_ 321 ReSideRdrRiDetn49RdrDetnPwr 0;
BA_ "GenSigStartValue" SG_ 321 ReSideRdrRiDetn49RdrDetnRng 10050;
BA_ "GenSigSendType" SG_ 321 ReSideRdrRiDetn49RdrDetnRng 0;
BA_ "GenSigStartValue" SG_ 321 ReSideRdrRiDetn49RdrDetnRngV 4000;
BA_ "GenSigSendType" SG_ 321 ReSideRdrRiDetn49RdrDetnRngV 0;
BA_ "GenSigStartValue" SG_ 321 ReSideRdrRiDetn49RdrDetnSts 3;
BA_ "GenSigSendType" SG_ 321 ReSideRdrRiDetn49RdrDetnSts 0;
BA_ "GenSigStartValue" SG_ 321 ReSideRdrRiDetn50RdrDetnAzi 900;
BA_ "GenSigSendType" SG_ 321 ReSideRdrRiDetn50RdrDetnAzi 0;
BA_ "GenSigSendType" SG_ 321 ReSideRdrRiDetn50RdrDetnChks 0;
BA_ "GenSigFuncType" SG_ 321 ReSideRdrRiDetn50RdrDetnChks 15;
BA_ "GenSigDataID" SG_ 321 ReSideRdrRiDetn50RdrDetnChks "0xA72";
BA_ "GenSigSendType" SG_ 321 ReSideRdrRiDetn50RdrDetnCntr 0;
BA_ "GenSigFuncType" SG_ 321 ReSideRdrRiDetn50RdrDetnCntr 16;
BA_ "GenSigSendType" SG_ 321 ReSideRdrRiDetn50RdrDetnConf 0;
BA_ "GenSigStartValue" SG_ 321 ReSideRdrRiDetn50RdrDetnElevn 15;
BA_ "GenSigSendType" SG_ 321 ReSideRdrRiDetn50RdrDetnElevn 0;
BA_ "GenSigSendType" SG_ 321 ReSideRdrRiDetn50RdrDetnPwr 0;
BA_ "GenSigStartValue" SG_ 321 ReSideRdrRiDetn50RdrDetnRng 10050;
BA_ "GenSigSendType" SG_ 321 ReSideRdrRiDetn50RdrDetnRng 0;
BA_ "GenSigStartValue" SG_ 321 ReSideRdrRiDetn50RdrDetnRngV 4000;
BA_ "GenSigSendType" SG_ 321 ReSideRdrRiDetn50RdrDetnRngV 0;
BA_ "GenSigStartValue" SG_ 321 ReSideRdrRiDetn50RdrDetnSts 3;
BA_ "GenSigSendType" SG_ 321 ReSideRdrRiDetn50RdrDetnSts 0;
BA_ "GenSigStartValue" SG_ 321 ReSideRdrRiDetn51RdrDetnAzi 900;
BA_ "GenSigSendType" SG_ 321 ReSideRdrRiDetn51RdrDetnAzi 0;
BA_ "GenSigSendType" SG_ 321 ReSideRdrRiDetn51RdrDetnChks 0;
BA_ "GenSigFuncType" SG_ 321 ReSideRdrRiDetn51RdrDetnChks 15;
BA_ "GenSigDataID" SG_ 321 ReSideRdrRiDetn51RdrDetnChks "0xA73";
BA_ "GenSigSendType" SG_ 321 ReSideRdrRiDetn51RdrDetnCntr 0;
BA_ "GenSigFuncType" SG_ 321 ReSideRdrRiDetn51RdrDetnCntr 16;
BA_ "GenSigSendType" SG_ 321 ReSideRdrRiDetn51RdrDetnConf 0;
BA_ "GenSigStartValue" SG_ 321 ReSideRdrRiDetn51RdrDetnElevn 15;
BA_ "GenSigSendType" SG_ 321 ReSideRdrRiDetn51RdrDetnElevn 0;
BA_ "GenSigSendType" SG_ 321 ReSideRdrRiDetn51RdrDetnPwr 0;
BA_ "GenSigStartValue" SG_ 321 ReSideRdrRiDetn51RdrDetnRng 10050;
BA_ "GenSigSendType" SG_ 321 ReSideRdrRiDetn51RdrDetnRng 0;
BA_ "GenSigStartValue" SG_ 321 ReSideRdrRiDetn51RdrDetnRngV 4000;
BA_ "GenSigSendType" SG_ 321 ReSideRdrRiDetn51RdrDetnRngV 0;
BA_ "GenSigStartValue" SG_ 321 ReSideRdrRiDetn51RdrDetnSts 3;
BA_ "GenSigSendType" SG_ 321 ReSideRdrRiDetn51RdrDetnSts 0;
BA_ "GenSigStartValue" SG_ 321 ReSideRdrRiDetn52RdrDetnAzi 900;
BA_ "GenSigSendType" SG_ 321 ReSideRdrRiDetn52RdrDetnAzi 0;
BA_ "GenSigSendType" SG_ 321 ReSideRdrRiDetn52RdrDetnChks 0;
BA_ "GenSigFuncType" SG_ 321 ReSideRdrRiDetn52RdrDetnChks 15;
BA_ "GenSigDataID" SG_ 321 ReSideRdrRiDetn52RdrDetnChks "0xA74";
BA_ "GenSigSendType" SG_ 321 ReSideRdrRiDetn52RdrDetnCntr 0;
BA_ "GenSigFuncType" SG_ 321 ReSideRdrRiDetn52RdrDetnCntr 16;
BA_ "GenSigSendType" SG_ 321 ReSideRdrRiDetn52RdrDetnConf 0;
BA_ "GenSigStartValue" SG_ 321 ReSideRdrRiDetn52RdrDetnElevn 15;
BA_ "GenSigSendType" SG_ 321 ReSideRdrRiDetn52RdrDetnElevn 0;
BA_ "GenSigSendType" SG_ 321 ReSideRdrRiDetn52RdrDetnPwr 0;
BA_ "GenSigStartValue" SG_ 321 ReSideRdrRiDetn52RdrDetnRng 10050;
BA_ "GenSigSendType" SG_ 321 ReSideRdrRiDetn52RdrDetnRng 0;
BA_ "GenSigStartValue" SG_ 321 ReSideRdrRiDetn52RdrDetnRngV 4000;
BA_ "GenSigSendType" SG_ 321 ReSideRdrRiDetn52RdrDetnRngV 0;
BA_ "GenSigStartValue" SG_ 321 ReSideRdrRiDetn52RdrDetnSts 3;
BA_ "GenSigSendType" SG_ 321 ReSideRdrRiDetn52RdrDetnSts 0;
BA_ "GenSigStartValue" SG_ 321 ReSideRdrRiDetn53RdrDetnAzi 900;
BA_ "GenSigSendType" SG_ 321 ReSideRdrRiDetn53RdrDetnAzi 0;
BA_ "GenSigSendType" SG_ 321 ReSideRdrRiDetn53RdrDetnChks 0;
BA_ "GenSigFuncType" SG_ 321 ReSideRdrRiDetn53RdrDetnChks 15;
BA_ "GenSigDataID" SG_ 321 ReSideRdrRiDetn53RdrDetnChks "0xA75";
BA_ "GenSigSendType" SG_ 321 ReSideRdrRiDetn53RdrDetnCntr 0;
BA_ "GenSigFuncType" SG_ 321 ReSideRdrRiDetn53RdrDetnCntr 16;
BA_ "GenSigSendType" SG_ 321 ReSideRdrRiDetn53RdrDetnConf 0;
BA_ "GenSigStartValue" SG_ 321 ReSideRdrRiDetn53RdrDetnElevn 15;
BA_ "GenSigSendType" SG_ 321 ReSideRdrRiDetn53RdrDetnElevn 0;
BA_ "GenSigSendType" SG_ 321 ReSideRdrRiDetn53RdrDetnPwr 0;
BA_ "GenSigStartValue" SG_ 321 ReSideRdrRiDetn53RdrDetnRng 10050;
BA_ "GenSigSendType" SG_ 321 ReSideRdrRiDetn53RdrDetnRng 0;
BA_ "GenSigStartValue" SG_ 321 ReSideRdrRiDetn53RdrDetnRngV 4000;
BA_ "GenSigSendType" SG_ 321 ReSideRdrRiDetn53RdrDetnRngV 0;
BA_ "GenSigStartValue" SG_ 321 ReSideRdrRiDetn53RdrDetnSts 3;
BA_ "GenSigSendType" SG_ 321 ReSideRdrRiDetn53RdrDetnSts 0;
BA_ "GenSigStartValue" SG_ 321 ReSideRdrRiDetn54RdrDetnAzi 900;
BA_ "GenSigSendType" SG_ 321 ReSideRdrRiDetn54RdrDetnAzi 0;
BA_ "GenSigSendType" SG_ 321 ReSideRdrRiDetn54RdrDetnChks 0;
BA_ "GenSigFuncType" SG_ 321 ReSideRdrRiDetn54RdrDetnChks 15;
BA_ "GenSigDataID" SG_ 321 ReSideRdrRiDetn54RdrDetnChks "0xA76";
BA_ "GenSigSendType" SG_ 321 ReSideRdrRiDetn54RdrDetnCntr 0;
BA_ "GenSigFuncType" SG_ 321 ReSideRdrRiDetn54RdrDetnCntr 16;
BA_ "GenSigSendType" SG_ 321 ReSideRdrRiDetn54RdrDetnConf 0;
BA_ "GenSigStartValue" SG_ 321 ReSideRdrRiDetn54RdrDetnElevn 15;
BA_ "GenSigSendType" SG_ 321 ReSideRdrRiDetn54RdrDetnElevn 0;
BA_ "GenSigSendType" SG_ 321 ReSideRdrRiDetn54RdrDetnPwr 0;
BA_ "GenSigStartValue" SG_ 321 ReSideRdrRiDetn54RdrDetnRng 10050;
BA_ "GenSigSendType" SG_ 321 ReSideRdrRiDetn54RdrDetnRng 0;
BA_ "GenSigStartValue" SG_ 321 ReSideRdrRiDetn54RdrDetnRngV 4000;
BA_ "GenSigSendType" SG_ 321 ReSideRdrRiDetn54RdrDetnRngV 0;
BA_ "GenSigStartValue" SG_ 321 ReSideRdrRiDetn54RdrDetnSts 3;
BA_ "GenSigSendType" SG_ 321 ReSideRdrRiDetn54RdrDetnSts 0;
// Frame: SODRSafetyCANFD3Frame10
BA_ "VFrameFormat" BO_ 323 14;
BA_ "GenMsgSendType" BO_ 323 0;
BA_ "GenMsgCycleTime" BO_ 323 50.000;
BA_ "GenSigStartValue" SG_ 323 ReSideRdrRiDetn55RdrDetnAzi 900;
BA_ "GenSigSendType" SG_ 323 ReSideRdrRiDetn55RdrDetnAzi 0;
BA_ "GenSigSendType" SG_ 323 ReSideRdrRiDetn55RdrDetnChks 0;
BA_ "GenSigFuncType" SG_ 323 ReSideRdrRiDetn55RdrDetnChks 15;
BA_ "GenSigDataID" SG_ 323 ReSideRdrRiDetn55RdrDetnChks "0xA77";
BA_ "GenSigSendType" SG_ 323 ReSideRdrRiDetn55RdrDetnCntr 0;
BA_ "GenSigFuncType" SG_ 323 ReSideRdrRiDetn55RdrDetnCntr 16;
BA_ "GenSigSendType" SG_ 323 ReSideRdrRiDetn55RdrDetnConf 0;
BA_ "GenSigStartValue" SG_ 323 ReSideRdrRiDetn55RdrDetnElevn 15;
BA_ "GenSigSendType" SG_ 323 ReSideRdrRiDetn55RdrDetnElevn 0;
BA_ "GenSigSendType" SG_ 323 ReSideRdrRiDetn55RdrDetnPwr 0;
BA_ "GenSigStartValue" SG_ 323 ReSideRdrRiDetn55RdrDetnRng 10050;
BA_ "GenSigSendType" SG_ 323 ReSideRdrRiDetn55RdrDetnRng 0;
BA_ "GenSigStartValue" SG_ 323 ReSideRdrRiDetn55RdrDetnRngV 4000;
BA_ "GenSigSendType" SG_ 323 ReSideRdrRiDetn55RdrDetnRngV 0;
BA_ "GenSigStartValue" SG_ 323 ReSideRdrRiDetn55RdrDetnSts 3;
BA_ "GenSigSendType" SG_ 323 ReSideRdrRiDetn55RdrDetnSts 0;
BA_ "GenSigStartValue" SG_ 323 ReSideRdrRiDetn56RdrDetnAzi 900;
BA_ "GenSigSendType" SG_ 323 ReSideRdrRiDetn56RdrDetnAzi 0;
BA_ "GenSigSendType" SG_ 323 ReSideRdrRiDetn56RdrDetnChks 0;
BA_ "GenSigFuncType" SG_ 323 ReSideRdrRiDetn56RdrDetnChks 15;
BA_ "GenSigDataID" SG_ 323 ReSideRdrRiDetn56RdrDetnChks "0xA78";
BA_ "GenSigSendType" SG_ 323 ReSideRdrRiDetn56RdrDetnCntr 0;
BA_ "GenSigFuncType" SG_ 323 ReSideRdrRiDetn56RdrDetnCntr 16;
BA_ "GenSigSendType" SG_ 323 ReSideRdrRiDetn56RdrDetnConf 0;
BA_ "GenSigStartValue" SG_ 323 ReSideRdrRiDetn56RdrDetnElevn 15;
BA_ "GenSigSendType" SG_ 323 ReSideRdrRiDetn56RdrDetnElevn 0;
BA_ "GenSigSendType" SG_ 323 ReSideRdrRiDetn56RdrDetnPwr 0;
BA_ "GenSigStartValue" SG_ 323 ReSideRdrRiDetn56RdrDetnRng 10050;
BA_ "GenSigSendType" SG_ 323 ReSideRdrRiDetn56RdrDetnRng 0;
BA_ "GenSigStartValue" SG_ 323 ReSideRdrRiDetn56RdrDetnRngV 4000;
BA_ "GenSigSendType" SG_ 323 ReSideRdrRiDetn56RdrDetnRngV 0;
BA_ "GenSigStartValue" SG_ 323 ReSideRdrRiDetn56RdrDetnSts 3;
BA_ "GenSigSendType" SG_ 323 ReSideRdrRiDetn56RdrDetnSts 0;
BA_ "GenSigStartValue" SG_ 323 ReSideRdrRiDetn57RdrDetnAzi 900;
BA_ "GenSigSendType" SG_ 323 ReSideRdrRiDetn57RdrDetnAzi 0;
BA_ "GenSigSendType" SG_ 323 ReSideRdrRiDetn57RdrDetnChks 0;
BA_ "GenSigFuncType" SG_ 323 ReSideRdrRiDetn57RdrDetnChks 15;
BA_ "GenSigDataID" SG_ 323 ReSideRdrRiDetn57RdrDetnChks "0xA79";
BA_ "GenSigSendType" SG_ 323 ReSideRdrRiDetn57RdrDetnCntr 0;
BA_ "GenSigFuncType" SG_ 323 ReSideRdrRiDetn57RdrDetnCntr 16;
BA_ "GenSigSendType" SG_ 323 ReSideRdrRiDetn57RdrDetnConf 0;
BA_ "GenSigStartValue" SG_ 323 ReSideRdrRiDetn57RdrDetnElevn 15;
BA_ "GenSigSendType" SG_ 323 ReSideRdrRiDetn57RdrDetnElevn 0;
BA_ "GenSigSendType" SG_ 323 ReSideRdrRiDetn57RdrDetnPwr 0;
BA_ "GenSigStartValue" SG_ 323 ReSideRdrRiDetn57RdrDetnRng 10050;
BA_ "GenSigSendType" SG_ 323 ReSideRdrRiDetn57RdrDetnRng 0;
BA_ "GenSigStartValue" SG_ 323 ReSideRdrRiDetn57RdrDetnRngV 4000;
BA_ "GenSigSendType" SG_ 323 ReSideRdrRiDetn57RdrDetnRngV 0;
BA_ "GenSigStartValue" SG_ 323 ReSideRdrRiDetn57RdrDetnSts 3;
BA_ "GenSigSendType" SG_ 323 ReSideRdrRiDetn57RdrDetnSts 0;
BA_ "GenSigStartValue" SG_ 323 ReSideRdrRiDetn58RdrDetnAzi 900;
BA_ "GenSigSendType" SG_ 323 ReSideRdrRiDetn58RdrDetnAzi 0;
BA_ "GenSigSendType" SG_ 323 ReSideRdrRiDetn58RdrDetnChks 0;
BA_ "GenSigFuncType" SG_ 323 ReSideRdrRiDetn58RdrDetnChks 15;
BA_ "GenSigDataID" SG_ 323 ReSideRdrRiDetn58RdrDetnChks "0xA7A";
BA_ "GenSigSendType" SG_ 323 ReSideRdrRiDetn58RdrDetnCntr 0;
BA_ "GenSigFuncType" SG_ 323 ReSideRdrRiDetn58RdrDetnCntr 16;
BA_ "GenSigSendType" SG_ 323 ReSideRdrRiDetn58RdrDetnConf 0;
BA_ "GenSigStartValue" SG_ 323 ReSideRdrRiDetn58RdrDetnElevn 15;
BA_ "GenSigSendType" SG_ 323 ReSideRdrRiDetn58RdrDetnElevn 0;
BA_ "GenSigSendType" SG_ 323 ReSideRdrRiDetn58RdrDetnPwr 0;
BA_ "GenSigStartValue" SG_ 323 ReSideRdrRiDetn58RdrDetnRng 10050;
BA_ "GenSigSendType" SG_ 323 ReSideRdrRiDetn58RdrDetnRng 0;
BA_ "GenSigStartValue" SG_ 323 ReSideRdrRiDetn58RdrDetnRngV 4000;
BA_ "GenSigSendType" SG_ 323 ReSideRdrRiDetn58RdrDetnRngV 0;
BA_ "GenSigStartValue" SG_ 323 ReSideRdrRiDetn58RdrDetnSts 3;
BA_ "GenSigSendType" SG_ 323 ReSideRdrRiDetn58RdrDetnSts 0;
BA_ "GenSigStartValue" SG_ 323 ReSideRdrRiDetn59RdrDetnAzi 900;
BA_ "GenSigSendType" SG_ 323 ReSideRdrRiDetn59RdrDetnAzi 0;
BA_ "GenSigSendType" SG_ 323 ReSideRdrRiDetn59RdrDetnChks 0;
BA_ "GenSigFuncType" SG_ 323 ReSideRdrRiDetn59RdrDetnChks 15;
BA_ "GenSigDataID" SG_ 323 ReSideRdrRiDetn59RdrDetnChks "0xA7B";
BA_ "GenSigSendType" SG_ 323 ReSideRdrRiDetn59RdrDetnCntr 0;
BA_ "GenSigFuncType" SG_ 323 ReSideRdrRiDetn59RdrDetnCntr 16;
BA_ "GenSigSendType" SG_ 323 ReSideRdrRiDetn59RdrDetnConf 0;
BA_ "GenSigStartValue" SG_ 323 ReSideRdrRiDetn59RdrDetnElevn 15;
BA_ "GenSigSendType" SG_ 323 ReSideRdrRiDetn59RdrDetnElevn 0;
BA_ "GenSigSendType" SG_ 323 ReSideRdrRiDetn59RdrDetnPwr 0;
BA_ "GenSigStartValue" SG_ 323 ReSideRdrRiDetn59RdrDetnRng 10050;
BA_ "GenSigSendType" SG_ 323 ReSideRdrRiDetn59RdrDetnRng 0;
BA_ "GenSigStartValue" SG_ 323 ReSideRdrRiDetn59RdrDetnRngV 4000;
BA_ "GenSigSendType" SG_ 323 ReSideRdrRiDetn59RdrDetnRngV 0;
BA_ "GenSigStartValue" SG_ 323 ReSideRdrRiDetn59RdrDetnSts 3;
BA_ "GenSigSendType" SG_ 323 ReSideRdrRiDetn59RdrDetnSts 0;
BA_ "GenSigStartValue" SG_ 323 ReSideRdrRiDetn60RdrDetnAzi 900;
BA_ "GenSigSendType" SG_ 323 ReSideRdrRiDetn60RdrDetnAzi 0;
BA_ "GenSigSendType" SG_ 323 ReSideRdrRiDetn60RdrDetnChks 0;
BA_ "GenSigFuncType" SG_ 323 ReSideRdrRiDetn60RdrDetnChks 15;
BA_ "GenSigDataID" SG_ 323 ReSideRdrRiDetn60RdrDetnChks "0xA7C";
BA_ "GenSigSendType" SG_ 323 ReSideRdrRiDetn60RdrDetnCntr 0;
BA_ "GenSigFuncType" SG_ 323 ReSideRdrRiDetn60RdrDetnCntr 16;
BA_ "GenSigSendType" SG_ 323 ReSideRdrRiDetn60RdrDetnConf 0;
BA_ "GenSigStartValue" SG_ 323 ReSideRdrRiDetn60RdrDetnElevn 15;
BA_ "GenSigSendType" SG_ 323 ReSideRdrRiDetn60RdrDetnElevn 0;
BA_ "GenSigSendType" SG_ 323 ReSideRdrRiDetn60RdrDetnPwr 0;
BA_ "GenSigStartValue" SG_ 323 ReSideRdrRiDetn60RdrDetnRng 10050;
BA_ "GenSigSendType" SG_ 323 ReSideRdrRiDetn60RdrDetnRng 0;
BA_ "GenSigStartValue" SG_ 323 ReSideRdrRiDetn60RdrDetnRngV 4000;
BA_ "GenSigSendType" SG_ 323 ReSideRdrRiDetn60RdrDetnRngV 0;
BA_ "GenSigStartValue" SG_ 323 ReSideRdrRiDetn60RdrDetnSts 3;
BA_ "GenSigSendType" SG_ 323 ReSideRdrRiDetn60RdrDetnSts 0;
// Frame: SODRSafetyCANFD3Frame11
BA_ "VFrameFormat" BO_ 325 14;
BA_ "GenMsgSendType" BO_ 325 0;
BA_ "GenMsgCycleTime" BO_ 325 50.000;
BA_ "GenSigStartValue" SG_ 325 ReSideRdrRiDetn61RdrDetnAzi 900;
BA_ "GenSigSendType" SG_ 325 ReSideRdrRiDetn61RdrDetnAzi 0;
BA_ "GenSigSendType" SG_ 325 ReSideRdrRiDetn61RdrDetnChks 0;
BA_ "GenSigFuncType" SG_ 325 ReSideRdrRiDetn61RdrDetnChks 15;
BA_ "GenSigDataID" SG_ 325 ReSideRdrRiDetn61RdrDetnChks "0xA7D";
BA_ "GenSigSendType" SG_ 325 ReSideRdrRiDetn61RdrDetnCntr 0;
BA_ "GenSigFuncType" SG_ 325 ReSideRdrRiDetn61RdrDetnCntr 16;
BA_ "GenSigSendType" SG_ 325 ReSideRdrRiDetn61RdrDetnConf 0;
BA_ "GenSigStartValue" SG_ 325 ReSideRdrRiDetn61RdrDetnElevn 15;
BA_ "GenSigSendType" SG_ 325 ReSideRdrRiDetn61RdrDetnElevn 0;
BA_ "GenSigSendType" SG_ 325 ReSideRdrRiDetn61RdrDetnPwr 0;
BA_ "GenSigStartValue" SG_ 325 ReSideRdrRiDetn61RdrDetnRng 10050;
BA_ "GenSigSendType" SG_ 325 ReSideRdrRiDetn61RdrDetnRng 0;
BA_ "GenSigStartValue" SG_ 325 ReSideRdrRiDetn61RdrDetnRngV 4000;
BA_ "GenSigSendType" SG_ 325 ReSideRdrRiDetn61RdrDetnRngV 0;
BA_ "GenSigStartValue" SG_ 325 ReSideRdrRiDetn61RdrDetnSts 3;
BA_ "GenSigSendType" SG_ 325 ReSideRdrRiDetn61RdrDetnSts 0;
BA_ "GenSigStartValue" SG_ 325 ReSideRdrRiDetn62RdrDetnAzi 900;
BA_ "GenSigSendType" SG_ 325 ReSideRdrRiDetn62RdrDetnAzi 0;
BA_ "GenSigSendType" SG_ 325 ReSideRdrRiDetn62RdrDetnChks 0;
BA_ "GenSigFuncType" SG_ 325 ReSideRdrRiDetn62RdrDetnChks 15;
BA_ "GenSigDataID" SG_ 325 ReSideRdrRiDetn62RdrDetnChks "0xA7E";
BA_ "GenSigSendType" SG_ 325 ReSideRdrRiDetn62RdrDetnCntr 0;
BA_ "GenSigFuncType" SG_ 325 ReSideRdrRiDetn62RdrDetnCntr 16;
BA_ "GenSigSendType" SG_ 325 ReSideRdrRiDetn62RdrDetnConf 0;
BA_ "GenSigStartValue" SG_ 325 ReSideRdrRiDetn62RdrDetnElevn 15;
BA_ "GenSigSendType" SG_ 325 ReSideRdrRiDetn62RdrDetnElevn 0;
BA_ "GenSigSendType" SG_ 325 ReSideRdrRiDetn62RdrDetnPwr 0;
BA_ "GenSigStartValue" SG_ 325 ReSideRdrRiDetn62RdrDetnRng 10050;
BA_ "GenSigSendType" SG_ 325 ReSideRdrRiDetn62RdrDetnRng 0;
BA_ "GenSigStartValue" SG_ 325 ReSideRdrRiDetn62RdrDetnRngV 4000;
BA_ "GenSigSendType" SG_ 325 ReSideRdrRiDetn62RdrDetnRngV 0;
BA_ "GenSigStartValue" SG_ 325 ReSideRdrRiDetn62RdrDetnSts 3;
BA_ "GenSigSendType" SG_ 325 ReSideRdrRiDetn62RdrDetnSts 0;
BA_ "GenSigStartValue" SG_ 325 ReSideRdrRiDetn63RdrDetnAzi 900;
BA_ "GenSigSendType" SG_ 325 ReSideRdrRiDetn63RdrDetnAzi 0;
BA_ "GenSigSendType" SG_ 325 ReSideRdrRiDetn63RdrDetnChks 0;
BA_ "GenSigFuncType" SG_ 325 ReSideRdrRiDetn63RdrDetnChks 15;
BA_ "GenSigDataID" SG_ 325 ReSideRdrRiDetn63RdrDetnChks "0xA7F";
BA_ "GenSigSendType" SG_ 325 ReSideRdrRiDetn63RdrDetnCntr 0;
BA_ "GenSigFuncType" SG_ 325 ReSideRdrRiDetn63RdrDetnCntr 16;
BA_ "GenSigSendType" SG_ 325 ReSideRdrRiDetn63RdrDetnConf 0;
BA_ "GenSigStartValue" SG_ 325 ReSideRdrRiDetn63RdrDetnElevn 15;
BA_ "GenSigSendType" SG_ 325 ReSideRdrRiDetn63RdrDetnElevn 0;
BA_ "GenSigSendType" SG_ 325 ReSideRdrRiDetn63RdrDetnPwr 0;
BA_ "GenSigStartValue" SG_ 325 ReSideRdrRiDetn63RdrDetnRng 10050;
BA_ "GenSigSendType" SG_ 325 ReSideRdrRiDetn63RdrDetnRng 0;
BA_ "GenSigStartValue" SG_ 325 ReSideRdrRiDetn63RdrDetnRngV 4000;
BA_ "GenSigSendType" SG_ 325 ReSideRdrRiDetn63RdrDetnRngV 0;
BA_ "GenSigStartValue" SG_ 325 ReSideRdrRiDetn63RdrDetnSts 3;
BA_ "GenSigSendType" SG_ 325 ReSideRdrRiDetn63RdrDetnSts 0;
BA_ "GenSigStartValue" SG_ 325 ReSideRdrRiDetn64RdrDetnAzi 900;
BA_ "GenSigSendType" SG_ 325 ReSideRdrRiDetn64RdrDetnAzi 0;
BA_ "GenSigSendType" SG_ 325 ReSideRdrRiDetn64RdrDetnChks 0;
BA_ "GenSigFuncType" SG_ 325 ReSideRdrRiDetn64RdrDetnChks 15;
BA_ "GenSigDataID" SG_ 325 ReSideRdrRiDetn64RdrDetnChks "0xA80";
BA_ "GenSigSendType" SG_ 325 ReSideRdrRiDetn64RdrDetnCntr 0;
BA_ "GenSigFuncType" SG_ 325 ReSideRdrRiDetn64RdrDetnCntr 16;
BA_ "GenSigSendType" SG_ 325 ReSideRdrRiDetn64RdrDetnConf 0;
BA_ "GenSigStartValue" SG_ 325 ReSideRdrRiDetn64RdrDetnElevn 15;
BA_ "GenSigSendType" SG_ 325 ReSideRdrRiDetn64RdrDetnElevn 0;
BA_ "GenSigSendType" SG_ 325 ReSideRdrRiDetn64RdrDetnPwr 0;
BA_ "GenSigStartValue" SG_ 325 ReSideRdrRiDetn64RdrDetnRng 10050;
BA_ "GenSigSendType" SG_ 325 ReSideRdrRiDetn64RdrDetnRng 0;
BA_ "GenSigStartValue" SG_ 325 ReSideRdrRiDetn64RdrDetnRngV 4000;
BA_ "GenSigSendType" SG_ 325 ReSideRdrRiDetn64RdrDetnRngV 0;
BA_ "GenSigStartValue" SG_ 325 ReSideRdrRiDetn64RdrDetnSts 3;
BA_ "GenSigSendType" SG_ 325 ReSideRdrRiDetn64RdrDetnSts 0;
BA_ "GenSigStartValue" SG_ 325 ReSideRdrRiDetn65RdrDetnAzi 900;
BA_ "GenSigSendType" SG_ 325 ReSideRdrRiDetn65RdrDetnAzi 0;
BA_ "GenSigSendType" SG_ 325 ReSideRdrRiDetn65RdrDetnChks 0;
BA_ "GenSigFuncType" SG_ 325 ReSideRdrRiDetn65RdrDetnChks 15;
BA_ "GenSigDataID" SG_ 325 ReSideRdrRiDetn65RdrDetnChks "0xA81";
BA_ "GenSigSendType" SG_ 325 ReSideRdrRiDetn65RdrDetnCntr 0;
BA_ "GenSigFuncType" SG_ 325 ReSideRdrRiDetn65RdrDetnCntr 16;
BA_ "GenSigSendType" SG_ 325 ReSideRdrRiDetn65RdrDetnConf 0;
BA_ "GenSigStartValue" SG_ 325 ReSideRdrRiDetn65RdrDetnElevn 15;
BA_ "GenSigSendType" SG_ 325 ReSideRdrRiDetn65RdrDetnElevn 0;
BA_ "GenSigSendType" SG_ 325 ReSideRdrRiDetn65RdrDetnPwr 0;
BA_ "GenSigStartValue" SG_ 325 ReSideRdrRiDetn65RdrDetnRng 10050;
BA_ "GenSigSendType" SG_ 325 ReSideRdrRiDetn65RdrDetnRng 0;
BA_ "GenSigStartValue" SG_ 325 ReSideRdrRiDetn65RdrDetnRngV 4000;
BA_ "GenSigSendType" SG_ 325 ReSideRdrRiDetn65RdrDetnRngV 0;
BA_ "GenSigStartValue" SG_ 325 ReSideRdrRiDetn65RdrDetnSts 3;
BA_ "GenSigSendType" SG_ 325 ReSideRdrRiDetn65RdrDetnSts 0;
BA_ "GenSigStartValue" SG_ 325 ReSideRdrRiDetn66RdrDetnAzi 900;
BA_ "GenSigSendType" SG_ 325 ReSideRdrRiDetn66RdrDetnAzi 0;
BA_ "GenSigSendType" SG_ 325 ReSideRdrRiDetn66RdrDetnChks 0;
BA_ "GenSigFuncType" SG_ 325 ReSideRdrRiDetn66RdrDetnChks 15;
BA_ "GenSigDataID" SG_ 325 ReSideRdrRiDetn66RdrDetnChks "0xA82";
BA_ "GenSigSendType" SG_ 325 ReSideRdrRiDetn66RdrDetnCntr 0;
BA_ "GenSigFuncType" SG_ 325 ReSideRdrRiDetn66RdrDetnCntr 16;
BA_ "GenSigSendType" SG_ 325 ReSideRdrRiDetn66RdrDetnConf 0;
BA_ "GenSigStartValue" SG_ 325 ReSideRdrRiDetn66RdrDetnElevn 15;
BA_ "GenSigSendType" SG_ 325 ReSideRdrRiDetn66RdrDetnElevn 0;
BA_ "GenSigSendType" SG_ 325 ReSideRdrRiDetn66RdrDetnPwr 0;
BA_ "GenSigStartValue" SG_ 325 ReSideRdrRiDetn66RdrDetnRng 10050;
BA_ "GenSigSendType" SG_ 325 ReSideRdrRiDetn66RdrDetnRng 0;
BA_ "GenSigStartValue" SG_ 325 ReSideRdrRiDetn66RdrDetnRngV 4000;
BA_ "GenSigSendType" SG_ 325 ReSideRdrRiDetn66RdrDetnRngV 0;
BA_ "GenSigStartValue" SG_ 325 ReSideRdrRiDetn66RdrDetnSts 3;
BA_ "GenSigSendType" SG_ 325 ReSideRdrRiDetn66RdrDetnSts 0;
// Frame: SODRSafetyCANFD3Frame12
BA_ "VFrameFormat" BO_ 327 14;
BA_ "GenMsgSendType" BO_ 327 0;
BA_ "GenMsgCycleTime" BO_ 327 50.000;
BA_ "GenSigStartValue" SG_ 327 ReSideRdrRiDetn67RdrDetnAzi 900;
BA_ "GenSigSendType" SG_ 327 ReSideRdrRiDetn67RdrDetnAzi 0;
BA_ "GenSigSendType" SG_ 327 ReSideRdrRiDetn67RdrDetnChks 0;
BA_ "GenSigFuncType" SG_ 327 ReSideRdrRiDetn67RdrDetnChks 15;
BA_ "GenSigDataID" SG_ 327 ReSideRdrRiDetn67RdrDetnChks "0xA83";
BA_ "GenSigSendType" SG_ 327 ReSideRdrRiDetn67RdrDetnCntr 0;
BA_ "GenSigFuncType" SG_ 327 ReSideRdrRiDetn67RdrDetnCntr 16;
BA_ "GenSigSendType" SG_ 327 ReSideRdrRiDetn67RdrDetnConf 0;
BA_ "GenSigStartValue" SG_ 327 ReSideRdrRiDetn67RdrDetnElevn 15;
BA_ "GenSigSendType" SG_ 327 ReSideRdrRiDetn67RdrDetnElevn 0;
BA_ "GenSigSendType" SG_ 327 ReSideRdrRiDetn67RdrDetnPwr 0;
BA_ "GenSigStartValue" SG_ 327 ReSideRdrRiDetn67RdrDetnRng 10050;
BA_ "GenSigSendType" SG_ 327 ReSideRdrRiDetn67RdrDetnRng 0;
BA_ "GenSigStartValue" SG_ 327 ReSideRdrRiDetn67RdrDetnRngV 4000;
BA_ "GenSigSendType" SG_ 327 ReSideRdrRiDetn67RdrDetnRngV 0;
BA_ "GenSigStartValue" SG_ 327 ReSideRdrRiDetn67RdrDetnSts 3;
BA_ "GenSigSendType" SG_ 327 ReSideRdrRiDetn67RdrDetnSts 0;
BA_ "GenSigStartValue" SG_ 327 ReSideRdrRiDetn68RdrDetnAzi 900;
BA_ "GenSigSendType" SG_ 327 ReSideRdrRiDetn68RdrDetnAzi 0;
BA_ "GenSigSendType" SG_ 327 ReSideRdrRiDetn68RdrDetnChks 0;
BA_ "GenSigFuncType" SG_ 327 ReSideRdrRiDetn68RdrDetnChks 15;
BA_ "GenSigDataID" SG_ 327 ReSideRdrRiDetn68RdrDetnChks "0xA84";
BA_ "GenSigSendType" SG_ 327 ReSideRdrRiDetn68RdrDetnCntr 0;
BA_ "GenSigFuncType" SG_ 327 ReSideRdrRiDetn68RdrDetnCntr 16;
BA_ "GenSigSendType" SG_ 327 ReSideRdrRiDetn68RdrDetnConf 0;
BA_ "GenSigStartValue" SG_ 327 ReSideRdrRiDetn68RdrDetnElevn 15;
BA_ "GenSigSendType" SG_ 327 ReSideRdrRiDetn68RdrDetnElevn 0;
BA_ "GenSigSendType" SG_ 327 ReSideRdrRiDetn68RdrDetnPwr 0;
BA_ "GenSigStartValue" SG_ 327 ReSideRdrRiDetn68RdrDetnRng 10050;
BA_ "GenSigSendType" SG_ 327 ReSideRdrRiDetn68RdrDetnRng 0;
BA_ "GenSigStartValue" SG_ 327 ReSideRdrRiDetn68RdrDetnRngV 4000;
BA_ "GenSigSendType" SG_ 327 ReSideRdrRiDetn68RdrDetnRngV 0;
BA_ "GenSigStartValue" SG_ 327 ReSideRdrRiDetn68RdrDetnSts 3;
BA_ "GenSigSendType" SG_ 327 ReSideRdrRiDetn68RdrDetnSts 0;
BA_ "GenSigStartValue" SG_ 327 ReSideRdrRiDetn69RdrDetnAzi 900;
BA_ "GenSigSendType" SG_ 327 ReSideRdrRiDetn69RdrDetnAzi 0;
BA_ "GenSigSendType" SG_ 327 ReSideRdrRiDetn69RdrDetnChks 0;
BA_ "GenSigFuncType" SG_ 327 ReSideRdrRiDetn69RdrDetnChks 15;
BA_ "GenSigDataID" SG_ 327 ReSideRdrRiDetn69RdrDetnChks "0xA85";
BA_ "GenSigSendType" SG_ 327 ReSideRdrRiDetn69RdrDetnCntr 0;
BA_ "GenSigFuncType" SG_ 327 ReSideRdrRiDetn69RdrDetnCntr 16;
BA_ "GenSigSendType" SG_ 327 ReSideRdrRiDetn69RdrDetnConf 0;
BA_ "GenSigStartValue" SG_ 327 ReSideRdrRiDetn69RdrDetnElevn 15;
BA_ "GenSigSendType" SG_ 327 ReSideRdrRiDetn69RdrDetnElevn 0;
BA_ "GenSigSendType" SG_ 327 ReSideRdrRiDetn69RdrDetnPwr 0;
BA_ "GenSigStartValue" SG_ 327 ReSideRdrRiDetn69RdrDetnRng 10050;
BA_ "GenSigSendType" SG_ 327 ReSideRdrRiDetn69RdrDetnRng 0;
BA_ "GenSigStartValue" SG_ 327 ReSideRdrRiDetn69RdrDetnRngV 4000;
BA_ "GenSigSendType" SG_ 327 ReSideRdrRiDetn69RdrDetnRngV 0;
BA_ "GenSigStartValue" SG_ 327 ReSideRdrRiDetn69RdrDetnSts 3;
BA_ "GenSigSendType" SG_ 327 ReSideRdrRiDetn69RdrDetnSts 0;
BA_ "GenSigStartValue" SG_ 327 ReSideRdrRiDetn70RdrDetnAzi 900;
BA_ "GenSigSendType" SG_ 327 ReSideRdrRiDetn70RdrDetnAzi 0;
BA_ "GenSigSendType" SG_ 327 ReSideRdrRiDetn70RdrDetnChks 0;
BA_ "GenSigFuncType" SG_ 327 ReSideRdrRiDetn70RdrDetnChks 15;
BA_ "GenSigDataID" SG_ 327 ReSideRdrRiDetn70RdrDetnChks "0xA86";
BA_ "GenSigSendType" SG_ 327 ReSideRdrRiDetn70RdrDetnCntr 0;
BA_ "GenSigFuncType" SG_ 327 ReSideRdrRiDetn70RdrDetnCntr 16;
BA_ "GenSigSendType" SG_ 327 ReSideRdrRiDetn70RdrDetnConf 0;
BA_ "GenSigStartValue" SG_ 327 ReSideRdrRiDetn70RdrDetnElevn 15;
BA_ "GenSigSendType" SG_ 327 ReSideRdrRiDetn70RdrDetnElevn 0;
BA_ "GenSigSendType" SG_ 327 ReSideRdrRiDetn70RdrDetnPwr 0;
BA_ "GenSigStartValue" SG_ 327 ReSideRdrRiDetn70RdrDetnRng 10050;
BA_ "GenSigSendType" SG_ 327 ReSideRdrRiDetn70RdrDetnRng 0;
BA_ "GenSigStartValue" SG_ 327 ReSideRdrRiDetn70RdrDetnRngV 4000;
BA_ "GenSigSendType" SG_ 327 ReSideRdrRiDetn70RdrDetnRngV 0;
BA_ "GenSigStartValue" SG_ 327 ReSideRdrRiDetn70RdrDetnSts 3;
BA_ "GenSigSendType" SG_ 327 ReSideRdrRiDetn70RdrDetnSts 0;
BA_ "GenSigStartValue" SG_ 327 ReSideRdrRiDetn71RdrDetnAzi 900;
BA_ "GenSigSendType" SG_ 327 ReSideRdrRiDetn71RdrDetnAzi 0;
BA_ "GenSigSendType" SG_ 327 ReSideRdrRiDetn71RdrDetnChks 0;
BA_ "GenSigFuncType" SG_ 327 ReSideRdrRiDetn71RdrDetnChks 15;
BA_ "GenSigDataID" SG_ 327 ReSideRdrRiDetn71RdrDetnChks "0xA87";
BA_ "GenSigSendType" SG_ 327 ReSideRdrRiDetn71RdrDetnCntr 0;
BA_ "GenSigFuncType" SG_ 327 ReSideRdrRiDetn71RdrDetnCntr 16;
BA_ "GenSigSendType" SG_ 327 ReSideRdrRiDetn71RdrDetnConf 0;
BA_ "GenSigStartValue" SG_ 327 ReSideRdrRiDetn71RdrDetnElevn 15;
BA_ "GenSigSendType" SG_ 327 ReSideRdrRiDetn71RdrDetnElevn 0;
BA_ "GenSigSendType" SG_ 327 ReSideRdrRiDetn71RdrDetnPwr 0;
BA_ "GenSigStartValue" SG_ 327 ReSideRdrRiDetn71RdrDetnRng 10050;
BA_ "GenSigSendType" SG_ 327 ReSideRdrRiDetn71RdrDetnRng 0;
BA_ "GenSigStartValue" SG_ 327 ReSideRdrRiDetn71RdrDetnRngV 4000;
BA_ "GenSigSendType" SG_ 327 ReSideRdrRiDetn71RdrDetnRngV 0;
BA_ "GenSigStartValue" SG_ 327 ReSideRdrRiDetn71RdrDetnSts 3;
BA_ "GenSigSendType" SG_ 327 ReSideRdrRiDetn71RdrDetnSts 0;
BA_ "GenSigStartValue" SG_ 327 ReSideRdrRiDetn72RdrDetnAzi 900;
BA_ "GenSigSendType" SG_ 327 ReSideRdrRiDetn72RdrDetnAzi 0;
BA_ "GenSigSendType" SG_ 327 ReSideRdrRiDetn72RdrDetnChks 0;
BA_ "GenSigFuncType" SG_ 327 ReSideRdrRiDetn72RdrDetnChks 15;
BA_ "GenSigDataID" SG_ 327 ReSideRdrRiDetn72RdrDetnChks "0xA88";
BA_ "GenSigSendType" SG_ 327 ReSideRdrRiDetn72RdrDetnCntr 0;
BA_ "GenSigFuncType" SG_ 327 ReSideRdrRiDetn72RdrDetnCntr 16;
BA_ "GenSigSendType" SG_ 327 ReSideRdrRiDetn72RdrDetnConf 0;
BA_ "GenSigStartValue" SG_ 327 ReSideRdrRiDetn72RdrDetnElevn 15;
BA_ "GenSigSendType" SG_ 327 ReSideRdrRiDetn72RdrDetnElevn 0;
BA_ "GenSigSendType" SG_ 327 ReSideRdrRiDetn72RdrDetnPwr 0;
BA_ "GenSigStartValue" SG_ 327 ReSideRdrRiDetn72RdrDetnRng 10050;
BA_ "GenSigSendType" SG_ 327 ReSideRdrRiDetn72RdrDetnRng 0;
BA_ "GenSigStartValue" SG_ 327 ReSideRdrRiDetn72RdrDetnRngV 4000;
BA_ "GenSigSendType" SG_ 327 ReSideRdrRiDetn72RdrDetnRngV 0;
BA_ "GenSigStartValue" SG_ 327 ReSideRdrRiDetn72RdrDetnSts 3;
BA_ "GenSigSendType" SG_ 327 ReSideRdrRiDetn72RdrDetnSts 0;
// Frame: SODRSafetyCANFD3Frame13
BA_ "VFrameFormat" BO_ 329 14;
BA_ "GenMsgSendType" BO_ 329 0;
BA_ "GenMsgCycleTime" BO_ 329 50.000;
BA_ "GenSigStartValue" SG_ 329 ReSideRdrRiDetn73RdrDetnAzi 900;
BA_ "GenSigSendType" SG_ 329 ReSideRdrRiDetn73RdrDetnAzi 0;
BA_ "GenSigSendType" SG_ 329 ReSideRdrRiDetn73RdrDetnChks 0;
BA_ "GenSigFuncType" SG_ 329 ReSideRdrRiDetn73RdrDetnChks 15;
BA_ "GenSigDataID" SG_ 329 ReSideRdrRiDetn73RdrDetnChks "0xA89";
BA_ "GenSigSendType" SG_ 329 ReSideRdrRiDetn73RdrDetnCntr 0;
BA_ "GenSigFuncType" SG_ 329 ReSideRdrRiDetn73RdrDetnCntr 16;
BA_ "GenSigSendType" SG_ 329 ReSideRdrRiDetn73RdrDetnConf 0;
BA_ "GenSigStartValue" SG_ 329 ReSideRdrRiDetn73RdrDetnElevn 15;
BA_ "GenSigSendType" SG_ 329 ReSideRdrRiDetn73RdrDetnElevn 0;
BA_ "GenSigSendType" SG_ 329 ReSideRdrRiDetn73RdrDetnPwr 0;
BA_ "GenSigStartValue" SG_ 329 ReSideRdrRiDetn73RdrDetnRng 10050;
BA_ "GenSigSendType" SG_ 329 ReSideRdrRiDetn73RdrDetnRng 0;
BA_ "GenSigStartValue" SG_ 329 ReSideRdrRiDetn73RdrDetnRngV 4000;
BA_ "GenSigSendType" SG_ 329 ReSideRdrRiDetn73RdrDetnRngV 0;
BA_ "GenSigStartValue" SG_ 329 ReSideRdrRiDetn73RdrDetnSts 3;
BA_ "GenSigSendType" SG_ 329 ReSideRdrRiDetn73RdrDetnSts 0;
BA_ "GenSigStartValue" SG_ 329 ReSideRdrRiDetn74RdrDetnAzi 900;
BA_ "GenSigSendType" SG_ 329 ReSideRdrRiDetn74RdrDetnAzi 0;
BA_ "GenSigSendType" SG_ 329 ReSideRdrRiDetn74RdrDetnChks 0;
BA_ "GenSigFuncType" SG_ 329 ReSideRdrRiDetn74RdrDetnChks 15;
BA_ "GenSigDataID" SG_ 329 ReSideRdrRiDetn74RdrDetnChks "0xA8A";
BA_ "GenSigSendType" SG_ 329 ReSideRdrRiDetn74RdrDetnCntr 0;
BA_ "GenSigFuncType" SG_ 329 ReSideRdrRiDetn74RdrDetnCntr 16;
BA_ "GenSigSendType" SG_ 329 ReSideRdrRiDetn74RdrDetnConf 0;
BA_ "GenSigStartValue" SG_ 329 ReSideRdrRiDetn74RdrDetnElevn 15;
BA_ "GenSigSendType" SG_ 329 ReSideRdrRiDetn74RdrDetnElevn 0;
BA_ "GenSigSendType" SG_ 329 ReSideRdrRiDetn74RdrDetnPwr 0;
BA_ "GenSigStartValue" SG_ 329 ReSideRdrRiDetn74RdrDetnRng 10050;
BA_ "GenSigSendType" SG_ 329 ReSideRdrRiDetn74RdrDetnRng 0;
BA_ "GenSigStartValue" SG_ 329 ReSideRdrRiDetn74RdrDetnRngV 4000;
BA_ "GenSigSendType" SG_ 329 ReSideRdrRiDetn74RdrDetnRngV 0;
BA_ "GenSigStartValue" SG_ 329 ReSideRdrRiDetn74RdrDetnSts 3;
BA_ "GenSigSendType" SG_ 329 ReSideRdrRiDetn74RdrDetnSts 0;
BA_ "GenSigStartValue" SG_ 329 ReSideRdrRiDetn75RdrDetnAzi 900;
BA_ "GenSigSendType" SG_ 329 ReSideRdrRiDetn75RdrDetnAzi 0;
BA_ "GenSigSendType" SG_ 329 ReSideRdrRiDetn75RdrDetnChks 0;
BA_ "GenSigFuncType" SG_ 329 ReSideRdrRiDetn75RdrDetnChks 15;
BA_ "GenSigDataID" SG_ 329 ReSideRdrRiDetn75RdrDetnChks "0xA8B";
BA_ "GenSigSendType" SG_ 329 ReSideRdrRiDetn75RdrDetnCntr 0;
BA_ "GenSigFuncType" SG_ 329 ReSideRdrRiDetn75RdrDetnCntr 16;
BA_ "GenSigSendType" SG_ 329 ReSideRdrRiDetn75RdrDetnConf 0;
BA_ "GenSigStartValue" SG_ 329 ReSideRdrRiDetn75RdrDetnElevn 15;
BA_ "GenSigSendType" SG_ 329 ReSideRdrRiDetn75RdrDetnElevn 0;
BA_ "GenSigSendType" SG_ 329 ReSideRdrRiDetn75RdrDetnPwr 0;
BA_ "GenSigStartValue" SG_ 329 ReSideRdrRiDetn75RdrDetnRng 10050;
BA_ "GenSigSendType" SG_ 329 ReSideRdrRiDetn75RdrDetnRng 0;
BA_ "GenSigStartValue" SG_ 329 ReSideRdrRiDetn75RdrDetnRngV 4000;
BA_ "GenSigSendType" SG_ 329 ReSideRdrRiDetn75RdrDetnRngV 0;
BA_ "GenSigStartValue" SG_ 329 ReSideRdrRiDetn75RdrDetnSts 3;
BA_ "GenSigSendType" SG_ 329 ReSideRdrRiDetn75RdrDetnSts 0;
BA_ "GenSigStartValue" SG_ 329 ReSideRdrRiDetn76RdrDetnAzi 900;
BA_ "GenSigSendType" SG_ 329 ReSideRdrRiDetn76RdrDetnAzi 0;
BA_ "GenSigSendType" SG_ 329 ReSideRdrRiDetn76RdrDetnChks 0;
BA_ "GenSigFuncType" SG_ 329 ReSideRdrRiDetn76RdrDetnChks 15;
BA_ "GenSigDataID" SG_ 329 ReSideRdrRiDetn76RdrDetnChks "0xA8C";
BA_ "GenSigSendType" SG_ 329 ReSideRdrRiDetn76RdrDetnCntr 0;
BA_ "GenSigFuncType" SG_ 329 ReSideRdrRiDetn76RdrDetnCntr 16;
BA_ "GenSigSendType" SG_ 329 ReSideRdrRiDetn76RdrDetnConf 0;
BA_ "GenSigStartValue" SG_ 329 ReSideRdrRiDetn76RdrDetnElevn 15;
BA_ "GenSigSendType" SG_ 329 ReSideRdrRiDetn76RdrDetnElevn 0;
BA_ "GenSigSendType" SG_ 329 ReSideRdrRiDetn76RdrDetnPwr 0;
BA_ "GenSigStartValue" SG_ 329 ReSideRdrRiDetn76RdrDetnRng 10050;
BA_ "GenSigSendType" SG_ 329 ReSideRdrRiDetn76RdrDetnRng 0;
BA_ "GenSigStartValue" SG_ 329 ReSideRdrRiDetn76RdrDetnRngV 4000;
BA_ "GenSigSendType" SG_ 329 ReSideRdrRiDetn76RdrDetnRngV 0;
BA_ "GenSigStartValue" SG_ 329 ReSideRdrRiDetn76RdrDetnSts 3;
BA_ "GenSigSendType" SG_ 329 ReSideRdrRiDetn76RdrDetnSts 0;
BA_ "GenSigStartValue" SG_ 329 ReSideRdrRiDetn77RdrDetnAzi 900;
BA_ "GenSigSendType" SG_ 329 ReSideRdrRiDetn77RdrDetnAzi 0;
BA_ "GenSigSendType" SG_ 329 ReSideRdrRiDetn77RdrDetnChks 0;
BA_ "GenSigFuncType" SG_ 329 ReSideRdrRiDetn77RdrDetnChks 15;
BA_ "GenSigDataID" SG_ 329 ReSideRdrRiDetn77RdrDetnChks "0xA8D";
BA_ "GenSigSendType" SG_ 329 ReSideRdrRiDetn77RdrDetnCntr 0;
BA_ "GenSigFuncType" SG_ 329 ReSideRdrRiDetn77RdrDetnCntr 16;
BA_ "GenSigSendType" SG_ 329 ReSideRdrRiDetn77RdrDetnConf 0;
BA_ "GenSigStartValue" SG_ 329 ReSideRdrRiDetn77RdrDetnElevn 15;
BA_ "GenSigSendType" SG_ 329 ReSideRdrRiDetn77RdrDetnElevn 0;
BA_ "GenSigSendType" SG_ 329 ReSideRdrRiDetn77RdrDetnPwr 0;
BA_ "GenSigStartValue" SG_ 329 ReSideRdrRiDetn77RdrDetnRng 10050;
BA_ "GenSigSendType" SG_ 329 ReSideRdrRiDetn77RdrDetnRng 0;
BA_ "GenSigStartValue" SG_ 329 ReSideRdrRiDetn77RdrDetnRngV 4000;
BA_ "GenSigSendType" SG_ 329 ReSideRdrRiDetn77RdrDetnRngV 0;
BA_ "GenSigStartValue" SG_ 329 ReSideRdrRiDetn77RdrDetnSts 3;
BA_ "GenSigSendType" SG_ 329 ReSideRdrRiDetn77RdrDetnSts 0;
BA_ "GenSigStartValue" SG_ 329 ReSideRdrRiDetn78RdrDetnAzi 900;
BA_ "GenSigSendType" SG_ 329 ReSideRdrRiDetn78RdrDetnAzi 0;
BA_ "GenSigSendType" SG_ 329 ReSideRdrRiDetn78RdrDetnChks 0;
BA_ "GenSigFuncType" SG_ 329 ReSideRdrRiDetn78RdrDetnChks 15;
BA_ "GenSigDataID" SG_ 329 ReSideRdrRiDetn78RdrDetnChks "0xA8E";
BA_ "GenSigSendType" SG_ 329 ReSideRdrRiDetn78RdrDetnCntr 0;
BA_ "GenSigFuncType" SG_ 329 ReSideRdrRiDetn78RdrDetnCntr 16;
BA_ "GenSigSendType" SG_ 329 ReSideRdrRiDetn78RdrDetnConf 0;
BA_ "GenSigStartValue" SG_ 329 ReSideRdrRiDetn78RdrDetnElevn 15;
BA_ "GenSigSendType" SG_ 329 ReSideRdrRiDetn78RdrDetnElevn 0;
BA_ "GenSigSendType" SG_ 329 ReSideRdrRiDetn78RdrDetnPwr 0;
BA_ "GenSigStartValue" SG_ 329 ReSideRdrRiDetn78RdrDetnRng 10050;
BA_ "GenSigSendType" SG_ 329 ReSideRdrRiDetn78RdrDetnRng 0;
BA_ "GenSigStartValue" SG_ 329 ReSideRdrRiDetn78RdrDetnRngV 4000;
BA_ "GenSigSendType" SG_ 329 ReSideRdrRiDetn78RdrDetnRngV 0;
BA_ "GenSigStartValue" SG_ 329 ReSideRdrRiDetn78RdrDetnSts 3;
BA_ "GenSigSendType" SG_ 329 ReSideRdrRiDetn78RdrDetnSts 0;
// Frame: SODRSafetyCANFD3Frame14
BA_ "VFrameFormat" BO_ 331 14;
BA_ "GenMsgSendType" BO_ 331 0;
BA_ "GenMsgCycleTime" BO_ 331 50.000;
BA_ "GenSigStartValue" SG_ 331 ReSideRdrRiDetn79RdrDetnAzi 900;
BA_ "GenSigSendType" SG_ 331 ReSideRdrRiDetn79RdrDetnAzi 0;
BA_ "GenSigSendType" SG_ 331 ReSideRdrRiDetn79RdrDetnChks 0;
BA_ "GenSigFuncType" SG_ 331 ReSideRdrRiDetn79RdrDetnChks 15;
BA_ "GenSigDataID" SG_ 331 ReSideRdrRiDetn79RdrDetnChks "0xA8F";
BA_ "GenSigSendType" SG_ 331 ReSideRdrRiDetn79RdrDetnCntr 0;
BA_ "GenSigFuncType" SG_ 331 ReSideRdrRiDetn79RdrDetnCntr 16;
BA_ "GenSigSendType" SG_ 331 ReSideRdrRiDetn79RdrDetnConf 0;
BA_ "GenSigStartValue" SG_ 331 ReSideRdrRiDetn79RdrDetnElevn 15;
BA_ "GenSigSendType" SG_ 331 ReSideRdrRiDetn79RdrDetnElevn 0;
BA_ "GenSigSendType" SG_ 331 ReSideRdrRiDetn79RdrDetnPwr 0;
BA_ "GenSigStartValue" SG_ 331 ReSideRdrRiDetn79RdrDetnRng 10050;
BA_ "GenSigSendType" SG_ 331 ReSideRdrRiDetn79RdrDetnRng 0;
BA_ "GenSigStartValue" SG_ 331 ReSideRdrRiDetn79RdrDetnRngV 4000;
BA_ "GenSigSendType" SG_ 331 ReSideRdrRiDetn79RdrDetnRngV 0;
BA_ "GenSigStartValue" SG_ 331 ReSideRdrRiDetn79RdrDetnSts 3;
BA_ "GenSigSendType" SG_ 331 ReSideRdrRiDetn79RdrDetnSts 0;
BA_ "GenSigStartValue" SG_ 331 ReSideRdrRiDetn80RdrDetnAzi 900;
BA_ "GenSigSendType" SG_ 331 ReSideRdrRiDetn80RdrDetnAzi 0;
BA_ "GenSigSendType" SG_ 331 ReSideRdrRiDetn80RdrDetnChks 0;
BA_ "GenSigFuncType" SG_ 331 ReSideRdrRiDetn80RdrDetnChks 15;
BA_ "GenSigDataID" SG_ 331 ReSideRdrRiDetn80RdrDetnChks "0xA90";
BA_ "GenSigSendType" SG_ 331 ReSideRdrRiDetn80RdrDetnCntr 0;
BA_ "GenSigFuncType" SG_ 331 ReSideRdrRiDetn80RdrDetnCntr 16;
BA_ "GenSigSendType" SG_ 331 ReSideRdrRiDetn80RdrDetnConf 0;
BA_ "GenSigStartValue" SG_ 331 ReSideRdrRiDetn80RdrDetnElevn 15;
BA_ "GenSigSendType" SG_ 331 ReSideRdrRiDetn80RdrDetnElevn 0;
BA_ "GenSigSendType" SG_ 331 ReSideRdrRiDetn80RdrDetnPwr 0;
BA_ "GenSigStartValue" SG_ 331 ReSideRdrRiDetn80RdrDetnRng 10050;
BA_ "GenSigSendType" SG_ 331 ReSideRdrRiDetn80RdrDetnRng 0;
BA_ "GenSigStartValue" SG_ 331 ReSideRdrRiDetn80RdrDetnRngV 4000;
BA_ "GenSigSendType" SG_ 331 ReSideRdrRiDetn80RdrDetnRngV 0;
BA_ "GenSigStartValue" SG_ 331 ReSideRdrRiDetn80RdrDetnSts 3;
BA_ "GenSigSendType" SG_ 331 ReSideRdrRiDetn80RdrDetnSts 0;
BA_ "GenSigStartValue" SG_ 331 ReSideRdrRiDetn81RdrDetnAzi 900;
BA_ "GenSigSendType" SG_ 331 ReSideRdrRiDetn81RdrDetnAzi 0;
BA_ "GenSigSendType" SG_ 331 ReSideRdrRiDetn81RdrDetnChks 0;
BA_ "GenSigFuncType" SG_ 331 ReSideRdrRiDetn81RdrDetnChks 15;
BA_ "GenSigDataID" SG_ 331 ReSideRdrRiDetn81RdrDetnChks "0xA91";
BA_ "GenSigSendType" SG_ 331 ReSideRdrRiDetn81RdrDetnCntr 0;
BA_ "GenSigFuncType" SG_ 331 ReSideRdrRiDetn81RdrDetnCntr 16;
BA_ "GenSigSendType" SG_ 331 ReSideRdrRiDetn81RdrDetnConf 0;
BA_ "GenSigStartValue" SG_ 331 ReSideRdrRiDetn81RdrDetnElevn 15;
BA_ "GenSigSendType" SG_ 331 ReSideRdrRiDetn81RdrDetnElevn 0;
BA_ "GenSigSendType" SG_ 331 ReSideRdrRiDetn81RdrDetnPwr 0;
BA_ "GenSigStartValue" SG_ 331 ReSideRdrRiDetn81RdrDetnRng 10050;
BA_ "GenSigSendType" SG_ 331 ReSideRdrRiDetn81RdrDetnRng 0;
BA_ "GenSigStartValue" SG_ 331 ReSideRdrRiDetn81RdrDetnRngV 4000;
BA_ "GenSigSendType" SG_ 331 ReSideRdrRiDetn81RdrDetnRngV 0;
BA_ "GenSigStartValue" SG_ 331 ReSideRdrRiDetn81RdrDetnSts 3;
BA_ "GenSigSendType" SG_ 331 ReSideRdrRiDetn81RdrDetnSts 0;
BA_ "GenSigStartValue" SG_ 331 ReSideRdrRiDetn82RdrDetnAzi 900;
BA_ "GenSigSendType" SG_ 331 ReSideRdrRiDetn82RdrDetnAzi 0;
BA_ "GenSigSendType" SG_ 331 ReSideRdrRiDetn82RdrDetnChks 0;
BA_ "GenSigFuncType" SG_ 331 ReSideRdrRiDetn82RdrDetnChks 15;
BA_ "GenSigDataID" SG_ 331 ReSideRdrRiDetn82RdrDetnChks "0xA92";
BA_ "GenSigSendType" SG_ 331 ReSideRdrRiDetn82RdrDetnCntr 0;
BA_ "GenSigFuncType" SG_ 331 ReSideRdrRiDetn82RdrDetnCntr 16;
BA_ "GenSigSendType" SG_ 331 ReSideRdrRiDetn82RdrDetnConf 0;
BA_ "GenSigStartValue" SG_ 331 ReSideRdrRiDetn82RdrDetnElevn 15;
BA_ "GenSigSendType" SG_ 331 ReSideRdrRiDetn82RdrDetnElevn 0;
BA_ "GenSigSendType" SG_ 331 ReSideRdrRiDetn82RdrDetnPwr 0;
BA_ "GenSigStartValue" SG_ 331 ReSideRdrRiDetn82RdrDetnRng 10050;
BA_ "GenSigSendType" SG_ 331 ReSideRdrRiDetn82RdrDetnRng 0;
BA_ "GenSigStartValue" SG_ 331 ReSideRdrRiDetn82RdrDetnRngV 4000;
BA_ "GenSigSendType" SG_ 331 ReSideRdrRiDetn82RdrDetnRngV 0;
BA_ "GenSigStartValue" SG_ 331 ReSideRdrRiDetn82RdrDetnSts 3;
BA_ "GenSigSendType" SG_ 331 ReSideRdrRiDetn82RdrDetnSts 0;
BA_ "GenSigStartValue" SG_ 331 ReSideRdrRiDetn83RdrDetnAzi 900;
BA_ "GenSigSendType" SG_ 331 ReSideRdrRiDetn83RdrDetnAzi 0;
BA_ "GenSigSendType" SG_ 331 ReSideRdrRiDetn83RdrDetnChks 0;
BA_ "GenSigFuncType" SG_ 331 ReSideRdrRiDetn83RdrDetnChks 15;
BA_ "GenSigDataID" SG_ 331 ReSideRdrRiDetn83RdrDetnChks "0xA93";
BA_ "GenSigSendType" SG_ 331 ReSideRdrRiDetn83RdrDetnCntr 0;
BA_ "GenSigFuncType" SG_ 331 ReSideRdrRiDetn83RdrDetnCntr 16;
BA_ "GenSigSendType" SG_ 331 ReSideRdrRiDetn83RdrDetnConf 0;
BA_ "GenSigStartValue" SG_ 331 ReSideRdrRiDetn83RdrDetnElevn 15;
BA_ "GenSigSendType" SG_ 331 ReSideRdrRiDetn83RdrDetnElevn 0;
BA_ "GenSigSendType" SG_ 331 ReSideRdrRiDetn83RdrDetnPwr 0;
BA_ "GenSigStartValue" SG_ 331 ReSideRdrRiDetn83RdrDetnRng 10050;
BA_ "GenSigSendType" SG_ 331 ReSideRdrRiDetn83RdrDetnRng 0;
BA_ "GenSigStartValue" SG_ 331 ReSideRdrRiDetn83RdrDetnRngV 4000;
BA_ "GenSigSendType" SG_ 331 ReSideRdrRiDetn83RdrDetnRngV 0;
BA_ "GenSigStartValue" SG_ 331 ReSideRdrRiDetn83RdrDetnSts 3;
BA_ "GenSigSendType" SG_ 331 ReSideRdrRiDetn83RdrDetnSts 0;
BA_ "GenSigStartValue" SG_ 331 ReSideRdrRiDetn84RdrDetnAzi 900;
BA_ "GenSigSendType" SG_ 331 ReSideRdrRiDetn84RdrDetnAzi 0;
BA_ "GenSigSendType" SG_ 331 ReSideRdrRiDetn84RdrDetnChks 0;
BA_ "GenSigFuncType" SG_ 331 ReSideRdrRiDetn84RdrDetnChks 15;
BA_ "GenSigDataID" SG_ 331 ReSideRdrRiDetn84RdrDetnChks "0xA94";
BA_ "GenSigSendType" SG_ 331 ReSideRdrRiDetn84RdrDetnCntr 0;
BA_ "GenSigFuncType" SG_ 331 ReSideRdrRiDetn84RdrDetnCntr 16;
BA_ "GenSigSendType" SG_ 331 ReSideRdrRiDetn84RdrDetnConf 0;
BA_ "GenSigStartValue" SG_ 331 ReSideRdrRiDetn84RdrDetnElevn 15;
BA_ "GenSigSendType" SG_ 331 ReSideRdrRiDetn84RdrDetnElevn 0;
BA_ "GenSigSendType" SG_ 331 ReSideRdrRiDetn84RdrDetnPwr 0;
BA_ "GenSigStartValue" SG_ 331 ReSideRdrRiDetn84RdrDetnRng 10050;
BA_ "GenSigSendType" SG_ 331 ReSideRdrRiDetn84RdrDetnRng 0;
BA_ "GenSigStartValue" SG_ 331 ReSideRdrRiDetn84RdrDetnRngV 4000;
BA_ "GenSigSendType" SG_ 331 ReSideRdrRiDetn84RdrDetnRngV 0;
BA_ "GenSigStartValue" SG_ 331 ReSideRdrRiDetn84RdrDetnSts 3;
BA_ "GenSigSendType" SG_ 331 ReSideRdrRiDetn84RdrDetnSts 0;
// Frame: SODRSafetyCANFD3Frame15
BA_ "VFrameFormat" BO_ 333 14;
BA_ "GenMsgSendType" BO_ 333 0;
BA_ "GenMsgCycleTime" BO_ 333 50.000;
BA_ "GenSigStartValue" SG_ 333 ReSideRdrRiDetn85RdrDetnAzi 900;
BA_ "GenSigSendType" SG_ 333 ReSideRdrRiDetn85RdrDetnAzi 0;
BA_ "GenSigSendType" SG_ 333 ReSideRdrRiDetn85RdrDetnChks 0;
BA_ "GenSigFuncType" SG_ 333 ReSideRdrRiDetn85RdrDetnChks 15;
BA_ "GenSigDataID" SG_ 333 ReSideRdrRiDetn85RdrDetnChks "0xA95";
BA_ "GenSigSendType" SG_ 333 ReSideRdrRiDetn85RdrDetnCntr 0;
BA_ "GenSigFuncType" SG_ 333 ReSideRdrRiDetn85RdrDetnCntr 16;
BA_ "GenSigSendType" SG_ 333 ReSideRdrRiDetn85RdrDetnConf 0;
BA_ "GenSigStartValue" SG_ 333 ReSideRdrRiDetn85RdrDetnElevn 15;
BA_ "GenSigSendType" SG_ 333 ReSideRdrRiDetn85RdrDetnElevn 0;
BA_ "GenSigSendType" SG_ 333 ReSideRdrRiDetn85RdrDetnPwr 0;
BA_ "GenSigStartValue" SG_ 333 ReSideRdrRiDetn85RdrDetnRng 10050;
BA_ "GenSigSendType" SG_ 333 ReSideRdrRiDetn85RdrDetnRng 0;
BA_ "GenSigStartValue" SG_ 333 ReSideRdrRiDetn85RdrDetnRngV 4000;
BA_ "GenSigSendType" SG_ 333 ReSideRdrRiDetn85RdrDetnRngV 0;
BA_ "GenSigStartValue" SG_ 333 ReSideRdrRiDetn85RdrDetnSts 3;
BA_ "GenSigSendType" SG_ 333 ReSideRdrRiDetn85RdrDetnSts 0;
BA_ "GenSigStartValue" SG_ 333 ReSideRdrRiDetn86RdrDetnAzi 900;
BA_ "GenSigSendType" SG_ 333 ReSideRdrRiDetn86RdrDetnAzi 0;
BA_ "GenSigSendType" SG_ 333 ReSideRdrRiDetn86RdrDetnChks 0;
BA_ "GenSigFuncType" SG_ 333 ReSideRdrRiDetn86RdrDetnChks 15;
BA_ "GenSigDataID" SG_ 333 ReSideRdrRiDetn86RdrDetnChks "0xA96";
BA_ "GenSigSendType" SG_ 333 ReSideRdrRiDetn86RdrDetnCntr 0;
BA_ "GenSigFuncType" SG_ 333 ReSideRdrRiDetn86RdrDetnCntr 16;
BA_ "GenSigSendType" SG_ 333 ReSideRdrRiDetn86RdrDetnConf 0;
BA_ "GenSigStartValue" SG_ 333 ReSideRdrRiDetn86RdrDetnElevn 15;
BA_ "GenSigSendType" SG_ 333 ReSideRdrRiDetn86RdrDetnElevn 0;
BA_ "GenSigSendType" SG_ 333 ReSideRdrRiDetn86RdrDetnPwr 0;
BA_ "GenSigStartValue" SG_ 333 ReSideRdrRiDetn86RdrDetnRng 10050;
BA_ "GenSigSendType" SG_ 333 ReSideRdrRiDetn86RdrDetnRng 0;
BA_ "GenSigStartValue" SG_ 333 ReSideRdrRiDetn86RdrDetnRngV 4000;
BA_ "GenSigSendType" SG_ 333 ReSideRdrRiDetn86RdrDetnRngV 0;
BA_ "GenSigStartValue" SG_ 333 ReSideRdrRiDetn86RdrDetnSts 3;
BA_ "GenSigSendType" SG_ 333 ReSideRdrRiDetn86RdrDetnSts 0;
BA_ "GenSigStartValue" SG_ 333 ReSideRdrRiDetn87RdrDetnAzi 900;
BA_ "GenSigSendType" SG_ 333 ReSideRdrRiDetn87RdrDetnAzi 0;
BA_ "GenSigSendType" SG_ 333 ReSideRdrRiDetn87RdrDetnChks 0;
BA_ "GenSigFuncType" SG_ 333 ReSideRdrRiDetn87RdrDetnChks 15;
BA_ "GenSigDataID" SG_ 333 ReSideRdrRiDetn87RdrDetnChks "0xA97";
BA_ "GenSigSendType" SG_ 333 ReSideRdrRiDetn87RdrDetnCntr 0;
BA_ "GenSigFuncType" SG_ 333 ReSideRdrRiDetn87RdrDetnCntr 16;
BA_ "GenSigSendType" SG_ 333 ReSideRdrRiDetn87RdrDetnConf 0;
BA_ "GenSigStartValue" SG_ 333 ReSideRdrRiDetn87RdrDetnElevn 15;
BA_ "GenSigSendType" SG_ 333 ReSideRdrRiDetn87RdrDetnElevn 0;
BA_ "GenSigSendType" SG_ 333 ReSideRdrRiDetn87RdrDetnPwr 0;
BA_ "GenSigStartValue" SG_ 333 ReSideRdrRiDetn87RdrDetnRng 10050;
BA_ "GenSigSendType" SG_ 333 ReSideRdrRiDetn87RdrDetnRng 0;
BA_ "GenSigStartValue" SG_ 333 ReSideRdrRiDetn87RdrDetnRngV 4000;
BA_ "GenSigSendType" SG_ 333 ReSideRdrRiDetn87RdrDetnRngV 0;
BA_ "GenSigStartValue" SG_ 333 ReSideRdrRiDetn87RdrDetnSts 3;
BA_ "GenSigSendType" SG_ 333 ReSideRdrRiDetn87RdrDetnSts 0;
BA_ "GenSigStartValue" SG_ 333 ReSideRdrRiDetn88RdrDetnAzi 900;
BA_ "GenSigSendType" SG_ 333 ReSideRdrRiDetn88RdrDetnAzi 0;
BA_ "GenSigSendType" SG_ 333 ReSideRdrRiDetn88RdrDetnChks 0;
BA_ "GenSigFuncType" SG_ 333 ReSideRdrRiDetn88RdrDetnChks 15;
BA_ "GenSigDataID" SG_ 333 ReSideRdrRiDetn88RdrDetnChks "0xA98";
BA_ "GenSigSendType" SG_ 333 ReSideRdrRiDetn88RdrDetnCntr 0;
BA_ "GenSigFuncType" SG_ 333 ReSideRdrRiDetn88RdrDetnCntr 16;
BA_ "GenSigSendType" SG_ 333 ReSideRdrRiDetn88RdrDetnConf 0;
BA_ "GenSigStartValue" SG_ 333 ReSideRdrRiDetn88RdrDetnElevn 15;
BA_ "GenSigSendType" SG_ 333 ReSideRdrRiDetn88RdrDetnElevn 0;
BA_ "GenSigSendType" SG_ 333 ReSideRdrRiDetn88RdrDetnPwr 0;
BA_ "GenSigStartValue" SG_ 333 ReSideRdrRiDetn88RdrDetnRng 10050;
BA_ "GenSigSendType" SG_ 333 ReSideRdrRiDetn88RdrDetnRng 0;
BA_ "GenSigStartValue" SG_ 333 ReSideRdrRiDetn88RdrDetnRngV 4000;
BA_ "GenSigSendType" SG_ 333 ReSideRdrRiDetn88RdrDetnRngV 0;
BA_ "GenSigStartValue" SG_ 333 ReSideRdrRiDetn88RdrDetnSts 3;
BA_ "GenSigSendType" SG_ 333 ReSideRdrRiDetn88RdrDetnSts 0;
BA_ "GenSigStartValue" SG_ 333 ReSideRdrRiDetn89RdrDetnAzi 900;
BA_ "GenSigSendType" SG_ 333 ReSideRdrRiDetn89RdrDetnAzi 0;
BA_ "GenSigSendType" SG_ 333 ReSideRdrRiDetn89RdrDetnChks 0;
BA_ "GenSigFuncType" SG_ 333 ReSideRdrRiDetn89RdrDetnChks 15;
BA_ "GenSigDataID" SG_ 333 ReSideRdrRiDetn89RdrDetnChks "0xA99";
BA_ "GenSigSendType" SG_ 333 ReSideRdrRiDetn89RdrDetnCntr 0;
BA_ "GenSigFuncType" SG_ 333 ReSideRdrRiDetn89RdrDetnCntr 16;
BA_ "GenSigSendType" SG_ 333 ReSideRdrRiDetn89RdrDetnConf 0;
BA_ "GenSigStartValue" SG_ 333 ReSideRdrRiDetn89RdrDetnElevn 15;
BA_ "GenSigSendType" SG_ 333 ReSideRdrRiDetn89RdrDetnElevn 0;
BA_ "GenSigSendType" SG_ 333 ReSideRdrRiDetn89RdrDetnPwr 0;
BA_ "GenSigStartValue" SG_ 333 ReSideRdrRiDetn89RdrDetnRng 10050;
BA_ "GenSigSendType" SG_ 333 ReSideRdrRiDetn89RdrDetnRng 0;
BA_ "GenSigStartValue" SG_ 333 ReSideRdrRiDetn89RdrDetnRngV 4000;
BA_ "GenSigSendType" SG_ 333 ReSideRdrRiDetn89RdrDetnRngV 0;
BA_ "GenSigStartValue" SG_ 333 ReSideRdrRiDetn89RdrDetnSts 3;
BA_ "GenSigSendType" SG_ 333 ReSideRdrRiDetn89RdrDetnSts 0;
BA_ "GenSigStartValue" SG_ 333 ReSideRdrRiDetn90RdrDetnAzi 900;
BA_ "GenSigSendType" SG_ 333 ReSideRdrRiDetn90RdrDetnAzi 0;
BA_ "GenSigSendType" SG_ 333 ReSideRdrRiDetn90RdrDetnChks 0;
BA_ "GenSigFuncType" SG_ 333 ReSideRdrRiDetn90RdrDetnChks 15;
BA_ "GenSigDataID" SG_ 333 ReSideRdrRiDetn90RdrDetnChks "0xA9A";
BA_ "GenSigSendType" SG_ 333 ReSideRdrRiDetn90RdrDetnCntr 0;
BA_ "GenSigFuncType" SG_ 333 ReSideRdrRiDetn90RdrDetnCntr 16;
BA_ "GenSigSendType" SG_ 333 ReSideRdrRiDetn90RdrDetnConf 0;
BA_ "GenSigStartValue" SG_ 333 ReSideRdrRiDetn90RdrDetnElevn 15;
BA_ "GenSigSendType" SG_ 333 ReSideRdrRiDetn90RdrDetnElevn 0;
BA_ "GenSigSendType" SG_ 333 ReSideRdrRiDetn90RdrDetnPwr 0;
BA_ "GenSigStartValue" SG_ 333 ReSideRdrRiDetn90RdrDetnRng 10050;
BA_ "GenSigSendType" SG_ 333 ReSideRdrRiDetn90RdrDetnRng 0;
BA_ "GenSigStartValue" SG_ 333 ReSideRdrRiDetn90RdrDetnRngV 4000;
BA_ "GenSigSendType" SG_ 333 ReSideRdrRiDetn90RdrDetnRngV 0;
BA_ "GenSigStartValue" SG_ 333 ReSideRdrRiDetn90RdrDetnSts 3;
BA_ "GenSigSendType" SG_ 333 ReSideRdrRiDetn90RdrDetnSts 0;
VAL_ 319 ReSideRdrRiDetn43RdrDetnSts 0 "RdrDetnSts_Ukwn" 1 "RdrDetnSts_Movg" 2 "RdrDetnSts_Staty" 3 "RdrDetnSts_Invalid";
VAL_ 319 ReSideRdrRiDetn44RdrDetnSts 0 "RdrDetnSts_Ukwn" 1 "RdrDetnSts_Movg" 2 "RdrDetnSts_Staty" 3 "RdrDetnSts_Invalid";
VAL_ 319 ReSideRdrRiDetn45RdrDetnSts 0 "RdrDetnSts_Ukwn" 1 "RdrDetnSts_Movg" 2 "RdrDetnSts_Staty" 3 "RdrDetnSts_Invalid";
VAL_ 319 ReSideRdrRiDetn46RdrDetnSts 0 "RdrDetnSts_Ukwn" 1 "RdrDetnSts_Movg" 2 "RdrDetnSts_Staty" 3 "RdrDetnSts_Invalid";
VAL_ 319 ReSideRdrRiDetn47RdrDetnSts 0 "RdrDetnSts_Ukwn" 1 "RdrDetnSts_Movg" 2 "RdrDetnSts_Staty" 3 "RdrDetnSts_Invalid";
VAL_ 319 ReSideRdrRiDetn48RdrDetnSts 0 "RdrDetnSts_Ukwn" 1 "RdrDetnSts_Movg" 2 "RdrDetnSts_Staty" 3 "RdrDetnSts_Invalid";
VAL_ 321 ReSideRdrRiDetn49RdrDetnSts 0 "RdrDetnSts_Ukwn" 1 "RdrDetnSts_Movg" 2 "RdrDetnSts_Staty" 3 "RdrDetnSts_Invalid";
VAL_ 321 ReSideRdrRiDetn50RdrDetnSts 0 "RdrDetnSts_Ukwn" 1 "RdrDetnSts_Movg" 2 "RdrDetnSts_Staty" 3 "RdrDetnSts_Invalid";
VAL_ 321 ReSideRdrRiDetn51RdrDetnSts 0 "RdrDetnSts_Ukwn" 1 "RdrDetnSts_Movg" 2 "RdrDetnSts_Staty" 3 "RdrDetnSts_Invalid";
VAL_ 321 ReSideRdrRiDetn52RdrDetnSts 0 "RdrDetnSts_Ukwn" 1 "RdrDetnSts_Movg" 2 "RdrDetnSts_Staty" 3 "RdrDetnSts_Invalid";
VAL_ 321 ReSideRdrRiDetn53RdrDetnSts 0 "RdrDetnSts_Ukwn" 1 "RdrDetnSts_Movg" 2 "RdrDetnSts_Staty" 3 "RdrDetnSts_Invalid";
VAL_ 321 ReSideRdrRiDetn54RdrDetnSts 0 "RdrDetnSts_Ukwn" 1 "RdrDetnSts_Movg" 2 "RdrDetnSts_Staty" 3 "RdrDetnSts_Invalid";
VAL_ 323 ReSideRdrRiDetn55RdrDetnSts 0 "RdrDetnSts_Ukwn" 1 "RdrDetnSts_Movg" 2 "RdrDetnSts_Staty" 3 "RdrDetnSts_Invalid";
VAL_ 323 ReSideRdrRiDetn56RdrDetnSts 0 "RdrDetnSts_Ukwn" 1 "RdrDetnSts_Movg" 2 "RdrDetnSts_Staty" 3 "RdrDetnSts_Invalid";
VAL_ 323 ReSideRdrRiDetn57RdrDetnSts 0 "RdrDetnSts_Ukwn" 1 "RdrDetnSts_Movg" 2 "RdrDetnSts_Staty" 3 "RdrDetnSts_Invalid";
VAL_ 323 ReSideRdrRiDetn58RdrDetnSts 0 "RdrDetnSts_Ukwn" 1 "RdrDetnSts_Movg" 2 "RdrDetnSts_Staty" 3 "RdrDetnSts_Invalid";
VAL_ 323 ReSideRdrRiDetn59RdrDetnSts 0 "RdrDetnSts_Ukwn" 1 "RdrDetnSts_Movg" 2 "RdrDetnSts_Staty" 3 "RdrDetnSts_Invalid";
VAL_ 323 ReSideRdrRiDetn60RdrDetnSts 0 "RdrDetnSts_Ukwn" 1 "RdrDetnSts_Movg" 2 "RdrDetnSts_Staty" 3 "RdrDetnSts_Invalid";
VAL_ 325 ReSideRdrRiDetn61RdrDetnSts 0 "RdrDetnSts_Ukwn" 1 "RdrDetnSts_Movg" 2 "RdrDetnSts_Staty" 3 "RdrDetnSts_Invalid";
VAL_ 325 ReSideRdrRiDetn62RdrDetnSts 0 "RdrDetnSts_Ukwn" 1 "RdrDetnSts_Movg" 2 "RdrDetnSts_Staty" 3 "RdrDetnSts_Invalid";
VAL_ 325 ReSideRdrRiDetn63RdrDetnSts 0 "RdrDetnSts_Ukwn" 1 "RdrDetnSts_Movg" 2 "RdrDetnSts_Staty" 3 "RdrDetnSts_Invalid";
VAL_ 325 ReSideRdrRiDetn64RdrDetnSts 0 "RdrDetnSts_Ukwn" 1 "RdrDetnSts_Movg" 2 "RdrDetnSts_Staty" 3 "RdrDetnSts_Invalid";
VAL_ 325 ReSideRdrRiDetn65RdrDetnSts 0 "RdrDetnSts_Ukwn" 1 "RdrDetnSts_Movg" 2 "RdrDetnSts_Staty" 3 "RdrDetnSts_Invalid";
VAL_ 325 ReSideRdrRiDetn66RdrDetnSts 0 "RdrDetnSts_Ukwn" 1 "RdrDetnSts_Movg" 2 "RdrDetnSts_Staty" 3 "RdrDetnSts_Invalid";
VAL_ 327 ReSideRdrRiDetn67RdrDetnSts 0 "RdrDetnSts_Ukwn" 1 "RdrDetnSts_Movg" 2 "RdrDetnSts_Staty" 3 "RdrDetnSts_Invalid";
VAL_ 327 ReSideRdrRiDetn68RdrDetnSts 0 "RdrDetnSts_Ukwn" 1 "RdrDetnSts_Movg" 2 "RdrDetnSts_Staty" 3 "RdrDetnSts_Invalid";
VAL_ 327 ReSideRdrRiDetn69RdrDetnSts 0 "RdrDetnSts_Ukwn" 1 "RdrDetnSts_Movg" 2 "RdrDetnSts_Staty" 3 "RdrDetnSts_Invalid";
VAL_ 327 ReSideRdrRiDetn70RdrDetnSts 0 "RdrDetnSts_Ukwn" 1 "RdrDetnSts_Movg" 2 "RdrDetnSts_Staty" 3 "RdrDetnSts_Invalid";
VAL_ 327 ReSideRdrRiDetn71RdrDetnSts 0 "RdrDetnSts_Ukwn" 1 "RdrDetnSts_Movg" 2 "RdrDetnSts_Staty" 3 "RdrDetnSts_Invalid";
VAL_ 327 ReSideRdrRiDetn72RdrDetnSts 0 "RdrDetnSts_Ukwn" 1 "RdrDetnSts_Movg" 2 "RdrDetnSts_Staty" 3 "RdrDetnSts_Invalid";
VAL_ 329 ReSideRdrRiDetn73RdrDetnSts 0 "RdrDetnSts_Ukwn" 1 "RdrDetnSts_Movg" 2 "RdrDetnSts_Staty" 3 "RdrDetnSts_Invalid";
VAL_ 329 ReSideRdrRiDetn74RdrDetnSts 0 "RdrDetnSts_Ukwn" 1 "RdrDetnSts_Movg" 2 "RdrDetnSts_Staty" 3 "RdrDetnSts_Invalid";
VAL_ 329 ReSideRdrRiDetn75RdrDetnSts 0 "RdrDetnSts_Ukwn" 1 "RdrDetnSts_Movg" 2 "RdrDetnSts_Staty" 3 "RdrDetnSts_Invalid";
VAL_ 329 ReSideRdrRiDetn76RdrDetnSts 0 "RdrDetnSts_Ukwn" 1 "RdrDetnSts_Movg" 2 "RdrDetnSts_Staty" 3 "RdrDetnSts_Invalid";
VAL_ 329 ReSideRdrRiDetn77RdrDetnSts 0 "RdrDetnSts_Ukwn" 1 "RdrDetnSts_Movg" 2 "RdrDetnSts_Staty" 3 "RdrDetnSts_Invalid";
VAL_ 329 ReSideRdrRiDetn78RdrDetnSts 0 "RdrDetnSts_Ukwn" 1 "RdrDetnSts_Movg" 2 "RdrDetnSts_Staty" 3 "RdrDetnSts_Invalid";
VAL_ 331 ReSideRdrRiDetn79RdrDetnSts 0 "RdrDetnSts_Ukwn" 1 "RdrDetnSts_Movg" 2 "RdrDetnSts_Staty" 3 "RdrDetnSts_Invalid";
VAL_ 331 ReSideRdrRiDetn80RdrDetnSts 0 "RdrDetnSts_Ukwn" 1 "RdrDetnSts_Movg" 2 "RdrDetnSts_Staty" 3 "RdrDetnSts_Invalid";
VAL_ 331 ReSideRdrRiDetn81RdrDetnSts 0 "RdrDetnSts_Ukwn" 1 "RdrDetnSts_Movg" 2 "RdrDetnSts_Staty" 3 "RdrDetnSts_Invalid";
VAL_ 331 ReSideRdrRiDetn82RdrDetnSts 0 "RdrDetnSts_Ukwn" 1 "RdrDetnSts_Movg" 2 "RdrDetnSts_Staty" 3 "RdrDetnSts_Invalid";
VAL_ 331 ReSideRdrRiDetn83RdrDetnSts 0 "RdrDetnSts_Ukwn" 1 "RdrDetnSts_Movg" 2 "RdrDetnSts_Staty" 3 "RdrDetnSts_Invalid";
VAL_ 331 ReSideRdrRiDetn84RdrDetnSts 0 "RdrDetnSts_Ukwn" 1 "RdrDetnSts_Movg" 2 "RdrDetnSts_Staty" 3 "RdrDetnSts_Invalid";
VAL_ 333 ReSideRdrRiDetn85RdrDetnSts 0 "RdrDetnSts_Ukwn" 1 "RdrDetnSts_Movg" 2 "RdrDetnSts_Staty" 3 "RdrDetnSts_Invalid";
VAL_ 333 ReSideRdrRiDetn86RdrDetnSts 0 "RdrDetnSts_Ukwn" 1 "RdrDetnSts_Movg" 2 "RdrDetnSts_Staty" 3 "RdrDetnSts_Invalid";
VAL_ 333 ReSideRdrRiDetn87RdrDetnSts 0 "RdrDetnSts_Ukwn" 1 "RdrDetnSts_Movg" 2 "RdrDetnSts_Staty" 3 "RdrDetnSts_Invalid";
VAL_ 333 ReSideRdrRiDetn88RdrDetnSts 0 "RdrDetnSts_Ukwn" 1 "RdrDetnSts_Movg" 2 "RdrDetnSts_Staty" 3 "RdrDetnSts_Invalid";
VAL_ 333 ReSideRdrRiDetn89RdrDetnSts 0 "RdrDetnSts_Ukwn" 1 "RdrDetnSts_Movg" 2 "RdrDetnSts_Staty" 3 "RdrDetnSts_Invalid";
VAL_ 333 ReSideRdrRiDetn90RdrDetnSts 0 "RdrDetnSts_Ukwn" 1 "RdrDetnSts_Movg" 2 "RdrDetnSts_Staty" 3 "RdrDetnSts_Invalid";
SIG_GROUP_ 319 ReSideRdrRiDetn43 1 : ReSideRdrRiDetn43RdrDetnAzi ReSideRdrRiDetn43RdrDetnChks ReSideRdrRiDetn43RdrDetnCntr ReSideRdrRiDetn43RdrDetnConf ReSideRdrRiDetn43RdrDetnElevn ReSideRdrRiDetn43RdrDetnPwr ReSideRdrRiDetn43RdrDetnRng ReSideRdrRiDetn43RdrDetnRngV ReSideRdrRiDetn43RdrDetnSts;
SIG_GROUP_ 319 ReSideRdrRiDetn44 1 : ReSideRdrRiDetn44RdrDetnAzi ReSideRdrRiDetn44RdrDetnChks ReSideRdrRiDetn44RdrDetnCntr ReSideRdrRiDetn44RdrDetnConf ReSideRdrRiDetn44RdrDetnElevn ReSideRdrRiDetn44RdrDetnPwr ReSideRdrRiDetn44RdrDetnRng ReSideRdrRiDetn44RdrDetnRngV ReSideRdrRiDetn44RdrDetnSts;
SIG_GROUP_ 319 ReSideRdrRiDetn45 1 : ReSideRdrRiDetn45RdrDetnAzi ReSideRdrRiDetn45RdrDetnChks ReSideRdrRiDetn45RdrDetnCntr ReSideRdrRiDetn45RdrDetnConf ReSideRdrRiDetn45RdrDetnElevn ReSideRdrRiDetn45RdrDetnPwr ReSideRdrRiDetn45RdrDetnRng ReSideRdrRiDetn45RdrDetnRngV ReSideRdrRiDetn45RdrDetnSts;
SIG_GROUP_ 319 ReSideRdrRiDetn46 1 : ReSideRdrRiDetn46RdrDetnAzi ReSideRdrRiDetn46RdrDetnChks ReSideRdrRiDetn46RdrDetnCntr ReSideRdrRiDetn46RdrDetnConf ReSideRdrRiDetn46RdrDetnElevn ReSideRdrRiDetn46RdrDetnPwr ReSideRdrRiDetn46RdrDetnRng ReSideRdrRiDetn46RdrDetnRngV ReSideRdrRiDetn46RdrDetnSts;
SIG_GROUP_ 319 ReSideRdrRiDetn47 1 : ReSideRdrRiDetn47RdrDetnAzi ReSideRdrRiDetn47RdrDetnChks ReSideRdrRiDetn47RdrDetnCntr ReSideRdrRiDetn47RdrDetnConf ReSideRdrRiDetn47RdrDetnElevn ReSideRdrRiDetn47RdrDetnPwr ReSideRdrRiDetn47RdrDetnRng ReSideRdrRiDetn47RdrDetnRngV ReSideRdrRiDetn47RdrDetnSts;
SIG_GROUP_ 319 ReSideRdrRiDetn48 1 : ReSideRdrRiDetn48RdrDetnAzi ReSideRdrRiDetn48RdrDetnChks ReSideRdrRiDetn48RdrDetnCntr ReSideRdrRiDetn48RdrDetnConf ReSideRdrRiDetn48RdrDetnElevn ReSideRdrRiDetn48RdrDetnPwr ReSideRdrRiDetn48RdrDetnRng ReSideRdrRiDetn48RdrDetnRngV ReSideRdrRiDetn48RdrDetnSts;
SIG_GROUP_ 321 ReSideRdrRiDetn49 1 : ReSideRdrRiDetn49RdrDetnAzi ReSideRdrRiDetn49RdrDetnChks ReSideRdrRiDetn49RdrDetnCntr ReSideRdrRiDetn49RdrDetnConf ReSideRdrRiDetn49RdrDetnElevn ReSideRdrRiDetn49RdrDetnPwr ReSideRdrRiDetn49RdrDetnRng ReSideRdrRiDetn49RdrDetnRngV ReSideRdrRiDetn49RdrDetnSts;
SIG_GROUP_ 321 ReSideRdrRiDetn50 1 : ReSideRdrRiDetn50RdrDetnAzi ReSideRdrRiDetn50RdrDetnChks ReSideRdrRiDetn50RdrDetnCntr ReSideRdrRiDetn50RdrDetnConf ReSideRdrRiDetn50RdrDetnElevn ReSideRdrRiDetn50RdrDetnPwr ReSideRdrRiDetn50RdrDetnRng ReSideRdrRiDetn50RdrDetnRngV ReSideRdrRiDetn50RdrDetnSts;
SIG_GROUP_ 321 ReSideRdrRiDetn51 1 : ReSideRdrRiDetn51RdrDetnAzi ReSideRdrRiDetn51RdrDetnChks ReSideRdrRiDetn51RdrDetnCntr ReSideRdrRiDetn51RdrDetnConf ReSideRdrRiDetn51RdrDetnElevn ReSideRdrRiDetn51RdrDetnPwr ReSideRdrRiDetn51RdrDetnRng ReSideRdrRiDetn51RdrDetnRngV ReSideRdrRiDetn51RdrDetnSts;
SIG_GROUP_ 321 ReSideRdrRiDetn52 1 : ReSideRdrRiDetn52RdrDetnAzi ReSideRdrRiDetn52RdrDetnChks ReSideRdrRiDetn52RdrDetnCntr ReSideRdrRiDetn52RdrDetnConf ReSideRdrRiDetn52RdrDetnElevn ReSideRdrRiDetn52RdrDetnPwr ReSideRdrRiDetn52RdrDetnRng ReSideRdrRiDetn52RdrDetnRngV ReSideRdrRiDetn52RdrDetnSts;
SIG_GROUP_ 321 ReSideRdrRiDetn53 1 : ReSideRdrRiDetn53RdrDetnAzi ReSideRdrRiDetn53RdrDetnChks ReSideRdrRiDetn53RdrDetnCntr ReSideRdrRiDetn53RdrDetnConf ReSideRdrRiDetn53RdrDetnElevn ReSideRdrRiDetn53RdrDetnPwr ReSideRdrRiDetn53RdrDetnRng ReSideRdrRiDetn53RdrDetnRngV ReSideRdrRiDetn53RdrDetnSts;
SIG_GROUP_ 321 ReSideRdrRiDetn54 1 : ReSideRdrRiDetn54RdrDetnAzi ReSideRdrRiDetn54RdrDetnChks ReSideRdrRiDetn54RdrDetnCntr ReSideRdrRiDetn54RdrDetnConf ReSideRdrRiDetn54RdrDetnElevn ReSideRdrRiDetn54RdrDetnPwr ReSideRdrRiDetn54RdrDetnRng ReSideRdrRiDetn54RdrDetnRngV ReSideRdrRiDetn54RdrDetnSts;
SIG_GROUP_ 323 ReSideRdrRiDetn55 1 : ReSideRdrRiDetn55RdrDetnAzi ReSideRdrRiDetn55RdrDetnChks ReSideRdrRiDetn55RdrDetnCntr ReSideRdrRiDetn55RdrDetnConf ReSideRdrRiDetn55RdrDetnElevn ReSideRdrRiDetn55RdrDetnPwr ReSideRdrRiDetn55RdrDetnRng ReSideRdrRiDetn55RdrDetnRngV ReSideRdrRiDetn55RdrDetnSts;
SIG_GROUP_ 323 ReSideRdrRiDetn56 1 : ReSideRdrRiDetn56RdrDetnAzi ReSideRdrRiDetn56RdrDetnChks ReSideRdrRiDetn56RdrDetnCntr ReSideRdrRiDetn56RdrDetnConf ReSideRdrRiDetn56RdrDetnElevn ReSideRdrRiDetn56RdrDetnPwr ReSideRdrRiDetn56RdrDetnRng ReSideRdrRiDetn56RdrDetnRngV ReSideRdrRiDetn56RdrDetnSts;
SIG_GROUP_ 323 ReSideRdrRiDetn57 1 : ReSideRdrRiDetn57RdrDetnAzi ReSideRdrRiDetn57RdrDetnChks ReSideRdrRiDetn57RdrDetnCntr ReSideRdrRiDetn57RdrDetnConf ReSideRdrRiDetn57RdrDetnElevn ReSideRdrRiDetn57RdrDetnPwr ReSideRdrRiDetn57RdrDetnRng ReSideRdrRiDetn57RdrDetnRngV ReSideRdrRiDetn57RdrDetnSts;
SIG_GROUP_ 323 ReSideRdrRiDetn58 1 : ReSideRdrRiDetn58RdrDetnAzi ReSideRdrRiDetn58RdrDetnChks ReSideRdrRiDetn58RdrDetnCntr ReSideRdrRiDetn58RdrDetnConf ReSideRdrRiDetn58RdrDetnElevn ReSideRdrRiDetn58RdrDetnPwr ReSideRdrRiDetn58RdrDetnRng ReSideRdrRiDetn58RdrDetnRngV ReSideRdrRiDetn58RdrDetnSts;
SIG_GROUP_ 323 ReSideRdrRiDetn59 1 : ReSideRdrRiDetn59RdrDetnAzi ReSideRdrRiDetn59RdrDetnChks ReSideRdrRiDetn59RdrDetnCntr ReSideRdrRiDetn59RdrDetnConf ReSideRdrRiDetn59RdrDetnElevn ReSideRdrRiDetn59RdrDetnPwr ReSideRdrRiDetn59RdrDetnRng ReSideRdrRiDetn59RdrDetnRngV ReSideRdrRiDetn59RdrDetnSts;
SIG_GROUP_ 323 ReSideRdrRiDetn60 1 : ReSideRdrRiDetn60RdrDetnAzi ReSideRdrRiDetn60RdrDetnChks ReSideRdrRiDetn60RdrDetnCntr ReSideRdrRiDetn60RdrDetnConf ReSideRdrRiDetn60RdrDetnElevn ReSideRdrRiDetn60RdrDetnPwr ReSideRdrRiDetn60RdrDetnRng ReSideRdrRiDetn60RdrDetnRngV ReSideRdrRiDetn60RdrDetnSts;
SIG_GROUP_ 325 ReSideRdrRiDetn61 1 : ReSideRdrRiDetn61RdrDetnAzi ReSideRdrRiDetn61RdrDetnChks ReSideRdrRiDetn61RdrDetnCntr ReSideRdrRiDetn61RdrDetnConf ReSideRdrRiDetn61RdrDetnElevn ReSideRdrRiDetn61RdrDetnPwr ReSideRdrRiDetn61RdrDetnRng ReSideRdrRiDetn61RdrDetnRngV ReSideRdrRiDetn61RdrDetnSts;
SIG_GROUP_ 325 ReSideRdrRiDetn62 1 : ReSideRdrRiDetn62RdrDetnAzi ReSideRdrRiDetn62RdrDetnChks ReSideRdrRiDetn62RdrDetnCntr ReSideRdrRiDetn62RdrDetnConf ReSideRdrRiDetn62RdrDetnElevn ReSideRdrRiDetn62RdrDetnPwr ReSideRdrRiDetn62RdrDetnRng ReSideRdrRiDetn62RdrDetnRngV ReSideRdrRiDetn62RdrDetnSts;
SIG_GROUP_ 325 ReSideRdrRiDetn63 1 : ReSideRdrRiDetn63RdrDetnAzi ReSideRdrRiDetn63RdrDetnChks ReSideRdrRiDetn63RdrDetnCntr ReSideRdrRiDetn63RdrDetnConf ReSideRdrRiDetn63RdrDetnElevn ReSideRdrRiDetn63RdrDetnPwr ReSideRdrRiDetn63RdrDetnRng ReSideRdrRiDetn63RdrDetnRngV ReSideRdrRiDetn63RdrDetnSts;
SIG_GROUP_ 325 ReSideRdrRiDetn64 1 : ReSideRdrRiDetn64RdrDetnAzi ReSideRdrRiDetn64RdrDetnChks ReSideRdrRiDetn64RdrDetnCntr ReSideRdrRiDetn64RdrDetnConf ReSideRdrRiDetn64RdrDetnElevn ReSideRdrRiDetn64RdrDetnPwr ReSideRdrRiDetn64RdrDetnRng ReSideRdrRiDetn64RdrDetnRngV ReSideRdrRiDetn64RdrDetnSts;
SIG_GROUP_ 325 ReSideRdrRiDetn65 1 : ReSideRdrRiDetn65RdrDetnAzi ReSideRdrRiDetn65RdrDetnChks ReSideRdrRiDetn65RdrDetnCntr ReSideRdrRiDetn65RdrDetnConf ReSideRdrRiDetn65RdrDetnElevn ReSideRdrRiDetn65RdrDetnPwr ReSideRdrRiDetn65RdrDetnRng ReSideRdrRiDetn65RdrDetnRngV ReSideRdrRiDetn65RdrDetnSts;
SIG_GROUP_ 325 ReSideRdrRiDetn66 1 : ReSideRdrRiDetn66RdrDetnAzi ReSideRdrRiDetn66RdrDetnChks ReSideRdrRiDetn66RdrDetnCntr ReSideRdrRiDetn66RdrDetnConf ReSideRdrRiDetn66RdrDetnElevn ReSideRdrRiDetn66RdrDetnPwr ReSideRdrRiDetn66RdrDetnRng ReSideRdrRiDetn66RdrDetnRngV ReSideRdrRiDetn66RdrDetnSts;
SIG_GROUP_ 327 ReSideRdrRiDetn67 1 : ReSideRdrRiDetn67RdrDetnAzi ReSideRdrRiDetn67RdrDetnChks ReSideRdrRiDetn67RdrDetnCntr ReSideRdrRiDetn67RdrDetnConf ReSideRdrRiDetn67RdrDetnElevn ReSideRdrRiDetn67RdrDetnPwr ReSideRdrRiDetn67RdrDetnRng ReSideRdrRiDetn67RdrDetnRngV ReSideRdrRiDetn67RdrDetnSts;
SIG_GROUP_ 327 ReSideRdrRiDetn68 1 : ReSideRdrRiDetn68RdrDetnAzi ReSideRdrRiDetn68RdrDetnChks ReSideRdrRiDetn68RdrDetnCntr ReSideRdrRiDetn68RdrDetnConf ReSideRdrRiDetn68RdrDetnElevn ReSideRdrRiDetn68RdrDetnPwr ReSideRdrRiDetn68RdrDetnRng ReSideRdrRiDetn68RdrDetnRngV ReSideRdrRiDetn68RdrDetnSts;
SIG_GROUP_ 327 ReSideRdrRiDetn69 1 : ReSideRdrRiDetn69RdrDetnAzi ReSideRdrRiDetn69RdrDetnChks ReSideRdrRiDetn69RdrDetnCntr ReSideRdrRiDetn69RdrDetnConf ReSideRdrRiDetn69RdrDetnElevn ReSideRdrRiDetn69RdrDetnPwr ReSideRdrRiDetn69RdrDetnRng ReSideRdrRiDetn69RdrDetnRngV ReSideRdrRiDetn69RdrDetnSts;
SIG_GROUP_ 327 ReSideRdrRiDetn70 1 : ReSideRdrRiDetn70RdrDetnAzi ReSideRdrRiDetn70RdrDetnChks ReSideRdrRiDetn70RdrDetnCntr ReSideRdrRiDetn70RdrDetnConf ReSideRdrRiDetn70RdrDetnElevn ReSideRdrRiDetn70RdrDetnPwr ReSideRdrRiDetn70RdrDetnRng ReSideRdrRiDetn70RdrDetnRngV ReSideRdrRiDetn70RdrDetnSts;
SIG_GROUP_ 327 ReSideRdrRiDetn71 1 : ReSideRdrRiDetn71RdrDetnAzi ReSideRdrRiDetn71RdrDetnChks ReSideRdrRiDetn71RdrDetnCntr ReSideRdrRiDetn71RdrDetnConf ReSideRdrRiDetn71RdrDetnElevn ReSideRdrRiDetn71RdrDetnPwr ReSideRdrRiDetn71RdrDetnRng ReSideRdrRiDetn71RdrDetnRngV ReSideRdrRiDetn71RdrDetnSts;
SIG_GROUP_ 327 ReSideRdrRiDetn72 1 : ReSideRdrRiDetn72RdrDetnAzi ReSideRdrRiDetn72RdrDetnChks ReSideRdrRiDetn72RdrDetnCntr ReSideRdrRiDetn72RdrDetnConf ReSideRdrRiDetn72RdrDetnElevn ReSideRdrRiDetn72RdrDetnPwr ReSideRdrRiDetn72RdrDetnRng ReSideRdrRiDetn72RdrDetnRngV ReSideRdrRiDetn72RdrDetnSts;
SIG_GROUP_ 329 ReSideRdrRiDetn73 1 : ReSideRdrRiDetn73RdrDetnAzi ReSideRdrRiDetn73RdrDetnChks ReSideRdrRiDetn73RdrDetnCntr ReSideRdrRiDetn73RdrDetnConf ReSideRdrRiDetn73RdrDetnElevn ReSideRdrRiDetn73RdrDetnPwr ReSideRdrRiDetn73RdrDetnRng ReSideRdrRiDetn73RdrDetnRngV ReSideRdrRiDetn73RdrDetnSts;
SIG_GROUP_ 329 ReSideRdrRiDetn74 1 : ReSideRdrRiDetn74RdrDetnAzi ReSideRdrRiDetn74RdrDetnChks ReSideRdrRiDetn74RdrDetnCntr ReSideRdrRiDetn74RdrDetnConf ReSideRdrRiDetn74RdrDetnElevn ReSideRdrRiDetn74RdrDetnPwr ReSideRdrRiDetn74RdrDetnRng ReSideRdrRiDetn74RdrDetnRngV ReSideRdrRiDetn74RdrDetnSts;
SIG_GROUP_ 329 ReSideRdrRiDetn75 1 : ReSideRdrRiDetn75RdrDetnAzi ReSideRdrRiDetn75RdrDetnChks ReSideRdrRiDetn75RdrDetnCntr ReSideRdrRiDetn75RdrDetnConf ReSideRdrRiDetn75RdrDetnElevn ReSideRdrRiDetn75RdrDetnPwr ReSideRdrRiDetn75RdrDetnRng ReSideRdrRiDetn75RdrDetnRngV ReSideRdrRiDetn75RdrDetnSts;
SIG_GROUP_ 329 ReSideRdrRiDetn76 1 : ReSideRdrRiDetn76RdrDetnAzi ReSideRdrRiDetn76RdrDetnChks ReSideRdrRiDetn76RdrDetnCntr ReSideRdrRiDetn76RdrDetnConf ReSideRdrRiDetn76RdrDetnElevn ReSideRdrRiDetn76RdrDetnPwr ReSideRdrRiDetn76RdrDetnRng ReSideRdrRiDetn76RdrDetnRngV ReSideRdrRiDetn76RdrDetnSts;
SIG_GROUP_ 329 ReSideRdrRiDetn77 1 : ReSideRdrRiDetn77RdrDetnAzi ReSideRdrRiDetn77RdrDetnChks ReSideRdrRiDetn77RdrDetnCntr ReSideRdrRiDetn77RdrDetnConf ReSideRdrRiDetn77RdrDetnElevn ReSideRdrRiDetn77RdrDetnPwr ReSideRdrRiDetn77RdrDetnRng ReSideRdrRiDetn77RdrDetnRngV ReSideRdrRiDetn77RdrDetnSts;
SIG_GROUP_ 329 ReSideRdrRiDetn78 1 : ReSideRdrRiDetn78RdrDetnAzi ReSideRdrRiDetn78RdrDetnChks ReSideRdrRiDetn78RdrDetnCntr ReSideRdrRiDetn78RdrDetnConf ReSideRdrRiDetn78RdrDetnElevn ReSideRdrRiDetn78RdrDetnPwr ReSideRdrRiDetn78RdrDetnRng ReSideRdrRiDetn78RdrDetnRngV ReSideRdrRiDetn78RdrDetnSts;
SIG_GROUP_ 331 ReSideRdrRiDetn79 1 : ReSideRdrRiDetn79RdrDetnAzi ReSideRdrRiDetn79RdrDetnChks ReSideRdrRiDetn79RdrDetnCntr ReSideRdrRiDetn79RdrDetnConf ReSideRdrRiDetn79RdrDetnElevn ReSideRdrRiDetn79RdrDetnPwr ReSideRdrRiDetn79RdrDetnRng ReSideRdrRiDetn79RdrDetnRngV ReSideRdrRiDetn79RdrDetnSts;
SIG_GROUP_ 331 ReSideRdrRiDetn80 1 : ReSideRdrRiDetn80RdrDetnAzi ReSideRdrRiDetn80RdrDetnChks ReSideRdrRiDetn80RdrDetnCntr ReSideRdrRiDetn80RdrDetnConf ReSideRdrRiDetn80RdrDetnElevn ReSideRdrRiDetn80RdrDetnPwr ReSideRdrRiDetn80RdrDetnRng ReSideRdrRiDetn80RdrDetnRngV ReSideRdrRiDetn80RdrDetnSts;
SIG_GROUP_ 331 ReSideRdrRiDetn81 1 : ReSideRdrRiDetn81RdrDetnAzi ReSideRdrRiDetn81RdrDetnChks ReSideRdrRiDetn81RdrDetnCntr ReSideRdrRiDetn81RdrDetnConf ReSideRdrRiDetn81RdrDetnElevn ReSideRdrRiDetn81RdrDetnPwr ReSideRdrRiDetn81RdrDetnRng ReSideRdrRiDetn81RdrDetnRngV ReSideRdrRiDetn81RdrDetnSts;
SIG_GROUP_ 331 ReSideRdrRiDetn82 1 : ReSideRdrRiDetn82RdrDetnAzi ReSideRdrRiDetn82RdrDetnChks ReSideRdrRiDetn82RdrDetnCntr ReSideRdrRiDetn82RdrDetnConf ReSideRdrRiDetn82RdrDetnElevn ReSideRdrRiDetn82RdrDetnPwr ReSideRdrRiDetn82RdrDetnRng ReSideRdrRiDetn82RdrDetnRngV ReSideRdrRiDetn82RdrDetnSts;
SIG_GROUP_ 331 ReSideRdrRiDetn83 1 : ReSideRdrRiDetn83RdrDetnAzi ReSideRdrRiDetn83RdrDetnChks ReSideRdrRiDetn83RdrDetnCntr ReSideRdrRiDetn83RdrDetnConf ReSideRdrRiDetn83RdrDetnElevn ReSideRdrRiDetn83RdrDetnPwr ReSideRdrRiDetn83RdrDetnRng ReSideRdrRiDetn83RdrDetnRngV ReSideRdrRiDetn83RdrDetnSts;
SIG_GROUP_ 331 ReSideRdrRiDetn84 1 : ReSideRdrRiDetn84RdrDetnAzi ReSideRdrRiDetn84RdrDetnChks ReSideRdrRiDetn84RdrDetnCntr ReSideRdrRiDetn84RdrDetnConf ReSideRdrRiDetn84RdrDetnElevn ReSideRdrRiDetn84RdrDetnPwr ReSideRdrRiDetn84RdrDetnRng ReSideRdrRiDetn84RdrDetnRngV ReSideRdrRiDetn84RdrDetnSts;
SIG_GROUP_ 333 ReSideRdrRiDetn85 1 : ReSideRdrRiDetn85RdrDetnAzi ReSideRdrRiDetn85RdrDetnChks ReSideRdrRiDetn85RdrDetnCntr ReSideRdrRiDetn85RdrDetnConf ReSideRdrRiDetn85RdrDetnElevn ReSideRdrRiDetn85RdrDetnPwr ReSideRdrRiDetn85RdrDetnRng ReSideRdrRiDetn85RdrDetnRngV ReSideRdrRiDetn85RdrDetnSts;
SIG_GROUP_ 333 ReSideRdrRiDetn86 1 : ReSideRdrRiDetn86RdrDetnAzi ReSideRdrRiDetn86RdrDetnChks ReSideRdrRiDetn86RdrDetnCntr ReSideRdrRiDetn86RdrDetnConf ReSideRdrRiDetn86RdrDetnElevn ReSideRdrRiDetn86RdrDetnPwr ReSideRdrRiDetn86RdrDetnRng ReSideRdrRiDetn86RdrDetnRngV ReSideRdrRiDetn86RdrDetnSts;
SIG_GROUP_ 333 ReSideRdrRiDetn87 1 : ReSideRdrRiDetn87RdrDetnAzi ReSideRdrRiDetn87RdrDetnChks ReSideRdrRiDetn87RdrDetnCntr ReSideRdrRiDetn87RdrDetnConf ReSideRdrRiDetn87RdrDetnElevn ReSideRdrRiDetn87RdrDetnPwr ReSideRdrRiDetn87RdrDetnRng ReSideRdrRiDetn87RdrDetnRngV ReSideRdrRiDetn87RdrDetnSts;
SIG_GROUP_ 333 ReSideRdrRiDetn88 1 : ReSideRdrRiDetn88RdrDetnAzi ReSideRdrRiDetn88RdrDetnChks ReSideRdrRiDetn88RdrDetnCntr ReSideRdrRiDetn88RdrDetnConf ReSideRdrRiDetn88RdrDetnElevn ReSideRdrRiDetn88RdrDetnPwr ReSideRdrRiDetn88RdrDetnRng ReSideRdrRiDetn88RdrDetnRngV ReSideRdrRiDetn88RdrDetnSts;
SIG_GROUP_ 333 ReSideRdrRiDetn89 1 : ReSideRdrRiDetn89RdrDetnAzi ReSideRdrRiDetn89RdrDetnChks ReSideRdrRiDetn89RdrDetnCntr ReSideRdrRiDetn89RdrDetnConf ReSideRdrRiDetn89RdrDetnElevn ReSideRdrRiDetn89RdrDetnPwr ReSideRdrRiDetn89RdrDetnRng ReSideRdrRiDetn89RdrDetnRngV ReSideRdrRiDetn89RdrDetnSts;
SIG_GROUP_ 333 ReSideRdrRiDetn90 1 : ReSideRdrRiDetn90RdrDetnAzi ReSideRdrRiDetn90RdrDetnChks ReSideRdrRiDetn90RdrDetnCntr ReSideRdrRiDetn90RdrDetnConf ReSideRdrRiDetn90RdrDetnElevn ReSideRdrRiDetn90RdrDetnPwr ReSideRdrRiDetn90RdrDetnRng ReSideRdrRiDetn90RdrDetnRngV ReSideRdrRiDetn90RdrDetnSts;
