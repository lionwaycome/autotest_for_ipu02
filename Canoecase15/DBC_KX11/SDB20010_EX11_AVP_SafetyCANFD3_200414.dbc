// *************************************************************************** *
// *                                                                           *
// *                      Mentor Graphics Corporation                          *
// *                          All rights reserved                              *
// *                                                                           *
// *************************************************************************** *
// *                                                                           *
// * Description:         CANDB File                                           *
// * Generated at:        2020-04-14 13:14:03                                  *
// * System:              SDB20010                                             *
// * Variant:             EX11_AVP                                             *
// * Network:             SafetyCANFD3                                         *
// *                                                                           *
// *************************************************************************** *
// *                                                                           *
// *             THIS CONFIGURATION MIGHT CONTAIN SOME ERRORS                  *
// *              IF THE INPUT MODEL WAS NOT PROPERLY FORMED!                  *
// *                    Do Not Use this File directly!                         *
// *                                                                           *
// *************************************************************************** *
VERSION "SafetyCANFD3"

NS_ :

BS_:

BU_:  ASDM ETC PAS SODL SODR

BO_ 350 SODLSafetyCANFD3Frame24: 64 SODL
 SG_ ReSideRdrLeObj2_UB : 291|1@0+ (1,0) [0|1] "" ASDM,PAS
 SG_ ReSideRdrLeObj2Heading : 287|12@0+ (0.1,-180.0) [-180.0|180.0] "Deg" ASDM,PAS
 SG_ ReSideRdrLeObj2ObjBoxCenterLat : 23|9@0+ (0.1,-25.0) [-25.0|25.0] "m" ASDM,PAS
 SG_ ReSideRdrLeObj2ObjBoxCenterLgt : 30|9@0+ (0.1,-25.0) [-25.0|25.0] "m" ASDM,PAS
 SG_ ReSideRdrLeObj2ObservationHist : 63|32@0+ (1.0,0.0) [0.0|4294967295.0] "Unitless" ASDM,PAS
 SG_ ReSideRdrLeObj2RdrObjAx : 7|8@0- (0.1,0.0) [-12.8|12.700000000000001] "m/s^2" ASDM,PAS
 SG_ ReSideRdrLeObj2RdrObjAy : 15|8@0- (0.1,0.0) [-12.8|12.700000000000001] "m/s^2" ASDM,PAS
 SG_ ReSideRdrLeObj2RdrObjBoxLength : 37|9@0+ (0.1,0.0) [0.0|50.0] "m" ASDM,PAS
 SG_ ReSideRdrLeObj2RdrObjBoxWidth : 44|9@0+ (0.1,0.0) [0.0|50.0] "m" ASDM,PAS
 SG_ ReSideRdrLeObj2RdrObjChks : 95|8@0+ (1.0,0.0) [0.0|255.0] "Unitless" ASDM,PAS
 SG_ ReSideRdrLeObj2RdrObjCntr : 103|4@0+ (1.0,0.0) [0.0|15.0] "Unitless" ASDM,PAS
 SG_ ReSideRdrLeObj2RdrObjCoastCnt : 279|5@0+ (1.0,0.0) [0.0|31.0] "Unitless" ASDM,PAS
 SG_ ReSideRdrLeObj2RdrObjConf : 99|4@0+ (7.0,0.0) [0.0|105.0] "%" ASDM,PAS
 SG_ ReSideRdrLeObj2RdrObjDx : 191|13@0+ (0.05,-200.0) [-200.0|200.0] "m" ASDM,PAS
 SG_ ReSideRdrLeObj2RdrObjDxStdDe : 111|8@0+ (0.05,0.0) [0.0|12.700000000000001] "m" ASDM,PAS
 SG_ ReSideRdrLeObj2RdrObjDy : 119|13@0+ (0.05,-200.0) [-200.0|200.0] "m" ASDM,PAS
 SG_ ReSideRdrLeObj2RdrObjDyStdDe : 183|8@0+ (0.05,0.0) [0.0|12.700000000000001] "m" ASDM,PAS
 SG_ ReSideRdrLeObj2RdrObjElevnConf : 223|4@0+ (7.0,0.0) [0.0|105.0] "%" ASDM,PAS
 SG_ ReSideRdrLeObj2RdrObjElevnSts : 153|2@0+ (1,0) [0|3] "" ASDM,PAS
 SG_ ReSideRdrLeObj2RdrObjID : 167|8@0+ (1.0,0.0) [0.0|255.0] "Unitless" ASDM,PAS
 SG_ ReSideRdrLeObj2RdrObjIsInFreeSpace : 192|1@0+ (1,0) [0|1] "" ASDM,PAS
 SG_ ReSideRdrLeObj2RdrObjMirrProblty : 219|4@0+ (7.0,0.0) [0.0|105.0] "%" ASDM,PAS
 SG_ ReSideRdrLeObj2RdrObjMtnPat : 122|3@0+ (1,0) [0|7] "" ASDM,PAS
 SG_ ReSideRdrLeObj2RdrObjNotRealProblty : 231|4@0+ (7.0,0.0) [0.0|105.0] "%" ASDM,PAS
 SG_ ReSideRdrLeObj2RdrObjStatyCnt : 239|7@0+ (1.0,0.0) [0.0|127.0] "Unitless" ASDM,PAS
 SG_ ReSideRdrLeObj2RdrObjTiAlv : 247|7@0+ (1.0,0.0) [0.0|127.0] "Unitless" ASDM,PAS
 SG_ ReSideRdrLeObj2RdrObjTrackSts : 194|2@0+ (1,0) [0|3] "" ASDM,PAS
 SG_ ReSideRdrLeObj2RdrObjTyp : 51|4@0+ (1,0) [0|15] "" ASDM,PAS
 SG_ ReSideRdrLeObj2RdrObjTypConfBike : 175|4@0+ (7.0,0.0) [0.0|105.0] "%" ASDM,PAS
 SG_ ReSideRdrLeObj2RdrObjTypConfPed : 171|4@0+ (7.0,0.0) [0.0|105.0] "%" ASDM,PAS
 SG_ ReSideRdrLeObj2RdrObjTypConfVeh : 227|4@0+ (7.0,0.0) [0.0|105.0] "%" ASDM,PAS
 SG_ ReSideRdrLeObj2RdrObjVx : 255|14@0+ (0.02,-128.0) [-128.0|128.0] "m/s" ASDM,PAS
 SG_ ReSideRdrLeObj2RdrObjVxStdDe : 271|6@0+ (0.05,0.0) [0.0|2.0] "m/s" ASDM,PAS
 SG_ ReSideRdrLeObj2RdrObjVy : 207|14@0+ (0.02,-128.0) [-128.0|128.0] "m/s" ASDM,PAS
 SG_ ReSideRdrLeObj2RdrObjVyStdDe : 159|6@0+ (0.05,0.0) [0.0|2.0] "m/s" ASDM,PAS
 SG_ ReSideRdrLeObj2RelVx : 135|12@0+ (0.02,-35.6) [-35.6|35.6] "m/s" ASDM,PAS
 SG_ ReSideRdrLeObj2RelVy : 139|12@0+ (0.02,-35.6) [-35.6|35.6] "m/s" ASDM,PAS

BO_ 352 SODLSafetyCANFD3Frame25: 64 SODL
 SG_ ReSideRdrLeObj3_UB : 291|1@0+ (1,0) [0|1] "" ASDM,PAS
 SG_ ReSideRdrLeObj3Heading : 287|12@0+ (0.1,-180.0) [-180.0|180.0] "Deg" ASDM,PAS
 SG_ ReSideRdrLeObj3ObjBoxCenterLat : 23|9@0+ (0.1,-25.0) [-25.0|25.0] "m" ASDM,PAS
 SG_ ReSideRdrLeObj3ObjBoxCenterLgt : 30|9@0+ (0.1,-25.0) [-25.0|25.0] "m" ASDM,PAS
 SG_ ReSideRdrLeObj3ObservationHist : 63|32@0+ (1.0,0.0) [0.0|4294967295.0] "Unitless" ASDM,PAS
 SG_ ReSideRdrLeObj3RdrObjAx : 7|8@0- (0.1,0.0) [-12.8|12.700000000000001] "m/s^2" ASDM,PAS
 SG_ ReSideRdrLeObj3RdrObjAy : 15|8@0- (0.1,0.0) [-12.8|12.700000000000001] "m/s^2" ASDM,PAS
 SG_ ReSideRdrLeObj3RdrObjBoxLength : 37|9@0+ (0.1,0.0) [0.0|50.0] "m" ASDM,PAS
 SG_ ReSideRdrLeObj3RdrObjBoxWidth : 44|9@0+ (0.1,0.0) [0.0|50.0] "m" ASDM,PAS
 SG_ ReSideRdrLeObj3RdrObjChks : 95|8@0+ (1.0,0.0) [0.0|255.0] "Unitless" ASDM,PAS
 SG_ ReSideRdrLeObj3RdrObjCntr : 103|4@0+ (1.0,0.0) [0.0|15.0] "Unitless" ASDM,PAS
 SG_ ReSideRdrLeObj3RdrObjCoastCnt : 279|5@0+ (1.0,0.0) [0.0|31.0] "Unitless" ASDM,PAS
 SG_ ReSideRdrLeObj3RdrObjConf : 99|4@0+ (7.0,0.0) [0.0|105.0] "%" ASDM,PAS
 SG_ ReSideRdrLeObj3RdrObjDx : 191|13@0+ (0.05,-200.0) [-200.0|200.0] "m" ASDM,PAS
 SG_ ReSideRdrLeObj3RdrObjDxStdDe : 111|8@0+ (0.05,0.0) [0.0|12.700000000000001] "m" ASDM,PAS
 SG_ ReSideRdrLeObj3RdrObjDy : 119|13@0+ (0.05,-200.0) [-200.0|200.0] "m" ASDM,PAS
 SG_ ReSideRdrLeObj3RdrObjDyStdDe : 183|8@0+ (0.05,0.0) [0.0|12.700000000000001] "m" ASDM,PAS
 SG_ ReSideRdrLeObj3RdrObjElevnConf : 223|4@0+ (7.0,0.0) [0.0|105.0] "%" ASDM,PAS
 SG_ ReSideRdrLeObj3RdrObjElevnSts : 153|2@0+ (1,0) [0|3] "" ASDM,PAS
 SG_ ReSideRdrLeObj3RdrObjID : 167|8@0+ (1.0,0.0) [0.0|255.0] "Unitless" ASDM,PAS
 SG_ ReSideRdrLeObj3RdrObjIsInFreeSpace : 192|1@0+ (1,0) [0|1] "" ASDM,PAS
 SG_ ReSideRdrLeObj3RdrObjMirrProblty : 219|4@0+ (7.0,0.0) [0.0|105.0] "%" ASDM,PAS
 SG_ ReSideRdrLeObj3RdrObjMtnPat : 122|3@0+ (1,0) [0|7] "" ASDM,PAS
 SG_ ReSideRdrLeObj3RdrObjNotRealProblty : 231|4@0+ (7.0,0.0) [0.0|105.0] "%" ASDM,PAS
 SG_ ReSideRdrLeObj3RdrObjStatyCnt : 239|7@0+ (1.0,0.0) [0.0|127.0] "Unitless" ASDM,PAS
 SG_ ReSideRdrLeObj3RdrObjTiAlv : 247|7@0+ (1.0,0.0) [0.0|127.0] "Unitless" ASDM,PAS
 SG_ ReSideRdrLeObj3RdrObjTrackSts : 194|2@0+ (1,0) [0|3] "" ASDM,PAS
 SG_ ReSideRdrLeObj3RdrObjTyp : 51|4@0+ (1,0) [0|15] "" ASDM,PAS
 SG_ ReSideRdrLeObj3RdrObjTypConfBike : 175|4@0+ (7.0,0.0) [0.0|105.0] "%" ASDM,PAS
 SG_ ReSideRdrLeObj3RdrObjTypConfPed : 171|4@0+ (7.0,0.0) [0.0|105.0] "%" ASDM,PAS
 SG_ ReSideRdrLeObj3RdrObjTypConfVeh : 227|4@0+ (7.0,0.0) [0.0|105.0] "%" ASDM,PAS
 SG_ ReSideRdrLeObj3RdrObjVx : 255|14@0+ (0.02,-128.0) [-128.0|128.0] "m/s" ASDM,PAS
 SG_ ReSideRdrLeObj3RdrObjVxStdDe : 271|6@0+ (0.05,0.0) [0.0|2.0] "m/s" ASDM,PAS
 SG_ ReSideRdrLeObj3RdrObjVy : 207|14@0+ (0.02,-128.0) [-128.0|128.0] "m/s" ASDM,PAS
 SG_ ReSideRdrLeObj3RdrObjVyStdDe : 159|6@0+ (0.05,0.0) [0.0|2.0] "m/s" ASDM,PAS
 SG_ ReSideRdrLeObj3RelVx : 135|12@0+ (0.02,-35.6) [-35.6|35.6] "m/s" ASDM,PAS
 SG_ ReSideRdrLeObj3RelVy : 139|12@0+ (0.02,-35.6) [-35.6|35.6] "m/s" ASDM,PAS

BO_ 354 SODLSafetyCANFD3Frame26: 64 SODL
 SG_ ReSideRdrLeObj4_UB : 291|1@0+ (1,0) [0|1] "" ASDM,PAS
 SG_ ReSideRdrLeObj4Heading : 287|12@0+ (0.1,-180.0) [-180.0|180.0] "Deg" ASDM,PAS
 SG_ ReSideRdrLeObj4ObjBoxCenterLat : 23|9@0+ (0.1,-25.0) [-25.0|25.0] "m" ASDM,PAS
 SG_ ReSideRdrLeObj4ObjBoxCenterLgt : 30|9@0+ (0.1,-25.0) [-25.0|25.0] "m" ASDM,PAS
 SG_ ReSideRdrLeObj4ObservationHist : 63|32@0+ (1.0,0.0) [0.0|4294967295.0] "Unitless" ASDM,PAS
 SG_ ReSideRdrLeObj4RdrObjAx : 7|8@0- (0.1,0.0) [-12.8|12.700000000000001] "m/s^2" ASDM,PAS
 SG_ ReSideRdrLeObj4RdrObjAy : 15|8@0- (0.1,0.0) [-12.8|12.700000000000001] "m/s^2" ASDM,PAS
 SG_ ReSideRdrLeObj4RdrObjBoxLength : 37|9@0+ (0.1,0.0) [0.0|50.0] "m" ASDM,PAS
 SG_ ReSideRdrLeObj4RdrObjBoxWidth : 44|9@0+ (0.1,0.0) [0.0|50.0] "m" ASDM,PAS
 SG_ ReSideRdrLeObj4RdrObjChks : 95|8@0+ (1.0,0.0) [0.0|255.0] "Unitless" ASDM,PAS
 SG_ ReSideRdrLeObj4RdrObjCntr : 103|4@0+ (1.0,0.0) [0.0|15.0] "Unitless" ASDM,PAS
 SG_ ReSideRdrLeObj4RdrObjCoastCnt : 279|5@0+ (1.0,0.0) [0.0|31.0] "Unitless" ASDM,PAS
 SG_ ReSideRdrLeObj4RdrObjConf : 99|4@0+ (7.0,0.0) [0.0|105.0] "%" ASDM,PAS
 SG_ ReSideRdrLeObj4RdrObjDx : 191|13@0+ (0.05,-200.0) [-200.0|200.0] "m" ASDM,PAS
 SG_ ReSideRdrLeObj4RdrObjDxStdDe : 111|8@0+ (0.05,0.0) [0.0|12.700000000000001] "m" ASDM,PAS
 SG_ ReSideRdrLeObj4RdrObjDy : 119|13@0+ (0.05,-200.0) [-200.0|200.0] "m" ASDM,PAS
 SG_ ReSideRdrLeObj4RdrObjDyStdDe : 183|8@0+ (0.05,0.0) [0.0|12.700000000000001] "m" ASDM,PAS
 SG_ ReSideRdrLeObj4RdrObjElevnConf : 223|4@0+ (7.0,0.0) [0.0|105.0] "%" ASDM,PAS
 SG_ ReSideRdrLeObj4RdrObjElevnSts : 153|2@0+ (1,0) [0|3] "" ASDM,PAS
 SG_ ReSideRdrLeObj4RdrObjID : 167|8@0+ (1.0,0.0) [0.0|255.0] "Unitless" ASDM,PAS
 SG_ ReSideRdrLeObj4RdrObjIsInFreeSpace : 192|1@0+ (1,0) [0|1] "" ASDM,PAS
 SG_ ReSideRdrLeObj4RdrObjMirrProblty : 219|4@0+ (7.0,0.0) [0.0|105.0] "%" ASDM,PAS
 SG_ ReSideRdrLeObj4RdrObjMtnPat : 122|3@0+ (1,0) [0|7] "" ASDM,PAS
 SG_ ReSideRdrLeObj4RdrObjNotRealProblty : 231|4@0+ (7.0,0.0) [0.0|105.0] "%" ASDM,PAS
 SG_ ReSideRdrLeObj4RdrObjStatyCnt : 239|7@0+ (1.0,0.0) [0.0|127.0] "Unitless" ASDM,PAS
 SG_ ReSideRdrLeObj4RdrObjTiAlv : 247|7@0+ (1.0,0.0) [0.0|127.0] "Unitless" ASDM,PAS
 SG_ ReSideRdrLeObj4RdrObjTrackSts : 194|2@0+ (1,0) [0|3] "" ASDM,PAS
 SG_ ReSideRdrLeObj4RdrObjTyp : 51|4@0+ (1,0) [0|15] "" ASDM,PAS
 SG_ ReSideRdrLeObj4RdrObjTypConfBike : 175|4@0+ (7.0,0.0) [0.0|105.0] "%" ASDM,PAS
 SG_ ReSideRdrLeObj4RdrObjTypConfPed : 171|4@0+ (7.0,0.0) [0.0|105.0] "%" ASDM,PAS
 SG_ ReSideRdrLeObj4RdrObjTypConfVeh : 227|4@0+ (7.0,0.0) [0.0|105.0] "%" ASDM,PAS
 SG_ ReSideRdrLeObj4RdrObjVx : 255|14@0+ (0.02,-128.0) [-128.0|128.0] "m/s" ASDM,PAS
 SG_ ReSideRdrLeObj4RdrObjVxStdDe : 271|6@0+ (0.05,0.0) [0.0|2.0] "m/s" ASDM,PAS
 SG_ ReSideRdrLeObj4RdrObjVy : 207|14@0+ (0.02,-128.0) [-128.0|128.0] "m/s" ASDM,PAS
 SG_ ReSideRdrLeObj4RdrObjVyStdDe : 159|6@0+ (0.05,0.0) [0.0|2.0] "m/s" ASDM,PAS
 SG_ ReSideRdrLeObj4RelVx : 135|12@0+ (0.02,-35.6) [-35.6|35.6] "m/s" ASDM,PAS
 SG_ ReSideRdrLeObj4RelVy : 139|12@0+ (0.02,-35.6) [-35.6|35.6] "m/s" ASDM,PAS

BO_ 356 SODLSafetyCANFD3Frame27: 64 SODL
 SG_ ReSideRdrLeObj5_UB : 291|1@0+ (1,0) [0|1] "" ASDM,PAS
 SG_ ReSideRdrLeObj5Heading : 287|12@0+ (0.1,-180.0) [-180.0|180.0] "Deg" ASDM,PAS
 SG_ ReSideRdrLeObj5ObjBoxCenterLat : 23|9@0+ (0.1,-25.0) [-25.0|25.0] "m" ASDM,PAS
 SG_ ReSideRdrLeObj5ObjBoxCenterLgt : 30|9@0+ (0.1,-25.0) [-25.0|25.0] "m" ASDM,PAS
 SG_ ReSideRdrLeObj5ObservationHist : 63|32@0+ (1.0,0.0) [0.0|4294967295.0] "Unitless" ASDM,PAS
 SG_ ReSideRdrLeObj5RdrObjAx : 7|8@0- (0.1,0.0) [-12.8|12.700000000000001] "m/s^2" ASDM,PAS
 SG_ ReSideRdrLeObj5RdrObjAy : 15|8@0- (0.1,0.0) [-12.8|12.700000000000001] "m/s^2" ASDM,PAS
 SG_ ReSideRdrLeObj5RdrObjBoxLength : 37|9@0+ (0.1,0.0) [0.0|50.0] "m" ASDM,PAS
 SG_ ReSideRdrLeObj5RdrObjBoxWidth : 44|9@0+ (0.1,0.0) [0.0|50.0] "m" ASDM,PAS
 SG_ ReSideRdrLeObj5RdrObjChks : 95|8@0+ (1.0,0.0) [0.0|255.0] "Unitless" ASDM,PAS
 SG_ ReSideRdrLeObj5RdrObjCntr : 103|4@0+ (1.0,0.0) [0.0|15.0] "Unitless" ASDM,PAS
 SG_ ReSideRdrLeObj5RdrObjCoastCnt : 279|5@0+ (1.0,0.0) [0.0|31.0] "Unitless" ASDM,PAS
 SG_ ReSideRdrLeObj5RdrObjConf : 99|4@0+ (7.0,0.0) [0.0|105.0] "%" ASDM,PAS
 SG_ ReSideRdrLeObj5RdrObjDx : 191|13@0+ (0.05,-200.0) [-200.0|200.0] "m" ASDM,PAS
 SG_ ReSideRdrLeObj5RdrObjDxStdDe : 111|8@0+ (0.05,0.0) [0.0|12.700000000000001] "m" ASDM,PAS
 SG_ ReSideRdrLeObj5RdrObjDy : 119|13@0+ (0.05,-200.0) [-200.0|200.0] "m" ASDM,PAS
 SG_ ReSideRdrLeObj5RdrObjDyStdDe : 183|8@0+ (0.05,0.0) [0.0|12.700000000000001] "m" ASDM,PAS
 SG_ ReSideRdrLeObj5RdrObjElevnConf : 223|4@0+ (7.0,0.0) [0.0|105.0] "%" ASDM,PAS
 SG_ ReSideRdrLeObj5RdrObjElevnSts : 153|2@0+ (1,0) [0|3] "" ASDM,PAS
 SG_ ReSideRdrLeObj5RdrObjID : 167|8@0+ (1.0,0.0) [0.0|255.0] "Unitless" ASDM,PAS
 SG_ ReSideRdrLeObj5RdrObjIsInFreeSpace : 192|1@0+ (1,0) [0|1] "" ASDM,PAS
 SG_ ReSideRdrLeObj5RdrObjMirrProblty : 219|4@0+ (7.0,0.0) [0.0|105.0] "%" ASDM,PAS
 SG_ ReSideRdrLeObj5RdrObjMtnPat : 122|3@0+ (1,0) [0|7] "" ASDM,PAS
 SG_ ReSideRdrLeObj5RdrObjNotRealProblty : 231|4@0+ (7.0,0.0) [0.0|105.0] "%" ASDM,PAS
 SG_ ReSideRdrLeObj5RdrObjStatyCnt : 239|7@0+ (1.0,0.0) [0.0|127.0] "Unitless" ASDM,PAS
 SG_ ReSideRdrLeObj5RdrObjTiAlv : 247|7@0+ (1.0,0.0) [0.0|127.0] "Unitless" ASDM,PAS
 SG_ ReSideRdrLeObj5RdrObjTrackSts : 194|2@0+ (1,0) [0|3] "" ASDM,PAS
 SG_ ReSideRdrLeObj5RdrObjTyp : 51|4@0+ (1,0) [0|15] "" ASDM,PAS
 SG_ ReSideRdrLeObj5RdrObjTypConfBike : 175|4@0+ (7.0,0.0) [0.0|105.0] "%" ASDM,PAS
 SG_ ReSideRdrLeObj5RdrObjTypConfPed : 171|4@0+ (7.0,0.0) [0.0|105.0] "%" ASDM,PAS
 SG_ ReSideRdrLeObj5RdrObjTypConfVeh : 227|4@0+ (7.0,0.0) [0.0|105.0] "%" ASDM,PAS
 SG_ ReSideRdrLeObj5RdrObjVx : 255|14@0+ (0.02,-128.0) [-128.0|128.0] "m/s" ASDM,PAS
 SG_ ReSideRdrLeObj5RdrObjVxStdDe : 271|6@0+ (0.05,0.0) [0.0|2.0] "m/s" ASDM,PAS
 SG_ ReSideRdrLeObj5RdrObjVy : 207|14@0+ (0.02,-128.0) [-128.0|128.0] "m/s" ASDM,PAS
 SG_ ReSideRdrLeObj5RdrObjVyStdDe : 159|6@0+ (0.05,0.0) [0.0|2.0] "m/s" ASDM,PAS
 SG_ ReSideRdrLeObj5RelVx : 135|12@0+ (0.02,-35.6) [-35.6|35.6] "m/s" ASDM,PAS
 SG_ ReSideRdrLeObj5RelVy : 139|12@0+ (0.02,-35.6) [-35.6|35.6] "m/s" ASDM,PAS

BO_ 358 SODLSafetyCANFD3Frame28: 64 SODL
 SG_ ReSideRdrLeObj6_UB : 291|1@0+ (1,0) [0|1] "" ASDM,PAS
 SG_ ReSideRdrLeObj6Heading : 287|12@0+ (0.1,-180.0) [-180.0|180.0] "Deg" ASDM,PAS
 SG_ ReSideRdrLeObj6ObjBoxCenterLat : 23|9@0+ (0.1,-25.0) [-25.0|25.0] "m" ASDM,PAS
 SG_ ReSideRdrLeObj6ObjBoxCenterLgt : 30|9@0+ (0.1,-25.0) [-25.0|25.0] "m" ASDM,PAS
 SG_ ReSideRdrLeObj6ObservationHist : 63|32@0+ (1.0,0.0) [0.0|4294967295.0] "Unitless" ASDM,PAS
 SG_ ReSideRdrLeObj6RdrObjAx : 7|8@0- (0.1,0.0) [-12.8|12.700000000000001] "m/s^2" ASDM,PAS
 SG_ ReSideRdrLeObj6RdrObjAy : 15|8@0- (0.1,0.0) [-12.8|12.700000000000001] "m/s^2" ASDM,PAS
 SG_ ReSideRdrLeObj6RdrObjBoxLength : 37|9@0+ (0.1,0.0) [0.0|50.0] "m" ASDM,PAS
 SG_ ReSideRdrLeObj6RdrObjBoxWidth : 44|9@0+ (0.1,0.0) [0.0|50.0] "m" ASDM,PAS
 SG_ ReSideRdrLeObj6RdrObjChks : 95|8@0+ (1.0,0.0) [0.0|255.0] "Unitless" ASDM,PAS
 SG_ ReSideRdrLeObj6RdrObjCntr : 103|4@0+ (1.0,0.0) [0.0|15.0] "Unitless" ASDM,PAS
 SG_ ReSideRdrLeObj6RdrObjCoastCnt : 279|5@0+ (1.0,0.0) [0.0|31.0] "Unitless" ASDM,PAS
 SG_ ReSideRdrLeObj6RdrObjConf : 99|4@0+ (7.0,0.0) [0.0|105.0] "%" ASDM,PAS
 SG_ ReSideRdrLeObj6RdrObjDx : 191|13@0+ (0.05,-200.0) [-200.0|200.0] "m" ASDM,PAS
 SG_ ReSideRdrLeObj6RdrObjDxStdDe : 111|8@0+ (0.05,0.0) [0.0|12.700000000000001] "m" ASDM,PAS
 SG_ ReSideRdrLeObj6RdrObjDy : 119|13@0+ (0.05,-200.0) [-200.0|200.0] "m" ASDM,PAS
 SG_ ReSideRdrLeObj6RdrObjDyStdDe : 183|8@0+ (0.05,0.0) [0.0|12.700000000000001] "m" ASDM,PAS
 SG_ ReSideRdrLeObj6RdrObjElevnConf : 223|4@0+ (7.0,0.0) [0.0|105.0] "%" ASDM,PAS
 SG_ ReSideRdrLeObj6RdrObjElevnSts : 153|2@0+ (1,0) [0|3] "" ASDM,PAS
 SG_ ReSideRdrLeObj6RdrObjID : 167|8@0+ (1.0,0.0) [0.0|255.0] "Unitless" ASDM,PAS
 SG_ ReSideRdrLeObj6RdrObjIsInFreeSpace : 192|1@0+ (1,0) [0|1] "" ASDM,PAS
 SG_ ReSideRdrLeObj6RdrObjMirrProblty : 219|4@0+ (7.0,0.0) [0.0|105.0] "%" ASDM,PAS
 SG_ ReSideRdrLeObj6RdrObjMtnPat : 122|3@0+ (1,0) [0|7] "" ASDM,PAS
 SG_ ReSideRdrLeObj6RdrObjNotRealProblty : 231|4@0+ (7.0,0.0) [0.0|105.0] "%" ASDM,PAS
 SG_ ReSideRdrLeObj6RdrObjStatyCnt : 239|7@0+ (1.0,0.0) [0.0|127.0] "Unitless" ASDM,PAS
 SG_ ReSideRdrLeObj6RdrObjTiAlv : 247|7@0+ (1.0,0.0) [0.0|127.0] "Unitless" ASDM,PAS
 SG_ ReSideRdrLeObj6RdrObjTrackSts : 194|2@0+ (1,0) [0|3] "" ASDM,PAS
 SG_ ReSideRdrLeObj6RdrObjTyp : 51|4@0+ (1,0) [0|15] "" ASDM,PAS
 SG_ ReSideRdrLeObj6RdrObjTypConfBike : 175|4@0+ (7.0,0.0) [0.0|105.0] "%" ASDM,PAS
 SG_ ReSideRdrLeObj6RdrObjTypConfPed : 171|4@0+ (7.0,0.0) [0.0|105.0] "%" ASDM,PAS
 SG_ ReSideRdrLeObj6RdrObjTypConfVeh : 227|4@0+ (7.0,0.0) [0.0|105.0] "%" ASDM,PAS
 SG_ ReSideRdrLeObj6RdrObjVx : 255|14@0+ (0.02,-128.0) [-128.0|128.0] "m/s" ASDM,PAS
 SG_ ReSideRdrLeObj6RdrObjVxStdDe : 271|6@0+ (0.05,0.0) [0.0|2.0] "m/s" ASDM,PAS
 SG_ ReSideRdrLeObj6RdrObjVy : 207|14@0+ (0.02,-128.0) [-128.0|128.0] "m/s" ASDM,PAS
 SG_ ReSideRdrLeObj6RdrObjVyStdDe : 159|6@0+ (0.05,0.0) [0.0|2.0] "m/s" ASDM,PAS
 SG_ ReSideRdrLeObj6RelVx : 135|12@0+ (0.02,-35.6) [-35.6|35.6] "m/s" ASDM,PAS
 SG_ ReSideRdrLeObj6RelVy : 139|12@0+ (0.02,-35.6) [-35.6|35.6] "m/s" ASDM,PAS

BO_ 360 SODLSafetyCANFD3Frame29: 64 SODL
 SG_ ReSideRdrLeObj7_UB : 291|1@0+ (1,0) [0|1] "" ASDM,PAS
 SG_ ReSideRdrLeObj7Heading : 287|12@0+ (0.1,-180.0) [-180.0|180.0] "Deg" ASDM,PAS
 SG_ ReSideRdrLeObj7ObjBoxCenterLat : 23|9@0+ (0.1,-25.0) [-25.0|25.0] "m" ASDM,PAS
 SG_ ReSideRdrLeObj7ObjBoxCenterLgt : 30|9@0+ (0.1,-25.0) [-25.0|25.0] "m" ASDM,PAS
 SG_ ReSideRdrLeObj7ObservationHist : 63|32@0+ (1.0,0.0) [0.0|4294967295.0] "Unitless" ASDM,PAS
 SG_ ReSideRdrLeObj7RdrObjAx : 7|8@0- (0.1,0.0) [-12.8|12.700000000000001] "m/s^2" ASDM,PAS
 SG_ ReSideRdrLeObj7RdrObjAy : 15|8@0- (0.1,0.0) [-12.8|12.700000000000001] "m/s^2" ASDM,PAS
 SG_ ReSideRdrLeObj7RdrObjBoxLength : 37|9@0+ (0.1,0.0) [0.0|50.0] "m" ASDM,PAS
 SG_ ReSideRdrLeObj7RdrObjBoxWidth : 44|9@0+ (0.1,0.0) [0.0|50.0] "m" ASDM,PAS
 SG_ ReSideRdrLeObj7RdrObjChks : 95|8@0+ (1.0,0.0) [0.0|255.0] "Unitless" ASDM,PAS
 SG_ ReSideRdrLeObj7RdrObjCntr : 103|4@0+ (1.0,0.0) [0.0|15.0] "Unitless" ASDM,PAS
 SG_ ReSideRdrLeObj7RdrObjCoastCnt : 279|5@0+ (1.0,0.0) [0.0|31.0] "Unitless" ASDM,PAS
 SG_ ReSideRdrLeObj7RdrObjConf : 99|4@0+ (7.0,0.0) [0.0|105.0] "%" ASDM,PAS
 SG_ ReSideRdrLeObj7RdrObjDx : 191|13@0+ (0.05,-200.0) [-200.0|200.0] "m" ASDM,PAS
 SG_ ReSideRdrLeObj7RdrObjDxStdDe : 111|8@0+ (0.05,0.0) [0.0|12.700000000000001] "m" ASDM,PAS
 SG_ ReSideRdrLeObj7RdrObjDy : 119|13@0+ (0.05,-200.0) [-200.0|200.0] "m" ASDM,PAS
 SG_ ReSideRdrLeObj7RdrObjDyStdDe : 183|8@0+ (0.05,0.0) [0.0|12.700000000000001] "m" ASDM,PAS
 SG_ ReSideRdrLeObj7RdrObjElevnConf : 223|4@0+ (7.0,0.0) [0.0|105.0] "%" ASDM,PAS
 SG_ ReSideRdrLeObj7RdrObjElevnSts : 153|2@0+ (1,0) [0|3] "" ASDM,PAS
 SG_ ReSideRdrLeObj7RdrObjID : 167|8@0+ (1.0,0.0) [0.0|255.0] "Unitless" ASDM,PAS
 SG_ ReSideRdrLeObj7RdrObjIsInFreeSpace : 192|1@0+ (1,0) [0|1] "" ASDM,PAS
 SG_ ReSideRdrLeObj7RdrObjMirrProblty : 219|4@0+ (7.0,0.0) [0.0|105.0] "%" ASDM,PAS
 SG_ ReSideRdrLeObj7RdrObjMtnPat : 122|3@0+ (1,0) [0|7] "" ASDM,PAS
 SG_ ReSideRdrLeObj7RdrObjNotRealProblty : 231|4@0+ (7.0,0.0) [0.0|105.0] "%" ASDM,PAS
 SG_ ReSideRdrLeObj7RdrObjStatyCnt : 239|7@0+ (1.0,0.0) [0.0|127.0] "Unitless" ASDM,PAS
 SG_ ReSideRdrLeObj7RdrObjTiAlv : 247|7@0+ (1.0,0.0) [0.0|127.0] "Unitless" ASDM,PAS
 SG_ ReSideRdrLeObj7RdrObjTrackSts : 194|2@0+ (1,0) [0|3] "" ASDM,PAS
 SG_ ReSideRdrLeObj7RdrObjTyp : 51|4@0+ (1,0) [0|15] "" ASDM,PAS
 SG_ ReSideRdrLeObj7RdrObjTypConfBike : 175|4@0+ (7.0,0.0) [0.0|105.0] "%" ASDM,PAS
 SG_ ReSideRdrLeObj7RdrObjTypConfPed : 171|4@0+ (7.0,0.0) [0.0|105.0] "%" ASDM,PAS
 SG_ ReSideRdrLeObj7RdrObjTypConfVeh : 227|4@0+ (7.0,0.0) [0.0|105.0] "%" ASDM,PAS
 SG_ ReSideRdrLeObj7RdrObjVx : 255|14@0+ (0.02,-128.0) [-128.0|128.0] "m/s" ASDM,PAS
 SG_ ReSideRdrLeObj7RdrObjVxStdDe : 271|6@0+ (0.05,0.0) [0.0|2.0] "m/s" ASDM,PAS
 SG_ ReSideRdrLeObj7RdrObjVy : 207|14@0+ (0.02,-128.0) [-128.0|128.0] "m/s" ASDM,PAS
 SG_ ReSideRdrLeObj7RdrObjVyStdDe : 159|6@0+ (0.05,0.0) [0.0|2.0] "m/s" ASDM,PAS
 SG_ ReSideRdrLeObj7RelVx : 135|12@0+ (0.02,-35.6) [-35.6|35.6] "m/s" ASDM,PAS
 SG_ ReSideRdrLeObj7RelVy : 139|12@0+ (0.02,-35.6) [-35.6|35.6] "m/s" ASDM,PAS

BO_ 362 SODLSafetyCANFD3Frame30: 64 SODL
 SG_ ReSideRdrLeObj8_UB : 291|1@0+ (1,0) [0|1] "" ASDM,PAS
 SG_ ReSideRdrLeObj8Heading : 287|12@0+ (0.1,-180.0) [-180.0|180.0] "Deg" ASDM,PAS
 SG_ ReSideRdrLeObj8ObjBoxCenterLat : 23|9@0+ (0.1,-25.0) [-25.0|25.0] "m" ASDM,PAS
 SG_ ReSideRdrLeObj8ObjBoxCenterLgt : 30|9@0+ (0.1,-25.0) [-25.0|25.0] "m" ASDM,PAS
 SG_ ReSideRdrLeObj8ObservationHist : 63|32@0+ (1.0,0.0) [0.0|4294967295.0] "Unitless" ASDM,PAS
 SG_ ReSideRdrLeObj8RdrObjAx : 7|8@0- (0.1,0.0) [-12.8|12.700000000000001] "m/s^2" ASDM,PAS
 SG_ ReSideRdrLeObj8RdrObjAy : 15|8@0- (0.1,0.0) [-12.8|12.700000000000001] "m/s^2" ASDM,PAS
 SG_ ReSideRdrLeObj8RdrObjBoxLength : 37|9@0+ (0.1,0.0) [0.0|50.0] "m" ASDM,PAS
 SG_ ReSideRdrLeObj8RdrObjBoxWidth : 44|9@0+ (0.1,0.0) [0.0|50.0] "m" ASDM,PAS
 SG_ ReSideRdrLeObj8RdrObjChks : 95|8@0+ (1.0,0.0) [0.0|255.0] "Unitless" ASDM,PAS
 SG_ ReSideRdrLeObj8RdrObjCntr : 103|4@0+ (1.0,0.0) [0.0|15.0] "Unitless" ASDM,PAS
 SG_ ReSideRdrLeObj8RdrObjCoastCnt : 279|5@0+ (1.0,0.0) [0.0|31.0] "Unitless" ASDM,PAS
 SG_ ReSideRdrLeObj8RdrObjConf : 99|4@0+ (7.0,0.0) [0.0|105.0] "%" ASDM,PAS
 SG_ ReSideRdrLeObj8RdrObjDx : 191|13@0+ (0.05,-200.0) [-200.0|200.0] "m" ASDM,PAS
 SG_ ReSideRdrLeObj8RdrObjDxStdDe : 111|8@0+ (0.05,0.0) [0.0|12.700000000000001] "m" ASDM,PAS
 SG_ ReSideRdrLeObj8RdrObjDy : 119|13@0+ (0.05,-200.0) [-200.0|200.0] "m" ASDM,PAS
 SG_ ReSideRdrLeObj8RdrObjDyStdDe : 183|8@0+ (0.05,0.0) [0.0|12.700000000000001] "m" ASDM,PAS
 SG_ ReSideRdrLeObj8RdrObjElevnConf : 223|4@0+ (7.0,0.0) [0.0|105.0] "%" ASDM,PAS
 SG_ ReSideRdrLeObj8RdrObjElevnSts : 153|2@0+ (1,0) [0|3] "" ASDM,PAS
 SG_ ReSideRdrLeObj8RdrObjID : 167|8@0+ (1.0,0.0) [0.0|255.0] "Unitless" ASDM,PAS
 SG_ ReSideRdrLeObj8RdrObjIsInFreeSpace : 192|1@0+ (1,0) [0|1] "" ASDM,PAS
 SG_ ReSideRdrLeObj8RdrObjMirrProblty : 219|4@0+ (7.0,0.0) [0.0|105.0] "%" ASDM,PAS
 SG_ ReSideRdrLeObj8RdrObjMtnPat : 122|3@0+ (1,0) [0|7] "" ASDM,PAS
 SG_ ReSideRdrLeObj8RdrObjNotRealProblty : 231|4@0+ (7.0,0.0) [0.0|105.0] "%" ASDM,PAS
 SG_ ReSideRdrLeObj8RdrObjStatyCnt : 239|7@0+ (1.0,0.0) [0.0|127.0] "Unitless" ASDM,PAS
 SG_ ReSideRdrLeObj8RdrObjTiAlv : 247|7@0+ (1.0,0.0) [0.0|127.0] "Unitless" ASDM,PAS
 SG_ ReSideRdrLeObj8RdrObjTrackSts : 194|2@0+ (1,0) [0|3] "" ASDM,PAS
 SG_ ReSideRdrLeObj8RdrObjTyp : 51|4@0+ (1,0) [0|15] "" ASDM,PAS
 SG_ ReSideRdrLeObj8RdrObjTypConfBike : 175|4@0+ (7.0,0.0) [0.0|105.0] "%" ASDM,PAS
 SG_ ReSideRdrLeObj8RdrObjTypConfPed : 171|4@0+ (7.0,0.0) [0.0|105.0] "%" ASDM,PAS
 SG_ ReSideRdrLeObj8RdrObjTypConfVeh : 227|4@0+ (7.0,0.0) [0.0|105.0] "%" ASDM,PAS
 SG_ ReSideRdrLeObj8RdrObjVx : 255|14@0+ (0.02,-128.0) [-128.0|128.0] "m/s" ASDM,PAS
 SG_ ReSideRdrLeObj8RdrObjVxStdDe : 271|6@0+ (0.05,0.0) [0.0|2.0] "m/s" ASDM,PAS
 SG_ ReSideRdrLeObj8RdrObjVy : 207|14@0+ (0.02,-128.0) [-128.0|128.0] "m/s" ASDM,PAS
 SG_ ReSideRdrLeObj8RdrObjVyStdDe : 159|6@0+ (0.05,0.0) [0.0|2.0] "m/s" ASDM,PAS
 SG_ ReSideRdrLeObj8RelVx : 135|12@0+ (0.02,-35.6) [-35.6|35.6] "m/s" ASDM,PAS
 SG_ ReSideRdrLeObj8RelVy : 139|12@0+ (0.02,-35.6) [-35.6|35.6] "m/s" ASDM,PAS

BO_ 364 SODLSafetyCANFD3Frame31: 64 SODL
 SG_ ReSideRdrLeObj9_UB : 291|1@0+ (1,0) [0|1] "" ASDM,PAS
 SG_ ReSideRdrLeObj9Heading : 287|12@0+ (0.1,-180.0) [-180.0|180.0] "Deg" ASDM,PAS
 SG_ ReSideRdrLeObj9ObjBoxCenterLat : 23|9@0+ (0.1,-25.0) [-25.0|25.0] "m" ASDM,PAS
 SG_ ReSideRdrLeObj9ObjBoxCenterLgt : 30|9@0+ (0.1,-25.0) [-25.0|25.0] "m" ASDM,PAS
 SG_ ReSideRdrLeObj9ObservationHist : 63|32@0+ (1.0,0.0) [0.0|4294967295.0] "Unitless" ASDM,PAS
 SG_ ReSideRdrLeObj9RdrObjAx : 7|8@0- (0.1,0.0) [-12.8|12.700000000000001] "m/s^2" ASDM,PAS
 SG_ ReSideRdrLeObj9RdrObjAy : 15|8@0- (0.1,0.0) [-12.8|12.700000000000001] "m/s^2" ASDM,PAS
 SG_ ReSideRdrLeObj9RdrObjBoxLength : 37|9@0+ (0.1,0.0) [0.0|50.0] "m" ASDM,PAS
 SG_ ReSideRdrLeObj9RdrObjBoxWidth : 44|9@0+ (0.1,0.0) [0.0|50.0] "m" ASDM,PAS
 SG_ ReSideRdrLeObj9RdrObjChks : 95|8@0+ (1.0,0.0) [0.0|255.0] "Unitless" ASDM,PAS
 SG_ ReSideRdrLeObj9RdrObjCntr : 103|4@0+ (1.0,0.0) [0.0|15.0] "Unitless" ASDM,PAS
 SG_ ReSideRdrLeObj9RdrObjCoastCnt : 279|5@0+ (1.0,0.0) [0.0|31.0] "Unitless" ASDM,PAS
 SG_ ReSideRdrLeObj9RdrObjConf : 99|4@0+ (7.0,0.0) [0.0|105.0] "%" ASDM,PAS
 SG_ ReSideRdrLeObj9RdrObjDx : 191|13@0+ (0.05,-200.0) [-200.0|200.0] "m" ASDM,PAS
 SG_ ReSideRdrLeObj9RdrObjDxStdDe : 111|8@0+ (0.05,0.0) [0.0|12.700000000000001] "m" ASDM,PAS
 SG_ ReSideRdrLeObj9RdrObjDy : 119|13@0+ (0.05,-200.0) [-200.0|200.0] "m" ASDM,PAS
 SG_ ReSideRdrLeObj9RdrObjDyStdDe : 183|8@0+ (0.05,0.0) [0.0|12.700000000000001] "m" ASDM,PAS
 SG_ ReSideRdrLeObj9RdrObjElevnConf : 223|4@0+ (7.0,0.0) [0.0|105.0] "%" ASDM,PAS
 SG_ ReSideRdrLeObj9RdrObjElevnSts : 153|2@0+ (1,0) [0|3] "" ASDM,PAS
 SG_ ReSideRdrLeObj9RdrObjID : 167|8@0+ (1.0,0.0) [0.0|255.0] "Unitless" ASDM,PAS
 SG_ ReSideRdrLeObj9RdrObjIsInFreeSpace : 192|1@0+ (1,0) [0|1] "" ASDM,PAS
 SG_ ReSideRdrLeObj9RdrObjMirrProblty : 219|4@0+ (7.0,0.0) [0.0|105.0] "%" ASDM,PAS
 SG_ ReSideRdrLeObj9RdrObjMtnPat : 122|3@0+ (1,0) [0|7] "" ASDM,PAS
 SG_ ReSideRdrLeObj9RdrObjNotRealProblty : 231|4@0+ (7.0,0.0) [0.0|105.0] "%" ASDM,PAS
 SG_ ReSideRdrLeObj9RdrObjStatyCnt : 239|7@0+ (1.0,0.0) [0.0|127.0] "Unitless" ASDM,PAS
 SG_ ReSideRdrLeObj9RdrObjTiAlv : 247|7@0+ (1.0,0.0) [0.0|127.0] "Unitless" ASDM,PAS
 SG_ ReSideRdrLeObj9RdrObjTrackSts : 194|2@0+ (1,0) [0|3] "" ASDM,PAS
 SG_ ReSideRdrLeObj9RdrObjTyp : 51|4@0+ (1,0) [0|15] "" ASDM,PAS
 SG_ ReSideRdrLeObj9RdrObjTypConfBike : 175|4@0+ (7.0,0.0) [0.0|105.0] "%" ASDM,PAS
 SG_ ReSideRdrLeObj9RdrObjTypConfPed : 171|4@0+ (7.0,0.0) [0.0|105.0] "%" ASDM,PAS
 SG_ ReSideRdrLeObj9RdrObjTypConfVeh : 227|4@0+ (7.0,0.0) [0.0|105.0] "%" ASDM,PAS
 SG_ ReSideRdrLeObj9RdrObjVx : 255|14@0+ (0.02,-128.0) [-128.0|128.0] "m/s" ASDM,PAS
 SG_ ReSideRdrLeObj9RdrObjVxStdDe : 271|6@0+ (0.05,0.0) [0.0|2.0] "m/s" ASDM,PAS
 SG_ ReSideRdrLeObj9RdrObjVy : 207|14@0+ (0.02,-128.0) [-128.0|128.0] "m/s" ASDM,PAS
 SG_ ReSideRdrLeObj9RdrObjVyStdDe : 159|6@0+ (0.05,0.0) [0.0|2.0] "m/s" ASDM,PAS
 SG_ ReSideRdrLeObj9RelVx : 135|12@0+ (0.02,-35.6) [-35.6|35.6] "m/s" ASDM,PAS
 SG_ ReSideRdrLeObj9RelVy : 139|12@0+ (0.02,-35.6) [-35.6|35.6] "m/s" ASDM,PAS

BO_ 366 SODLSafetyCANFD3Frame32: 64 SODL
 SG_ ReSideRdrLeObj10_UB : 291|1@0+ (1,0) [0|1] "" ASDM,PAS
 SG_ ReSideRdrLeObj10Heading : 287|12@0+ (0.1,-180.0) [-180.0|180.0] "Deg" ASDM,PAS
 SG_ ReSideRdrLeObj10ObjBoxCenterLat : 23|9@0+ (0.1,-25.0) [-25.0|25.0] "m" ASDM,PAS
 SG_ ReSideRdrLeObj10ObjBoxCenterLgt : 30|9@0+ (0.1,-25.0) [-25.0|25.0] "m" ASDM,PAS
 SG_ ReSideRdrLeObj10ObservationHist : 63|32@0+ (1.0,0.0) [0.0|4294967295.0] "Unitless" ASDM,PAS
 SG_ ReSideRdrLeObj10RdrObjAx : 7|8@0- (0.1,0.0) [-12.8|12.700000000000001] "m/s^2" ASDM,PAS
 SG_ ReSideRdrLeObj10RdrObjAy : 15|8@0- (0.1,0.0) [-12.8|12.700000000000001] "m/s^2" ASDM,PAS
 SG_ ReSideRdrLeObj10RdrObjBoxLength : 37|9@0+ (0.1,0.0) [0.0|50.0] "m" ASDM,PAS
 SG_ ReSideRdrLeObj10RdrObjBoxWidth : 44|9@0+ (0.1,0.0) [0.0|50.0] "m" ASDM,PAS
 SG_ ReSideRdrLeObj10RdrObjChks : 95|8@0+ (1.0,0.0) [0.0|255.0] "Unitless" ASDM,PAS
 SG_ ReSideRdrLeObj10RdrObjCntr : 103|4@0+ (1.0,0.0) [0.0|15.0] "Unitless" ASDM,PAS
 SG_ ReSideRdrLeObj10RdrObjCoastCnt : 279|5@0+ (1.0,0.0) [0.0|31.0] "Unitless" ASDM,PAS
 SG_ ReSideRdrLeObj10RdrObjConf : 99|4@0+ (7.0,0.0) [0.0|105.0] "%" ASDM,PAS
 SG_ ReSideRdrLeObj10RdrObjDx : 191|13@0+ (0.05,-200.0) [-200.0|200.0] "m" ASDM,PAS
 SG_ ReSideRdrLeObj10RdrObjDxStdDe : 111|8@0+ (0.05,0.0) [0.0|12.700000000000001] "m" ASDM,PAS
 SG_ ReSideRdrLeObj10RdrObjDy : 119|13@0+ (0.05,-200.0) [-200.0|200.0] "m" ASDM,PAS
 SG_ ReSideRdrLeObj10RdrObjDyStdDe : 183|8@0+ (0.05,0.0) [0.0|12.700000000000001] "m" ASDM,PAS
 SG_ ReSideRdrLeObj10RdrObjElevnConf : 223|4@0+ (7.0,0.0) [0.0|105.0] "%" ASDM,PAS
 SG_ ReSideRdrLeObj10RdrObjElevnSts : 153|2@0+ (1,0) [0|3] "" ASDM,PAS
 SG_ ReSideRdrLeObj10RdrObjID : 167|8@0+ (1.0,0.0) [0.0|255.0] "Unitless" ASDM,PAS
 SG_ ReSideRdrLeObj10RdrObjIsInFreeSpace : 192|1@0+ (1,0) [0|1] "" ASDM,PAS
 SG_ ReSideRdrLeObj10RdrObjMirrProblty : 219|4@0+ (7.0,0.0) [0.0|105.0] "%" ASDM,PAS
 SG_ ReSideRdrLeObj10RdrObjMtnPat : 122|3@0+ (1,0) [0|7] "" ASDM,PAS
 SG_ ReSideRdrLeObj10RdrObjNotRealProblty : 231|4@0+ (7.0,0.0) [0.0|105.0] "%" ASDM,PAS
 SG_ ReSideRdrLeObj10RdrObjStatyCnt : 239|7@0+ (1.0,0.0) [0.0|127.0] "Unitless" ASDM,PAS
 SG_ ReSideRdrLeObj10RdrObjTiAlv : 247|7@0+ (1.0,0.0) [0.0|127.0] "Unitless" ASDM,PAS
 SG_ ReSideRdrLeObj10RdrObjTrackSts : 194|2@0+ (1,0) [0|3] "" ASDM,PAS
 SG_ ReSideRdrLeObj10RdrObjTyp : 51|4@0+ (1,0) [0|15] "" ASDM,PAS
 SG_ ReSideRdrLeObj10RdrObjTypConfBike : 175|4@0+ (7.0,0.0) [0.0|105.0] "%" ASDM,PAS
 SG_ ReSideRdrLeObj10RdrObjTypConfPed : 171|4@0+ (7.0,0.0) [0.0|105.0] "%" ASDM,PAS
 SG_ ReSideRdrLeObj10RdrObjTypConfVeh : 227|4@0+ (7.0,0.0) [0.0|105.0] "%" ASDM,PAS
 SG_ ReSideRdrLeObj10RdrObjVx : 255|14@0+ (0.02,-128.0) [-128.0|128.0] "m/s" ASDM,PAS
 SG_ ReSideRdrLeObj10RdrObjVxStdDe : 271|6@0+ (0.05,0.0) [0.0|2.0] "m/s" ASDM,PAS
 SG_ ReSideRdrLeObj10RdrObjVy : 207|14@0+ (0.02,-128.0) [-128.0|128.0] "m/s" ASDM,PAS
 SG_ ReSideRdrLeObj10RdrObjVyStdDe : 159|6@0+ (0.05,0.0) [0.0|2.0] "m/s" ASDM,PAS
 SG_ ReSideRdrLeObj10RelVx : 135|12@0+ (0.02,-35.6) [-35.6|35.6] "m/s" ASDM,PAS
 SG_ ReSideRdrLeObj10RelVy : 139|12@0+ (0.02,-35.6) [-35.6|35.6] "m/s" ASDM,PAS

BO_ 368 SODLSafetyCANFD3Frame33: 64 SODL
 SG_ ReSideRdrLeObj11_UB : 291|1@0+ (1,0) [0|1] "" ASDM,PAS
 SG_ ReSideRdrLeObj11Heading : 287|12@0+ (0.1,-180.0) [-180.0|180.0] "Deg" ASDM,PAS
 SG_ ReSideRdrLeObj11ObjBoxCenterLat : 23|9@0+ (0.1,-25.0) [-25.0|25.0] "m" ASDM,PAS
 SG_ ReSideRdrLeObj11ObjBoxCenterLgt : 30|9@0+ (0.1,-25.0) [-25.0|25.0] "m" ASDM,PAS
 SG_ ReSideRdrLeObj11ObservationHist : 63|32@0+ (1.0,0.0) [0.0|4294967295.0] "Unitless" ASDM,PAS
 SG_ ReSideRdrLeObj11RdrObjAx : 7|8@0- (0.1,0.0) [-12.8|12.700000000000001] "m/s^2" ASDM,PAS
 SG_ ReSideRdrLeObj11RdrObjAy : 15|8@0- (0.1,0.0) [-12.8|12.700000000000001] "m/s^2" ASDM,PAS
 SG_ ReSideRdrLeObj11RdrObjBoxLength : 37|9@0+ (0.1,0.0) [0.0|50.0] "m" ASDM,PAS
 SG_ ReSideRdrLeObj11RdrObjBoxWidth : 44|9@0+ (0.1,0.0) [0.0|50.0] "m" ASDM,PAS
 SG_ ReSideRdrLeObj11RdrObjChks : 95|8@0+ (1.0,0.0) [0.0|255.0] "Unitless" ASDM,PAS
 SG_ ReSideRdrLeObj11RdrObjCntr : 103|4@0+ (1.0,0.0) [0.0|15.0] "Unitless" ASDM,PAS
 SG_ ReSideRdrLeObj11RdrObjCoastCnt : 279|5@0+ (1.0,0.0) [0.0|31.0] "Unitless" ASDM,PAS
 SG_ ReSideRdrLeObj11RdrObjConf : 99|4@0+ (7.0,0.0) [0.0|105.0] "%" ASDM,PAS
 SG_ ReSideRdrLeObj11RdrObjDx : 191|13@0+ (0.05,-200.0) [-200.0|200.0] "m" ASDM,PAS
 SG_ ReSideRdrLeObj11RdrObjDxStdDe : 111|8@0+ (0.05,0.0) [0.0|12.700000000000001] "m" ASDM,PAS
 SG_ ReSideRdrLeObj11RdrObjDy : 119|13@0+ (0.05,-200.0) [-200.0|200.0] "m" ASDM,PAS
 SG_ ReSideRdrLeObj11RdrObjDyStdDe : 183|8@0+ (0.05,0.0) [0.0|12.700000000000001] "m" ASDM,PAS
 SG_ ReSideRdrLeObj11RdrObjElevnConf : 223|4@0+ (7.0,0.0) [0.0|105.0] "%" ASDM,PAS
 SG_ ReSideRdrLeObj11RdrObjElevnSts : 153|2@0+ (1,0) [0|3] "" ASDM,PAS
 SG_ ReSideRdrLeObj11RdrObjID : 167|8@0+ (1.0,0.0) [0.0|255.0] "Unitless" ASDM,PAS
 SG_ ReSideRdrLeObj11RdrObjIsInFreeSpace : 192|1@0+ (1,0) [0|1] "" ASDM,PAS
 SG_ ReSideRdrLeObj11RdrObjMirrProblty : 219|4@0+ (7.0,0.0) [0.0|105.0] "%" ASDM,PAS
 SG_ ReSideRdrLeObj11RdrObjMtnPat : 122|3@0+ (1,0) [0|7] "" ASDM,PAS
 SG_ ReSideRdrLeObj11RdrObjNotRealProblty : 231|4@0+ (7.0,0.0) [0.0|105.0] "%" ASDM,PAS
 SG_ ReSideRdrLeObj11RdrObjStatyCnt : 239|7@0+ (1.0,0.0) [0.0|127.0] "Unitless" ASDM,PAS
 SG_ ReSideRdrLeObj11RdrObjTiAlv : 247|7@0+ (1.0,0.0) [0.0|127.0] "Unitless" ASDM,PAS
 SG_ ReSideRdrLeObj11RdrObjTrackSts : 194|2@0+ (1,0) [0|3] "" ASDM,PAS
 SG_ ReSideRdrLeObj11RdrObjTyp : 51|4@0+ (1,0) [0|15] "" ASDM,PAS
 SG_ ReSideRdrLeObj11RdrObjTypConfBike : 175|4@0+ (7.0,0.0) [0.0|105.0] "%" ASDM,PAS
 SG_ ReSideRdrLeObj11RdrObjTypConfPed : 171|4@0+ (7.0,0.0) [0.0|105.0] "%" ASDM,PAS
 SG_ ReSideRdrLeObj11RdrObjTypConfVeh : 227|4@0+ (7.0,0.0) [0.0|105.0] "%" ASDM,PAS
 SG_ ReSideRdrLeObj11RdrObjVx : 255|14@0+ (0.02,-128.0) [-128.0|128.0] "m/s" ASDM,PAS
 SG_ ReSideRdrLeObj11RdrObjVxStdDe : 271|6@0+ (0.05,0.0) [0.0|2.0] "m/s" ASDM,PAS
 SG_ ReSideRdrLeObj11RdrObjVy : 207|14@0+ (0.02,-128.0) [-128.0|128.0] "m/s" ASDM,PAS
 SG_ ReSideRdrLeObj11RdrObjVyStdDe : 159|6@0+ (0.05,0.0) [0.0|2.0] "m/s" ASDM,PAS
 SG_ ReSideRdrLeObj11RelVx : 135|12@0+ (0.02,-35.6) [-35.6|35.6] "m/s" ASDM,PAS
 SG_ ReSideRdrLeObj11RelVy : 139|12@0+ (0.02,-35.6) [-35.6|35.6] "m/s" ASDM,PAS

BO_ 370 SODLSafetyCANFD3Frame34: 64 SODL
 SG_ ReSideRdrLeObj12_UB : 291|1@0+ (1,0) [0|1] "" ASDM,PAS
 SG_ ReSideRdrLeObj12Heading : 287|12@0+ (0.1,-180.0) [-180.0|180.0] "Deg" ASDM,PAS
 SG_ ReSideRdrLeObj12ObjBoxCenterLat : 23|9@0+ (0.1,-25.0) [-25.0|25.0] "m" ASDM,PAS
 SG_ ReSideRdrLeObj12ObjBoxCenterLgt : 30|9@0+ (0.1,-25.0) [-25.0|25.0] "m" ASDM,PAS
 SG_ ReSideRdrLeObj12ObservationHist : 63|32@0+ (1.0,0.0) [0.0|4294967295.0] "Unitless" ASDM,PAS
 SG_ ReSideRdrLeObj12RdrObjAx : 7|8@0- (0.1,0.0) [-12.8|12.700000000000001] "m/s^2" ASDM,PAS
 SG_ ReSideRdrLeObj12RdrObjAy : 15|8@0- (0.1,0.0) [-12.8|12.700000000000001] "m/s^2" ASDM,PAS
 SG_ ReSideRdrLeObj12RdrObjBoxLength : 37|9@0+ (0.1,0.0) [0.0|50.0] "m" ASDM,PAS
 SG_ ReSideRdrLeObj12RdrObjBoxWidth : 44|9@0+ (0.1,0.0) [0.0|50.0] "m" ASDM,PAS
 SG_ ReSideRdrLeObj12RdrObjChks : 95|8@0+ (1.0,0.0) [0.0|255.0] "Unitless" ASDM,PAS
 SG_ ReSideRdrLeObj12RdrObjCntr : 103|4@0+ (1.0,0.0) [0.0|15.0] "Unitless" ASDM,PAS
 SG_ ReSideRdrLeObj12RdrObjCoastCnt : 279|5@0+ (1.0,0.0) [0.0|31.0] "Unitless" ASDM,PAS
 SG_ ReSideRdrLeObj12RdrObjConf : 99|4@0+ (7.0,0.0) [0.0|105.0] "%" ASDM,PAS
 SG_ ReSideRdrLeObj12RdrObjDx : 191|13@0+ (0.05,-200.0) [-200.0|200.0] "m" ASDM,PAS
 SG_ ReSideRdrLeObj12RdrObjDxStdDe : 111|8@0+ (0.05,0.0) [0.0|12.700000000000001] "m" ASDM,PAS
 SG_ ReSideRdrLeObj12RdrObjDy : 119|13@0+ (0.05,-200.0) [-200.0|200.0] "m" ASDM,PAS
 SG_ ReSideRdrLeObj12RdrObjDyStdDe : 183|8@0+ (0.05,0.0) [0.0|12.700000000000001] "m" ASDM,PAS
 SG_ ReSideRdrLeObj12RdrObjElevnConf : 223|4@0+ (7.0,0.0) [0.0|105.0] "%" ASDM,PAS
 SG_ ReSideRdrLeObj12RdrObjElevnSts : 153|2@0+ (1,0) [0|3] "" ASDM,PAS
 SG_ ReSideRdrLeObj12RdrObjID : 167|8@0+ (1.0,0.0) [0.0|255.0] "Unitless" ASDM,PAS
 SG_ ReSideRdrLeObj12RdrObjIsInFreeSpace : 192|1@0+ (1,0) [0|1] "" ASDM,PAS
 SG_ ReSideRdrLeObj12RdrObjMirrProblty : 219|4@0+ (7.0,0.0) [0.0|105.0] "%" ASDM,PAS
 SG_ ReSideRdrLeObj12RdrObjMtnPat : 122|3@0+ (1,0) [0|7] "" ASDM,PAS
 SG_ ReSideRdrLeObj12RdrObjNotRealProblty : 231|4@0+ (7.0,0.0) [0.0|105.0] "%" ASDM,PAS
 SG_ ReSideRdrLeObj12RdrObjStatyCnt : 239|7@0+ (1.0,0.0) [0.0|127.0] "Unitless" ASDM,PAS
 SG_ ReSideRdrLeObj12RdrObjTiAlv : 247|7@0+ (1.0,0.0) [0.0|127.0] "Unitless" ASDM,PAS
 SG_ ReSideRdrLeObj12RdrObjTrackSts : 194|2@0+ (1,0) [0|3] "" ASDM,PAS
 SG_ ReSideRdrLeObj12RdrObjTyp : 51|4@0+ (1,0) [0|15] "" ASDM,PAS
 SG_ ReSideRdrLeObj12RdrObjTypConfBike : 175|4@0+ (7.0,0.0) [0.0|105.0] "%" ASDM,PAS
 SG_ ReSideRdrLeObj12RdrObjTypConfPed : 171|4@0+ (7.0,0.0) [0.0|105.0] "%" ASDM,PAS
 SG_ ReSideRdrLeObj12RdrObjTypConfVeh : 227|4@0+ (7.0,0.0) [0.0|105.0] "%" ASDM,PAS
 SG_ ReSideRdrLeObj12RdrObjVx : 255|14@0+ (0.02,-128.0) [-128.0|128.0] "m/s" ASDM,PAS
 SG_ ReSideRdrLeObj12RdrObjVxStdDe : 271|6@0+ (0.05,0.0) [0.0|2.0] "m/s" ASDM,PAS
 SG_ ReSideRdrLeObj12RdrObjVy : 207|14@0+ (0.02,-128.0) [-128.0|128.0] "m/s" ASDM,PAS
 SG_ ReSideRdrLeObj12RdrObjVyStdDe : 159|6@0+ (0.05,0.0) [0.0|2.0] "m/s" ASDM,PAS
 SG_ ReSideRdrLeObj12RelVx : 135|12@0+ (0.02,-35.6) [-35.6|35.6] "m/s" ASDM,PAS
 SG_ ReSideRdrLeObj12RelVy : 139|12@0+ (0.02,-35.6) [-35.6|35.6] "m/s" ASDM,PAS

BO_ 372 SODLSafetyCANFD3Frame35: 64 SODL
 SG_ ReSideRdrLeObj13_UB : 291|1@0+ (1,0) [0|1] "" ASDM,PAS
 SG_ ReSideRdrLeObj13Heading : 287|12@0+ (0.1,-180.0) [-180.0|180.0] "Deg" ASDM,PAS
 SG_ ReSideRdrLeObj13ObjBoxCenterLat : 23|9@0+ (0.1,-25.0) [-25.0|25.0] "m" ASDM,PAS
 SG_ ReSideRdrLeObj13ObjBoxCenterLgt : 30|9@0+ (0.1,-25.0) [-25.0|25.0] "m" ASDM,PAS
 SG_ ReSideRdrLeObj13ObservationHist : 63|32@0+ (1.0,0.0) [0.0|4294967295.0] "Unitless" ASDM,PAS
 SG_ ReSideRdrLeObj13RdrObjAx : 7|8@0- (0.1,0.0) [-12.8|12.700000000000001] "m/s^2" ASDM,PAS
 SG_ ReSideRdrLeObj13RdrObjAy : 15|8@0- (0.1,0.0) [-12.8|12.700000000000001] "m/s^2" ASDM,PAS
 SG_ ReSideRdrLeObj13RdrObjBoxLength : 37|9@0+ (0.1,0.0) [0.0|50.0] "m" ASDM,PAS
 SG_ ReSideRdrLeObj13RdrObjBoxWidth : 44|9@0+ (0.1,0.0) [0.0|50.0] "m" ASDM,PAS
 SG_ ReSideRdrLeObj13RdrObjChks : 95|8@0+ (1.0,0.0) [0.0|255.0] "Unitless" ASDM,PAS
 SG_ ReSideRdrLeObj13RdrObjCntr : 103|4@0+ (1.0,0.0) [0.0|15.0] "Unitless" ASDM,PAS
 SG_ ReSideRdrLeObj13RdrObjCoastCnt : 279|5@0+ (1.0,0.0) [0.0|31.0] "Unitless" ASDM,PAS
 SG_ ReSideRdrLeObj13RdrObjConf : 99|4@0+ (7.0,0.0) [0.0|105.0] "%" ASDM,PAS
 SG_ ReSideRdrLeObj13RdrObjDx : 191|13@0+ (0.05,-200.0) [-200.0|200.0] "m" ASDM,PAS
 SG_ ReSideRdrLeObj13RdrObjDxStdDe : 111|8@0+ (0.05,0.0) [0.0|12.700000000000001] "m" ASDM,PAS
 SG_ ReSideRdrLeObj13RdrObjDy : 119|13@0+ (0.05,-200.0) [-200.0|200.0] "m" ASDM,PAS
 SG_ ReSideRdrLeObj13RdrObjDyStdDe : 183|8@0+ (0.05,0.0) [0.0|12.700000000000001] "m" ASDM,PAS
 SG_ ReSideRdrLeObj13RdrObjElevnConf : 223|4@0+ (7.0,0.0) [0.0|105.0] "%" ASDM,PAS
 SG_ ReSideRdrLeObj13RdrObjElevnSts : 153|2@0+ (1,0) [0|3] "" ASDM,PAS
 SG_ ReSideRdrLeObj13RdrObjID : 167|8@0+ (1.0,0.0) [0.0|255.0] "Unitless" ASDM,PAS
 SG_ ReSideRdrLeObj13RdrObjIsInFreeSpace : 192|1@0+ (1,0) [0|1] "" ASDM,PAS
 SG_ ReSideRdrLeObj13RdrObjMirrProblty : 219|4@0+ (7.0,0.0) [0.0|105.0] "%" ASDM,PAS
 SG_ ReSideRdrLeObj13RdrObjMtnPat : 122|3@0+ (1,0) [0|7] "" ASDM,PAS
 SG_ ReSideRdrLeObj13RdrObjNotRealProblty : 231|4@0+ (7.0,0.0) [0.0|105.0] "%" ASDM,PAS
 SG_ ReSideRdrLeObj13RdrObjStatyCnt : 239|7@0+ (1.0,0.0) [0.0|127.0] "Unitless" ASDM,PAS
 SG_ ReSideRdrLeObj13RdrObjTiAlv : 247|7@0+ (1.0,0.0) [0.0|127.0] "Unitless" ASDM,PAS
 SG_ ReSideRdrLeObj13RdrObjTrackSts : 194|2@0+ (1,0) [0|3] "" ASDM,PAS
 SG_ ReSideRdrLeObj13RdrObjTyp : 51|4@0+ (1,0) [0|15] "" ASDM,PAS
 SG_ ReSideRdrLeObj13RdrObjTypConfBike : 175|4@0+ (7.0,0.0) [0.0|105.0] "%" ASDM,PAS
 SG_ ReSideRdrLeObj13RdrObjTypConfPed : 171|4@0+ (7.0,0.0) [0.0|105.0] "%" ASDM,PAS
 SG_ ReSideRdrLeObj13RdrObjTypConfVeh : 227|4@0+ (7.0,0.0) [0.0|105.0] "%" ASDM,PAS
 SG_ ReSideRdrLeObj13RdrObjVx : 255|14@0+ (0.02,-128.0) [-128.0|128.0] "m/s" ASDM,PAS
 SG_ ReSideRdrLeObj13RdrObjVxStdDe : 271|6@0+ (0.05,0.0) [0.0|2.0] "m/s" ASDM,PAS
 SG_ ReSideRdrLeObj13RdrObjVy : 207|14@0+ (0.02,-128.0) [-128.0|128.0] "m/s" ASDM,PAS
 SG_ ReSideRdrLeObj13RdrObjVyStdDe : 159|6@0+ (0.05,0.0) [0.0|2.0] "m/s" ASDM,PAS
 SG_ ReSideRdrLeObj13RelVx : 135|12@0+ (0.02,-35.6) [-35.6|35.6] "m/s" ASDM,PAS
 SG_ ReSideRdrLeObj13RelVy : 139|12@0+ (0.02,-35.6) [-35.6|35.6] "m/s" ASDM,PAS

BO_ 374 SODLSafetyCANFD3Frame36: 64 SODL
 SG_ ReSideRdrLeObj14_UB : 291|1@0+ (1,0) [0|1] "" ASDM,PAS
 SG_ ReSideRdrLeObj14Heading : 287|12@0+ (0.1,-180.0) [-180.0|180.0] "Deg" ASDM,PAS
 SG_ ReSideRdrLeObj14ObjBoxCenterLat : 23|9@0+ (0.1,-25.0) [-25.0|25.0] "m" ASDM,PAS
 SG_ ReSideRdrLeObj14ObjBoxCenterLgt : 30|9@0+ (0.1,-25.0) [-25.0|25.0] "m" ASDM,PAS
 SG_ ReSideRdrLeObj14ObservationHist : 63|32@0+ (1.0,0.0) [0.0|4294967295.0] "Unitless" ASDM,PAS
 SG_ ReSideRdrLeObj14RdrObjAx : 7|8@0- (0.1,0.0) [-12.8|12.700000000000001] "m/s^2" ASDM,PAS
 SG_ ReSideRdrLeObj14RdrObjAy : 15|8@0- (0.1,0.0) [-12.8|12.700000000000001] "m/s^2" ASDM,PAS
 SG_ ReSideRdrLeObj14RdrObjBoxLength : 37|9@0+ (0.1,0.0) [0.0|50.0] "m" ASDM,PAS
 SG_ ReSideRdrLeObj14RdrObjBoxWidth : 44|9@0+ (0.1,0.0) [0.0|50.0] "m" ASDM,PAS
 SG_ ReSideRdrLeObj14RdrObjChks : 95|8@0+ (1.0,0.0) [0.0|255.0] "Unitless" ASDM,PAS
 SG_ ReSideRdrLeObj14RdrObjCntr : 103|4@0+ (1.0,0.0) [0.0|15.0] "Unitless" ASDM,PAS
 SG_ ReSideRdrLeObj14RdrObjCoastCnt : 279|5@0+ (1.0,0.0) [0.0|31.0] "Unitless" ASDM,PAS
 SG_ ReSideRdrLeObj14RdrObjConf : 99|4@0+ (7.0,0.0) [0.0|105.0] "%" ASDM,PAS
 SG_ ReSideRdrLeObj14RdrObjDx : 191|13@0+ (0.05,-200.0) [-200.0|200.0] "m" ASDM,PAS
 SG_ ReSideRdrLeObj14RdrObjDxStdDe : 111|8@0+ (0.05,0.0) [0.0|12.700000000000001] "m" ASDM,PAS
 SG_ ReSideRdrLeObj14RdrObjDy : 119|13@0+ (0.05,-200.0) [-200.0|200.0] "m" ASDM,PAS
 SG_ ReSideRdrLeObj14RdrObjDyStdDe : 183|8@0+ (0.05,0.0) [0.0|12.700000000000001] "m" ASDM,PAS
 SG_ ReSideRdrLeObj14RdrObjElevnConf : 223|4@0+ (7.0,0.0) [0.0|105.0] "%" ASDM,PAS
 SG_ ReSideRdrLeObj14RdrObjElevnSts : 153|2@0+ (1,0) [0|3] "" ASDM,PAS
 SG_ ReSideRdrLeObj14RdrObjID : 167|8@0+ (1.0,0.0) [0.0|255.0] "Unitless" ASDM,PAS
 SG_ ReSideRdrLeObj14RdrObjIsInFreeSpace : 192|1@0+ (1,0) [0|1] "" ASDM,PAS
 SG_ ReSideRdrLeObj14RdrObjMirrProblty : 219|4@0+ (7.0,0.0) [0.0|105.0] "%" ASDM,PAS
 SG_ ReSideRdrLeObj14RdrObjMtnPat : 122|3@0+ (1,0) [0|7] "" ASDM,PAS
 SG_ ReSideRdrLeObj14RdrObjNotRealProblty : 231|4@0+ (7.0,0.0) [0.0|105.0] "%" ASDM,PAS
 SG_ ReSideRdrLeObj14RdrObjStatyCnt : 239|7@0+ (1.0,0.0) [0.0|127.0] "Unitless" ASDM,PAS
 SG_ ReSideRdrLeObj14RdrObjTiAlv : 247|7@0+ (1.0,0.0) [0.0|127.0] "Unitless" ASDM,PAS
 SG_ ReSideRdrLeObj14RdrObjTrackSts : 194|2@0+ (1,0) [0|3] "" ASDM,PAS
 SG_ ReSideRdrLeObj14RdrObjTyp : 51|4@0+ (1,0) [0|15] "" ASDM,PAS
 SG_ ReSideRdrLeObj14RdrObjTypConfBike : 175|4@0+ (7.0,0.0) [0.0|105.0] "%" ASDM,PAS
 SG_ ReSideRdrLeObj14RdrObjTypConfPed : 171|4@0+ (7.0,0.0) [0.0|105.0] "%" ASDM,PAS
 SG_ ReSideRdrLeObj14RdrObjTypConfVeh : 227|4@0+ (7.0,0.0) [0.0|105.0] "%" ASDM,PAS
 SG_ ReSideRdrLeObj14RdrObjVx : 255|14@0+ (0.02,-128.0) [-128.0|128.0] "m/s" ASDM,PAS
 SG_ ReSideRdrLeObj14RdrObjVxStdDe : 271|6@0+ (0.05,0.0) [0.0|2.0] "m/s" ASDM,PAS
 SG_ ReSideRdrLeObj14RdrObjVy : 207|14@0+ (0.02,-128.0) [-128.0|128.0] "m/s" ASDM,PAS
 SG_ ReSideRdrLeObj14RdrObjVyStdDe : 159|6@0+ (0.05,0.0) [0.0|2.0] "m/s" ASDM,PAS
 SG_ ReSideRdrLeObj14RelVx : 135|12@0+ (0.02,-35.6) [-35.6|35.6] "m/s" ASDM,PAS
 SG_ ReSideRdrLeObj14RelVy : 139|12@0+ (0.02,-35.6) [-35.6|35.6] "m/s" ASDM,PAS

CM_ SG_ 350 ReSideRdrLeObj2Heading "Refer to the data element description in ReSideRdrRiObj1 with the same data element name";
CM_ SG_ 350 ReSideRdrLeObj2ObjBoxCenterLat "Box center y coordinate (relative closest point)";
CM_ SG_ 350 ReSideRdrLeObj2ObjBoxCenterLgt "Refer to the data element description in ReSideRdrLeObj1 with the same data element name";
CM_ SG_ 350 ReSideRdrLeObj2ObservationHist "Refer to the data element description in ReSideRdrRiObj1 with the same data element name";
CM_ SG_ 350 ReSideRdrLeObj2RdrObjAx "Refer to the data element description in ReSideRdrLeObj1 with the same data element name";
CM_ SG_ 350 ReSideRdrLeObj2RdrObjAy "Refer to the data element description in ReSideRdrLeObj1 with the same data element name";
CM_ SG_ 350 ReSideRdrLeObj2RdrObjBoxLength "Refer to the data element description in ReSideRdrRiObj1 with the same data element name";
CM_ SG_ 350 ReSideRdrLeObj2RdrObjBoxWidth "Refer to the data element description in ReSideRdrRiObj1 with the same data element name";
CM_ SG_ 350 ReSideRdrLeObj2RdrObjChks "Refer to the data element description in ReSideRdrLeObj1 with the same data element name";
CM_ SG_ 350 ReSideRdrLeObj2RdrObjCntr "Refer to the data element description in ReSideRdrLeObj1 with the same data element name";
CM_ SG_ 350 ReSideRdrLeObj2RdrObjCoastCnt "Refer to the data element description in ReSideRdrLeObj1 with the same data element name";
CM_ SG_ 350 ReSideRdrLeObj2RdrObjConf "Refer to the data element description in ReSideRdrLeObj1 with the same data element name";
CM_ SG_ 350 ReSideRdrLeObj2RdrObjDx "Refer to the data element description in ReSideRdrLeObj1 with the same data element name";
CM_ SG_ 350 ReSideRdrLeObj2RdrObjDxStdDe "Refer to the data element description in ReSideRdrLeObj1 with the same data element name";
CM_ SG_ 350 ReSideRdrLeObj2RdrObjDy "Refer to the data element description in ReSideRdrLeObj1 with the same data element name";
CM_ SG_ 350 ReSideRdrLeObj2RdrObjDyStdDe "Refer to the data element description in ReSideRdrLeObj1 with the same data element name";
CM_ SG_ 350 ReSideRdrLeObj2RdrObjElevnConf "Refer to the data element description in ReSideRdrLeObj1 with the same data element name";
CM_ SG_ 350 ReSideRdrLeObj2RdrObjElevnSts "Refer to the data element description in ReSideRdrLeObj1 with the same data element name";
CM_ SG_ 350 ReSideRdrLeObj2RdrObjID "Refer to the data element description in ReSideRdrLeObj1 with the same data element name";
CM_ SG_ 350 ReSideRdrLeObj2RdrObjIsInFreeSpace "Refer to the data element description in ReSideRdrLeObj1 with the same data element name";
CM_ SG_ 350 ReSideRdrLeObj2RdrObjMirrProblty "Refer to the data element description in ReSideRdrLeObj1 with the same data element name";
CM_ SG_ 350 ReSideRdrLeObj2RdrObjMtnPat "Refer to the data element description in ReSideRdrLeObj1 with the same data element name";
CM_ SG_ 350 ReSideRdrLeObj2RdrObjNotRealProblty "Refer to the data element description in ReSideRdrLeObj1 with the same data element name";
CM_ SG_ 350 ReSideRdrLeObj2RdrObjStatyCnt "Refer to the data element description in ReSideRdrLeObj1 with the same data element name";
CM_ SG_ 350 ReSideRdrLeObj2RdrObjTiAlv "Refer to the data element description in ReSideRdrLeObj1 with the same data element name";
CM_ SG_ 350 ReSideRdrLeObj2RdrObjTrackSts "Refer to the data element description in ReSideRdrLeObj1 with the same data element name";
CM_ SG_ 350 ReSideRdrLeObj2RdrObjTyp "Refer to the data element description in ReSideRdrLeObj1 with the same data element name";
CM_ SG_ 350 ReSideRdrLeObj2RdrObjTypConfBike "Refer to the data element description in ReSideRdrLeObj1 with the same data element name";
CM_ SG_ 350 ReSideRdrLeObj2RdrObjTypConfPed "Refer to the data element description in ReSideRdrLeObj1 with the same data element name";
CM_ SG_ 350 ReSideRdrLeObj2RdrObjTypConfVeh "Refer to the data element description in ReSideRdrLeObj1 with the same data element name";
CM_ SG_ 350 ReSideRdrLeObj2RdrObjVx "Refer to the data element description in ReSideRdrLeObj1 with the same data element name";
CM_ SG_ 350 ReSideRdrLeObj2RdrObjVxStdDe "Refer to the data element description in ReSideRdrLeObj1 with the same data element name";
CM_ SG_ 350 ReSideRdrLeObj2RdrObjVy "Refer to the data element description in ReSideRdrLeObj1 with the same data element name";
CM_ SG_ 350 ReSideRdrLeObj2RdrObjVyStdDe "Refer to the data element description in ReSideRdrLeObj1 with the same data element name";
CM_ SG_ 350 ReSideRdrLeObj2RelVx "Refer to the data element description in ReSideRdrRiObj1 with the same data element name";
CM_ SG_ 350 ReSideRdrLeObj2RelVy "Refer to the data element description in ReSideRdrRiObj1 with the same data element name";
CM_ SG_ 352 ReSideRdrLeObj3Heading "Refer to the data element description in ReSideRdrRiObj1 with the same data element name";
CM_ SG_ 352 ReSideRdrLeObj3ObjBoxCenterLat "Box center y coordinate (relative closest point)";
CM_ SG_ 352 ReSideRdrLeObj3ObjBoxCenterLgt "Refer to the data element description in ReSideRdrLeObj1 with the same data element name";
CM_ SG_ 352 ReSideRdrLeObj3ObservationHist "Refer to the data element description in ReSideRdrRiObj1 with the same data element name";
CM_ SG_ 352 ReSideRdrLeObj3RdrObjAx "Refer to the data element description in ReSideRdrLeObj1 with the same data element name";
CM_ SG_ 352 ReSideRdrLeObj3RdrObjAy "Refer to the data element description in ReSideRdrLeObj1 with the same data element name";
CM_ SG_ 352 ReSideRdrLeObj3RdrObjBoxLength "Refer to the data element description in ReSideRdrRiObj1 with the same data element name";
CM_ SG_ 352 ReSideRdrLeObj3RdrObjBoxWidth "Refer to the data element description in ReSideRdrRiObj1 with the same data element name";
CM_ SG_ 352 ReSideRdrLeObj3RdrObjChks "Refer to the data element description in ReSideRdrLeObj1 with the same data element name";
CM_ SG_ 352 ReSideRdrLeObj3RdrObjCntr "Refer to the data element description in ReSideRdrLeObj1 with the same data element name";
CM_ SG_ 352 ReSideRdrLeObj3RdrObjCoastCnt "Refer to the data element description in ReSideRdrLeObj1 with the same data element name";
CM_ SG_ 352 ReSideRdrLeObj3RdrObjConf "Refer to the data element description in ReSideRdrLeObj1 with the same data element name";
CM_ SG_ 352 ReSideRdrLeObj3RdrObjDx "Refer to the data element description in ReSideRdrLeObj1 with the same data element name";
CM_ SG_ 352 ReSideRdrLeObj3RdrObjDxStdDe "Refer to the data element description in ReSideRdrLeObj1 with the same data element name";
CM_ SG_ 352 ReSideRdrLeObj3RdrObjDy "Refer to the data element description in ReSideRdrLeObj1 with the same data element name";
CM_ SG_ 352 ReSideRdrLeObj3RdrObjDyStdDe "Refer to the data element description in ReSideRdrLeObj1 with the same data element name";
CM_ SG_ 352 ReSideRdrLeObj3RdrObjElevnConf "Refer to the data element description in ReSideRdrLeObj1 with the same data element name";
CM_ SG_ 352 ReSideRdrLeObj3RdrObjElevnSts "Refer to the data element description in ReSideRdrLeObj1 with the same data element name";
CM_ SG_ 352 ReSideRdrLeObj3RdrObjID "Refer to the data element description in ReSideRdrLeObj1 with the same data element name";
CM_ SG_ 352 ReSideRdrLeObj3RdrObjIsInFreeSpace "Refer to the data element description in ReSideRdrLeObj1 with the same data element name";
CM_ SG_ 352 ReSideRdrLeObj3RdrObjMirrProblty "Refer to the data element description in ReSideRdrLeObj1 with the same data element name";
CM_ SG_ 352 ReSideRdrLeObj3RdrObjMtnPat "Refer to the data element description in ReSideRdrLeObj1 with the same data element name";
CM_ SG_ 352 ReSideRdrLeObj3RdrObjNotRealProblty "Refer to the data element description in ReSideRdrLeObj1 with the same data element name";
CM_ SG_ 352 ReSideRdrLeObj3RdrObjStatyCnt "Refer to the data element description in ReSideRdrLeObj1 with the same data element name";
CM_ SG_ 352 ReSideRdrLeObj3RdrObjTiAlv "Refer to the data element description in ReSideRdrLeObj1 with the same data element name";
CM_ SG_ 352 ReSideRdrLeObj3RdrObjTrackSts "Refer to the data element description in ReSideRdrLeObj1 with the same data element name";
CM_ SG_ 352 ReSideRdrLeObj3RdrObjTyp "Refer to the data element description in ReSideRdrLeObj1 with the same data element name";
CM_ SG_ 352 ReSideRdrLeObj3RdrObjTypConfBike "Refer to the data element description in ReSideRdrLeObj1 with the same data element name";
CM_ SG_ 352 ReSideRdrLeObj3RdrObjTypConfPed "Refer to the data element description in ReSideRdrLeObj1 with the same data element name";
CM_ SG_ 352 ReSideRdrLeObj3RdrObjTypConfVeh "Refer to the data element description in ReSideRdrLeObj1 with the same data element name";
CM_ SG_ 352 ReSideRdrLeObj3RdrObjVx "Refer to the data element description in ReSideRdrLeObj1 with the same data element name";
CM_ SG_ 352 ReSideRdrLeObj3RdrObjVxStdDe "Refer to the data element description in ReSideRdrLeObj1 with the same data element name";
CM_ SG_ 352 ReSideRdrLeObj3RdrObjVy "Refer to the data element description in ReSideRdrLeObj1 with the same data element name";
CM_ SG_ 352 ReSideRdrLeObj3RdrObjVyStdDe "Refer to the data element description in ReSideRdrLeObj1 with the same data element name";
CM_ SG_ 352 ReSideRdrLeObj3RelVx "Refer to the data element description in ReSideRdrRiObj1 with the same data element name";
CM_ SG_ 352 ReSideRdrLeObj3RelVy "Refer to the data element description in ReSideRdrRiObj1 with the same data element name";
CM_ SG_ 354 ReSideRdrLeObj4Heading "Refer to the data element description in ReSideRdrRiObj1 with the same data element name";
CM_ SG_ 354 ReSideRdrLeObj4ObjBoxCenterLat "Box center y coordinate (relative closest point)";
CM_ SG_ 354 ReSideRdrLeObj4ObjBoxCenterLgt "Refer to the data element description in ReSideRdrLeObj1 with the same data element name";
CM_ SG_ 354 ReSideRdrLeObj4ObservationHist "Refer to the data element description in ReSideRdrRiObj1 with the same data element name";
CM_ SG_ 354 ReSideRdrLeObj4RdrObjAx "Refer to the data element description in ReSideRdrLeObj1 with the same data element name";
CM_ SG_ 354 ReSideRdrLeObj4RdrObjAy "Refer to the data element description in ReSideRdrLeObj1 with the same data element name";
CM_ SG_ 354 ReSideRdrLeObj4RdrObjBoxLength "Refer to the data element description in ReSideRdrRiObj1 with the same data element name";
CM_ SG_ 354 ReSideRdrLeObj4RdrObjBoxWidth "Refer to the data element description in ReSideRdrRiObj1 with the same data element name";
CM_ SG_ 354 ReSideRdrLeObj4RdrObjChks "Refer to the data element description in ReSideRdrLeObj1 with the same data element name";
CM_ SG_ 354 ReSideRdrLeObj4RdrObjCntr "Refer to the data element description in ReSideRdrLeObj1 with the same data element name";
CM_ SG_ 354 ReSideRdrLeObj4RdrObjCoastCnt "Refer to the data element description in ReSideRdrLeObj1 with the same data element name";
CM_ SG_ 354 ReSideRdrLeObj4RdrObjConf "Refer to the data element description in ReSideRdrLeObj1 with the same data element name";
CM_ SG_ 354 ReSideRdrLeObj4RdrObjDx "Refer to the data element description in ReSideRdrLeObj1 with the same data element name";
CM_ SG_ 354 ReSideRdrLeObj4RdrObjDxStdDe "Refer to the data element description in ReSideRdrLeObj1 with the same data element name";
CM_ SG_ 354 ReSideRdrLeObj4RdrObjDy "Refer to the data element description in ReSideRdrLeObj1 with the same data element name";
CM_ SG_ 354 ReSideRdrLeObj4RdrObjDyStdDe "Refer to the data element description in ReSideRdrLeObj1 with the same data element name";
CM_ SG_ 354 ReSideRdrLeObj4RdrObjElevnConf "Refer to the data element description in ReSideRdrLeObj1 with the same data element name";
CM_ SG_ 354 ReSideRdrLeObj4RdrObjElevnSts "Refer to the data element description in ReSideRdrLeObj1 with the same data element name";
CM_ SG_ 354 ReSideRdrLeObj4RdrObjID "Refer to the data element description in ReSideRdrLeObj1 with the same data element name";
CM_ SG_ 354 ReSideRdrLeObj4RdrObjIsInFreeSpace "Refer to the data element description in ReSideRdrLeObj1 with the same data element name";
CM_ SG_ 354 ReSideRdrLeObj4RdrObjMirrProblty "Refer to the data element description in ReSideRdrLeObj1 with the same data element name";
CM_ SG_ 354 ReSideRdrLeObj4RdrObjMtnPat "Refer to the data element description in ReSideRdrLeObj1 with the same data element name";
CM_ SG_ 354 ReSideRdrLeObj4RdrObjNotRealProblty "Refer to the data element description in ReSideRdrLeObj1 with the same data element name";
CM_ SG_ 354 ReSideRdrLeObj4RdrObjStatyCnt "Refer to the data element description in ReSideRdrLeObj1 with the same data element name";
CM_ SG_ 354 ReSideRdrLeObj4RdrObjTiAlv "Refer to the data element description in ReSideRdrLeObj1 with the same data element name";
CM_ SG_ 354 ReSideRdrLeObj4RdrObjTrackSts "Refer to the data element description in ReSideRdrLeObj1 with the same data element name";
CM_ SG_ 354 ReSideRdrLeObj4RdrObjTyp "Refer to the data element description in ReSideRdrLeObj1 with the same data element name";
CM_ SG_ 354 ReSideRdrLeObj4RdrObjTypConfBike "Refer to the data element description in ReSideRdrLeObj1 with the same data element name";
CM_ SG_ 354 ReSideRdrLeObj4RdrObjTypConfPed "Refer to the data element description in ReSideRdrLeObj1 with the same data element name";
CM_ SG_ 354 ReSideRdrLeObj4RdrObjTypConfVeh "Refer to the data element description in ReSideRdrLeObj1 with the same data element name";
CM_ SG_ 354 ReSideRdrLeObj4RdrObjVx "Refer to the data element description in ReSideRdrLeObj1 with the same data element name";
CM_ SG_ 354 ReSideRdrLeObj4RdrObjVxStdDe "Refer to the data element description in ReSideRdrLeObj1 with the same data element name";
CM_ SG_ 354 ReSideRdrLeObj4RdrObjVy "Refer to the data element description in ReSideRdrLeObj1 with the same data element name";
CM_ SG_ 354 ReSideRdrLeObj4RdrObjVyStdDe "Refer to the data element description in ReSideRdrLeObj1 with the same data element name";
CM_ SG_ 354 ReSideRdrLeObj4RelVx "Refer to the data element description in ReSideRdrRiObj1 with the same data element name";
CM_ SG_ 354 ReSideRdrLeObj4RelVy "Refer to the data element description in ReSideRdrRiObj1 with the same data element name";
CM_ SG_ 356 ReSideRdrLeObj5Heading "Refer to the data element description in ReSideRdrRiObj1 with the same data element name";
CM_ SG_ 356 ReSideRdrLeObj5ObjBoxCenterLat "Box center y coordinate (relative closest point)";
CM_ SG_ 356 ReSideRdrLeObj5ObjBoxCenterLgt "Refer to the data element description in ReSideRdrLeObj1 with the same data element name";
CM_ SG_ 356 ReSideRdrLeObj5ObservationHist "Refer to the data element description in ReSideRdrRiObj1 with the same data element name";
CM_ SG_ 356 ReSideRdrLeObj5RdrObjAx "Refer to the data element description in ReSideRdrLeObj1 with the same data element name";
CM_ SG_ 356 ReSideRdrLeObj5RdrObjAy "Refer to the data element description in ReSideRdrLeObj1 with the same data element name";
CM_ SG_ 356 ReSideRdrLeObj5RdrObjBoxLength "Refer to the data element description in ReSideRdrRiObj1 with the same data element name";
CM_ SG_ 356 ReSideRdrLeObj5RdrObjBoxWidth "Refer to the data element description in ReSideRdrRiObj1 with the same data element name";
CM_ SG_ 356 ReSideRdrLeObj5RdrObjChks "Refer to the data element description in ReSideRdrLeObj1 with the same data element name";
CM_ SG_ 356 ReSideRdrLeObj5RdrObjCntr "Refer to the data element description in ReSideRdrLeObj1 with the same data element name";
CM_ SG_ 356 ReSideRdrLeObj5RdrObjCoastCnt "Refer to the data element description in ReSideRdrLeObj1 with the same data element name";
CM_ SG_ 356 ReSideRdrLeObj5RdrObjConf "Refer to the data element description in ReSideRdrLeObj1 with the same data element name";
CM_ SG_ 356 ReSideRdrLeObj5RdrObjDx "Refer to the data element description in ReSideRdrLeObj1 with the same data element name";
CM_ SG_ 356 ReSideRdrLeObj5RdrObjDxStdDe "Refer to the data element description in ReSideRdrLeObj1 with the same data element name";
CM_ SG_ 356 ReSideRdrLeObj5RdrObjDy "Refer to the data element description in ReSideRdrLeObj1 with the same data element name";
CM_ SG_ 356 ReSideRdrLeObj5RdrObjDyStdDe "Refer to the data element description in ReSideRdrLeObj1 with the same data element name";
CM_ SG_ 356 ReSideRdrLeObj5RdrObjElevnConf "Refer to the data element description in ReSideRdrLeObj1 with the same data element name";
CM_ SG_ 356 ReSideRdrLeObj5RdrObjElevnSts "Refer to the data element description in ReSideRdrLeObj1 with the same data element name";
CM_ SG_ 356 ReSideRdrLeObj5RdrObjID "Refer to the data element description in ReSideRdrLeObj1 with the same data element name";
CM_ SG_ 356 ReSideRdrLeObj5RdrObjIsInFreeSpace "Refer to the data element description in ReSideRdrLeObj1 with the same data element name";
CM_ SG_ 356 ReSideRdrLeObj5RdrObjMirrProblty "Refer to the data element description in ReSideRdrLeObj1 with the same data element name";
CM_ SG_ 356 ReSideRdrLeObj5RdrObjMtnPat "Refer to the data element description in ReSideRdrLeObj1 with the same data element name";
CM_ SG_ 356 ReSideRdrLeObj5RdrObjNotRealProblty "Refer to the data element description in ReSideRdrLeObj1 with the same data element name";
CM_ SG_ 356 ReSideRdrLeObj5RdrObjStatyCnt "Refer to the data element description in ReSideRdrLeObj1 with the same data element name";
CM_ SG_ 356 ReSideRdrLeObj5RdrObjTiAlv "Refer to the data element description in ReSideRdrLeObj1 with the same data element name";
CM_ SG_ 356 ReSideRdrLeObj5RdrObjTrackSts "Refer to the data element description in ReSideRdrLeObj1 with the same data element name";
CM_ SG_ 356 ReSideRdrLeObj5RdrObjTyp "Refer to the data element description in ReSideRdrLeObj1 with the same data element name";
CM_ SG_ 356 ReSideRdrLeObj5RdrObjTypConfBike "Refer to the data element description in ReSideRdrLeObj1 with the same data element name";
CM_ SG_ 356 ReSideRdrLeObj5RdrObjTypConfPed "Refer to the data element description in ReSideRdrLeObj1 with the same data element name";
CM_ SG_ 356 ReSideRdrLeObj5RdrObjTypConfVeh "Refer to the data element description in ReSideRdrLeObj1 with the same data element name";
CM_ SG_ 356 ReSideRdrLeObj5RdrObjVx "Refer to the data element description in ReSideRdrLeObj1 with the same data element name";
CM_ SG_ 356 ReSideRdrLeObj5RdrObjVxStdDe "Refer to the data element description in ReSideRdrLeObj1 with the same data element name";
CM_ SG_ 356 ReSideRdrLeObj5RdrObjVy "Refer to the data element description in ReSideRdrLeObj1 with the same data element name";
CM_ SG_ 356 ReSideRdrLeObj5RdrObjVyStdDe "Refer to the data element description in ReSideRdrLeObj1 with the same data element name";
CM_ SG_ 356 ReSideRdrLeObj5RelVx "Refer to the data element description in ReSideRdrRiObj1 with the same data element name";
CM_ SG_ 356 ReSideRdrLeObj5RelVy "Refer to the data element description in ReSideRdrRiObj1 with the same data element name";
CM_ SG_ 358 ReSideRdrLeObj6Heading "Refer to the data element description in ReSideRdrRiObj1 with the same data element name";
CM_ SG_ 358 ReSideRdrLeObj6ObjBoxCenterLat "Box center y coordinate (relative closest point)";
CM_ SG_ 358 ReSideRdrLeObj6ObjBoxCenterLgt "Refer to the data element description in ReSideRdrLeObj1 with the same data element name";
CM_ SG_ 358 ReSideRdrLeObj6ObservationHist "Refer to the data element description in ReSideRdrRiObj1 with the same data element name";
CM_ SG_ 358 ReSideRdrLeObj6RdrObjAx "Refer to the data element description in ReSideRdrLeObj1 with the same data element name";
CM_ SG_ 358 ReSideRdrLeObj6RdrObjAy "Refer to the data element description in ReSideRdrLeObj1 with the same data element name";
CM_ SG_ 358 ReSideRdrLeObj6RdrObjBoxLength "Refer to the data element description in ReSideRdrRiObj1 with the same data element name";
CM_ SG_ 358 ReSideRdrLeObj6RdrObjBoxWidth "Refer to the data element description in ReSideRdrRiObj1 with the same data element name";
CM_ SG_ 358 ReSideRdrLeObj6RdrObjChks "Refer to the data element description in ReSideRdrLeObj1 with the same data element name";
CM_ SG_ 358 ReSideRdrLeObj6RdrObjCntr "Refer to the data element description in ReSideRdrLeObj1 with the same data element name";
CM_ SG_ 358 ReSideRdrLeObj6RdrObjCoastCnt "Refer to the data element description in ReSideRdrLeObj1 with the same data element name";
CM_ SG_ 358 ReSideRdrLeObj6RdrObjConf "Refer to the data element description in ReSideRdrLeObj1 with the same data element name";
CM_ SG_ 358 ReSideRdrLeObj6RdrObjDx "Refer to the data element description in ReSideRdrLeObj1 with the same data element name";
CM_ SG_ 358 ReSideRdrLeObj6RdrObjDxStdDe "Refer to the data element description in ReSideRdrLeObj1 with the same data element name";
CM_ SG_ 358 ReSideRdrLeObj6RdrObjDy "Refer to the data element description in ReSideRdrLeObj1 with the same data element name";
CM_ SG_ 358 ReSideRdrLeObj6RdrObjDyStdDe "Refer to the data element description in ReSideRdrLeObj1 with the same data element name";
CM_ SG_ 358 ReSideRdrLeObj6RdrObjElevnConf "Refer to the data element description in ReSideRdrLeObj1 with the same data element name";
CM_ SG_ 358 ReSideRdrLeObj6RdrObjElevnSts "Refer to the data element description in ReSideRdrLeObj1 with the same data element name";
CM_ SG_ 358 ReSideRdrLeObj6RdrObjID "Refer to the data element description in ReSideRdrLeObj1 with the same data element name";
CM_ SG_ 358 ReSideRdrLeObj6RdrObjIsInFreeSpace "Refer to the data element description in ReSideRdrLeObj1 with the same data element name";
CM_ SG_ 358 ReSideRdrLeObj6RdrObjMirrProblty "Refer to the data element description in ReSideRdrLeObj1 with the same data element name";
CM_ SG_ 358 ReSideRdrLeObj6RdrObjMtnPat "Refer to the data element description in ReSideRdrLeObj1 with the same data element name";
CM_ SG_ 358 ReSideRdrLeObj6RdrObjNotRealProblty "Refer to the data element description in ReSideRdrLeObj1 with the same data element name";
CM_ SG_ 358 ReSideRdrLeObj6RdrObjStatyCnt "Refer to the data element description in ReSideRdrLeObj1 with the same data element name";
CM_ SG_ 358 ReSideRdrLeObj6RdrObjTiAlv "Refer to the data element description in ReSideRdrLeObj1 with the same data element name";
CM_ SG_ 358 ReSideRdrLeObj6RdrObjTrackSts "Refer to the data element description in ReSideRdrLeObj1 with the same data element name";
CM_ SG_ 358 ReSideRdrLeObj6RdrObjTyp "Refer to the data element description in ReSideRdrLeObj1 with the same data element name";
CM_ SG_ 358 ReSideRdrLeObj6RdrObjTypConfBike "Refer to the data element description in ReSideRdrLeObj1 with the same data element name";
CM_ SG_ 358 ReSideRdrLeObj6RdrObjTypConfPed "Refer to the data element description in ReSideRdrLeObj1 with the same data element name";
CM_ SG_ 358 ReSideRdrLeObj6RdrObjTypConfVeh "Refer to the data element description in ReSideRdrLeObj1 with the same data element name";
CM_ SG_ 358 ReSideRdrLeObj6RdrObjVx "Refer to the data element description in ReSideRdrLeObj1 with the same data element name";
CM_ SG_ 358 ReSideRdrLeObj6RdrObjVxStdDe "Refer to the data element description in ReSideRdrLeObj1 with the same data element name";
CM_ SG_ 358 ReSideRdrLeObj6RdrObjVy "Refer to the data element description in ReSideRdrLeObj1 with the same data element name";
CM_ SG_ 358 ReSideRdrLeObj6RdrObjVyStdDe "Refer to the data element description in ReSideRdrLeObj1 with the same data element name";
CM_ SG_ 358 ReSideRdrLeObj6RelVx "Refer to the data element description in ReSideRdrRiObj1 with the same data element name";
CM_ SG_ 358 ReSideRdrLeObj6RelVy "Refer to the data element description in ReSideRdrRiObj1 with the same data element name";
CM_ SG_ 360 ReSideRdrLeObj7Heading "Refer to the data element description in ReSideRdrRiObj1 with the same data element name";
CM_ SG_ 360 ReSideRdrLeObj7ObjBoxCenterLat "Box center y coordinate (relative closest point)";
CM_ SG_ 360 ReSideRdrLeObj7ObjBoxCenterLgt "Refer to the data element description in ReSideRdrLeObj1 with the same data element name";
CM_ SG_ 360 ReSideRdrLeObj7ObservationHist "Refer to the data element description in ReSideRdrRiObj1 with the same data element name";
CM_ SG_ 360 ReSideRdrLeObj7RdrObjAx "Refer to the data element description in ReSideRdrLeObj1 with the same data element name";
CM_ SG_ 360 ReSideRdrLeObj7RdrObjAy "Refer to the data element description in ReSideRdrLeObj1 with the same data element name";
CM_ SG_ 360 ReSideRdrLeObj7RdrObjBoxLength "Refer to the data element description in ReSideRdrRiObj1 with the same data element name";
CM_ SG_ 360 ReSideRdrLeObj7RdrObjBoxWidth "Refer to the data element description in ReSideRdrRiObj1 with the same data element name";
CM_ SG_ 360 ReSideRdrLeObj7RdrObjChks "Refer to the data element description in ReSideRdrLeObj1 with the same data element name";
CM_ SG_ 360 ReSideRdrLeObj7RdrObjCntr "Refer to the data element description in ReSideRdrLeObj1 with the same data element name";
CM_ SG_ 360 ReSideRdrLeObj7RdrObjCoastCnt "Refer to the data element description in ReSideRdrLeObj1 with the same data element name";
CM_ SG_ 360 ReSideRdrLeObj7RdrObjConf "Refer to the data element description in ReSideRdrLeObj1 with the same data element name";
CM_ SG_ 360 ReSideRdrLeObj7RdrObjDx "Refer to the data element description in ReSideRdrLeObj1 with the same data element name";
CM_ SG_ 360 ReSideRdrLeObj7RdrObjDxStdDe "Refer to the data element description in ReSideRdrLeObj1 with the same data element name";
CM_ SG_ 360 ReSideRdrLeObj7RdrObjDy "Refer to the data element description in ReSideRdrLeObj1 with the same data element name";
CM_ SG_ 360 ReSideRdrLeObj7RdrObjDyStdDe "Refer to the data element description in ReSideRdrLeObj1 with the same data element name";
CM_ SG_ 360 ReSideRdrLeObj7RdrObjElevnConf "Refer to the data element description in ReSideRdrLeObj1 with the same data element name";
CM_ SG_ 360 ReSideRdrLeObj7RdrObjElevnSts "Refer to the data element description in ReSideRdrLeObj1 with the same data element name";
CM_ SG_ 360 ReSideRdrLeObj7RdrObjID "Refer to the data element description in ReSideRdrLeObj1 with the same data element name";
CM_ SG_ 360 ReSideRdrLeObj7RdrObjIsInFreeSpace "Refer to the data element description in ReSideRdrLeObj1 with the same data element name";
CM_ SG_ 360 ReSideRdrLeObj7RdrObjMirrProblty "Refer to the data element description in ReSideRdrLeObj1 with the same data element name";
CM_ SG_ 360 ReSideRdrLeObj7RdrObjMtnPat "Refer to the data element description in ReSideRdrLeObj1 with the same data element name";
CM_ SG_ 360 ReSideRdrLeObj7RdrObjNotRealProblty "Refer to the data element description in ReSideRdrLeObj1 with the same data element name";
CM_ SG_ 360 ReSideRdrLeObj7RdrObjStatyCnt "Refer to the data element description in ReSideRdrLeObj1 with the same data element name";
CM_ SG_ 360 ReSideRdrLeObj7RdrObjTiAlv "Refer to the data element description in ReSideRdrLeObj1 with the same data element name";
CM_ SG_ 360 ReSideRdrLeObj7RdrObjTrackSts "Refer to the data element description in ReSideRdrLeObj1 with the same data element name";
CM_ SG_ 360 ReSideRdrLeObj7RdrObjTyp "Refer to the data element description in ReSideRdrLeObj1 with the same data element name";
CM_ SG_ 360 ReSideRdrLeObj7RdrObjTypConfBike "Refer to the data element description in ReSideRdrLeObj1 with the same data element name";
CM_ SG_ 360 ReSideRdrLeObj7RdrObjTypConfPed "Refer to the data element description in ReSideRdrLeObj1 with the same data element name";
CM_ SG_ 360 ReSideRdrLeObj7RdrObjTypConfVeh "Refer to the data element description in ReSideRdrLeObj1 with the same data element name";
CM_ SG_ 360 ReSideRdrLeObj7RdrObjVx "Refer to the data element description in ReSideRdrLeObj1 with the same data element name";
CM_ SG_ 360 ReSideRdrLeObj7RdrObjVxStdDe "Refer to the data element description in ReSideRdrLeObj1 with the same data element name";
CM_ SG_ 360 ReSideRdrLeObj7RdrObjVy "Refer to the data element description in ReSideRdrLeObj1 with the same data element name";
CM_ SG_ 360 ReSideRdrLeObj7RdrObjVyStdDe "Refer to the data element description in ReSideRdrLeObj1 with the same data element name";
CM_ SG_ 360 ReSideRdrLeObj7RelVx "Refer to the data element description in ReSideRdrRiObj1 with the same data element name";
CM_ SG_ 360 ReSideRdrLeObj7RelVy "Refer to the data element description in ReSideRdrRiObj1 with the same data element name";
CM_ SG_ 362 ReSideRdrLeObj8Heading "Refer to the data element description in ReSideRdrRiObj1 with the same data element name";
CM_ SG_ 362 ReSideRdrLeObj8ObjBoxCenterLat "Box center y coordinate (relative closest point)";
CM_ SG_ 362 ReSideRdrLeObj8ObjBoxCenterLgt "Refer to the data element description in ReSideRdrLeObj1 with the same data element name";
CM_ SG_ 362 ReSideRdrLeObj8ObservationHist "Refer to the data element description in ReSideRdrRiObj1 with the same data element name";
CM_ SG_ 362 ReSideRdrLeObj8RdrObjAx "Refer to the data element description in ReSideRdrLeObj1 with the same data element name";
CM_ SG_ 362 ReSideRdrLeObj8RdrObjAy "Refer to the data element description in ReSideRdrLeObj1 with the same data element name";
CM_ SG_ 362 ReSideRdrLeObj8RdrObjBoxLength "Refer to the data element description in ReSideRdrRiObj1 with the same data element name";
CM_ SG_ 362 ReSideRdrLeObj8RdrObjBoxWidth "Refer to the data element description in ReSideRdrRiObj1 with the same data element name";
CM_ SG_ 362 ReSideRdrLeObj8RdrObjChks "Refer to the data element description in ReSideRdrLeObj1 with the same data element name";
CM_ SG_ 362 ReSideRdrLeObj8RdrObjCntr "Refer to the data element description in ReSideRdrLeObj1 with the same data element name";
CM_ SG_ 362 ReSideRdrLeObj8RdrObjCoastCnt "Refer to the data element description in ReSideRdrLeObj1 with the same data element name";
CM_ SG_ 362 ReSideRdrLeObj8RdrObjConf "Refer to the data element description in ReSideRdrLeObj1 with the same data element name";
CM_ SG_ 362 ReSideRdrLeObj8RdrObjDx "Refer to the data element description in ReSideRdrLeObj1 with the same data element name";
CM_ SG_ 362 ReSideRdrLeObj8RdrObjDxStdDe "Refer to the data element description in ReSideRdrLeObj1 with the same data element name";
CM_ SG_ 362 ReSideRdrLeObj8RdrObjDy "Refer to the data element description in ReSideRdrLeObj1 with the same data element name";
CM_ SG_ 362 ReSideRdrLeObj8RdrObjDyStdDe "Refer to the data element description in ReSideRdrLeObj1 with the same data element name";
CM_ SG_ 362 ReSideRdrLeObj8RdrObjElevnConf "Refer to the data element description in ReSideRdrLeObj1 with the same data element name";
CM_ SG_ 362 ReSideRdrLeObj8RdrObjElevnSts "Refer to the data element description in ReSideRdrLeObj1 with the same data element name";
CM_ SG_ 362 ReSideRdrLeObj8RdrObjID "Refer to the data element description in ReSideRdrLeObj1 with the same data element name";
CM_ SG_ 362 ReSideRdrLeObj8RdrObjIsInFreeSpace "Refer to the data element description in ReSideRdrLeObj1 with the same data element name";
CM_ SG_ 362 ReSideRdrLeObj8RdrObjMirrProblty "Refer to the data element description in ReSideRdrLeObj1 with the same data element name";
CM_ SG_ 362 ReSideRdrLeObj8RdrObjMtnPat "Refer to the data element description in ReSideRdrLeObj1 with the same data element name";
CM_ SG_ 362 ReSideRdrLeObj8RdrObjNotRealProblty "Refer to the data element description in ReSideRdrLeObj1 with the same data element name";
CM_ SG_ 362 ReSideRdrLeObj8RdrObjStatyCnt "Refer to the data element description in ReSideRdrLeObj1 with the same data element name";
CM_ SG_ 362 ReSideRdrLeObj8RdrObjTiAlv "Refer to the data element description in ReSideRdrLeObj1 with the same data element name";
CM_ SG_ 362 ReSideRdrLeObj8RdrObjTrackSts "Refer to the data element description in ReSideRdrLeObj1 with the same data element name";
CM_ SG_ 362 ReSideRdrLeObj8RdrObjTyp "Refer to the data element description in ReSideRdrLeObj1 with the same data element name";
CM_ SG_ 362 ReSideRdrLeObj8RdrObjTypConfBike "Refer to the data element description in ReSideRdrLeObj1 with the same data element name";
CM_ SG_ 362 ReSideRdrLeObj8RdrObjTypConfPed "Refer to the data element description in ReSideRdrLeObj1 with the same data element name";
CM_ SG_ 362 ReSideRdrLeObj8RdrObjTypConfVeh "Refer to the data element description in ReSideRdrLeObj1 with the same data element name";
CM_ SG_ 362 ReSideRdrLeObj8RdrObjVx "Refer to the data element description in ReSideRdrLeObj1 with the same data element name";
CM_ SG_ 362 ReSideRdrLeObj8RdrObjVxStdDe "Refer to the data element description in ReSideRdrLeObj1 with the same data element name";
CM_ SG_ 362 ReSideRdrLeObj8RdrObjVy "Refer to the data element description in ReSideRdrLeObj1 with the same data element name";
CM_ SG_ 362 ReSideRdrLeObj8RdrObjVyStdDe "Refer to the data element description in ReSideRdrLeObj1 with the same data element name";
CM_ SG_ 362 ReSideRdrLeObj8RelVx "Refer to the data element description in ReSideRdrRiObj1 with the same data element name";
CM_ SG_ 362 ReSideRdrLeObj8RelVy "Refer to the data element description in ReSideRdrRiObj1 with the same data element name";
CM_ SG_ 364 ReSideRdrLeObj9Heading "Refer to the data element description in ReSideRdrRiObj1 with the same data element name";
CM_ SG_ 364 ReSideRdrLeObj9ObjBoxCenterLat "Box center y coordinate (relative closest point)";
CM_ SG_ 364 ReSideRdrLeObj9ObjBoxCenterLgt "Refer to the data element description in ReSideRdrLeObj1 with the same data element name";
CM_ SG_ 364 ReSideRdrLeObj9ObservationHist "Refer to the data element description in ReSideRdrRiObj1 with the same data element name";
CM_ SG_ 364 ReSideRdrLeObj9RdrObjAx "Refer to the data element description in ReSideRdrLeObj1 with the same data element name";
CM_ SG_ 364 ReSideRdrLeObj9RdrObjAy "Refer to the data element description in ReSideRdrLeObj1 with the same data element name";
CM_ SG_ 364 ReSideRdrLeObj9RdrObjBoxLength "Refer to the data element description in ReSideRdrRiObj1 with the same data element name";
CM_ SG_ 364 ReSideRdrLeObj9RdrObjBoxWidth "Refer to the data element description in ReSideRdrRiObj1 with the same data element name";
CM_ SG_ 364 ReSideRdrLeObj9RdrObjChks "Refer to the data element description in ReSideRdrLeObj1 with the same data element name";
CM_ SG_ 364 ReSideRdrLeObj9RdrObjCntr "Refer to the data element description in ReSideRdrLeObj1 with the same data element name";
CM_ SG_ 364 ReSideRdrLeObj9RdrObjCoastCnt "Refer to the data element description in ReSideRdrLeObj1 with the same data element name";
CM_ SG_ 364 ReSideRdrLeObj9RdrObjConf "Refer to the data element description in ReSideRdrLeObj1 with the same data element name";
CM_ SG_ 364 ReSideRdrLeObj9RdrObjDx "Refer to the data element description in ReSideRdrLeObj1 with the same data element name";
CM_ SG_ 364 ReSideRdrLeObj9RdrObjDxStdDe "Refer to the data element description in ReSideRdrLeObj1 with the same data element name";
CM_ SG_ 364 ReSideRdrLeObj9RdrObjDy "Refer to the data element description in ReSideRdrLeObj1 with the same data element name";
CM_ SG_ 364 ReSideRdrLeObj9RdrObjDyStdDe "Refer to the data element description in ReSideRdrLeObj1 with the same data element name";
CM_ SG_ 364 ReSideRdrLeObj9RdrObjElevnConf "Refer to the data element description in ReSideRdrLeObj1 with the same data element name";
CM_ SG_ 364 ReSideRdrLeObj9RdrObjElevnSts "Refer to the data element description in ReSideRdrLeObj1 with the same data element name";
CM_ SG_ 364 ReSideRdrLeObj9RdrObjID "Refer to the data element description in ReSideRdrLeObj1 with the same data element name";
CM_ SG_ 364 ReSideRdrLeObj9RdrObjIsInFreeSpace "Refer to the data element description in ReSideRdrLeObj1 with the same data element name";
CM_ SG_ 364 ReSideRdrLeObj9RdrObjMirrProblty "Refer to the data element description in ReSideRdrLeObj1 with the same data element name";
CM_ SG_ 364 ReSideRdrLeObj9RdrObjMtnPat "Refer to the data element description in ReSideRdrLeObj1 with the same data element name";
CM_ SG_ 364 ReSideRdrLeObj9RdrObjNotRealProblty "Refer to the data element description in ReSideRdrLeObj1 with the same data element name";
CM_ SG_ 364 ReSideRdrLeObj9RdrObjStatyCnt "Refer to the data element description in ReSideRdrLeObj1 with the same data element name";
CM_ SG_ 364 ReSideRdrLeObj9RdrObjTiAlv "Refer to the data element description in ReSideRdrLeObj1 with the same data element name";
CM_ SG_ 364 ReSideRdrLeObj9RdrObjTrackSts "Refer to the data element description in ReSideRdrLeObj1 with the same data element name";
CM_ SG_ 364 ReSideRdrLeObj9RdrObjTyp "Refer to the data element description in ReSideRdrLeObj1 with the same data element name";
CM_ SG_ 364 ReSideRdrLeObj9RdrObjTypConfBike "Refer to the data element description in ReSideRdrLeObj1 with the same data element name";
CM_ SG_ 364 ReSideRdrLeObj9RdrObjTypConfPed "Refer to the data element description in ReSideRdrLeObj1 with the same data element name";
CM_ SG_ 364 ReSideRdrLeObj9RdrObjTypConfVeh "Refer to the data element description in ReSideRdrLeObj1 with the same data element name";
CM_ SG_ 364 ReSideRdrLeObj9RdrObjVx "Refer to the data element description in ReSideRdrLeObj1 with the same data element name";
CM_ SG_ 364 ReSideRdrLeObj9RdrObjVxStdDe "Refer to the data element description in ReSideRdrLeObj1 with the same data element name";
CM_ SG_ 364 ReSideRdrLeObj9RdrObjVy "Refer to the data element description in ReSideRdrLeObj1 with the same data element name";
CM_ SG_ 364 ReSideRdrLeObj9RdrObjVyStdDe "Refer to the data element description in ReSideRdrLeObj1 with the same data element name";
CM_ SG_ 364 ReSideRdrLeObj9RelVx "Refer to the data element description in ReSideRdrRiObj1 with the same data element name";
CM_ SG_ 364 ReSideRdrLeObj9RelVy "Refer to the data element description in ReSideRdrRiObj1 with the same data element name";
CM_ SG_ 366 ReSideRdrLeObj10Heading "Refer to the data element description in ReSideRdrRiObj1 with the same data element name";
CM_ SG_ 366 ReSideRdrLeObj10ObjBoxCenterLat "Box center y coordinate (relative closest point)";
CM_ SG_ 366 ReSideRdrLeObj10ObjBoxCenterLgt "Refer to the data element description in ReSideRdrLeObj1 with the same data element name";
CM_ SG_ 366 ReSideRdrLeObj10ObservationHist "Refer to the data element description in ReSideRdrRiObj1 with the same data element name";
CM_ SG_ 366 ReSideRdrLeObj10RdrObjAx "Refer to the data element description in ReSideRdrLeObj1 with the same data element name";
CM_ SG_ 366 ReSideRdrLeObj10RdrObjAy "Refer to the data element description in ReSideRdrLeObj1 with the same data element name";
CM_ SG_ 366 ReSideRdrLeObj10RdrObjBoxLength "Refer to the data element description in ReSideRdrRiObj1 with the same data element name";
CM_ SG_ 366 ReSideRdrLeObj10RdrObjBoxWidth "Refer to the data element description in ReSideRdrRiObj1 with the same data element name";
CM_ SG_ 366 ReSideRdrLeObj10RdrObjChks "Refer to the data element description in ReSideRdrLeObj1 with the same data element name";
CM_ SG_ 366 ReSideRdrLeObj10RdrObjCntr "Refer to the data element description in ReSideRdrLeObj1 with the same data element name";
CM_ SG_ 366 ReSideRdrLeObj10RdrObjCoastCnt "Refer to the data element description in ReSideRdrLeObj1 with the same data element name";
CM_ SG_ 366 ReSideRdrLeObj10RdrObjConf "Refer to the data element description in ReSideRdrLeObj1 with the same data element name";
CM_ SG_ 366 ReSideRdrLeObj10RdrObjDx "Refer to the data element description in ReSideRdrLeObj1 with the same data element name";
CM_ SG_ 366 ReSideRdrLeObj10RdrObjDxStdDe "Refer to the data element description in ReSideRdrLeObj1 with the same data element name";
CM_ SG_ 366 ReSideRdrLeObj10RdrObjDy "Refer to the data element description in ReSideRdrLeObj1 with the same data element name";
CM_ SG_ 366 ReSideRdrLeObj10RdrObjDyStdDe "Refer to the data element description in ReSideRdrLeObj1 with the same data element name";
CM_ SG_ 366 ReSideRdrLeObj10RdrObjElevnConf "Refer to the data element description in ReSideRdrLeObj1 with the same data element name";
CM_ SG_ 366 ReSideRdrLeObj10RdrObjElevnSts "Refer to the data element description in ReSideRdrLeObj1 with the same data element name";
CM_ SG_ 366 ReSideRdrLeObj10RdrObjID "Refer to the data element description in ReSideRdrLeObj1 with the same data element name";
CM_ SG_ 366 ReSideRdrLeObj10RdrObjIsInFreeSpace "Refer to the data element description in ReSideRdrLeObj1 with the same data element name";
CM_ SG_ 366 ReSideRdrLeObj10RdrObjMirrProblty "Refer to the data element description in ReSideRdrLeObj1 with the same data element name";
CM_ SG_ 366 ReSideRdrLeObj10RdrObjMtnPat "Refer to the data element description in ReSideRdrLeObj1 with the same data element name";
CM_ SG_ 366 ReSideRdrLeObj10RdrObjNotRealProblty "Refer to the data element description in ReSideRdrLeObj1 with the same data element name";
CM_ SG_ 366 ReSideRdrLeObj10RdrObjStatyCnt "Refer to the data element description in ReSideRdrLeObj1 with the same data element name";
CM_ SG_ 366 ReSideRdrLeObj10RdrObjTiAlv "Refer to the data element description in ReSideRdrLeObj1 with the same data element name";
CM_ SG_ 366 ReSideRdrLeObj10RdrObjTrackSts "Refer to the data element description in ReSideRdrLeObj1 with the same data element name";
CM_ SG_ 366 ReSideRdrLeObj10RdrObjTyp "Refer to the data element description in ReSideRdrLeObj1 with the same data element name";
CM_ SG_ 366 ReSideRdrLeObj10RdrObjTypConfBike "Refer to the data element description in ReSideRdrLeObj1 with the same data element name";
CM_ SG_ 366 ReSideRdrLeObj10RdrObjTypConfPed "Refer to the data element description in ReSideRdrLeObj1 with the same data element name";
CM_ SG_ 366 ReSideRdrLeObj10RdrObjTypConfVeh "Refer to the data element description in ReSideRdrLeObj1 with the same data element name";
CM_ SG_ 366 ReSideRdrLeObj10RdrObjVx "Refer to the data element description in ReSideRdrLeObj1 with the same data element name";
CM_ SG_ 366 ReSideRdrLeObj10RdrObjVxStdDe "Refer to the data element description in ReSideRdrLeObj1 with the same data element name";
CM_ SG_ 366 ReSideRdrLeObj10RdrObjVy "Refer to the data element description in ReSideRdrLeObj1 with the same data element name";
CM_ SG_ 366 ReSideRdrLeObj10RdrObjVyStdDe "Refer to the data element description in ReSideRdrLeObj1 with the same data element name";
CM_ SG_ 366 ReSideRdrLeObj10RelVx "Refer to the data element description in ReSideRdrRiObj1 with the same data element name";
CM_ SG_ 366 ReSideRdrLeObj10RelVy "Refer to the data element description in ReSideRdrRiObj1 with the same data element name";
CM_ SG_ 368 ReSideRdrLeObj11Heading "Refer to the data element description in ReSideRdrRiObj1 with the same data element name";
CM_ SG_ 368 ReSideRdrLeObj11ObjBoxCenterLat "Refer to the data element description in ReSideRdrLeObj1 with the same data element name";
CM_ SG_ 368 ReSideRdrLeObj11ObjBoxCenterLgt "Refer to the data element description in ReSideRdrLeObj1 with the same data element name";
CM_ SG_ 368 ReSideRdrLeObj11ObservationHist "Refer to the data element description in ReSideRdrRiObj1 with the same data element name";
CM_ SG_ 368 ReSideRdrLeObj11RdrObjAx "Refer to the data element description in ReSideRdrLeObj1 with the same data element name";
CM_ SG_ 368 ReSideRdrLeObj11RdrObjAy "Refer to the data element description in ReSideRdrLeObj1 with the same data element name";
CM_ SG_ 368 ReSideRdrLeObj11RdrObjBoxLength "Refer to the data element description in ReSideRdrRiObj1 with the same data element name";
CM_ SG_ 368 ReSideRdrLeObj11RdrObjBoxWidth "Refer to the data element description in ReSideRdrRiObj1 with the same data element name";
CM_ SG_ 368 ReSideRdrLeObj11RdrObjChks "Refer to the data element description in ReSideRdrLeObj1 with the same data element name";
CM_ SG_ 368 ReSideRdrLeObj11RdrObjCntr "Refer to the data element description in ReSideRdrLeObj1 with the same data element name";
CM_ SG_ 368 ReSideRdrLeObj11RdrObjCoastCnt "Refer to the data element description in ReSideRdrLeObj1 with the same data element name";
CM_ SG_ 368 ReSideRdrLeObj11RdrObjConf "Refer to the data element description in ReSideRdrLeObj1 with the same data element name";
CM_ SG_ 368 ReSideRdrLeObj11RdrObjDx "Refer to the data element description in ReSideRdrLeObj1 with the same data element name";
CM_ SG_ 368 ReSideRdrLeObj11RdrObjDxStdDe "Refer to the data element description in ReSideRdrLeObj1 with the same data element name";
CM_ SG_ 368 ReSideRdrLeObj11RdrObjDy "Refer to the data element description in ReSideRdrLeObj1 with the same data element name";
CM_ SG_ 368 ReSideRdrLeObj11RdrObjDyStdDe "Refer to the data element description in ReSideRdrLeObj1 with the same data element name";
CM_ SG_ 368 ReSideRdrLeObj11RdrObjElevnConf "Refer to the data element description in ReSideRdrLeObj1 with the same data element name";
CM_ SG_ 368 ReSideRdrLeObj11RdrObjElevnSts "Refer to the data element description in ReSideRdrLeObj1 with the same data element name";
CM_ SG_ 368 ReSideRdrLeObj11RdrObjID "Refer to the data element description in ReSideRdrLeObj1 with the same data element name";
CM_ SG_ 368 ReSideRdrLeObj11RdrObjIsInFreeSpace "Refer to the data element description in ReSideRdrLeObj1 with the same data element name";
CM_ SG_ 368 ReSideRdrLeObj11RdrObjMirrProblty "Refer to the data element description in ReSideRdrLeObj1 with the same data element name";
CM_ SG_ 368 ReSideRdrLeObj11RdrObjMtnPat "Refer to the data element description in ReSideRdrLeObj1 with the same data element name";
CM_ SG_ 368 ReSideRdrLeObj11RdrObjNotRealProblty "Refer to the data element description in ReSideRdrLeObj1 with the same data element name";
CM_ SG_ 368 ReSideRdrLeObj11RdrObjStatyCnt "Refer to the data element description in ReSideRdrLeObj1 with the same data element name";
CM_ SG_ 368 ReSideRdrLeObj11RdrObjTiAlv "Refer to the data element description in ReSideRdrLeObj1 with the same data element name";
CM_ SG_ 368 ReSideRdrLeObj11RdrObjTrackSts "Refer to the data element description in ReSideRdrLeObj1 with the same data element name";
CM_ SG_ 368 ReSideRdrLeObj11RdrObjTyp "Refer to the data element description in ReSideRdrLeObj1 with the same data element name";
CM_ SG_ 368 ReSideRdrLeObj11RdrObjTypConfBike "Refer to the data element description in ReSideRdrLeObj1 with the same data element name";
CM_ SG_ 368 ReSideRdrLeObj11RdrObjTypConfPed "Refer to the data element description in ReSideRdrLeObj1 with the same data element name";
CM_ SG_ 368 ReSideRdrLeObj11RdrObjTypConfVeh "Refer to the data element description in ReSideRdrLeObj1 with the same data element name";
CM_ SG_ 368 ReSideRdrLeObj11RdrObjVx "Refer to the data element description in ReSideRdrLeObj1 with the same data element name";
CM_ SG_ 368 ReSideRdrLeObj11RdrObjVxStdDe "Refer to the data element description in ReSideRdrLeObj1 with the same data element name";
CM_ SG_ 368 ReSideRdrLeObj11RdrObjVy "Refer to the data element description in ReSideRdrLeObj1 with the same data element name";
CM_ SG_ 368 ReSideRdrLeObj11RdrObjVyStdDe "Refer to the data element description in ReSideRdrLeObj1 with the same data element name";
CM_ SG_ 368 ReSideRdrLeObj11RelVx "Refer to the data element description in ReSideRdrRiObj1 with the same data element name";
CM_ SG_ 368 ReSideRdrLeObj11RelVy "Refer to the data element description in ReSideRdrRiObj1 with the same data element name";
CM_ SG_ 370 ReSideRdrLeObj12Heading "Refer to the data element description in ReSideRdrRiObj1 with the same data element name";
CM_ SG_ 370 ReSideRdrLeObj12ObjBoxCenterLat "Refer to the data element description in ReSideRdrLeObj1 with the same data element name";
CM_ SG_ 370 ReSideRdrLeObj12ObjBoxCenterLgt "Refer to the data element description in ReSideRdrLeObj1 with the same data element name";
CM_ SG_ 370 ReSideRdrLeObj12ObservationHist "Refer to the data element description in ReSideRdrRiObj1 with the same data element name";
CM_ SG_ 370 ReSideRdrLeObj12RdrObjAx "Refer to the data element description in ReSideRdrLeObj1 with the same data element name";
CM_ SG_ 370 ReSideRdrLeObj12RdrObjAy "Refer to the data element description in ReSideRdrLeObj1 with the same data element name";
CM_ SG_ 370 ReSideRdrLeObj12RdrObjBoxLength "Refer to the data element description in ReSideRdrRiObj1 with the same data element name";
CM_ SG_ 370 ReSideRdrLeObj12RdrObjBoxWidth "Refer to the data element description in ReSideRdrRiObj1 with the same data element name";
CM_ SG_ 370 ReSideRdrLeObj12RdrObjChks "Refer to the data element description in ReSideRdrLeObj1 with the same data element name";
CM_ SG_ 370 ReSideRdrLeObj12RdrObjCntr "Refer to the data element description in ReSideRdrLeObj1 with the same data element name";
CM_ SG_ 370 ReSideRdrLeObj12RdrObjCoastCnt "Refer to the data element description in ReSideRdrLeObj1 with the same data element name";
CM_ SG_ 370 ReSideRdrLeObj12RdrObjConf "Refer to the data element description in ReSideRdrLeObj1 with the same data element name";
CM_ SG_ 370 ReSideRdrLeObj12RdrObjDx "Refer to the data element description in ReSideRdrLeObj1 with the same data element name";
CM_ SG_ 370 ReSideRdrLeObj12RdrObjDxStdDe "Refer to the data element description in ReSideRdrLeObj1 with the same data element name";
CM_ SG_ 370 ReSideRdrLeObj12RdrObjDy "Refer to the data element description in ReSideRdrLeObj1 with the same data element name";
CM_ SG_ 370 ReSideRdrLeObj12RdrObjDyStdDe "Refer to the data element description in ReSideRdrLeObj1 with the same data element name";
CM_ SG_ 370 ReSideRdrLeObj12RdrObjElevnConf "Refer to the data element description in ReSideRdrLeObj1 with the same data element name";
CM_ SG_ 370 ReSideRdrLeObj12RdrObjElevnSts "Refer to the data element description in ReSideRdrLeObj1 with the same data element name";
CM_ SG_ 370 ReSideRdrLeObj12RdrObjID "Refer to the data element description in ReSideRdrLeObj1 with the same data element name";
CM_ SG_ 370 ReSideRdrLeObj12RdrObjIsInFreeSpace "Refer to the data element description in ReSideRdrLeObj1 with the same data element name";
CM_ SG_ 370 ReSideRdrLeObj12RdrObjMirrProblty "Refer to the data element description in ReSideRdrLeObj1 with the same data element name";
CM_ SG_ 370 ReSideRdrLeObj12RdrObjMtnPat "Refer to the data element description in ReSideRdrLeObj1 with the same data element name";
CM_ SG_ 370 ReSideRdrLeObj12RdrObjNotRealProblty "Refer to the data element description in ReSideRdrLeObj1 with the same data element name";
CM_ SG_ 370 ReSideRdrLeObj12RdrObjStatyCnt "Refer to the data element description in ReSideRdrLeObj1 with the same data element name";
CM_ SG_ 370 ReSideRdrLeObj12RdrObjTiAlv "Refer to the data element description in ReSideRdrLeObj1 with the same data element name";
CM_ SG_ 370 ReSideRdrLeObj12RdrObjTrackSts "Refer to the data element description in ReSideRdrLeObj1 with the same data element name";
CM_ SG_ 370 ReSideRdrLeObj12RdrObjTyp "Refer to the data element description in ReSideRdrLeObj1 with the same data element name";
CM_ SG_ 370 ReSideRdrLeObj12RdrObjTypConfBike "Refer to the data element description in ReSideRdrLeObj1 with the same data element name";
CM_ SG_ 370 ReSideRdrLeObj12RdrObjTypConfPed "Refer to the data element description in ReSideRdrLeObj1 with the same data element name";
CM_ SG_ 370 ReSideRdrLeObj12RdrObjTypConfVeh "Refer to the data element description in ReSideRdrLeObj1 with the same data element name";
CM_ SG_ 370 ReSideRdrLeObj12RdrObjVx "Refer to the data element description in ReSideRdrLeObj1 with the same data element name";
CM_ SG_ 370 ReSideRdrLeObj12RdrObjVxStdDe "Refer to the data element description in ReSideRdrLeObj1 with the same data element name";
CM_ SG_ 370 ReSideRdrLeObj12RdrObjVy "Refer to the data element description in ReSideRdrLeObj1 with the same data element name";
CM_ SG_ 370 ReSideRdrLeObj12RdrObjVyStdDe "Refer to the data element description in ReSideRdrLeObj1 with the same data element name";
CM_ SG_ 370 ReSideRdrLeObj12RelVx "Refer to the data element description in ReSideRdrRiObj1 with the same data element name";
CM_ SG_ 370 ReSideRdrLeObj12RelVy "Refer to the data element description in ReSideRdrRiObj1 with the same data element name";
CM_ SG_ 372 ReSideRdrLeObj13Heading "Refer to the data element description in ReSideRdrRiObj1 with the same data element name";
CM_ SG_ 372 ReSideRdrLeObj13ObjBoxCenterLat "Refer to the data element description in ReSideRdrLeObj1 with the same data element name";
CM_ SG_ 372 ReSideRdrLeObj13ObjBoxCenterLgt "Refer to the data element description in ReSideRdrLeObj1 with the same data element name";
CM_ SG_ 372 ReSideRdrLeObj13ObservationHist "Refer to the data element description in ReSideRdrRiObj1 with the same data element name";
CM_ SG_ 372 ReSideRdrLeObj13RdrObjAx "Refer to the data element description in ReSideRdrLeObj1 with the same data element name";
CM_ SG_ 372 ReSideRdrLeObj13RdrObjAy "Refer to the data element description in ReSideRdrLeObj1 with the same data element name";
CM_ SG_ 372 ReSideRdrLeObj13RdrObjBoxLength "Refer to the data element description in ReSideRdrRiObj1 with the same data element name";
CM_ SG_ 372 ReSideRdrLeObj13RdrObjBoxWidth "Refer to the data element description in ReSideRdrRiObj1 with the same data element name";
CM_ SG_ 372 ReSideRdrLeObj13RdrObjChks "Refer to the data element description in ReSideRdrLeObj1 with the same data element name";
CM_ SG_ 372 ReSideRdrLeObj13RdrObjCntr "Refer to the data element description in ReSideRdrLeObj1 with the same data element name";
CM_ SG_ 372 ReSideRdrLeObj13RdrObjCoastCnt "Refer to the data element description in ReSideRdrLeObj1 with the same data element name";
CM_ SG_ 372 ReSideRdrLeObj13RdrObjConf "Refer to the data element description in ReSideRdrLeObj1 with the same data element name";
CM_ SG_ 372 ReSideRdrLeObj13RdrObjDx "Refer to the data element description in ReSideRdrLeObj1 with the same data element name";
CM_ SG_ 372 ReSideRdrLeObj13RdrObjDxStdDe "Refer to the data element description in ReSideRdrLeObj1 with the same data element name";
CM_ SG_ 372 ReSideRdrLeObj13RdrObjDy "Refer to the data element description in ReSideRdrLeObj1 with the same data element name";
CM_ SG_ 372 ReSideRdrLeObj13RdrObjDyStdDe "Refer to the data element description in ReSideRdrLeObj1 with the same data element name";
CM_ SG_ 372 ReSideRdrLeObj13RdrObjElevnConf "Refer to the data element description in ReSideRdrLeObj1 with the same data element name";
CM_ SG_ 372 ReSideRdrLeObj13RdrObjElevnSts "Refer to the data element description in ReSideRdrLeObj1 with the same data element name";
CM_ SG_ 372 ReSideRdrLeObj13RdrObjID "Refer to the data element description in ReSideRdrLeObj1 with the same data element name";
CM_ SG_ 372 ReSideRdrLeObj13RdrObjIsInFreeSpace "Refer to the data element description in ReSideRdrLeObj1 with the same data element name";
CM_ SG_ 372 ReSideRdrLeObj13RdrObjMirrProblty "Refer to the data element description in ReSideRdrLeObj1 with the same data element name";
CM_ SG_ 372 ReSideRdrLeObj13RdrObjMtnPat "Refer to the data element description in ReSideRdrLeObj1 with the same data element name";
CM_ SG_ 372 ReSideRdrLeObj13RdrObjNotRealProblty "Refer to the data element description in ReSideRdrLeObj1 with the same data element name";
CM_ SG_ 372 ReSideRdrLeObj13RdrObjStatyCnt "Refer to the data element description in ReSideRdrLeObj1 with the same data element name";
CM_ SG_ 372 ReSideRdrLeObj13RdrObjTiAlv "Refer to the data element description in ReSideRdrLeObj1 with the same data element name";
CM_ SG_ 372 ReSideRdrLeObj13RdrObjTrackSts "Refer to the data element description in ReSideRdrLeObj1 with the same data element name";
CM_ SG_ 372 ReSideRdrLeObj13RdrObjTyp "Refer to the data element description in ReSideRdrLeObj1 with the same data element name";
CM_ SG_ 372 ReSideRdrLeObj13RdrObjTypConfBike "Refer to the data element description in ReSideRdrLeObj1 with the same data element name";
CM_ SG_ 372 ReSideRdrLeObj13RdrObjTypConfPed "Refer to the data element description in ReSideRdrLeObj1 with the same data element name";
CM_ SG_ 372 ReSideRdrLeObj13RdrObjTypConfVeh "Refer to the data element description in ReSideRdrLeObj1 with the same data element name";
CM_ SG_ 372 ReSideRdrLeObj13RdrObjVx "Refer to the data element description in ReSideRdrLeObj1 with the same data element name";
CM_ SG_ 372 ReSideRdrLeObj13RdrObjVxStdDe "Refer to the data element description in ReSideRdrLeObj1 with the same data element name";
CM_ SG_ 372 ReSideRdrLeObj13RdrObjVy "Refer to the data element description in ReSideRdrLeObj1 with the same data element name";
CM_ SG_ 372 ReSideRdrLeObj13RdrObjVyStdDe "Refer to the data element description in ReSideRdrLeObj1 with the same data element name";
CM_ SG_ 372 ReSideRdrLeObj13RelVx "Refer to the data element description in ReSideRdrRiObj1 with the same data element name";
CM_ SG_ 372 ReSideRdrLeObj13RelVy "Refer to the data element description in ReSideRdrRiObj1 with the same data element name";
CM_ SG_ 374 ReSideRdrLeObj14Heading "Refer to the data element description in ReSideRdrRiObj1 with the same data element name";
CM_ SG_ 374 ReSideRdrLeObj14ObjBoxCenterLat "Refer to the data element description in ReSideRdrLeObj1 with the same data element name";
CM_ SG_ 374 ReSideRdrLeObj14ObjBoxCenterLgt "Refer to the data element description in ReSideRdrLeObj1 with the same data element name";
CM_ SG_ 374 ReSideRdrLeObj14ObservationHist "Refer to the data element description in ReSideRdrRiObj1 with the same data element name";
CM_ SG_ 374 ReSideRdrLeObj14RdrObjAx "Refer to the data element description in ReSideRdrLeObj1 with the same data element name";
CM_ SG_ 374 ReSideRdrLeObj14RdrObjAy "Refer to the data element description in ReSideRdrLeObj1 with the same data element name";
CM_ SG_ 374 ReSideRdrLeObj14RdrObjBoxLength "Refer to the data element description in ReSideRdrRiObj1 with the same data element name";
CM_ SG_ 374 ReSideRdrLeObj14RdrObjBoxWidth "Refer to the data element description in ReSideRdrRiObj1 with the same data element name";
CM_ SG_ 374 ReSideRdrLeObj14RdrObjChks "Refer to the data element description in ReSideRdrLeObj1 with the same data element name";
CM_ SG_ 374 ReSideRdrLeObj14RdrObjCntr "Refer to the data element description in ReSideRdrLeObj1 with the same data element name";
CM_ SG_ 374 ReSideRdrLeObj14RdrObjCoastCnt "Refer to the data element description in ReSideRdrLeObj1 with the same data element name";
CM_ SG_ 374 ReSideRdrLeObj14RdrObjConf "Refer to the data element description in ReSideRdrLeObj1 with the same data element name";
CM_ SG_ 374 ReSideRdrLeObj14RdrObjDx "Refer to the data element description in ReSideRdrLeObj1 with the same data element name";
CM_ SG_ 374 ReSideRdrLeObj14RdrObjDxStdDe "Refer to the data element description in ReSideRdrLeObj1 with the same data element name";
CM_ SG_ 374 ReSideRdrLeObj14RdrObjDy "Refer to the data element description in ReSideRdrLeObj1 with the same data element name";
CM_ SG_ 374 ReSideRdrLeObj14RdrObjDyStdDe "Refer to the data element description in ReSideRdrLeObj1 with the same data element name";
CM_ SG_ 374 ReSideRdrLeObj14RdrObjElevnConf "Refer to the data element description in ReSideRdrLeObj1 with the same data element name";
CM_ SG_ 374 ReSideRdrLeObj14RdrObjElevnSts "Refer to the data element description in ReSideRdrLeObj1 with the same data element name";
CM_ SG_ 374 ReSideRdrLeObj14RdrObjID "Refer to the data element description in ReSideRdrLeObj1 with the same data element name";
CM_ SG_ 374 ReSideRdrLeObj14RdrObjIsInFreeSpace "Refer to the data element description in ReSideRdrLeObj1 with the same data element name";
CM_ SG_ 374 ReSideRdrLeObj14RdrObjMirrProblty "Refer to the data element description in ReSideRdrLeObj1 with the same data element name";
CM_ SG_ 374 ReSideRdrLeObj14RdrObjMtnPat "Refer to the data element description in ReSideRdrLeObj1 with the same data element name";
CM_ SG_ 374 ReSideRdrLeObj14RdrObjNotRealProblty "Refer to the data element description in ReSideRdrLeObj1 with the same data element name";
CM_ SG_ 374 ReSideRdrLeObj14RdrObjStatyCnt "Refer to the data element description in ReSideRdrLeObj1 with the same data element name";
CM_ SG_ 374 ReSideRdrLeObj14RdrObjTiAlv "Refer to the data element description in ReSideRdrLeObj1 with the same data element name";
CM_ SG_ 374 ReSideRdrLeObj14RdrObjTrackSts "Refer to the data element description in ReSideRdrLeObj1 with the same data element name";
CM_ SG_ 374 ReSideRdrLeObj14RdrObjTyp "Refer to the data element description in ReSideRdrLeObj1 with the same data element name";
CM_ SG_ 374 ReSideRdrLeObj14RdrObjTypConfBike "Refer to the data element description in ReSideRdrLeObj1 with the same data element name";
CM_ SG_ 374 ReSideRdrLeObj14RdrObjTypConfPed "Refer to the data element description in ReSideRdrLeObj1 with the same data element name";
CM_ SG_ 374 ReSideRdrLeObj14RdrObjTypConfVeh "Refer to the data element description in ReSideRdrLeObj1 with the same data element name";
CM_ SG_ 374 ReSideRdrLeObj14RdrObjVx "Refer to the data element description in ReSideRdrLeObj1 with the same data element name";
CM_ SG_ 374 ReSideRdrLeObj14RdrObjVxStdDe "Refer to the data element description in ReSideRdrLeObj1 with the same data element name";
CM_ SG_ 374 ReSideRdrLeObj14RdrObjVy "Refer to the data element description in ReSideRdrLeObj1 with the same data element name";
CM_ SG_ 374 ReSideRdrLeObj14RdrObjVyStdDe "Refer to the data element description in ReSideRdrLeObj1 with the same data element name";
CM_ SG_ 374 ReSideRdrLeObj14RelVx "Refer to the data element description in ReSideRdrRiObj1 with the same data element name";
CM_ SG_ 374 ReSideRdrLeObj14RelVy "Refer to the data element description in ReSideRdrRiObj1 with the same data element name";
BA_DEF_ BO_ "VFrameFormat" ENUM "StandardCAN","ExtendedCAN","reserved","J1939PG","reserved","reserved","reserved","reserved","reserved","reserved","reserved","reserved","reserved","reserved","StandardCAN_FD","ExtendedCAN_FD";
BA_DEF_ BO_ "CANFD_BRS" ENUM "0","1";
BA_DEF_ BO_ "GenMsgSendType" ENUM "cyclic", "spontaneous", "not-used", "not-used", "not-used", "cyclicAndSpontaneous", "not-used", "cyclicIfActive", "NoMsgSendType"; // [us]
BA_DEF_ BO_ "GenMsgCycleTime" INT 0 65536; // [ms]
BA_DEF_ BO_ "GenMsgStartDelayTime" INT 0 65536; // [ms]
BA_DEF_ BO_ "GenMsgDelayTime" INT 0 65536; // [ms]
BA_DEF_ SG_ "GenSigSendType" ENUM "Cyclic","OnWrite","OnWriteWithRepetition","OnChange","OnChangeWithRepetition","IfActive","IfActiveWithRepetition","NoSigSendType";
BA_DEF_ SG_ "GenSigStartValue" HEX 0 80000000;
BA_DEF_ BO_ "GenMsgILSupport" ENUM "No","Yes";
BA_DEF_ BO_ "NmAsrMessage" ENUM "No","Yes";
BA_DEF_ SG_ "GenSigFuncType" ENUM "NoFunction","n/a","n/a","n/a","n/a","n/a","n/a","n/a","n/a","n/a","n/a","n/a","n/a","n/a","n/a","CHK","CNTR","n/a","n/a","n/a","CNTR_AR_01","CRC_AR_01_BOTH","CRC_AR_01_ALT","CRC_AR_01_LOW","CRC_AR_01_NIBBLE","CNTR_AR_04","CRC_AR_04A","CNTR_AR_05","CRC_AR_05";
BA_DEF_ SG_ "GenSigDataID" STRING;

BA_DEF_DEF_ "VFrameFormat" "J1939PG";
BA_DEF_DEF_ "CANFD_BRS" "1";
BA_DEF_DEF_ "GenSigStartValue" 0;
BA_DEF_DEF_ "GenSigSendType" "NoSigSendType";
BA_DEF_DEF_ "GenMsgCycleTime" 0;
BA_DEF_DEF_ "GenMsgDelayTime" 0;
BA_DEF_DEF_ "GenMsgStartDelayTime" 0;
BA_DEF_DEF_ "GenMsgSendType" "NoMsgSendType";
BA_DEF_DEF_ "GenMsgILSupport" "Yes";
BA_DEF_DEF_ "NmAsrMessage" "No";
BA_DEF_DEF_ "GenSigFuncType" "NoFunction";
BA_DEF_DEF_ "GenSigDataID" "";
// Frame: SODLSafetyCANFD3Frame24
BA_ "VFrameFormat" BO_ 350 14;
BA_ "GenMsgSendType" BO_ 350 0;
BA_ "GenMsgCycleTime" BO_ 350 50.000;
BA_ "GenSigStartValue" SG_ 350 ReSideRdrLeObj2Heading 1800;
BA_ "GenSigSendType" SG_ 350 ReSideRdrLeObj2Heading 0;
BA_ "GenSigStartValue" SG_ 350 ReSideRdrLeObj2ObjBoxCenterLat 250;
BA_ "GenSigSendType" SG_ 350 ReSideRdrLeObj2ObjBoxCenterLat 0;
BA_ "GenSigStartValue" SG_ 350 ReSideRdrLeObj2ObjBoxCenterLgt 250;
BA_ "GenSigSendType" SG_ 350 ReSideRdrLeObj2ObjBoxCenterLgt 0;
BA_ "GenSigSendType" SG_ 350 ReSideRdrLeObj2ObservationHist 0;
BA_ "GenSigSendType" SG_ 350 ReSideRdrLeObj2RdrObjAx 0;
BA_ "GenSigSendType" SG_ 350 ReSideRdrLeObj2RdrObjAy 0;
BA_ "GenSigSendType" SG_ 350 ReSideRdrLeObj2RdrObjBoxLength 0;
BA_ "GenSigSendType" SG_ 350 ReSideRdrLeObj2RdrObjBoxWidth 0;
BA_ "GenSigSendType" SG_ 350 ReSideRdrLeObj2RdrObjChks 0;
BA_ "GenSigFuncType" SG_ 350 ReSideRdrLeObj2RdrObjChks 15;
BA_ "GenSigDataID" SG_ 350 ReSideRdrLeObj2RdrObjChks "0xA13";
BA_ "GenSigSendType" SG_ 350 ReSideRdrLeObj2RdrObjCntr 0;
BA_ "GenSigFuncType" SG_ 350 ReSideRdrLeObj2RdrObjCntr 16;
BA_ "GenSigStartValue" SG_ 350 ReSideRdrLeObj2RdrObjCoastCnt 31;
BA_ "GenSigSendType" SG_ 350 ReSideRdrLeObj2RdrObjCoastCnt 0;
BA_ "GenSigSendType" SG_ 350 ReSideRdrLeObj2RdrObjConf 0;
BA_ "GenSigSendType" SG_ 350 ReSideRdrLeObj2RdrObjDx 0;
BA_ "GenSigSendType" SG_ 350 ReSideRdrLeObj2RdrObjDxStdDe 0;
BA_ "GenSigStartValue" SG_ 350 ReSideRdrLeObj2RdrObjDy 4000;
BA_ "GenSigSendType" SG_ 350 ReSideRdrLeObj2RdrObjDy 0;
BA_ "GenSigSendType" SG_ 350 ReSideRdrLeObj2RdrObjDyStdDe 0;
BA_ "GenSigSendType" SG_ 350 ReSideRdrLeObj2RdrObjElevnConf 0;
BA_ "GenSigSendType" SG_ 350 ReSideRdrLeObj2RdrObjElevnSts 0;
BA_ "GenSigSendType" SG_ 350 ReSideRdrLeObj2RdrObjID 0;
BA_ "GenSigStartValue" SG_ 350 ReSideRdrLeObj2RdrObjIsInFreeSpace 1;
BA_ "GenSigSendType" SG_ 350 ReSideRdrLeObj2RdrObjIsInFreeSpace 0;
BA_ "GenSigSendType" SG_ 350 ReSideRdrLeObj2RdrObjMirrProblty 0;
BA_ "GenSigStartValue" SG_ 350 ReSideRdrLeObj2RdrObjMtnPat 3;
BA_ "GenSigSendType" SG_ 350 ReSideRdrLeObj2RdrObjMtnPat 0;
BA_ "GenSigSendType" SG_ 350 ReSideRdrLeObj2RdrObjNotRealProblty 0;
BA_ "GenSigSendType" SG_ 350 ReSideRdrLeObj2RdrObjStatyCnt 0;
BA_ "GenSigSendType" SG_ 350 ReSideRdrLeObj2RdrObjTiAlv 0;
BA_ "GenSigSendType" SG_ 350 ReSideRdrLeObj2RdrObjTrackSts 0;
BA_ "GenSigSendType" SG_ 350 ReSideRdrLeObj2RdrObjTyp 0;
BA_ "GenSigSendType" SG_ 350 ReSideRdrLeObj2RdrObjTypConfBike 0;
BA_ "GenSigSendType" SG_ 350 ReSideRdrLeObj2RdrObjTypConfPed 0;
BA_ "GenSigSendType" SG_ 350 ReSideRdrLeObj2RdrObjTypConfVeh 0;
BA_ "GenSigStartValue" SG_ 350 ReSideRdrLeObj2RdrObjVx 6400;
BA_ "GenSigSendType" SG_ 350 ReSideRdrLeObj2RdrObjVx 0;
BA_ "GenSigSendType" SG_ 350 ReSideRdrLeObj2RdrObjVxStdDe 0;
BA_ "GenSigStartValue" SG_ 350 ReSideRdrLeObj2RdrObjVy 6400;
BA_ "GenSigSendType" SG_ 350 ReSideRdrLeObj2RdrObjVy 0;
BA_ "GenSigSendType" SG_ 350 ReSideRdrLeObj2RdrObjVyStdDe 0;
BA_ "GenSigStartValue" SG_ 350 ReSideRdrLeObj2RelVx 1780;
BA_ "GenSigSendType" SG_ 350 ReSideRdrLeObj2RelVx 0;
BA_ "GenSigStartValue" SG_ 350 ReSideRdrLeObj2RelVy 1780;
BA_ "GenSigSendType" SG_ 350 ReSideRdrLeObj2RelVy 0;
// Frame: SODLSafetyCANFD3Frame25
BA_ "VFrameFormat" BO_ 352 14;
BA_ "GenMsgSendType" BO_ 352 0;
BA_ "GenMsgCycleTime" BO_ 352 50.000;
BA_ "GenSigStartValue" SG_ 352 ReSideRdrLeObj3Heading 1800;
BA_ "GenSigSendType" SG_ 352 ReSideRdrLeObj3Heading 0;
BA_ "GenSigStartValue" SG_ 352 ReSideRdrLeObj3ObjBoxCenterLat 250;
BA_ "GenSigSendType" SG_ 352 ReSideRdrLeObj3ObjBoxCenterLat 0;
BA_ "GenSigStartValue" SG_ 352 ReSideRdrLeObj3ObjBoxCenterLgt 250;
BA_ "GenSigSendType" SG_ 352 ReSideRdrLeObj3ObjBoxCenterLgt 0;
BA_ "GenSigSendType" SG_ 352 ReSideRdrLeObj3ObservationHist 0;
BA_ "GenSigSendType" SG_ 352 ReSideRdrLeObj3RdrObjAx 0;
BA_ "GenSigSendType" SG_ 352 ReSideRdrLeObj3RdrObjAy 0;
BA_ "GenSigSendType" SG_ 352 ReSideRdrLeObj3RdrObjBoxLength 0;
BA_ "GenSigSendType" SG_ 352 ReSideRdrLeObj3RdrObjBoxWidth 0;
BA_ "GenSigSendType" SG_ 352 ReSideRdrLeObj3RdrObjChks 0;
BA_ "GenSigFuncType" SG_ 352 ReSideRdrLeObj3RdrObjChks 15;
BA_ "GenSigDataID" SG_ 352 ReSideRdrLeObj3RdrObjChks "0xA14";
BA_ "GenSigSendType" SG_ 352 ReSideRdrLeObj3RdrObjCntr 0;
BA_ "GenSigFuncType" SG_ 352 ReSideRdrLeObj3RdrObjCntr 16;
BA_ "GenSigStartValue" SG_ 352 ReSideRdrLeObj3RdrObjCoastCnt 31;
BA_ "GenSigSendType" SG_ 352 ReSideRdrLeObj3RdrObjCoastCnt 0;
BA_ "GenSigSendType" SG_ 352 ReSideRdrLeObj3RdrObjConf 0;
BA_ "GenSigSendType" SG_ 352 ReSideRdrLeObj3RdrObjDx 0;
BA_ "GenSigSendType" SG_ 352 ReSideRdrLeObj3RdrObjDxStdDe 0;
BA_ "GenSigStartValue" SG_ 352 ReSideRdrLeObj3RdrObjDy 4000;
BA_ "GenSigSendType" SG_ 352 ReSideRdrLeObj3RdrObjDy 0;
BA_ "GenSigSendType" SG_ 352 ReSideRdrLeObj3RdrObjDyStdDe 0;
BA_ "GenSigSendType" SG_ 352 ReSideRdrLeObj3RdrObjElevnConf 0;
BA_ "GenSigSendType" SG_ 352 ReSideRdrLeObj3RdrObjElevnSts 0;
BA_ "GenSigSendType" SG_ 352 ReSideRdrLeObj3RdrObjID 0;
BA_ "GenSigStartValue" SG_ 352 ReSideRdrLeObj3RdrObjIsInFreeSpace 1;
BA_ "GenSigSendType" SG_ 352 ReSideRdrLeObj3RdrObjIsInFreeSpace 0;
BA_ "GenSigSendType" SG_ 352 ReSideRdrLeObj3RdrObjMirrProblty 0;
BA_ "GenSigStartValue" SG_ 352 ReSideRdrLeObj3RdrObjMtnPat 3;
BA_ "GenSigSendType" SG_ 352 ReSideRdrLeObj3RdrObjMtnPat 0;
BA_ "GenSigSendType" SG_ 352 ReSideRdrLeObj3RdrObjNotRealProblty 0;
BA_ "GenSigSendType" SG_ 352 ReSideRdrLeObj3RdrObjStatyCnt 0;
BA_ "GenSigSendType" SG_ 352 ReSideRdrLeObj3RdrObjTiAlv 0;
BA_ "GenSigSendType" SG_ 352 ReSideRdrLeObj3RdrObjTrackSts 0;
BA_ "GenSigSendType" SG_ 352 ReSideRdrLeObj3RdrObjTyp 0;
BA_ "GenSigSendType" SG_ 352 ReSideRdrLeObj3RdrObjTypConfBike 0;
BA_ "GenSigSendType" SG_ 352 ReSideRdrLeObj3RdrObjTypConfPed 0;
BA_ "GenSigSendType" SG_ 352 ReSideRdrLeObj3RdrObjTypConfVeh 0;
BA_ "GenSigStartValue" SG_ 352 ReSideRdrLeObj3RdrObjVx 6400;
BA_ "GenSigSendType" SG_ 352 ReSideRdrLeObj3RdrObjVx 0;
BA_ "GenSigSendType" SG_ 352 ReSideRdrLeObj3RdrObjVxStdDe 0;
BA_ "GenSigStartValue" SG_ 352 ReSideRdrLeObj3RdrObjVy 6400;
BA_ "GenSigSendType" SG_ 352 ReSideRdrLeObj3RdrObjVy 0;
BA_ "GenSigSendType" SG_ 352 ReSideRdrLeObj3RdrObjVyStdDe 0;
BA_ "GenSigStartValue" SG_ 352 ReSideRdrLeObj3RelVx 1780;
BA_ "GenSigSendType" SG_ 352 ReSideRdrLeObj3RelVx 0;
BA_ "GenSigStartValue" SG_ 352 ReSideRdrLeObj3RelVy 1780;
BA_ "GenSigSendType" SG_ 352 ReSideRdrLeObj3RelVy 0;
// Frame: SODLSafetyCANFD3Frame26
BA_ "VFrameFormat" BO_ 354 14;
BA_ "GenMsgSendType" BO_ 354 0;
BA_ "GenMsgCycleTime" BO_ 354 50.000;
BA_ "GenSigStartValue" SG_ 354 ReSideRdrLeObj4Heading 1800;
BA_ "GenSigSendType" SG_ 354 ReSideRdrLeObj4Heading 0;
BA_ "GenSigStartValue" SG_ 354 ReSideRdrLeObj4ObjBoxCenterLat 250;
BA_ "GenSigSendType" SG_ 354 ReSideRdrLeObj4ObjBoxCenterLat 0;
BA_ "GenSigStartValue" SG_ 354 ReSideRdrLeObj4ObjBoxCenterLgt 250;
BA_ "GenSigSendType" SG_ 354 ReSideRdrLeObj4ObjBoxCenterLgt 0;
BA_ "GenSigSendType" SG_ 354 ReSideRdrLeObj4ObservationHist 0;
BA_ "GenSigSendType" SG_ 354 ReSideRdrLeObj4RdrObjAx 0;
BA_ "GenSigSendType" SG_ 354 ReSideRdrLeObj4RdrObjAy 0;
BA_ "GenSigSendType" SG_ 354 ReSideRdrLeObj4RdrObjBoxLength 0;
BA_ "GenSigSendType" SG_ 354 ReSideRdrLeObj4RdrObjBoxWidth 0;
BA_ "GenSigSendType" SG_ 354 ReSideRdrLeObj4RdrObjChks 0;
BA_ "GenSigFuncType" SG_ 354 ReSideRdrLeObj4RdrObjChks 15;
BA_ "GenSigDataID" SG_ 354 ReSideRdrLeObj4RdrObjChks "0xA15";
BA_ "GenSigSendType" SG_ 354 ReSideRdrLeObj4RdrObjCntr 0;
BA_ "GenSigFuncType" SG_ 354 ReSideRdrLeObj4RdrObjCntr 16;
BA_ "GenSigStartValue" SG_ 354 ReSideRdrLeObj4RdrObjCoastCnt 31;
BA_ "GenSigSendType" SG_ 354 ReSideRdrLeObj4RdrObjCoastCnt 0;
BA_ "GenSigSendType" SG_ 354 ReSideRdrLeObj4RdrObjConf 0;
BA_ "GenSigSendType" SG_ 354 ReSideRdrLeObj4RdrObjDx 0;
BA_ "GenSigSendType" SG_ 354 ReSideRdrLeObj4RdrObjDxStdDe 0;
BA_ "GenSigStartValue" SG_ 354 ReSideRdrLeObj4RdrObjDy 4000;
BA_ "GenSigSendType" SG_ 354 ReSideRdrLeObj4RdrObjDy 0;
BA_ "GenSigSendType" SG_ 354 ReSideRdrLeObj4RdrObjDyStdDe 0;
BA_ "GenSigSendType" SG_ 354 ReSideRdrLeObj4RdrObjElevnConf 0;
BA_ "GenSigSendType" SG_ 354 ReSideRdrLeObj4RdrObjElevnSts 0;
BA_ "GenSigSendType" SG_ 354 ReSideRdrLeObj4RdrObjID 0;
BA_ "GenSigStartValue" SG_ 354 ReSideRdrLeObj4RdrObjIsInFreeSpace 1;
BA_ "GenSigSendType" SG_ 354 ReSideRdrLeObj4RdrObjIsInFreeSpace 0;
BA_ "GenSigSendType" SG_ 354 ReSideRdrLeObj4RdrObjMirrProblty 0;
BA_ "GenSigStartValue" SG_ 354 ReSideRdrLeObj4RdrObjMtnPat 3;
BA_ "GenSigSendType" SG_ 354 ReSideRdrLeObj4RdrObjMtnPat 0;
BA_ "GenSigSendType" SG_ 354 ReSideRdrLeObj4RdrObjNotRealProblty 0;
BA_ "GenSigSendType" SG_ 354 ReSideRdrLeObj4RdrObjStatyCnt 0;
BA_ "GenSigSendType" SG_ 354 ReSideRdrLeObj4RdrObjTiAlv 0;
BA_ "GenSigSendType" SG_ 354 ReSideRdrLeObj4RdrObjTrackSts 0;
BA_ "GenSigSendType" SG_ 354 ReSideRdrLeObj4RdrObjTyp 0;
BA_ "GenSigSendType" SG_ 354 ReSideRdrLeObj4RdrObjTypConfBike 0;
BA_ "GenSigSendType" SG_ 354 ReSideRdrLeObj4RdrObjTypConfPed 0;
BA_ "GenSigSendType" SG_ 354 ReSideRdrLeObj4RdrObjTypConfVeh 0;
BA_ "GenSigStartValue" SG_ 354 ReSideRdrLeObj4RdrObjVx 6400;
BA_ "GenSigSendType" SG_ 354 ReSideRdrLeObj4RdrObjVx 0;
BA_ "GenSigSendType" SG_ 354 ReSideRdrLeObj4RdrObjVxStdDe 0;
BA_ "GenSigStartValue" SG_ 354 ReSideRdrLeObj4RdrObjVy 6400;
BA_ "GenSigSendType" SG_ 354 ReSideRdrLeObj4RdrObjVy 0;
BA_ "GenSigSendType" SG_ 354 ReSideRdrLeObj4RdrObjVyStdDe 0;
BA_ "GenSigStartValue" SG_ 354 ReSideRdrLeObj4RelVx 1780;
BA_ "GenSigSendType" SG_ 354 ReSideRdrLeObj4RelVx 0;
BA_ "GenSigStartValue" SG_ 354 ReSideRdrLeObj4RelVy 1780;
BA_ "GenSigSendType" SG_ 354 ReSideRdrLeObj4RelVy 0;
// Frame: SODLSafetyCANFD3Frame27
BA_ "VFrameFormat" BO_ 356 14;
BA_ "GenMsgSendType" BO_ 356 0;
BA_ "GenMsgCycleTime" BO_ 356 50.000;
BA_ "GenSigStartValue" SG_ 356 ReSideRdrLeObj5Heading 1800;
BA_ "GenSigSendType" SG_ 356 ReSideRdrLeObj5Heading 0;
BA_ "GenSigStartValue" SG_ 356 ReSideRdrLeObj5ObjBoxCenterLat 250;
BA_ "GenSigSendType" SG_ 356 ReSideRdrLeObj5ObjBoxCenterLat 0;
BA_ "GenSigStartValue" SG_ 356 ReSideRdrLeObj5ObjBoxCenterLgt 250;
BA_ "GenSigSendType" SG_ 356 ReSideRdrLeObj5ObjBoxCenterLgt 0;
BA_ "GenSigSendType" SG_ 356 ReSideRdrLeObj5ObservationHist 0;
BA_ "GenSigSendType" SG_ 356 ReSideRdrLeObj5RdrObjAx 0;
BA_ "GenSigSendType" SG_ 356 ReSideRdrLeObj5RdrObjAy 0;
BA_ "GenSigSendType" SG_ 356 ReSideRdrLeObj5RdrObjBoxLength 0;
BA_ "GenSigSendType" SG_ 356 ReSideRdrLeObj5RdrObjBoxWidth 0;
BA_ "GenSigSendType" SG_ 356 ReSideRdrLeObj5RdrObjChks 0;
BA_ "GenSigFuncType" SG_ 356 ReSideRdrLeObj5RdrObjChks 15;
BA_ "GenSigDataID" SG_ 356 ReSideRdrLeObj5RdrObjChks "0xA16";
BA_ "GenSigSendType" SG_ 356 ReSideRdrLeObj5RdrObjCntr 0;
BA_ "GenSigFuncType" SG_ 356 ReSideRdrLeObj5RdrObjCntr 16;
BA_ "GenSigStartValue" SG_ 356 ReSideRdrLeObj5RdrObjCoastCnt 31;
BA_ "GenSigSendType" SG_ 356 ReSideRdrLeObj5RdrObjCoastCnt 0;
BA_ "GenSigSendType" SG_ 356 ReSideRdrLeObj5RdrObjConf 0;
BA_ "GenSigSendType" SG_ 356 ReSideRdrLeObj5RdrObjDx 0;
BA_ "GenSigSendType" SG_ 356 ReSideRdrLeObj5RdrObjDxStdDe 0;
BA_ "GenSigStartValue" SG_ 356 ReSideRdrLeObj5RdrObjDy 4000;
BA_ "GenSigSendType" SG_ 356 ReSideRdrLeObj5RdrObjDy 0;
BA_ "GenSigSendType" SG_ 356 ReSideRdrLeObj5RdrObjDyStdDe 0;
BA_ "GenSigSendType" SG_ 356 ReSideRdrLeObj5RdrObjElevnConf 0;
BA_ "GenSigSendType" SG_ 356 ReSideRdrLeObj5RdrObjElevnSts 0;
BA_ "GenSigSendType" SG_ 356 ReSideRdrLeObj5RdrObjID 0;
BA_ "GenSigStartValue" SG_ 356 ReSideRdrLeObj5RdrObjIsInFreeSpace 1;
BA_ "GenSigSendType" SG_ 356 ReSideRdrLeObj5RdrObjIsInFreeSpace 0;
BA_ "GenSigSendType" SG_ 356 ReSideRdrLeObj5RdrObjMirrProblty 0;
BA_ "GenSigStartValue" SG_ 356 ReSideRdrLeObj5RdrObjMtnPat 3;
BA_ "GenSigSendType" SG_ 356 ReSideRdrLeObj5RdrObjMtnPat 0;
BA_ "GenSigSendType" SG_ 356 ReSideRdrLeObj5RdrObjNotRealProblty 0;
BA_ "GenSigSendType" SG_ 356 ReSideRdrLeObj5RdrObjStatyCnt 0;
BA_ "GenSigSendType" SG_ 356 ReSideRdrLeObj5RdrObjTiAlv 0;
BA_ "GenSigSendType" SG_ 356 ReSideRdrLeObj5RdrObjTrackSts 0;
BA_ "GenSigSendType" SG_ 356 ReSideRdrLeObj5RdrObjTyp 0;
BA_ "GenSigSendType" SG_ 356 ReSideRdrLeObj5RdrObjTypConfBike 0;
BA_ "GenSigSendType" SG_ 356 ReSideRdrLeObj5RdrObjTypConfPed 0;
BA_ "GenSigSendType" SG_ 356 ReSideRdrLeObj5RdrObjTypConfVeh 0;
BA_ "GenSigStartValue" SG_ 356 ReSideRdrLeObj5RdrObjVx 6400;
BA_ "GenSigSendType" SG_ 356 ReSideRdrLeObj5RdrObjVx 0;
BA_ "GenSigSendType" SG_ 356 ReSideRdrLeObj5RdrObjVxStdDe 0;
BA_ "GenSigStartValue" SG_ 356 ReSideRdrLeObj5RdrObjVy 6400;
BA_ "GenSigSendType" SG_ 356 ReSideRdrLeObj5RdrObjVy 0;
BA_ "GenSigSendType" SG_ 356 ReSideRdrLeObj5RdrObjVyStdDe 0;
BA_ "GenSigStartValue" SG_ 356 ReSideRdrLeObj5RelVx 1780;
BA_ "GenSigSendType" SG_ 356 ReSideRdrLeObj5RelVx 0;
BA_ "GenSigStartValue" SG_ 356 ReSideRdrLeObj5RelVy 1780;
BA_ "GenSigSendType" SG_ 356 ReSideRdrLeObj5RelVy 0;
// Frame: SODLSafetyCANFD3Frame28
BA_ "VFrameFormat" BO_ 358 14;
BA_ "GenMsgSendType" BO_ 358 0;
BA_ "GenMsgCycleTime" BO_ 358 50.000;
BA_ "GenSigStartValue" SG_ 358 ReSideRdrLeObj6Heading 1800;
BA_ "GenSigSendType" SG_ 358 ReSideRdrLeObj6Heading 0;
BA_ "GenSigStartValue" SG_ 358 ReSideRdrLeObj6ObjBoxCenterLat 250;
BA_ "GenSigSendType" SG_ 358 ReSideRdrLeObj6ObjBoxCenterLat 0;
BA_ "GenSigStartValue" SG_ 358 ReSideRdrLeObj6ObjBoxCenterLgt 250;
BA_ "GenSigSendType" SG_ 358 ReSideRdrLeObj6ObjBoxCenterLgt 0;
BA_ "GenSigSendType" SG_ 358 ReSideRdrLeObj6ObservationHist 0;
BA_ "GenSigSendType" SG_ 358 ReSideRdrLeObj6RdrObjAx 0;
BA_ "GenSigSendType" SG_ 358 ReSideRdrLeObj6RdrObjAy 0;
BA_ "GenSigSendType" SG_ 358 ReSideRdrLeObj6RdrObjBoxLength 0;
BA_ "GenSigSendType" SG_ 358 ReSideRdrLeObj6RdrObjBoxWidth 0;
BA_ "GenSigSendType" SG_ 358 ReSideRdrLeObj6RdrObjChks 0;
BA_ "GenSigFuncType" SG_ 358 ReSideRdrLeObj6RdrObjChks 15;
BA_ "GenSigDataID" SG_ 358 ReSideRdrLeObj6RdrObjChks "0xA17";
BA_ "GenSigSendType" SG_ 358 ReSideRdrLeObj6RdrObjCntr 0;
BA_ "GenSigFuncType" SG_ 358 ReSideRdrLeObj6RdrObjCntr 16;
BA_ "GenSigStartValue" SG_ 358 ReSideRdrLeObj6RdrObjCoastCnt 31;
BA_ "GenSigSendType" SG_ 358 ReSideRdrLeObj6RdrObjCoastCnt 0;
BA_ "GenSigSendType" SG_ 358 ReSideRdrLeObj6RdrObjConf 0;
BA_ "GenSigSendType" SG_ 358 ReSideRdrLeObj6RdrObjDx 0;
BA_ "GenSigSendType" SG_ 358 ReSideRdrLeObj6RdrObjDxStdDe 0;
BA_ "GenSigStartValue" SG_ 358 ReSideRdrLeObj6RdrObjDy 4000;
BA_ "GenSigSendType" SG_ 358 ReSideRdrLeObj6RdrObjDy 0;
BA_ "GenSigSendType" SG_ 358 ReSideRdrLeObj6RdrObjDyStdDe 0;
BA_ "GenSigSendType" SG_ 358 ReSideRdrLeObj6RdrObjElevnConf 0;
BA_ "GenSigSendType" SG_ 358 ReSideRdrLeObj6RdrObjElevnSts 0;
BA_ "GenSigSendType" SG_ 358 ReSideRdrLeObj6RdrObjID 0;
BA_ "GenSigStartValue" SG_ 358 ReSideRdrLeObj6RdrObjIsInFreeSpace 1;
BA_ "GenSigSendType" SG_ 358 ReSideRdrLeObj6RdrObjIsInFreeSpace 0;
BA_ "GenSigSendType" SG_ 358 ReSideRdrLeObj6RdrObjMirrProblty 0;
BA_ "GenSigStartValue" SG_ 358 ReSideRdrLeObj6RdrObjMtnPat 3;
BA_ "GenSigSendType" SG_ 358 ReSideRdrLeObj6RdrObjMtnPat 0;
BA_ "GenSigSendType" SG_ 358 ReSideRdrLeObj6RdrObjNotRealProblty 0;
BA_ "GenSigSendType" SG_ 358 ReSideRdrLeObj6RdrObjStatyCnt 0;
BA_ "GenSigSendType" SG_ 358 ReSideRdrLeObj6RdrObjTiAlv 0;
BA_ "GenSigSendType" SG_ 358 ReSideRdrLeObj6RdrObjTrackSts 0;
BA_ "GenSigSendType" SG_ 358 ReSideRdrLeObj6RdrObjTyp 0;
BA_ "GenSigSendType" SG_ 358 ReSideRdrLeObj6RdrObjTypConfBike 0;
BA_ "GenSigSendType" SG_ 358 ReSideRdrLeObj6RdrObjTypConfPed 0;
BA_ "GenSigSendType" SG_ 358 ReSideRdrLeObj6RdrObjTypConfVeh 0;
BA_ "GenSigStartValue" SG_ 358 ReSideRdrLeObj6RdrObjVx 6400;
BA_ "GenSigSendType" SG_ 358 ReSideRdrLeObj6RdrObjVx 0;
BA_ "GenSigSendType" SG_ 358 ReSideRdrLeObj6RdrObjVxStdDe 0;
BA_ "GenSigStartValue" SG_ 358 ReSideRdrLeObj6RdrObjVy 6400;
BA_ "GenSigSendType" SG_ 358 ReSideRdrLeObj6RdrObjVy 0;
BA_ "GenSigSendType" SG_ 358 ReSideRdrLeObj6RdrObjVyStdDe 0;
BA_ "GenSigStartValue" SG_ 358 ReSideRdrLeObj6RelVx 1780;
BA_ "GenSigSendType" SG_ 358 ReSideRdrLeObj6RelVx 0;
BA_ "GenSigStartValue" SG_ 358 ReSideRdrLeObj6RelVy 1780;
BA_ "GenSigSendType" SG_ 358 ReSideRdrLeObj6RelVy 0;
// Frame: SODLSafetyCANFD3Frame29
BA_ "VFrameFormat" BO_ 360 14;
BA_ "GenMsgSendType" BO_ 360 0;
BA_ "GenMsgCycleTime" BO_ 360 50.000;
BA_ "GenSigStartValue" SG_ 360 ReSideRdrLeObj7Heading 1800;
BA_ "GenSigSendType" SG_ 360 ReSideRdrLeObj7Heading 0;
BA_ "GenSigStartValue" SG_ 360 ReSideRdrLeObj7ObjBoxCenterLat 250;
BA_ "GenSigSendType" SG_ 360 ReSideRdrLeObj7ObjBoxCenterLat 0;
BA_ "GenSigStartValue" SG_ 360 ReSideRdrLeObj7ObjBoxCenterLgt 250;
BA_ "GenSigSendType" SG_ 360 ReSideRdrLeObj7ObjBoxCenterLgt 0;
BA_ "GenSigSendType" SG_ 360 ReSideRdrLeObj7ObservationHist 0;
BA_ "GenSigSendType" SG_ 360 ReSideRdrLeObj7RdrObjAx 0;
BA_ "GenSigSendType" SG_ 360 ReSideRdrLeObj7RdrObjAy 0;
BA_ "GenSigSendType" SG_ 360 ReSideRdrLeObj7RdrObjBoxLength 0;
BA_ "GenSigSendType" SG_ 360 ReSideRdrLeObj7RdrObjBoxWidth 0;
BA_ "GenSigSendType" SG_ 360 ReSideRdrLeObj7RdrObjChks 0;
BA_ "GenSigFuncType" SG_ 360 ReSideRdrLeObj7RdrObjChks 15;
BA_ "GenSigDataID" SG_ 360 ReSideRdrLeObj7RdrObjChks "0xA18";
BA_ "GenSigSendType" SG_ 360 ReSideRdrLeObj7RdrObjCntr 0;
BA_ "GenSigFuncType" SG_ 360 ReSideRdrLeObj7RdrObjCntr 16;
BA_ "GenSigStartValue" SG_ 360 ReSideRdrLeObj7RdrObjCoastCnt 31;
BA_ "GenSigSendType" SG_ 360 ReSideRdrLeObj7RdrObjCoastCnt 0;
BA_ "GenSigSendType" SG_ 360 ReSideRdrLeObj7RdrObjConf 0;
BA_ "GenSigSendType" SG_ 360 ReSideRdrLeObj7RdrObjDx 0;
BA_ "GenSigSendType" SG_ 360 ReSideRdrLeObj7RdrObjDxStdDe 0;
BA_ "GenSigStartValue" SG_ 360 ReSideRdrLeObj7RdrObjDy 4000;
BA_ "GenSigSendType" SG_ 360 ReSideRdrLeObj7RdrObjDy 0;
BA_ "GenSigSendType" SG_ 360 ReSideRdrLeObj7RdrObjDyStdDe 0;
BA_ "GenSigSendType" SG_ 360 ReSideRdrLeObj7RdrObjElevnConf 0;
BA_ "GenSigSendType" SG_ 360 ReSideRdrLeObj7RdrObjElevnSts 0;
BA_ "GenSigSendType" SG_ 360 ReSideRdrLeObj7RdrObjID 0;
BA_ "GenSigStartValue" SG_ 360 ReSideRdrLeObj7RdrObjIsInFreeSpace 1;
BA_ "GenSigSendType" SG_ 360 ReSideRdrLeObj7RdrObjIsInFreeSpace 0;
BA_ "GenSigSendType" SG_ 360 ReSideRdrLeObj7RdrObjMirrProblty 0;
BA_ "GenSigStartValue" SG_ 360 ReSideRdrLeObj7RdrObjMtnPat 3;
BA_ "GenSigSendType" SG_ 360 ReSideRdrLeObj7RdrObjMtnPat 0;
BA_ "GenSigSendType" SG_ 360 ReSideRdrLeObj7RdrObjNotRealProblty 0;
BA_ "GenSigSendType" SG_ 360 ReSideRdrLeObj7RdrObjStatyCnt 0;
BA_ "GenSigSendType" SG_ 360 ReSideRdrLeObj7RdrObjTiAlv 0;
BA_ "GenSigSendType" SG_ 360 ReSideRdrLeObj7RdrObjTrackSts 0;
BA_ "GenSigSendType" SG_ 360 ReSideRdrLeObj7RdrObjTyp 0;
BA_ "GenSigSendType" SG_ 360 ReSideRdrLeObj7RdrObjTypConfBike 0;
BA_ "GenSigSendType" SG_ 360 ReSideRdrLeObj7RdrObjTypConfPed 0;
BA_ "GenSigSendType" SG_ 360 ReSideRdrLeObj7RdrObjTypConfVeh 0;
BA_ "GenSigStartValue" SG_ 360 ReSideRdrLeObj7RdrObjVx 6400;
BA_ "GenSigSendType" SG_ 360 ReSideRdrLeObj7RdrObjVx 0;
BA_ "GenSigSendType" SG_ 360 ReSideRdrLeObj7RdrObjVxStdDe 0;
BA_ "GenSigStartValue" SG_ 360 ReSideRdrLeObj7RdrObjVy 6400;
BA_ "GenSigSendType" SG_ 360 ReSideRdrLeObj7RdrObjVy 0;
BA_ "GenSigSendType" SG_ 360 ReSideRdrLeObj7RdrObjVyStdDe 0;
BA_ "GenSigStartValue" SG_ 360 ReSideRdrLeObj7RelVx 1780;
BA_ "GenSigSendType" SG_ 360 ReSideRdrLeObj7RelVx 0;
BA_ "GenSigStartValue" SG_ 360 ReSideRdrLeObj7RelVy 1780;
BA_ "GenSigSendType" SG_ 360 ReSideRdrLeObj7RelVy 0;
// Frame: SODLSafetyCANFD3Frame30
BA_ "VFrameFormat" BO_ 362 14;
BA_ "GenMsgSendType" BO_ 362 0;
BA_ "GenMsgCycleTime" BO_ 362 50.000;
BA_ "GenSigStartValue" SG_ 362 ReSideRdrLeObj8Heading 1800;
BA_ "GenSigSendType" SG_ 362 ReSideRdrLeObj8Heading 0;
BA_ "GenSigStartValue" SG_ 362 ReSideRdrLeObj8ObjBoxCenterLat 250;
BA_ "GenSigSendType" SG_ 362 ReSideRdrLeObj8ObjBoxCenterLat 0;
BA_ "GenSigStartValue" SG_ 362 ReSideRdrLeObj8ObjBoxCenterLgt 250;
BA_ "GenSigSendType" SG_ 362 ReSideRdrLeObj8ObjBoxCenterLgt 0;
BA_ "GenSigSendType" SG_ 362 ReSideRdrLeObj8ObservationHist 0;
BA_ "GenSigSendType" SG_ 362 ReSideRdrLeObj8RdrObjAx 0;
BA_ "GenSigSendType" SG_ 362 ReSideRdrLeObj8RdrObjAy 0;
BA_ "GenSigSendType" SG_ 362 ReSideRdrLeObj8RdrObjBoxLength 0;
BA_ "GenSigSendType" SG_ 362 ReSideRdrLeObj8RdrObjBoxWidth 0;
BA_ "GenSigSendType" SG_ 362 ReSideRdrLeObj8RdrObjChks 0;
BA_ "GenSigFuncType" SG_ 362 ReSideRdrLeObj8RdrObjChks 15;
BA_ "GenSigDataID" SG_ 362 ReSideRdrLeObj8RdrObjChks "0xA19";
BA_ "GenSigSendType" SG_ 362 ReSideRdrLeObj8RdrObjCntr 0;
BA_ "GenSigFuncType" SG_ 362 ReSideRdrLeObj8RdrObjCntr 16;
BA_ "GenSigStartValue" SG_ 362 ReSideRdrLeObj8RdrObjCoastCnt 31;
BA_ "GenSigSendType" SG_ 362 ReSideRdrLeObj8RdrObjCoastCnt 0;
BA_ "GenSigSendType" SG_ 362 ReSideRdrLeObj8RdrObjConf 0;
BA_ "GenSigSendType" SG_ 362 ReSideRdrLeObj8RdrObjDx 0;
BA_ "GenSigSendType" SG_ 362 ReSideRdrLeObj8RdrObjDxStdDe 0;
BA_ "GenSigStartValue" SG_ 362 ReSideRdrLeObj8RdrObjDy 4000;
BA_ "GenSigSendType" SG_ 362 ReSideRdrLeObj8RdrObjDy 0;
BA_ "GenSigSendType" SG_ 362 ReSideRdrLeObj8RdrObjDyStdDe 0;
BA_ "GenSigSendType" SG_ 362 ReSideRdrLeObj8RdrObjElevnConf 0;
BA_ "GenSigSendType" SG_ 362 ReSideRdrLeObj8RdrObjElevnSts 0;
BA_ "GenSigSendType" SG_ 362 ReSideRdrLeObj8RdrObjID 0;
BA_ "GenSigStartValue" SG_ 362 ReSideRdrLeObj8RdrObjIsInFreeSpace 1;
BA_ "GenSigSendType" SG_ 362 ReSideRdrLeObj8RdrObjIsInFreeSpace 0;
BA_ "GenSigSendType" SG_ 362 ReSideRdrLeObj8RdrObjMirrProblty 0;
BA_ "GenSigStartValue" SG_ 362 ReSideRdrLeObj8RdrObjMtnPat 3;
BA_ "GenSigSendType" SG_ 362 ReSideRdrLeObj8RdrObjMtnPat 0;
BA_ "GenSigSendType" SG_ 362 ReSideRdrLeObj8RdrObjNotRealProblty 0;
BA_ "GenSigSendType" SG_ 362 ReSideRdrLeObj8RdrObjStatyCnt 0;
BA_ "GenSigSendType" SG_ 362 ReSideRdrLeObj8RdrObjTiAlv 0;
BA_ "GenSigSendType" SG_ 362 ReSideRdrLeObj8RdrObjTrackSts 0;
BA_ "GenSigSendType" SG_ 362 ReSideRdrLeObj8RdrObjTyp 0;
BA_ "GenSigSendType" SG_ 362 ReSideRdrLeObj8RdrObjTypConfBike 0;
BA_ "GenSigSendType" SG_ 362 ReSideRdrLeObj8RdrObjTypConfPed 0;
BA_ "GenSigSendType" SG_ 362 ReSideRdrLeObj8RdrObjTypConfVeh 0;
BA_ "GenSigStartValue" SG_ 362 ReSideRdrLeObj8RdrObjVx 6400;
BA_ "GenSigSendType" SG_ 362 ReSideRdrLeObj8RdrObjVx 0;
BA_ "GenSigSendType" SG_ 362 ReSideRdrLeObj8RdrObjVxStdDe 0;
BA_ "GenSigStartValue" SG_ 362 ReSideRdrLeObj8RdrObjVy 6400;
BA_ "GenSigSendType" SG_ 362 ReSideRdrLeObj8RdrObjVy 0;
BA_ "GenSigSendType" SG_ 362 ReSideRdrLeObj8RdrObjVyStdDe 0;
BA_ "GenSigStartValue" SG_ 362 ReSideRdrLeObj8RelVx 1780;
BA_ "GenSigSendType" SG_ 362 ReSideRdrLeObj8RelVx 0;
BA_ "GenSigStartValue" SG_ 362 ReSideRdrLeObj8RelVy 1780;
BA_ "GenSigSendType" SG_ 362 ReSideRdrLeObj8RelVy 0;
// Frame: SODLSafetyCANFD3Frame31
BA_ "VFrameFormat" BO_ 364 14;
BA_ "GenMsgSendType" BO_ 364 0;
BA_ "GenMsgCycleTime" BO_ 364 50.000;
BA_ "GenSigStartValue" SG_ 364 ReSideRdrLeObj9Heading 1800;
BA_ "GenSigSendType" SG_ 364 ReSideRdrLeObj9Heading 0;
BA_ "GenSigStartValue" SG_ 364 ReSideRdrLeObj9ObjBoxCenterLat 250;
BA_ "GenSigSendType" SG_ 364 ReSideRdrLeObj9ObjBoxCenterLat 0;
BA_ "GenSigStartValue" SG_ 364 ReSideRdrLeObj9ObjBoxCenterLgt 250;
BA_ "GenSigSendType" SG_ 364 ReSideRdrLeObj9ObjBoxCenterLgt 0;
BA_ "GenSigSendType" SG_ 364 ReSideRdrLeObj9ObservationHist 0;
BA_ "GenSigSendType" SG_ 364 ReSideRdrLeObj9RdrObjAx 0;
BA_ "GenSigSendType" SG_ 364 ReSideRdrLeObj9RdrObjAy 0;
BA_ "GenSigSendType" SG_ 364 ReSideRdrLeObj9RdrObjBoxLength 0;
BA_ "GenSigSendType" SG_ 364 ReSideRdrLeObj9RdrObjBoxWidth 0;
BA_ "GenSigSendType" SG_ 364 ReSideRdrLeObj9RdrObjChks 0;
BA_ "GenSigFuncType" SG_ 364 ReSideRdrLeObj9RdrObjChks 15;
BA_ "GenSigDataID" SG_ 364 ReSideRdrLeObj9RdrObjChks "0xA1A";
BA_ "GenSigSendType" SG_ 364 ReSideRdrLeObj9RdrObjCntr 0;
BA_ "GenSigFuncType" SG_ 364 ReSideRdrLeObj9RdrObjCntr 16;
BA_ "GenSigStartValue" SG_ 364 ReSideRdrLeObj9RdrObjCoastCnt 31;
BA_ "GenSigSendType" SG_ 364 ReSideRdrLeObj9RdrObjCoastCnt 0;
BA_ "GenSigSendType" SG_ 364 ReSideRdrLeObj9RdrObjConf 0;
BA_ "GenSigSendType" SG_ 364 ReSideRdrLeObj9RdrObjDx 0;
BA_ "GenSigSendType" SG_ 364 ReSideRdrLeObj9RdrObjDxStdDe 0;
BA_ "GenSigStartValue" SG_ 364 ReSideRdrLeObj9RdrObjDy 4000;
BA_ "GenSigSendType" SG_ 364 ReSideRdrLeObj9RdrObjDy 0;
BA_ "GenSigSendType" SG_ 364 ReSideRdrLeObj9RdrObjDyStdDe 0;
BA_ "GenSigSendType" SG_ 364 ReSideRdrLeObj9RdrObjElevnConf 0;
BA_ "GenSigSendType" SG_ 364 ReSideRdrLeObj9RdrObjElevnSts 0;
BA_ "GenSigSendType" SG_ 364 ReSideRdrLeObj9RdrObjID 0;
BA_ "GenSigStartValue" SG_ 364 ReSideRdrLeObj9RdrObjIsInFreeSpace 1;
BA_ "GenSigSendType" SG_ 364 ReSideRdrLeObj9RdrObjIsInFreeSpace 0;
BA_ "GenSigSendType" SG_ 364 ReSideRdrLeObj9RdrObjMirrProblty 0;
BA_ "GenSigStartValue" SG_ 364 ReSideRdrLeObj9RdrObjMtnPat 3;
BA_ "GenSigSendType" SG_ 364 ReSideRdrLeObj9RdrObjMtnPat 0;
BA_ "GenSigSendType" SG_ 364 ReSideRdrLeObj9RdrObjNotRealProblty 0;
BA_ "GenSigSendType" SG_ 364 ReSideRdrLeObj9RdrObjStatyCnt 0;
BA_ "GenSigSendType" SG_ 364 ReSideRdrLeObj9RdrObjTiAlv 0;
BA_ "GenSigSendType" SG_ 364 ReSideRdrLeObj9RdrObjTrackSts 0;
BA_ "GenSigSendType" SG_ 364 ReSideRdrLeObj9RdrObjTyp 0;
BA_ "GenSigSendType" SG_ 364 ReSideRdrLeObj9RdrObjTypConfBike 0;
BA_ "GenSigSendType" SG_ 364 ReSideRdrLeObj9RdrObjTypConfPed 0;
BA_ "GenSigSendType" SG_ 364 ReSideRdrLeObj9RdrObjTypConfVeh 0;
BA_ "GenSigStartValue" SG_ 364 ReSideRdrLeObj9RdrObjVx 6400;
BA_ "GenSigSendType" SG_ 364 ReSideRdrLeObj9RdrObjVx 0;
BA_ "GenSigSendType" SG_ 364 ReSideRdrLeObj9RdrObjVxStdDe 0;
BA_ "GenSigStartValue" SG_ 364 ReSideRdrLeObj9RdrObjVy 6400;
BA_ "GenSigSendType" SG_ 364 ReSideRdrLeObj9RdrObjVy 0;
BA_ "GenSigSendType" SG_ 364 ReSideRdrLeObj9RdrObjVyStdDe 0;
BA_ "GenSigStartValue" SG_ 364 ReSideRdrLeObj9RelVx 1780;
BA_ "GenSigSendType" SG_ 364 ReSideRdrLeObj9RelVx 0;
BA_ "GenSigStartValue" SG_ 364 ReSideRdrLeObj9RelVy 1780;
BA_ "GenSigSendType" SG_ 364 ReSideRdrLeObj9RelVy 0;
// Frame: SODLSafetyCANFD3Frame32
BA_ "VFrameFormat" BO_ 366 14;
BA_ "GenMsgSendType" BO_ 366 0;
BA_ "GenMsgCycleTime" BO_ 366 50.000;
BA_ "GenSigStartValue" SG_ 366 ReSideRdrLeObj10Heading 1800;
BA_ "GenSigSendType" SG_ 366 ReSideRdrLeObj10Heading 0;
BA_ "GenSigStartValue" SG_ 366 ReSideRdrLeObj10ObjBoxCenterLat 250;
BA_ "GenSigSendType" SG_ 366 ReSideRdrLeObj10ObjBoxCenterLat 0;
BA_ "GenSigStartValue" SG_ 366 ReSideRdrLeObj10ObjBoxCenterLgt 250;
BA_ "GenSigSendType" SG_ 366 ReSideRdrLeObj10ObjBoxCenterLgt 0;
BA_ "GenSigSendType" SG_ 366 ReSideRdrLeObj10ObservationHist 0;
BA_ "GenSigSendType" SG_ 366 ReSideRdrLeObj10RdrObjAx 0;
BA_ "GenSigSendType" SG_ 366 ReSideRdrLeObj10RdrObjAy 0;
BA_ "GenSigSendType" SG_ 366 ReSideRdrLeObj10RdrObjBoxLength 0;
BA_ "GenSigSendType" SG_ 366 ReSideRdrLeObj10RdrObjBoxWidth 0;
BA_ "GenSigSendType" SG_ 366 ReSideRdrLeObj10RdrObjChks 0;
BA_ "GenSigFuncType" SG_ 366 ReSideRdrLeObj10RdrObjChks 15;
BA_ "GenSigDataID" SG_ 366 ReSideRdrLeObj10RdrObjChks "0xA1B";
BA_ "GenSigSendType" SG_ 366 ReSideRdrLeObj10RdrObjCntr 0;
BA_ "GenSigFuncType" SG_ 366 ReSideRdrLeObj10RdrObjCntr 16;
BA_ "GenSigStartValue" SG_ 366 ReSideRdrLeObj10RdrObjCoastCnt 31;
BA_ "GenSigSendType" SG_ 366 ReSideRdrLeObj10RdrObjCoastCnt 0;
BA_ "GenSigSendType" SG_ 366 ReSideRdrLeObj10RdrObjConf 0;
BA_ "GenSigSendType" SG_ 366 ReSideRdrLeObj10RdrObjDx 0;
BA_ "GenSigSendType" SG_ 366 ReSideRdrLeObj10RdrObjDxStdDe 0;
BA_ "GenSigStartValue" SG_ 366 ReSideRdrLeObj10RdrObjDy 4000;
BA_ "GenSigSendType" SG_ 366 ReSideRdrLeObj10RdrObjDy 0;
BA_ "GenSigSendType" SG_ 366 ReSideRdrLeObj10RdrObjDyStdDe 0;
BA_ "GenSigSendType" SG_ 366 ReSideRdrLeObj10RdrObjElevnConf 0;
BA_ "GenSigSendType" SG_ 366 ReSideRdrLeObj10RdrObjElevnSts 0;
BA_ "GenSigSendType" SG_ 366 ReSideRdrLeObj10RdrObjID 0;
BA_ "GenSigStartValue" SG_ 366 ReSideRdrLeObj10RdrObjIsInFreeSpace 1;
BA_ "GenSigSendType" SG_ 366 ReSideRdrLeObj10RdrObjIsInFreeSpace 0;
BA_ "GenSigSendType" SG_ 366 ReSideRdrLeObj10RdrObjMirrProblty 0;
BA_ "GenSigStartValue" SG_ 366 ReSideRdrLeObj10RdrObjMtnPat 3;
BA_ "GenSigSendType" SG_ 366 ReSideRdrLeObj10RdrObjMtnPat 0;
BA_ "GenSigSendType" SG_ 366 ReSideRdrLeObj10RdrObjNotRealProblty 0;
BA_ "GenSigSendType" SG_ 366 ReSideRdrLeObj10RdrObjStatyCnt 0;
BA_ "GenSigSendType" SG_ 366 ReSideRdrLeObj10RdrObjTiAlv 0;
BA_ "GenSigSendType" SG_ 366 ReSideRdrLeObj10RdrObjTrackSts 0;
BA_ "GenSigSendType" SG_ 366 ReSideRdrLeObj10RdrObjTyp 0;
BA_ "GenSigSendType" SG_ 366 ReSideRdrLeObj10RdrObjTypConfBike 0;
BA_ "GenSigSendType" SG_ 366 ReSideRdrLeObj10RdrObjTypConfPed 0;
BA_ "GenSigSendType" SG_ 366 ReSideRdrLeObj10RdrObjTypConfVeh 0;
BA_ "GenSigStartValue" SG_ 366 ReSideRdrLeObj10RdrObjVx 6400;
BA_ "GenSigSendType" SG_ 366 ReSideRdrLeObj10RdrObjVx 0;
BA_ "GenSigSendType" SG_ 366 ReSideRdrLeObj10RdrObjVxStdDe 0;
BA_ "GenSigStartValue" SG_ 366 ReSideRdrLeObj10RdrObjVy 6400;
BA_ "GenSigSendType" SG_ 366 ReSideRdrLeObj10RdrObjVy 0;
BA_ "GenSigSendType" SG_ 366 ReSideRdrLeObj10RdrObjVyStdDe 0;
BA_ "GenSigStartValue" SG_ 366 ReSideRdrLeObj10RelVx 1780;
BA_ "GenSigSendType" SG_ 366 ReSideRdrLeObj10RelVx 0;
BA_ "GenSigStartValue" SG_ 366 ReSideRdrLeObj10RelVy 1780;
BA_ "GenSigSendType" SG_ 366 ReSideRdrLeObj10RelVy 0;
// Frame: SODLSafetyCANFD3Frame33
BA_ "VFrameFormat" BO_ 368 14;
BA_ "GenMsgSendType" BO_ 368 0;
BA_ "GenMsgCycleTime" BO_ 368 50.000;
BA_ "GenSigStartValue" SG_ 368 ReSideRdrLeObj11Heading 1800;
BA_ "GenSigSendType" SG_ 368 ReSideRdrLeObj11Heading 0;
BA_ "GenSigStartValue" SG_ 368 ReSideRdrLeObj11ObjBoxCenterLat 250;
BA_ "GenSigSendType" SG_ 368 ReSideRdrLeObj11ObjBoxCenterLat 0;
BA_ "GenSigStartValue" SG_ 368 ReSideRdrLeObj11ObjBoxCenterLgt 250;
BA_ "GenSigSendType" SG_ 368 ReSideRdrLeObj11ObjBoxCenterLgt 0;
BA_ "GenSigSendType" SG_ 368 ReSideRdrLeObj11ObservationHist 0;
BA_ "GenSigSendType" SG_ 368 ReSideRdrLeObj11RdrObjAx 0;
BA_ "GenSigSendType" SG_ 368 ReSideRdrLeObj11RdrObjAy 0;
BA_ "GenSigSendType" SG_ 368 ReSideRdrLeObj11RdrObjBoxLength 0;
BA_ "GenSigSendType" SG_ 368 ReSideRdrLeObj11RdrObjBoxWidth 0;
BA_ "GenSigSendType" SG_ 368 ReSideRdrLeObj11RdrObjChks 0;
BA_ "GenSigFuncType" SG_ 368 ReSideRdrLeObj11RdrObjChks 15;
BA_ "GenSigDataID" SG_ 368 ReSideRdrLeObj11RdrObjChks "0xA1C";
BA_ "GenSigSendType" SG_ 368 ReSideRdrLeObj11RdrObjCntr 0;
BA_ "GenSigFuncType" SG_ 368 ReSideRdrLeObj11RdrObjCntr 16;
BA_ "GenSigStartValue" SG_ 368 ReSideRdrLeObj11RdrObjCoastCnt 31;
BA_ "GenSigSendType" SG_ 368 ReSideRdrLeObj11RdrObjCoastCnt 0;
BA_ "GenSigSendType" SG_ 368 ReSideRdrLeObj11RdrObjConf 0;
BA_ "GenSigSendType" SG_ 368 ReSideRdrLeObj11RdrObjDx 0;
BA_ "GenSigSendType" SG_ 368 ReSideRdrLeObj11RdrObjDxStdDe 0;
BA_ "GenSigStartValue" SG_ 368 ReSideRdrLeObj11RdrObjDy 4000;
BA_ "GenSigSendType" SG_ 368 ReSideRdrLeObj11RdrObjDy 0;
BA_ "GenSigSendType" SG_ 368 ReSideRdrLeObj11RdrObjDyStdDe 0;
BA_ "GenSigSendType" SG_ 368 ReSideRdrLeObj11RdrObjElevnConf 0;
BA_ "GenSigSendType" SG_ 368 ReSideRdrLeObj11RdrObjElevnSts 0;
BA_ "GenSigSendType" SG_ 368 ReSideRdrLeObj11RdrObjID 0;
BA_ "GenSigStartValue" SG_ 368 ReSideRdrLeObj11RdrObjIsInFreeSpace 1;
BA_ "GenSigSendType" SG_ 368 ReSideRdrLeObj11RdrObjIsInFreeSpace 0;
BA_ "GenSigSendType" SG_ 368 ReSideRdrLeObj11RdrObjMirrProblty 0;
BA_ "GenSigStartValue" SG_ 368 ReSideRdrLeObj11RdrObjMtnPat 3;
BA_ "GenSigSendType" SG_ 368 ReSideRdrLeObj11RdrObjMtnPat 0;
BA_ "GenSigSendType" SG_ 368 ReSideRdrLeObj11RdrObjNotRealProblty 0;
BA_ "GenSigSendType" SG_ 368 ReSideRdrLeObj11RdrObjStatyCnt 0;
BA_ "GenSigSendType" SG_ 368 ReSideRdrLeObj11RdrObjTiAlv 0;
BA_ "GenSigSendType" SG_ 368 ReSideRdrLeObj11RdrObjTrackSts 0;
BA_ "GenSigSendType" SG_ 368 ReSideRdrLeObj11RdrObjTyp 0;
BA_ "GenSigSendType" SG_ 368 ReSideRdrLeObj11RdrObjTypConfBike 0;
BA_ "GenSigSendType" SG_ 368 ReSideRdrLeObj11RdrObjTypConfPed 0;
BA_ "GenSigSendType" SG_ 368 ReSideRdrLeObj11RdrObjTypConfVeh 0;
BA_ "GenSigStartValue" SG_ 368 ReSideRdrLeObj11RdrObjVx 6400;
BA_ "GenSigSendType" SG_ 368 ReSideRdrLeObj11RdrObjVx 0;
BA_ "GenSigSendType" SG_ 368 ReSideRdrLeObj11RdrObjVxStdDe 0;
BA_ "GenSigStartValue" SG_ 368 ReSideRdrLeObj11RdrObjVy 6400;
BA_ "GenSigSendType" SG_ 368 ReSideRdrLeObj11RdrObjVy 0;
BA_ "GenSigSendType" SG_ 368 ReSideRdrLeObj11RdrObjVyStdDe 0;
BA_ "GenSigStartValue" SG_ 368 ReSideRdrLeObj11RelVx 1780;
BA_ "GenSigSendType" SG_ 368 ReSideRdrLeObj11RelVx 0;
BA_ "GenSigStartValue" SG_ 368 ReSideRdrLeObj11RelVy 1780;
BA_ "GenSigSendType" SG_ 368 ReSideRdrLeObj11RelVy 0;
// Frame: SODLSafetyCANFD3Frame34
BA_ "VFrameFormat" BO_ 370 14;
BA_ "GenMsgSendType" BO_ 370 0;
BA_ "GenMsgCycleTime" BO_ 370 50.000;
BA_ "GenSigStartValue" SG_ 370 ReSideRdrLeObj12Heading 1800;
BA_ "GenSigSendType" SG_ 370 ReSideRdrLeObj12Heading 0;
BA_ "GenSigStartValue" SG_ 370 ReSideRdrLeObj12ObjBoxCenterLat 250;
BA_ "GenSigSendType" SG_ 370 ReSideRdrLeObj12ObjBoxCenterLat 0;
BA_ "GenSigStartValue" SG_ 370 ReSideRdrLeObj12ObjBoxCenterLgt 250;
BA_ "GenSigSendType" SG_ 370 ReSideRdrLeObj12ObjBoxCenterLgt 0;
BA_ "GenSigSendType" SG_ 370 ReSideRdrLeObj12ObservationHist 0;
BA_ "GenSigSendType" SG_ 370 ReSideRdrLeObj12RdrObjAx 0;
BA_ "GenSigSendType" SG_ 370 ReSideRdrLeObj12RdrObjAy 0;
BA_ "GenSigSendType" SG_ 370 ReSideRdrLeObj12RdrObjBoxLength 0;
BA_ "GenSigSendType" SG_ 370 ReSideRdrLeObj12RdrObjBoxWidth 0;
BA_ "GenSigSendType" SG_ 370 ReSideRdrLeObj12RdrObjChks 0;
BA_ "GenSigFuncType" SG_ 370 ReSideRdrLeObj12RdrObjChks 15;
BA_ "GenSigDataID" SG_ 370 ReSideRdrLeObj12RdrObjChks "0xA1D";
BA_ "GenSigSendType" SG_ 370 ReSideRdrLeObj12RdrObjCntr 0;
BA_ "GenSigFuncType" SG_ 370 ReSideRdrLeObj12RdrObjCntr 16;
BA_ "GenSigStartValue" SG_ 370 ReSideRdrLeObj12RdrObjCoastCnt 31;
BA_ "GenSigSendType" SG_ 370 ReSideRdrLeObj12RdrObjCoastCnt 0;
BA_ "GenSigSendType" SG_ 370 ReSideRdrLeObj12RdrObjConf 0;
BA_ "GenSigSendType" SG_ 370 ReSideRdrLeObj12RdrObjDx 0;
BA_ "GenSigSendType" SG_ 370 ReSideRdrLeObj12RdrObjDxStdDe 0;
BA_ "GenSigStartValue" SG_ 370 ReSideRdrLeObj12RdrObjDy 4000;
BA_ "GenSigSendType" SG_ 370 ReSideRdrLeObj12RdrObjDy 0;
BA_ "GenSigSendType" SG_ 370 ReSideRdrLeObj12RdrObjDyStdDe 0;
BA_ "GenSigSendType" SG_ 370 ReSideRdrLeObj12RdrObjElevnConf 0;
BA_ "GenSigSendType" SG_ 370 ReSideRdrLeObj12RdrObjElevnSts 0;
BA_ "GenSigSendType" SG_ 370 ReSideRdrLeObj12RdrObjID 0;
BA_ "GenSigStartValue" SG_ 370 ReSideRdrLeObj12RdrObjIsInFreeSpace 1;
BA_ "GenSigSendType" SG_ 370 ReSideRdrLeObj12RdrObjIsInFreeSpace 0;
BA_ "GenSigSendType" SG_ 370 ReSideRdrLeObj12RdrObjMirrProblty 0;
BA_ "GenSigStartValue" SG_ 370 ReSideRdrLeObj12RdrObjMtnPat 3;
BA_ "GenSigSendType" SG_ 370 ReSideRdrLeObj12RdrObjMtnPat 0;
BA_ "GenSigSendType" SG_ 370 ReSideRdrLeObj12RdrObjNotRealProblty 0;
BA_ "GenSigSendType" SG_ 370 ReSideRdrLeObj12RdrObjStatyCnt 0;
BA_ "GenSigSendType" SG_ 370 ReSideRdrLeObj12RdrObjTiAlv 0;
BA_ "GenSigSendType" SG_ 370 ReSideRdrLeObj12RdrObjTrackSts 0;
BA_ "GenSigSendType" SG_ 370 ReSideRdrLeObj12RdrObjTyp 0;
BA_ "GenSigSendType" SG_ 370 ReSideRdrLeObj12RdrObjTypConfBike 0;
BA_ "GenSigSendType" SG_ 370 ReSideRdrLeObj12RdrObjTypConfPed 0;
BA_ "GenSigSendType" SG_ 370 ReSideRdrLeObj12RdrObjTypConfVeh 0;
BA_ "GenSigStartValue" SG_ 370 ReSideRdrLeObj12RdrObjVx 6400;
BA_ "GenSigSendType" SG_ 370 ReSideRdrLeObj12RdrObjVx 0;
BA_ "GenSigSendType" SG_ 370 ReSideRdrLeObj12RdrObjVxStdDe 0;
BA_ "GenSigStartValue" SG_ 370 ReSideRdrLeObj12RdrObjVy 6400;
BA_ "GenSigSendType" SG_ 370 ReSideRdrLeObj12RdrObjVy 0;
BA_ "GenSigSendType" SG_ 370 ReSideRdrLeObj12RdrObjVyStdDe 0;
BA_ "GenSigStartValue" SG_ 370 ReSideRdrLeObj12RelVx 1780;
BA_ "GenSigSendType" SG_ 370 ReSideRdrLeObj12RelVx 0;
BA_ "GenSigStartValue" SG_ 370 ReSideRdrLeObj12RelVy 1780;
BA_ "GenSigSendType" SG_ 370 ReSideRdrLeObj12RelVy 0;
// Frame: SODLSafetyCANFD3Frame35
BA_ "VFrameFormat" BO_ 372 14;
BA_ "GenMsgSendType" BO_ 372 0;
BA_ "GenMsgCycleTime" BO_ 372 50.000;
BA_ "GenSigStartValue" SG_ 372 ReSideRdrLeObj13Heading 1800;
BA_ "GenSigSendType" SG_ 372 ReSideRdrLeObj13Heading 0;
BA_ "GenSigStartValue" SG_ 372 ReSideRdrLeObj13ObjBoxCenterLat 250;
BA_ "GenSigSendType" SG_ 372 ReSideRdrLeObj13ObjBoxCenterLat 0;
BA_ "GenSigStartValue" SG_ 372 ReSideRdrLeObj13ObjBoxCenterLgt 250;
BA_ "GenSigSendType" SG_ 372 ReSideRdrLeObj13ObjBoxCenterLgt 0;
BA_ "GenSigSendType" SG_ 372 ReSideRdrLeObj13ObservationHist 0;
BA_ "GenSigSendType" SG_ 372 ReSideRdrLeObj13RdrObjAx 0;
BA_ "GenSigSendType" SG_ 372 ReSideRdrLeObj13RdrObjAy 0;
BA_ "GenSigSendType" SG_ 372 ReSideRdrLeObj13RdrObjBoxLength 0;
BA_ "GenSigSendType" SG_ 372 ReSideRdrLeObj13RdrObjBoxWidth 0;
BA_ "GenSigSendType" SG_ 372 ReSideRdrLeObj13RdrObjChks 0;
BA_ "GenSigFuncType" SG_ 372 ReSideRdrLeObj13RdrObjChks 15;
BA_ "GenSigDataID" SG_ 372 ReSideRdrLeObj13RdrObjChks "0xA1E";
BA_ "GenSigSendType" SG_ 372 ReSideRdrLeObj13RdrObjCntr 0;
BA_ "GenSigFuncType" SG_ 372 ReSideRdrLeObj13RdrObjCntr 16;
BA_ "GenSigStartValue" SG_ 372 ReSideRdrLeObj13RdrObjCoastCnt 31;
BA_ "GenSigSendType" SG_ 372 ReSideRdrLeObj13RdrObjCoastCnt 0;
BA_ "GenSigSendType" SG_ 372 ReSideRdrLeObj13RdrObjConf 0;
BA_ "GenSigSendType" SG_ 372 ReSideRdrLeObj13RdrObjDx 0;
BA_ "GenSigSendType" SG_ 372 ReSideRdrLeObj13RdrObjDxStdDe 0;
BA_ "GenSigStartValue" SG_ 372 ReSideRdrLeObj13RdrObjDy 4000;
BA_ "GenSigSendType" SG_ 372 ReSideRdrLeObj13RdrObjDy 0;
BA_ "GenSigSendType" SG_ 372 ReSideRdrLeObj13RdrObjDyStdDe 0;
BA_ "GenSigSendType" SG_ 372 ReSideRdrLeObj13RdrObjElevnConf 0;
BA_ "GenSigSendType" SG_ 372 ReSideRdrLeObj13RdrObjElevnSts 0;
BA_ "GenSigSendType" SG_ 372 ReSideRdrLeObj13RdrObjID 0;
BA_ "GenSigStartValue" SG_ 372 ReSideRdrLeObj13RdrObjIsInFreeSpace 1;
BA_ "GenSigSendType" SG_ 372 ReSideRdrLeObj13RdrObjIsInFreeSpace 0;
BA_ "GenSigSendType" SG_ 372 ReSideRdrLeObj13RdrObjMirrProblty 0;
BA_ "GenSigStartValue" SG_ 372 ReSideRdrLeObj13RdrObjMtnPat 3;
BA_ "GenSigSendType" SG_ 372 ReSideRdrLeObj13RdrObjMtnPat 0;
BA_ "GenSigSendType" SG_ 372 ReSideRdrLeObj13RdrObjNotRealProblty 0;
BA_ "GenSigSendType" SG_ 372 ReSideRdrLeObj13RdrObjStatyCnt 0;
BA_ "GenSigSendType" SG_ 372 ReSideRdrLeObj13RdrObjTiAlv 0;
BA_ "GenSigSendType" SG_ 372 ReSideRdrLeObj13RdrObjTrackSts 0;
BA_ "GenSigSendType" SG_ 372 ReSideRdrLeObj13RdrObjTyp 0;
BA_ "GenSigSendType" SG_ 372 ReSideRdrLeObj13RdrObjTypConfBike 0;
BA_ "GenSigSendType" SG_ 372 ReSideRdrLeObj13RdrObjTypConfPed 0;
BA_ "GenSigSendType" SG_ 372 ReSideRdrLeObj13RdrObjTypConfVeh 0;
BA_ "GenSigStartValue" SG_ 372 ReSideRdrLeObj13RdrObjVx 6400;
BA_ "GenSigSendType" SG_ 372 ReSideRdrLeObj13RdrObjVx 0;
BA_ "GenSigSendType" SG_ 372 ReSideRdrLeObj13RdrObjVxStdDe 0;
BA_ "GenSigStartValue" SG_ 372 ReSideRdrLeObj13RdrObjVy 6400;
BA_ "GenSigSendType" SG_ 372 ReSideRdrLeObj13RdrObjVy 0;
BA_ "GenSigSendType" SG_ 372 ReSideRdrLeObj13RdrObjVyStdDe 0;
BA_ "GenSigStartValue" SG_ 372 ReSideRdrLeObj13RelVx 1780;
BA_ "GenSigSendType" SG_ 372 ReSideRdrLeObj13RelVx 0;
BA_ "GenSigStartValue" SG_ 372 ReSideRdrLeObj13RelVy 1780;
BA_ "GenSigSendType" SG_ 372 ReSideRdrLeObj13RelVy 0;
// Frame: SODLSafetyCANFD3Frame36
BA_ "VFrameFormat" BO_ 374 14;
BA_ "GenMsgSendType" BO_ 374 0;
BA_ "GenMsgCycleTime" BO_ 374 50.000;
BA_ "GenSigStartValue" SG_ 374 ReSideRdrLeObj14Heading 1800;
BA_ "GenSigSendType" SG_ 374 ReSideRdrLeObj14Heading 0;
BA_ "GenSigStartValue" SG_ 374 ReSideRdrLeObj14ObjBoxCenterLat 250;
BA_ "GenSigSendType" SG_ 374 ReSideRdrLeObj14ObjBoxCenterLat 0;
BA_ "GenSigStartValue" SG_ 374 ReSideRdrLeObj14ObjBoxCenterLgt 250;
BA_ "GenSigSendType" SG_ 374 ReSideRdrLeObj14ObjBoxCenterLgt 0;
BA_ "GenSigSendType" SG_ 374 ReSideRdrLeObj14ObservationHist 0;
BA_ "GenSigSendType" SG_ 374 ReSideRdrLeObj14RdrObjAx 0;
BA_ "GenSigSendType" SG_ 374 ReSideRdrLeObj14RdrObjAy 0;
BA_ "GenSigSendType" SG_ 374 ReSideRdrLeObj14RdrObjBoxLength 0;
BA_ "GenSigSendType" SG_ 374 ReSideRdrLeObj14RdrObjBoxWidth 0;
BA_ "GenSigSendType" SG_ 374 ReSideRdrLeObj14RdrObjChks 0;
BA_ "GenSigFuncType" SG_ 374 ReSideRdrLeObj14RdrObjChks 15;
BA_ "GenSigDataID" SG_ 374 ReSideRdrLeObj14RdrObjChks "0xA1F";
BA_ "GenSigSendType" SG_ 374 ReSideRdrLeObj14RdrObjCntr 0;
BA_ "GenSigFuncType" SG_ 374 ReSideRdrLeObj14RdrObjCntr 16;
BA_ "GenSigStartValue" SG_ 374 ReSideRdrLeObj14RdrObjCoastCnt 31;
BA_ "GenSigSendType" SG_ 374 ReSideRdrLeObj14RdrObjCoastCnt 0;
BA_ "GenSigSendType" SG_ 374 ReSideRdrLeObj14RdrObjConf 0;
BA_ "GenSigSendType" SG_ 374 ReSideRdrLeObj14RdrObjDx 0;
BA_ "GenSigSendType" SG_ 374 ReSideRdrLeObj14RdrObjDxStdDe 0;
BA_ "GenSigStartValue" SG_ 374 ReSideRdrLeObj14RdrObjDy 4000;
BA_ "GenSigSendType" SG_ 374 ReSideRdrLeObj14RdrObjDy 0;
BA_ "GenSigSendType" SG_ 374 ReSideRdrLeObj14RdrObjDyStdDe 0;
BA_ "GenSigSendType" SG_ 374 ReSideRdrLeObj14RdrObjElevnConf 0;
BA_ "GenSigSendType" SG_ 374 ReSideRdrLeObj14RdrObjElevnSts 0;
BA_ "GenSigSendType" SG_ 374 ReSideRdrLeObj14RdrObjID 0;
BA_ "GenSigStartValue" SG_ 374 ReSideRdrLeObj14RdrObjIsInFreeSpace 1;
BA_ "GenSigSendType" SG_ 374 ReSideRdrLeObj14RdrObjIsInFreeSpace 0;
BA_ "GenSigSendType" SG_ 374 ReSideRdrLeObj14RdrObjMirrProblty 0;
BA_ "GenSigStartValue" SG_ 374 ReSideRdrLeObj14RdrObjMtnPat 3;
BA_ "GenSigSendType" SG_ 374 ReSideRdrLeObj14RdrObjMtnPat 0;
BA_ "GenSigSendType" SG_ 374 ReSideRdrLeObj14RdrObjNotRealProblty 0;
BA_ "GenSigSendType" SG_ 374 ReSideRdrLeObj14RdrObjStatyCnt 0;
BA_ "GenSigSendType" SG_ 374 ReSideRdrLeObj14RdrObjTiAlv 0;
BA_ "GenSigSendType" SG_ 374 ReSideRdrLeObj14RdrObjTrackSts 0;
BA_ "GenSigSendType" SG_ 374 ReSideRdrLeObj14RdrObjTyp 0;
BA_ "GenSigSendType" SG_ 374 ReSideRdrLeObj14RdrObjTypConfBike 0;
BA_ "GenSigSendType" SG_ 374 ReSideRdrLeObj14RdrObjTypConfPed 0;
BA_ "GenSigSendType" SG_ 374 ReSideRdrLeObj14RdrObjTypConfVeh 0;
BA_ "GenSigStartValue" SG_ 374 ReSideRdrLeObj14RdrObjVx 6400;
BA_ "GenSigSendType" SG_ 374 ReSideRdrLeObj14RdrObjVx 0;
BA_ "GenSigSendType" SG_ 374 ReSideRdrLeObj14RdrObjVxStdDe 0;
BA_ "GenSigStartValue" SG_ 374 ReSideRdrLeObj14RdrObjVy 6400;
BA_ "GenSigSendType" SG_ 374 ReSideRdrLeObj14RdrObjVy 0;
BA_ "GenSigSendType" SG_ 374 ReSideRdrLeObj14RdrObjVyStdDe 0;
BA_ "GenSigStartValue" SG_ 374 ReSideRdrLeObj14RelVx 1780;
BA_ "GenSigSendType" SG_ 374 ReSideRdrLeObj14RelVx 0;
BA_ "GenSigStartValue" SG_ 374 ReSideRdrLeObj14RelVy 1780;
BA_ "GenSigSendType" SG_ 374 ReSideRdrLeObj14RelVy 0;
VAL_ 350 ReSideRdrLeObj2RdrObjElevnSts 0 "RdrObjElevnSts_Unknown" 1 "RdrObjElevnSts_OverRidable" 2 "RdrObjElevnSts_Rlv" 3 "RdrObjElevnSts_UnderRidable";
VAL_ 350 ReSideRdrLeObj2RdrObjIsInFreeSpace 0 "YesNo2_No" 1 "YesNo2_Yes";
VAL_ 350 ReSideRdrLeObj2RdrObjMtnPat 0 "RdrObjMtnPat_Ukwn" 1 "RdrObjMtnPat_Staty" 2 "RdrObjMtnPat_StatyFromMovg" 3 "RdrObjMtnPat_Movg" 4 "RdrObjMtnPat_Receding" 5 "RdrObjMtnPat_Oncoming" 6 "RdrObjMtnPat_CrossingFromLe" 7 "RdrObjMtnPat_CrossingFromRi";
VAL_ 350 ReSideRdrLeObj2RdrObjTrackSts 0 "RdrObjTrackSts_Invld" 1 "RdrObjTrackSts_Updated" 2 "RdrObjTrackSts_New" 3 "RdrObjTrackSts_Coasted";
VAL_ 350 ReSideRdrLeObj2RdrObjTyp 0 "RdrObjTyp_Ukwn" 1 "RdrObjTyp_Car" 2 "RdrObjTyp_MotorCycle" 3 "RdrObjTyp_Truck" 4 "RdrObjTyp_Ped" 5 "RdrObjTyp_ObstdVert1" 6 "RdrObjTyp_ObstdVert2" 7 "RdrObjTyp_Anim" 8 "RdrObjTyp_ObjGen" 9 "RdrObjTyp_Bicycle" 10 "RdrObjTyp_VehofUkwnClass" 11 "RdrObjTyp_Reserved";
VAL_ 352 ReSideRdrLeObj3RdrObjElevnSts 0 "RdrObjElevnSts_Unknown" 1 "RdrObjElevnSts_OverRidable" 2 "RdrObjElevnSts_Rlv" 3 "RdrObjElevnSts_UnderRidable";
VAL_ 352 ReSideRdrLeObj3RdrObjIsInFreeSpace 0 "YesNo2_No" 1 "YesNo2_Yes";
VAL_ 352 ReSideRdrLeObj3RdrObjMtnPat 0 "RdrObjMtnPat_Ukwn" 1 "RdrObjMtnPat_Staty" 2 "RdrObjMtnPat_StatyFromMovg" 3 "RdrObjMtnPat_Movg" 4 "RdrObjMtnPat_Receding" 5 "RdrObjMtnPat_Oncoming" 6 "RdrObjMtnPat_CrossingFromLe" 7 "RdrObjMtnPat_CrossingFromRi";
VAL_ 352 ReSideRdrLeObj3RdrObjTrackSts 0 "RdrObjTrackSts_Invld" 1 "RdrObjTrackSts_Updated" 2 "RdrObjTrackSts_New" 3 "RdrObjTrackSts_Coasted";
VAL_ 352 ReSideRdrLeObj3RdrObjTyp 0 "RdrObjTyp_Ukwn" 1 "RdrObjTyp_Car" 2 "RdrObjTyp_MotorCycle" 3 "RdrObjTyp_Truck" 4 "RdrObjTyp_Ped" 5 "RdrObjTyp_ObstdVert1" 6 "RdrObjTyp_ObstdVert2" 7 "RdrObjTyp_Anim" 8 "RdrObjTyp_ObjGen" 9 "RdrObjTyp_Bicycle" 10 "RdrObjTyp_VehofUkwnClass" 11 "RdrObjTyp_Reserved";
VAL_ 354 ReSideRdrLeObj4RdrObjElevnSts 0 "RdrObjElevnSts_Unknown" 1 "RdrObjElevnSts_OverRidable" 2 "RdrObjElevnSts_Rlv" 3 "RdrObjElevnSts_UnderRidable";
VAL_ 354 ReSideRdrLeObj4RdrObjIsInFreeSpace 0 "YesNo2_No" 1 "YesNo2_Yes";
VAL_ 354 ReSideRdrLeObj4RdrObjMtnPat 0 "RdrObjMtnPat_Ukwn" 1 "RdrObjMtnPat_Staty" 2 "RdrObjMtnPat_StatyFromMovg" 3 "RdrObjMtnPat_Movg" 4 "RdrObjMtnPat_Receding" 5 "RdrObjMtnPat_Oncoming" 6 "RdrObjMtnPat_CrossingFromLe" 7 "RdrObjMtnPat_CrossingFromRi";
VAL_ 354 ReSideRdrLeObj4RdrObjTrackSts 0 "RdrObjTrackSts_Invld" 1 "RdrObjTrackSts_Updated" 2 "RdrObjTrackSts_New" 3 "RdrObjTrackSts_Coasted";
VAL_ 354 ReSideRdrLeObj4RdrObjTyp 0 "RdrObjTyp_Ukwn" 1 "RdrObjTyp_Car" 2 "RdrObjTyp_MotorCycle" 3 "RdrObjTyp_Truck" 4 "RdrObjTyp_Ped" 5 "RdrObjTyp_ObstdVert1" 6 "RdrObjTyp_ObstdVert2" 7 "RdrObjTyp_Anim" 8 "RdrObjTyp_ObjGen" 9 "RdrObjTyp_Bicycle" 10 "RdrObjTyp_VehofUkwnClass" 11 "RdrObjTyp_Reserved";
VAL_ 356 ReSideRdrLeObj5RdrObjElevnSts 0 "RdrObjElevnSts_Unknown" 1 "RdrObjElevnSts_OverRidable" 2 "RdrObjElevnSts_Rlv" 3 "RdrObjElevnSts_UnderRidable";
VAL_ 356 ReSideRdrLeObj5RdrObjIsInFreeSpace 0 "YesNo2_No" 1 "YesNo2_Yes";
VAL_ 356 ReSideRdrLeObj5RdrObjMtnPat 0 "RdrObjMtnPat_Ukwn" 1 "RdrObjMtnPat_Staty" 2 "RdrObjMtnPat_StatyFromMovg" 3 "RdrObjMtnPat_Movg" 4 "RdrObjMtnPat_Receding" 5 "RdrObjMtnPat_Oncoming" 6 "RdrObjMtnPat_CrossingFromLe" 7 "RdrObjMtnPat_CrossingFromRi";
VAL_ 356 ReSideRdrLeObj5RdrObjTrackSts 0 "RdrObjTrackSts_Invld" 1 "RdrObjTrackSts_Updated" 2 "RdrObjTrackSts_New" 3 "RdrObjTrackSts_Coasted";
VAL_ 356 ReSideRdrLeObj5RdrObjTyp 0 "RdrObjTyp_Ukwn" 1 "RdrObjTyp_Car" 2 "RdrObjTyp_MotorCycle" 3 "RdrObjTyp_Truck" 4 "RdrObjTyp_Ped" 5 "RdrObjTyp_ObstdVert1" 6 "RdrObjTyp_ObstdVert2" 7 "RdrObjTyp_Anim" 8 "RdrObjTyp_ObjGen" 9 "RdrObjTyp_Bicycle" 10 "RdrObjTyp_VehofUkwnClass" 11 "RdrObjTyp_Reserved";
VAL_ 358 ReSideRdrLeObj6RdrObjElevnSts 0 "RdrObjElevnSts_Unknown" 1 "RdrObjElevnSts_OverRidable" 2 "RdrObjElevnSts_Rlv" 3 "RdrObjElevnSts_UnderRidable";
VAL_ 358 ReSideRdrLeObj6RdrObjIsInFreeSpace 0 "YesNo2_No" 1 "YesNo2_Yes";
VAL_ 358 ReSideRdrLeObj6RdrObjMtnPat 0 "RdrObjMtnPat_Ukwn" 1 "RdrObjMtnPat_Staty" 2 "RdrObjMtnPat_StatyFromMovg" 3 "RdrObjMtnPat_Movg" 4 "RdrObjMtnPat_Receding" 5 "RdrObjMtnPat_Oncoming" 6 "RdrObjMtnPat_CrossingFromLe" 7 "RdrObjMtnPat_CrossingFromRi";
VAL_ 358 ReSideRdrLeObj6RdrObjTrackSts 0 "RdrObjTrackSts_Invld" 1 "RdrObjTrackSts_Updated" 2 "RdrObjTrackSts_New" 3 "RdrObjTrackSts_Coasted";
VAL_ 358 ReSideRdrLeObj6RdrObjTyp 0 "RdrObjTyp_Ukwn" 1 "RdrObjTyp_Car" 2 "RdrObjTyp_MotorCycle" 3 "RdrObjTyp_Truck" 4 "RdrObjTyp_Ped" 5 "RdrObjTyp_ObstdVert1" 6 "RdrObjTyp_ObstdVert2" 7 "RdrObjTyp_Anim" 8 "RdrObjTyp_ObjGen" 9 "RdrObjTyp_Bicycle" 10 "RdrObjTyp_VehofUkwnClass" 11 "RdrObjTyp_Reserved";
VAL_ 360 ReSideRdrLeObj7RdrObjElevnSts 0 "RdrObjElevnSts_Unknown" 1 "RdrObjElevnSts_OverRidable" 2 "RdrObjElevnSts_Rlv" 3 "RdrObjElevnSts_UnderRidable";
VAL_ 360 ReSideRdrLeObj7RdrObjIsInFreeSpace 0 "YesNo2_No" 1 "YesNo2_Yes";
VAL_ 360 ReSideRdrLeObj7RdrObjMtnPat 0 "RdrObjMtnPat_Ukwn" 1 "RdrObjMtnPat_Staty" 2 "RdrObjMtnPat_StatyFromMovg" 3 "RdrObjMtnPat_Movg" 4 "RdrObjMtnPat_Receding" 5 "RdrObjMtnPat_Oncoming" 6 "RdrObjMtnPat_CrossingFromLe" 7 "RdrObjMtnPat_CrossingFromRi";
VAL_ 360 ReSideRdrLeObj7RdrObjTrackSts 0 "RdrObjTrackSts_Invld" 1 "RdrObjTrackSts_Updated" 2 "RdrObjTrackSts_New" 3 "RdrObjTrackSts_Coasted";
VAL_ 360 ReSideRdrLeObj7RdrObjTyp 0 "RdrObjTyp_Ukwn" 1 "RdrObjTyp_Car" 2 "RdrObjTyp_MotorCycle" 3 "RdrObjTyp_Truck" 4 "RdrObjTyp_Ped" 5 "RdrObjTyp_ObstdVert1" 6 "RdrObjTyp_ObstdVert2" 7 "RdrObjTyp_Anim" 8 "RdrObjTyp_ObjGen" 9 "RdrObjTyp_Bicycle" 10 "RdrObjTyp_VehofUkwnClass" 11 "RdrObjTyp_Reserved";
VAL_ 362 ReSideRdrLeObj8RdrObjElevnSts 0 "RdrObjElevnSts_Unknown" 1 "RdrObjElevnSts_OverRidable" 2 "RdrObjElevnSts_Rlv" 3 "RdrObjElevnSts_UnderRidable";
VAL_ 362 ReSideRdrLeObj8RdrObjIsInFreeSpace 0 "YesNo2_No" 1 "YesNo2_Yes";
VAL_ 362 ReSideRdrLeObj8RdrObjMtnPat 0 "RdrObjMtnPat_Ukwn" 1 "RdrObjMtnPat_Staty" 2 "RdrObjMtnPat_StatyFromMovg" 3 "RdrObjMtnPat_Movg" 4 "RdrObjMtnPat_Receding" 5 "RdrObjMtnPat_Oncoming" 6 "RdrObjMtnPat_CrossingFromLe" 7 "RdrObjMtnPat_CrossingFromRi";
VAL_ 362 ReSideRdrLeObj8RdrObjTrackSts 0 "RdrObjTrackSts_Invld" 1 "RdrObjTrackSts_Updated" 2 "RdrObjTrackSts_New" 3 "RdrObjTrackSts_Coasted";
VAL_ 362 ReSideRdrLeObj8RdrObjTyp 0 "RdrObjTyp_Ukwn" 1 "RdrObjTyp_Car" 2 "RdrObjTyp_MotorCycle" 3 "RdrObjTyp_Truck" 4 "RdrObjTyp_Ped" 5 "RdrObjTyp_ObstdVert1" 6 "RdrObjTyp_ObstdVert2" 7 "RdrObjTyp_Anim" 8 "RdrObjTyp_ObjGen" 9 "RdrObjTyp_Bicycle" 10 "RdrObjTyp_VehofUkwnClass" 11 "RdrObjTyp_Reserved";
VAL_ 364 ReSideRdrLeObj9RdrObjElevnSts 0 "RdrObjElevnSts_Unknown" 1 "RdrObjElevnSts_OverRidable" 2 "RdrObjElevnSts_Rlv" 3 "RdrObjElevnSts_UnderRidable";
VAL_ 364 ReSideRdrLeObj9RdrObjIsInFreeSpace 0 "YesNo2_No" 1 "YesNo2_Yes";
VAL_ 364 ReSideRdrLeObj9RdrObjMtnPat 0 "RdrObjMtnPat_Ukwn" 1 "RdrObjMtnPat_Staty" 2 "RdrObjMtnPat_StatyFromMovg" 3 "RdrObjMtnPat_Movg" 4 "RdrObjMtnPat_Receding" 5 "RdrObjMtnPat_Oncoming" 6 "RdrObjMtnPat_CrossingFromLe" 7 "RdrObjMtnPat_CrossingFromRi";
VAL_ 364 ReSideRdrLeObj9RdrObjTrackSts 0 "RdrObjTrackSts_Invld" 1 "RdrObjTrackSts_Updated" 2 "RdrObjTrackSts_New" 3 "RdrObjTrackSts_Coasted";
VAL_ 364 ReSideRdrLeObj9RdrObjTyp 0 "RdrObjTyp_Ukwn" 1 "RdrObjTyp_Car" 2 "RdrObjTyp_MotorCycle" 3 "RdrObjTyp_Truck" 4 "RdrObjTyp_Ped" 5 "RdrObjTyp_ObstdVert1" 6 "RdrObjTyp_ObstdVert2" 7 "RdrObjTyp_Anim" 8 "RdrObjTyp_ObjGen" 9 "RdrObjTyp_Bicycle" 10 "RdrObjTyp_VehofUkwnClass" 11 "RdrObjTyp_Reserved";
VAL_ 366 ReSideRdrLeObj10RdrObjElevnSts 0 "RdrObjElevnSts_Unknown" 1 "RdrObjElevnSts_OverRidable" 2 "RdrObjElevnSts_Rlv" 3 "RdrObjElevnSts_UnderRidable";
VAL_ 366 ReSideRdrLeObj10RdrObjIsInFreeSpace 0 "YesNo2_No" 1 "YesNo2_Yes";
VAL_ 366 ReSideRdrLeObj10RdrObjMtnPat 0 "RdrObjMtnPat_Ukwn" 1 "RdrObjMtnPat_Staty" 2 "RdrObjMtnPat_StatyFromMovg" 3 "RdrObjMtnPat_Movg" 4 "RdrObjMtnPat_Receding" 5 "RdrObjMtnPat_Oncoming" 6 "RdrObjMtnPat_CrossingFromLe" 7 "RdrObjMtnPat_CrossingFromRi";
VAL_ 366 ReSideRdrLeObj10RdrObjTrackSts 0 "RdrObjTrackSts_Invld" 1 "RdrObjTrackSts_Updated" 2 "RdrObjTrackSts_New" 3 "RdrObjTrackSts_Coasted";
VAL_ 366 ReSideRdrLeObj10RdrObjTyp 0 "RdrObjTyp_Ukwn" 1 "RdrObjTyp_Car" 2 "RdrObjTyp_MotorCycle" 3 "RdrObjTyp_Truck" 4 "RdrObjTyp_Ped" 5 "RdrObjTyp_ObstdVert1" 6 "RdrObjTyp_ObstdVert2" 7 "RdrObjTyp_Anim" 8 "RdrObjTyp_ObjGen" 9 "RdrObjTyp_Bicycle" 10 "RdrObjTyp_VehofUkwnClass" 11 "RdrObjTyp_Reserved";
VAL_ 368 ReSideRdrLeObj11RdrObjElevnSts 0 "RdrObjElevnSts_Unknown" 1 "RdrObjElevnSts_OverRidable" 2 "RdrObjElevnSts_Rlv" 3 "RdrObjElevnSts_UnderRidable";
VAL_ 368 ReSideRdrLeObj11RdrObjIsInFreeSpace 0 "YesNo2_No" 1 "YesNo2_Yes";
VAL_ 368 ReSideRdrLeObj11RdrObjMtnPat 0 "RdrObjMtnPat_Ukwn" 1 "RdrObjMtnPat_Staty" 2 "RdrObjMtnPat_StatyFromMovg" 3 "RdrObjMtnPat_Movg" 4 "RdrObjMtnPat_Receding" 5 "RdrObjMtnPat_Oncoming" 6 "RdrObjMtnPat_CrossingFromLe" 7 "RdrObjMtnPat_CrossingFromRi";
VAL_ 368 ReSideRdrLeObj11RdrObjTrackSts 0 "RdrObjTrackSts_Invld" 1 "RdrObjTrackSts_Updated" 2 "RdrObjTrackSts_New" 3 "RdrObjTrackSts_Coasted";
VAL_ 368 ReSideRdrLeObj11RdrObjTyp 0 "RdrObjTyp_Ukwn" 1 "RdrObjTyp_Car" 2 "RdrObjTyp_MotorCycle" 3 "RdrObjTyp_Truck" 4 "RdrObjTyp_Ped" 5 "RdrObjTyp_ObstdVert1" 6 "RdrObjTyp_ObstdVert2" 7 "RdrObjTyp_Anim" 8 "RdrObjTyp_ObjGen" 9 "RdrObjTyp_Bicycle" 10 "RdrObjTyp_VehofUkwnClass" 11 "RdrObjTyp_Reserved";
VAL_ 370 ReSideRdrLeObj12RdrObjElevnSts 0 "RdrObjElevnSts_Unknown" 1 "RdrObjElevnSts_OverRidable" 2 "RdrObjElevnSts_Rlv" 3 "RdrObjElevnSts_UnderRidable";
VAL_ 370 ReSideRdrLeObj12RdrObjIsInFreeSpace 0 "YesNo2_No" 1 "YesNo2_Yes";
VAL_ 370 ReSideRdrLeObj12RdrObjMtnPat 0 "RdrObjMtnPat_Ukwn" 1 "RdrObjMtnPat_Staty" 2 "RdrObjMtnPat_StatyFromMovg" 3 "RdrObjMtnPat_Movg" 4 "RdrObjMtnPat_Receding" 5 "RdrObjMtnPat_Oncoming" 6 "RdrObjMtnPat_CrossingFromLe" 7 "RdrObjMtnPat_CrossingFromRi";
VAL_ 370 ReSideRdrLeObj12RdrObjTrackSts 0 "RdrObjTrackSts_Invld" 1 "RdrObjTrackSts_Updated" 2 "RdrObjTrackSts_New" 3 "RdrObjTrackSts_Coasted";
VAL_ 370 ReSideRdrLeObj12RdrObjTyp 0 "RdrObjTyp_Ukwn" 1 "RdrObjTyp_Car" 2 "RdrObjTyp_MotorCycle" 3 "RdrObjTyp_Truck" 4 "RdrObjTyp_Ped" 5 "RdrObjTyp_ObstdVert1" 6 "RdrObjTyp_ObstdVert2" 7 "RdrObjTyp_Anim" 8 "RdrObjTyp_ObjGen" 9 "RdrObjTyp_Bicycle" 10 "RdrObjTyp_VehofUkwnClass" 11 "RdrObjTyp_Reserved";
VAL_ 372 ReSideRdrLeObj13RdrObjElevnSts 0 "RdrObjElevnSts_Unknown" 1 "RdrObjElevnSts_OverRidable" 2 "RdrObjElevnSts_Rlv" 3 "RdrObjElevnSts_UnderRidable";
VAL_ 372 ReSideRdrLeObj13RdrObjIsInFreeSpace 0 "YesNo2_No" 1 "YesNo2_Yes";
VAL_ 372 ReSideRdrLeObj13RdrObjMtnPat 0 "RdrObjMtnPat_Ukwn" 1 "RdrObjMtnPat_Staty" 2 "RdrObjMtnPat_StatyFromMovg" 3 "RdrObjMtnPat_Movg" 4 "RdrObjMtnPat_Receding" 5 "RdrObjMtnPat_Oncoming" 6 "RdrObjMtnPat_CrossingFromLe" 7 "RdrObjMtnPat_CrossingFromRi";
VAL_ 372 ReSideRdrLeObj13RdrObjTrackSts 0 "RdrObjTrackSts_Invld" 1 "RdrObjTrackSts_Updated" 2 "RdrObjTrackSts_New" 3 "RdrObjTrackSts_Coasted";
VAL_ 372 ReSideRdrLeObj13RdrObjTyp 0 "RdrObjTyp_Ukwn" 1 "RdrObjTyp_Car" 2 "RdrObjTyp_MotorCycle" 3 "RdrObjTyp_Truck" 4 "RdrObjTyp_Ped" 5 "RdrObjTyp_ObstdVert1" 6 "RdrObjTyp_ObstdVert2" 7 "RdrObjTyp_Anim" 8 "RdrObjTyp_ObjGen" 9 "RdrObjTyp_Bicycle" 10 "RdrObjTyp_VehofUkwnClass" 11 "RdrObjTyp_Reserved";
VAL_ 374 ReSideRdrLeObj14RdrObjElevnSts 0 "RdrObjElevnSts_Unknown" 1 "RdrObjElevnSts_OverRidable" 2 "RdrObjElevnSts_Rlv" 3 "RdrObjElevnSts_UnderRidable";
VAL_ 374 ReSideRdrLeObj14RdrObjIsInFreeSpace 0 "YesNo2_No" 1 "YesNo2_Yes";
VAL_ 374 ReSideRdrLeObj14RdrObjMtnPat 0 "RdrObjMtnPat_Ukwn" 1 "RdrObjMtnPat_Staty" 2 "RdrObjMtnPat_StatyFromMovg" 3 "RdrObjMtnPat_Movg" 4 "RdrObjMtnPat_Receding" 5 "RdrObjMtnPat_Oncoming" 6 "RdrObjMtnPat_CrossingFromLe" 7 "RdrObjMtnPat_CrossingFromRi";
VAL_ 374 ReSideRdrLeObj14RdrObjTrackSts 0 "RdrObjTrackSts_Invld" 1 "RdrObjTrackSts_Updated" 2 "RdrObjTrackSts_New" 3 "RdrObjTrackSts_Coasted";
VAL_ 374 ReSideRdrLeObj14RdrObjTyp 0 "RdrObjTyp_Ukwn" 1 "RdrObjTyp_Car" 2 "RdrObjTyp_MotorCycle" 3 "RdrObjTyp_Truck" 4 "RdrObjTyp_Ped" 5 "RdrObjTyp_ObstdVert1" 6 "RdrObjTyp_ObstdVert2" 7 "RdrObjTyp_Anim" 8 "RdrObjTyp_ObjGen" 9 "RdrObjTyp_Bicycle" 10 "RdrObjTyp_VehofUkwnClass" 11 "RdrObjTyp_Reserved";
SIG_GROUP_ 366 ReSideRdrLeObj10 1 : ReSideRdrLeObj10Heading ReSideRdrLeObj10ObjBoxCenterLat ReSideRdrLeObj10ObjBoxCenterLgt ReSideRdrLeObj10ObservationHist ReSideRdrLeObj10RdrObjAx ReSideRdrLeObj10RdrObjAy ReSideRdrLeObj10RdrObjBoxLength ReSideRdrLeObj10RdrObjBoxWidth ReSideRdrLeObj10RdrObjChks ReSideRdrLeObj10RdrObjCntr ReSideRdrLeObj10RdrObjCoastCnt ReSideRdrLeObj10RdrObjConf ReSideRdrLeObj10RdrObjDx ReSideRdrLeObj10RdrObjDxStdDe ReSideRdrLeObj10RdrObjDy ReSideRdrLeObj10RdrObjDyStdDe ReSideRdrLeObj10RdrObjElevnConf ReSideRdrLeObj10RdrObjElevnSts ReSideRdrLeObj10RdrObjID ReSideRdrLeObj10RdrObjIsInFreeSpace ReSideRdrLeObj10RdrObjMirrProblty ReSideRdrLeObj10RdrObjMtnPat ReSideRdrLeObj10RdrObjNotRealProblty ReSideRdrLeObj10RdrObjStatyCnt ReSideRdrLeObj10RdrObjTiAlv ReSideRdrLeObj10RdrObjTrackSts ReSideRdrLeObj10RdrObjTyp ReSideRdrLeObj10RdrObjTypConfBike ReSideRdrLeObj10RdrObjTypConfPed ReSideRdrLeObj10RdrObjTypConfVeh ReSideRdrLeObj10RdrObjVx ReSideRdrLeObj10RdrObjVxStdDe ReSideRdrLeObj10RdrObjVy ReSideRdrLeObj10RdrObjVyStdDe ReSideRdrLeObj10RelVx ReSideRdrLeObj10RelVy;
SIG_GROUP_ 368 ReSideRdrLeObj11 1 : ReSideRdrLeObj11Heading ReSideRdrLeObj11ObjBoxCenterLat ReSideRdrLeObj11ObjBoxCenterLgt ReSideRdrLeObj11ObservationHist ReSideRdrLeObj11RdrObjAx ReSideRdrLeObj11RdrObjAy ReSideRdrLeObj11RdrObjBoxLength ReSideRdrLeObj11RdrObjBoxWidth ReSideRdrLeObj11RdrObjChks ReSideRdrLeObj11RdrObjCntr ReSideRdrLeObj11RdrObjCoastCnt ReSideRdrLeObj11RdrObjConf ReSideRdrLeObj11RdrObjDx ReSideRdrLeObj11RdrObjDxStdDe ReSideRdrLeObj11RdrObjDy ReSideRdrLeObj11RdrObjDyStdDe ReSideRdrLeObj11RdrObjElevnConf ReSideRdrLeObj11RdrObjElevnSts ReSideRdrLeObj11RdrObjID ReSideRdrLeObj11RdrObjIsInFreeSpace ReSideRdrLeObj11RdrObjMirrProblty ReSideRdrLeObj11RdrObjMtnPat ReSideRdrLeObj11RdrObjNotRealProblty ReSideRdrLeObj11RdrObjStatyCnt ReSideRdrLeObj11RdrObjTiAlv ReSideRdrLeObj11RdrObjTrackSts ReSideRdrLeObj11RdrObjTyp ReSideRdrLeObj11RdrObjTypConfBike ReSideRdrLeObj11RdrObjTypConfPed ReSideRdrLeObj11RdrObjTypConfVeh ReSideRdrLeObj11RdrObjVx ReSideRdrLeObj11RdrObjVxStdDe ReSideRdrLeObj11RdrObjVy ReSideRdrLeObj11RdrObjVyStdDe ReSideRdrLeObj11RelVx ReSideRdrLeObj11RelVy;
SIG_GROUP_ 370 ReSideRdrLeObj12 1 : ReSideRdrLeObj12Heading ReSideRdrLeObj12ObjBoxCenterLat ReSideRdrLeObj12ObjBoxCenterLgt ReSideRdrLeObj12ObservationHist ReSideRdrLeObj12RdrObjAx ReSideRdrLeObj12RdrObjAy ReSideRdrLeObj12RdrObjBoxLength ReSideRdrLeObj12RdrObjBoxWidth ReSideRdrLeObj12RdrObjChks ReSideRdrLeObj12RdrObjCntr ReSideRdrLeObj12RdrObjCoastCnt ReSideRdrLeObj12RdrObjConf ReSideRdrLeObj12RdrObjDx ReSideRdrLeObj12RdrObjDxStdDe ReSideRdrLeObj12RdrObjDy ReSideRdrLeObj12RdrObjDyStdDe ReSideRdrLeObj12RdrObjElevnConf ReSideRdrLeObj12RdrObjElevnSts ReSideRdrLeObj12RdrObjID ReSideRdrLeObj12RdrObjIsInFreeSpace ReSideRdrLeObj12RdrObjMirrProblty ReSideRdrLeObj12RdrObjMtnPat ReSideRdrLeObj12RdrObjNotRealProblty ReSideRdrLeObj12RdrObjStatyCnt ReSideRdrLeObj12RdrObjTiAlv ReSideRdrLeObj12RdrObjTrackSts ReSideRdrLeObj12RdrObjTyp ReSideRdrLeObj12RdrObjTypConfBike ReSideRdrLeObj12RdrObjTypConfPed ReSideRdrLeObj12RdrObjTypConfVeh ReSideRdrLeObj12RdrObjVx ReSideRdrLeObj12RdrObjVxStdDe ReSideRdrLeObj12RdrObjVy ReSideRdrLeObj12RdrObjVyStdDe ReSideRdrLeObj12RelVx ReSideRdrLeObj12RelVy;
SIG_GROUP_ 372 ReSideRdrLeObj13 1 : ReSideRdrLeObj13Heading ReSideRdrLeObj13ObjBoxCenterLat ReSideRdrLeObj13ObjBoxCenterLgt ReSideRdrLeObj13ObservationHist ReSideRdrLeObj13RdrObjAx ReSideRdrLeObj13RdrObjAy ReSideRdrLeObj13RdrObjBoxLength ReSideRdrLeObj13RdrObjBoxWidth ReSideRdrLeObj13RdrObjChks ReSideRdrLeObj13RdrObjCntr ReSideRdrLeObj13RdrObjCoastCnt ReSideRdrLeObj13RdrObjConf ReSideRdrLeObj13RdrObjDx ReSideRdrLeObj13RdrObjDxStdDe ReSideRdrLeObj13RdrObjDy ReSideRdrLeObj13RdrObjDyStdDe ReSideRdrLeObj13RdrObjElevnConf ReSideRdrLeObj13RdrObjElevnSts ReSideRdrLeObj13RdrObjID ReSideRdrLeObj13RdrObjIsInFreeSpace ReSideRdrLeObj13RdrObjMirrProblty ReSideRdrLeObj13RdrObjMtnPat ReSideRdrLeObj13RdrObjNotRealProblty ReSideRdrLeObj13RdrObjStatyCnt ReSideRdrLeObj13RdrObjTiAlv ReSideRdrLeObj13RdrObjTrackSts ReSideRdrLeObj13RdrObjTyp ReSideRdrLeObj13RdrObjTypConfBike ReSideRdrLeObj13RdrObjTypConfPed ReSideRdrLeObj13RdrObjTypConfVeh ReSideRdrLeObj13RdrObjVx ReSideRdrLeObj13RdrObjVxStdDe ReSideRdrLeObj13RdrObjVy ReSideRdrLeObj13RdrObjVyStdDe ReSideRdrLeObj13RelVx ReSideRdrLeObj13RelVy;
SIG_GROUP_ 374 ReSideRdrLeObj14 1 : ReSideRdrLeObj14Heading ReSideRdrLeObj14ObjBoxCenterLat ReSideRdrLeObj14ObjBoxCenterLgt ReSideRdrLeObj14ObservationHist ReSideRdrLeObj14RdrObjAx ReSideRdrLeObj14RdrObjAy ReSideRdrLeObj14RdrObjBoxLength ReSideRdrLeObj14RdrObjBoxWidth ReSideRdrLeObj14RdrObjChks ReSideRdrLeObj14RdrObjCntr ReSideRdrLeObj14RdrObjCoastCnt ReSideRdrLeObj14RdrObjConf ReSideRdrLeObj14RdrObjDx ReSideRdrLeObj14RdrObjDxStdDe ReSideRdrLeObj14RdrObjDy ReSideRdrLeObj14RdrObjDyStdDe ReSideRdrLeObj14RdrObjElevnConf ReSideRdrLeObj14RdrObjElevnSts ReSideRdrLeObj14RdrObjID ReSideRdrLeObj14RdrObjIsInFreeSpace ReSideRdrLeObj14RdrObjMirrProblty ReSideRdrLeObj14RdrObjMtnPat ReSideRdrLeObj14RdrObjNotRealProblty ReSideRdrLeObj14RdrObjStatyCnt ReSideRdrLeObj14RdrObjTiAlv ReSideRdrLeObj14RdrObjTrackSts ReSideRdrLeObj14RdrObjTyp ReSideRdrLeObj14RdrObjTypConfBike ReSideRdrLeObj14RdrObjTypConfPed ReSideRdrLeObj14RdrObjTypConfVeh ReSideRdrLeObj14RdrObjVx ReSideRdrLeObj14RdrObjVxStdDe ReSideRdrLeObj14RdrObjVy ReSideRdrLeObj14RdrObjVyStdDe ReSideRdrLeObj14RelVx ReSideRdrLeObj14RelVy;
SIG_GROUP_ 350 ReSideRdrLeObj2 1 : ReSideRdrLeObj2Heading ReSideRdrLeObj2ObjBoxCenterLat ReSideRdrLeObj2ObjBoxCenterLgt ReSideRdrLeObj2ObservationHist ReSideRdrLeObj2RdrObjAx ReSideRdrLeObj2RdrObjAy ReSideRdrLeObj2RdrObjBoxLength ReSideRdrLeObj2RdrObjBoxWidth ReSideRdrLeObj2RdrObjChks ReSideRdrLeObj2RdrObjCntr ReSideRdrLeObj2RdrObjCoastCnt ReSideRdrLeObj2RdrObjConf ReSideRdrLeObj2RdrObjDx ReSideRdrLeObj2RdrObjDxStdDe ReSideRdrLeObj2RdrObjDy ReSideRdrLeObj2RdrObjDyStdDe ReSideRdrLeObj2RdrObjElevnConf ReSideRdrLeObj2RdrObjElevnSts ReSideRdrLeObj2RdrObjID ReSideRdrLeObj2RdrObjIsInFreeSpace ReSideRdrLeObj2RdrObjMirrProblty ReSideRdrLeObj2RdrObjMtnPat ReSideRdrLeObj2RdrObjNotRealProblty ReSideRdrLeObj2RdrObjStatyCnt ReSideRdrLeObj2RdrObjTiAlv ReSideRdrLeObj2RdrObjTrackSts ReSideRdrLeObj2RdrObjTyp ReSideRdrLeObj2RdrObjTypConfBike ReSideRdrLeObj2RdrObjTypConfPed ReSideRdrLeObj2RdrObjTypConfVeh ReSideRdrLeObj2RdrObjVx ReSideRdrLeObj2RdrObjVxStdDe ReSideRdrLeObj2RdrObjVy ReSideRdrLeObj2RdrObjVyStdDe ReSideRdrLeObj2RelVx ReSideRdrLeObj2RelVy;
SIG_GROUP_ 352 ReSideRdrLeObj3 1 : ReSideRdrLeObj3Heading ReSideRdrLeObj3ObjBoxCenterLat ReSideRdrLeObj3ObjBoxCenterLgt ReSideRdrLeObj3ObservationHist ReSideRdrLeObj3RdrObjAx ReSideRdrLeObj3RdrObjAy ReSideRdrLeObj3RdrObjBoxLength ReSideRdrLeObj3RdrObjBoxWidth ReSideRdrLeObj3RdrObjChks ReSideRdrLeObj3RdrObjCntr ReSideRdrLeObj3RdrObjCoastCnt ReSideRdrLeObj3RdrObjConf ReSideRdrLeObj3RdrObjDx ReSideRdrLeObj3RdrObjDxStdDe ReSideRdrLeObj3RdrObjDy ReSideRdrLeObj3RdrObjDyStdDe ReSideRdrLeObj3RdrObjElevnConf ReSideRdrLeObj3RdrObjElevnSts ReSideRdrLeObj3RdrObjID ReSideRdrLeObj3RdrObjIsInFreeSpace ReSideRdrLeObj3RdrObjMirrProblty ReSideRdrLeObj3RdrObjMtnPat ReSideRdrLeObj3RdrObjNotRealProblty ReSideRdrLeObj3RdrObjStatyCnt ReSideRdrLeObj3RdrObjTiAlv ReSideRdrLeObj3RdrObjTrackSts ReSideRdrLeObj3RdrObjTyp ReSideRdrLeObj3RdrObjTypConfBike ReSideRdrLeObj3RdrObjTypConfPed ReSideRdrLeObj3RdrObjTypConfVeh ReSideRdrLeObj3RdrObjVx ReSideRdrLeObj3RdrObjVxStdDe ReSideRdrLeObj3RdrObjVy ReSideRdrLeObj3RdrObjVyStdDe ReSideRdrLeObj3RelVx ReSideRdrLeObj3RelVy;
SIG_GROUP_ 354 ReSideRdrLeObj4 1 : ReSideRdrLeObj4Heading ReSideRdrLeObj4ObjBoxCenterLat ReSideRdrLeObj4ObjBoxCenterLgt ReSideRdrLeObj4ObservationHist ReSideRdrLeObj4RdrObjAx ReSideRdrLeObj4RdrObjAy ReSideRdrLeObj4RdrObjBoxLength ReSideRdrLeObj4RdrObjBoxWidth ReSideRdrLeObj4RdrObjChks ReSideRdrLeObj4RdrObjCntr ReSideRdrLeObj4RdrObjCoastCnt ReSideRdrLeObj4RdrObjConf ReSideRdrLeObj4RdrObjDx ReSideRdrLeObj4RdrObjDxStdDe ReSideRdrLeObj4RdrObjDy ReSideRdrLeObj4RdrObjDyStdDe ReSideRdrLeObj4RdrObjElevnConf ReSideRdrLeObj4RdrObjElevnSts ReSideRdrLeObj4RdrObjID ReSideRdrLeObj4RdrObjIsInFreeSpace ReSideRdrLeObj4RdrObjMirrProblty ReSideRdrLeObj4RdrObjMtnPat ReSideRdrLeObj4RdrObjNotRealProblty ReSideRdrLeObj4RdrObjStatyCnt ReSideRdrLeObj4RdrObjTiAlv ReSideRdrLeObj4RdrObjTrackSts ReSideRdrLeObj4RdrObjTyp ReSideRdrLeObj4RdrObjTypConfBike ReSideRdrLeObj4RdrObjTypConfPed ReSideRdrLeObj4RdrObjTypConfVeh ReSideRdrLeObj4RdrObjVx ReSideRdrLeObj4RdrObjVxStdDe ReSideRdrLeObj4RdrObjVy ReSideRdrLeObj4RdrObjVyStdDe ReSideRdrLeObj4RelVx ReSideRdrLeObj4RelVy;
SIG_GROUP_ 356 ReSideRdrLeObj5 1 : ReSideRdrLeObj5Heading ReSideRdrLeObj5ObjBoxCenterLat ReSideRdrLeObj5ObjBoxCenterLgt ReSideRdrLeObj5ObservationHist ReSideRdrLeObj5RdrObjAx ReSideRdrLeObj5RdrObjAy ReSideRdrLeObj5RdrObjBoxLength ReSideRdrLeObj5RdrObjBoxWidth ReSideRdrLeObj5RdrObjChks ReSideRdrLeObj5RdrObjCntr ReSideRdrLeObj5RdrObjCoastCnt ReSideRdrLeObj5RdrObjConf ReSideRdrLeObj5RdrObjDx ReSideRdrLeObj5RdrObjDxStdDe ReSideRdrLeObj5RdrObjDy ReSideRdrLeObj5RdrObjDyStdDe ReSideRdrLeObj5RdrObjElevnConf ReSideRdrLeObj5RdrObjElevnSts ReSideRdrLeObj5RdrObjID ReSideRdrLeObj5RdrObjIsInFreeSpace ReSideRdrLeObj5RdrObjMirrProblty ReSideRdrLeObj5RdrObjMtnPat ReSideRdrLeObj5RdrObjNotRealProblty ReSideRdrLeObj5RdrObjStatyCnt ReSideRdrLeObj5RdrObjTiAlv ReSideRdrLeObj5RdrObjTrackSts ReSideRdrLeObj5RdrObjTyp ReSideRdrLeObj5RdrObjTypConfBike ReSideRdrLeObj5RdrObjTypConfPed ReSideRdrLeObj5RdrObjTypConfVeh ReSideRdrLeObj5RdrObjVx ReSideRdrLeObj5RdrObjVxStdDe ReSideRdrLeObj5RdrObjVy ReSideRdrLeObj5RdrObjVyStdDe ReSideRdrLeObj5RelVx ReSideRdrLeObj5RelVy;
SIG_GROUP_ 358 ReSideRdrLeObj6 1 : ReSideRdrLeObj6Heading ReSideRdrLeObj6ObjBoxCenterLat ReSideRdrLeObj6ObjBoxCenterLgt ReSideRdrLeObj6ObservationHist ReSideRdrLeObj6RdrObjAx ReSideRdrLeObj6RdrObjAy ReSideRdrLeObj6RdrObjBoxLength ReSideRdrLeObj6RdrObjBoxWidth ReSideRdrLeObj6RdrObjChks ReSideRdrLeObj6RdrObjCntr ReSideRdrLeObj6RdrObjCoastCnt ReSideRdrLeObj6RdrObjConf ReSideRdrLeObj6RdrObjDx ReSideRdrLeObj6RdrObjDxStdDe ReSideRdrLeObj6RdrObjDy ReSideRdrLeObj6RdrObjDyStdDe ReSideRdrLeObj6RdrObjElevnConf ReSideRdrLeObj6RdrObjElevnSts ReSideRdrLeObj6RdrObjID ReSideRdrLeObj6RdrObjIsInFreeSpace ReSideRdrLeObj6RdrObjMirrProblty ReSideRdrLeObj6RdrObjMtnPat ReSideRdrLeObj6RdrObjNotRealProblty ReSideRdrLeObj6RdrObjStatyCnt ReSideRdrLeObj6RdrObjTiAlv ReSideRdrLeObj6RdrObjTrackSts ReSideRdrLeObj6RdrObjTyp ReSideRdrLeObj6RdrObjTypConfBike ReSideRdrLeObj6RdrObjTypConfPed ReSideRdrLeObj6RdrObjTypConfVeh ReSideRdrLeObj6RdrObjVx ReSideRdrLeObj6RdrObjVxStdDe ReSideRdrLeObj6RdrObjVy ReSideRdrLeObj6RdrObjVyStdDe ReSideRdrLeObj6RelVx ReSideRdrLeObj6RelVy;
SIG_GROUP_ 360 ReSideRdrLeObj7 1 : ReSideRdrLeObj7Heading ReSideRdrLeObj7ObjBoxCenterLat ReSideRdrLeObj7ObjBoxCenterLgt ReSideRdrLeObj7ObservationHist ReSideRdrLeObj7RdrObjAx ReSideRdrLeObj7RdrObjAy ReSideRdrLeObj7RdrObjBoxLength ReSideRdrLeObj7RdrObjBoxWidth ReSideRdrLeObj7RdrObjChks ReSideRdrLeObj7RdrObjCntr ReSideRdrLeObj7RdrObjCoastCnt ReSideRdrLeObj7RdrObjConf ReSideRdrLeObj7RdrObjDx ReSideRdrLeObj7RdrObjDxStdDe ReSideRdrLeObj7RdrObjDy ReSideRdrLeObj7RdrObjDyStdDe ReSideRdrLeObj7RdrObjElevnConf ReSideRdrLeObj7RdrObjElevnSts ReSideRdrLeObj7RdrObjID ReSideRdrLeObj7RdrObjIsInFreeSpace ReSideRdrLeObj7RdrObjMirrProblty ReSideRdrLeObj7RdrObjMtnPat ReSideRdrLeObj7RdrObjNotRealProblty ReSideRdrLeObj7RdrObjStatyCnt ReSideRdrLeObj7RdrObjTiAlv ReSideRdrLeObj7RdrObjTrackSts ReSideRdrLeObj7RdrObjTyp ReSideRdrLeObj7RdrObjTypConfBike ReSideRdrLeObj7RdrObjTypConfPed ReSideRdrLeObj7RdrObjTypConfVeh ReSideRdrLeObj7RdrObjVx ReSideRdrLeObj7RdrObjVxStdDe ReSideRdrLeObj7RdrObjVy ReSideRdrLeObj7RdrObjVyStdDe ReSideRdrLeObj7RelVx ReSideRdrLeObj7RelVy;
SIG_GROUP_ 362 ReSideRdrLeObj8 1 : ReSideRdrLeObj8Heading ReSideRdrLeObj8ObjBoxCenterLat ReSideRdrLeObj8ObjBoxCenterLgt ReSideRdrLeObj8ObservationHist ReSideRdrLeObj8RdrObjAx ReSideRdrLeObj8RdrObjAy ReSideRdrLeObj8RdrObjBoxLength ReSideRdrLeObj8RdrObjBoxWidth ReSideRdrLeObj8RdrObjChks ReSideRdrLeObj8RdrObjCntr ReSideRdrLeObj8RdrObjCoastCnt ReSideRdrLeObj8RdrObjConf ReSideRdrLeObj8RdrObjDx ReSideRdrLeObj8RdrObjDxStdDe ReSideRdrLeObj8RdrObjDy ReSideRdrLeObj8RdrObjDyStdDe ReSideRdrLeObj8RdrObjElevnConf ReSideRdrLeObj8RdrObjElevnSts ReSideRdrLeObj8RdrObjID ReSideRdrLeObj8RdrObjIsInFreeSpace ReSideRdrLeObj8RdrObjMirrProblty ReSideRdrLeObj8RdrObjMtnPat ReSideRdrLeObj8RdrObjNotRealProblty ReSideRdrLeObj8RdrObjStatyCnt ReSideRdrLeObj8RdrObjTiAlv ReSideRdrLeObj8RdrObjTrackSts ReSideRdrLeObj8RdrObjTyp ReSideRdrLeObj8RdrObjTypConfBike ReSideRdrLeObj8RdrObjTypConfPed ReSideRdrLeObj8RdrObjTypConfVeh ReSideRdrLeObj8RdrObjVx ReSideRdrLeObj8RdrObjVxStdDe ReSideRdrLeObj8RdrObjVy ReSideRdrLeObj8RdrObjVyStdDe ReSideRdrLeObj8RelVx ReSideRdrLeObj8RelVy;
SIG_GROUP_ 364 ReSideRdrLeObj9 1 : ReSideRdrLeObj9Heading ReSideRdrLeObj9ObjBoxCenterLat ReSideRdrLeObj9ObjBoxCenterLgt ReSideRdrLeObj9ObservationHist ReSideRdrLeObj9RdrObjAx ReSideRdrLeObj9RdrObjAy ReSideRdrLeObj9RdrObjBoxLength ReSideRdrLeObj9RdrObjBoxWidth ReSideRdrLeObj9RdrObjChks ReSideRdrLeObj9RdrObjCntr ReSideRdrLeObj9RdrObjCoastCnt ReSideRdrLeObj9RdrObjConf ReSideRdrLeObj9RdrObjDx ReSideRdrLeObj9RdrObjDxStdDe ReSideRdrLeObj9RdrObjDy ReSideRdrLeObj9RdrObjDyStdDe ReSideRdrLeObj9RdrObjElevnConf ReSideRdrLeObj9RdrObjElevnSts ReSideRdrLeObj9RdrObjID ReSideRdrLeObj9RdrObjIsInFreeSpace ReSideRdrLeObj9RdrObjMirrProblty ReSideRdrLeObj9RdrObjMtnPat ReSideRdrLeObj9RdrObjNotRealProblty ReSideRdrLeObj9RdrObjStatyCnt ReSideRdrLeObj9RdrObjTiAlv ReSideRdrLeObj9RdrObjTrackSts ReSideRdrLeObj9RdrObjTyp ReSideRdrLeObj9RdrObjTypConfBike ReSideRdrLeObj9RdrObjTypConfPed ReSideRdrLeObj9RdrObjTypConfVeh ReSideRdrLeObj9RdrObjVx ReSideRdrLeObj9RdrObjVxStdDe ReSideRdrLeObj9RdrObjVy ReSideRdrLeObj9RdrObjVyStdDe ReSideRdrLeObj9RelVx ReSideRdrLeObj9RelVy;
