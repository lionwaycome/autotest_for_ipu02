// *************************************************************************** *
// *                                                                           *
// *                      Mentor Graphics Corporation                          *
// *                          All rights reserved                              *
// *                                                                           *
// *************************************************************************** *
// *                                                                           *
// * Description:         CANDB File                                           *
// * Generated at:        2020-04-14 13:14:03                                  *
// * System:              SDB20010                                             *
// * Variant:             EX11_AVP                                             *
// * Network:             SafetyCANFD3                                         *
// *                                                                           *
// *************************************************************************** *
// *                                                                           *
// *             THIS CONFIGURATION MIGHT CONTAIN SOME ERRORS                  *
// *              IF THE INPUT MODEL WAS NOT PROPERLY FORMED!                  *
// *                    Do Not Use this File directly!                         *
// *                                                                           *
// *************************************************************************** *
VERSION "SafetyCANFD3"

NS_ :

BS_:

BU_:  ASDM ETC PAS SODL SODR

BO_ 376 SODLSafetyCANFD3Frame37: 64 SODL
 SG_ ReSideRdrLeObj15_UB : 291|1@0+ (1,0) [0|1] "" ASDM,PAS
 SG_ ReSideRdrLeObj15Heading : 287|12@0+ (0.1,-180.0) [-180.0|180.0] "Deg" ASDM,PAS
 SG_ ReSideRdrLeObj15ObjBoxCenterLat : 23|9@0+ (0.1,-25.0) [-25.0|25.0] "m" ASDM,PAS
 SG_ ReSideRdrLeObj15ObjBoxCenterLgt : 30|9@0+ (0.1,-25.0) [-25.0|25.0] "m" ASDM,PAS
 SG_ ReSideRdrLeObj15ObservationHist : 63|32@0+ (1.0,0.0) [0.0|4294967295.0] "Unitless" ASDM,PAS
 SG_ ReSideRdrLeObj15RdrObjAx : 7|8@0- (0.1,0.0) [-12.8|12.700000000000001] "m/s^2" ASDM,PAS
 SG_ ReSideRdrLeObj15RdrObjAy : 15|8@0- (0.1,0.0) [-12.8|12.700000000000001] "m/s^2" ASDM,PAS
 SG_ ReSideRdrLeObj15RdrObjBoxLength : 37|9@0+ (0.1,0.0) [0.0|50.0] "m" ASDM,PAS
 SG_ ReSideRdrLeObj15RdrObjBoxWidth : 44|9@0+ (0.1,0.0) [0.0|50.0] "m" ASDM,PAS
 SG_ ReSideRdrLeObj15RdrObjChks : 95|8@0+ (1.0,0.0) [0.0|255.0] "Unitless" ASDM,PAS
 SG_ ReSideRdrLeObj15RdrObjCntr : 103|4@0+ (1.0,0.0) [0.0|15.0] "Unitless" ASDM,PAS
 SG_ ReSideRdrLeObj15RdrObjCoastCnt : 279|5@0+ (1.0,0.0) [0.0|31.0] "Unitless" ASDM,PAS
 SG_ ReSideRdrLeObj15RdrObjConf : 99|4@0+ (7.0,0.0) [0.0|105.0] "%" ASDM,PAS
 SG_ ReSideRdrLeObj15RdrObjDx : 191|13@0+ (0.05,-200.0) [-200.0|200.0] "m" ASDM,PAS
 SG_ ReSideRdrLeObj15RdrObjDxStdDe : 111|8@0+ (0.05,0.0) [0.0|12.700000000000001] "m" ASDM,PAS
 SG_ ReSideRdrLeObj15RdrObjDy : 119|13@0+ (0.05,-200.0) [-200.0|200.0] "m" ASDM,PAS
 SG_ ReSideRdrLeObj15RdrObjDyStdDe : 183|8@0+ (0.05,0.0) [0.0|12.700000000000001] "m" ASDM,PAS
 SG_ ReSideRdrLeObj15RdrObjElevnConf : 223|4@0+ (7.0,0.0) [0.0|105.0] "%" ASDM,PAS
 SG_ ReSideRdrLeObj15RdrObjElevnSts : 153|2@0+ (1,0) [0|3] "" ASDM,PAS
 SG_ ReSideRdrLeObj15RdrObjID : 167|8@0+ (1.0,0.0) [0.0|255.0] "Unitless" ASDM,PAS
 SG_ ReSideRdrLeObj15RdrObjIsInFreeSpace : 192|1@0+ (1,0) [0|1] "" ASDM,PAS
 SG_ ReSideRdrLeObj15RdrObjMirrProblty : 219|4@0+ (7.0,0.0) [0.0|105.0] "%" ASDM,PAS
 SG_ ReSideRdrLeObj15RdrObjMtnPat : 122|3@0+ (1,0) [0|7] "" ASDM,PAS
 SG_ ReSideRdrLeObj15RdrObjNotRealProblty : 231|4@0+ (7.0,0.0) [0.0|105.0] "%" ASDM,PAS
 SG_ ReSideRdrLeObj15RdrObjStatyCnt : 239|7@0+ (1.0,0.0) [0.0|127.0] "Unitless" ASDM,PAS
 SG_ ReSideRdrLeObj15RdrObjTiAlv : 247|7@0+ (1.0,0.0) [0.0|127.0] "Unitless" ASDM,PAS
 SG_ ReSideRdrLeObj15RdrObjTrackSts : 194|2@0+ (1,0) [0|3] "" ASDM,PAS
 SG_ ReSideRdrLeObj15RdrObjTyp : 51|4@0+ (1,0) [0|15] "" ASDM,PAS
 SG_ ReSideRdrLeObj15RdrObjTypConfBike : 175|4@0+ (7.0,0.0) [0.0|105.0] "%" ASDM,PAS
 SG_ ReSideRdrLeObj15RdrObjTypConfPed : 171|4@0+ (7.0,0.0) [0.0|105.0] "%" ASDM,PAS
 SG_ ReSideRdrLeObj15RdrObjTypConfVeh : 227|4@0+ (7.0,0.0) [0.0|105.0] "%" ASDM,PAS
 SG_ ReSideRdrLeObj15RdrObjVx : 255|14@0+ (0.02,-128.0) [-128.0|128.0] "m/s" ASDM,PAS
 SG_ ReSideRdrLeObj15RdrObjVxStdDe : 271|6@0+ (0.05,0.0) [0.0|2.0] "m/s" ASDM,PAS
 SG_ ReSideRdrLeObj15RdrObjVy : 207|14@0+ (0.02,-128.0) [-128.0|128.0] "m/s" ASDM,PAS
 SG_ ReSideRdrLeObj15RdrObjVyStdDe : 159|6@0+ (0.05,0.0) [0.0|2.0] "m/s" ASDM,PAS
 SG_ ReSideRdrLeObj15RelVx : 135|12@0+ (0.02,-35.6) [-35.6|35.6] "m/s" ASDM,PAS
 SG_ ReSideRdrLeObj15RelVy : 139|12@0+ (0.02,-35.6) [-35.6|35.6] "m/s" ASDM,PAS

BO_ 1282 SodlSafetyCanFD3NmFr: 8 SODL
 SG_ PNC16_SODL : 16|1@0+ (1,0) [0|0] "" ASDM
 SG_ PNC17_SODL : 17|1@0+ (1,0) [0|0] "" ASDM
 SG_ PNC18_SODL : 18|1@0+ (1,0) [0|0] "" ASDM
 SG_ PNC19_SODL : 19|1@0+ (1,0) [0|0] "" ASDM
 SG_ PNC20_SODL : 20|1@0+ (1,0) [0|0] "" ASDM
 SG_ PNC21_SODL : 21|1@0+ (1,0) [0|0] "" ASDM
 SG_ PNC22_SODL : 22|1@0+ (1,0) [0|0] "" ASDM
 SG_ PNC23_SODL : 23|1@0+ (1,0) [0|0] "" ASDM
 SG_ PNC24_SODL : 24|1@0+ (1,0) [0|0] "" ASDM
 SG_ PNC25_SODL : 25|1@0+ (1,0) [0|0] "" ASDM
 SG_ PNC26_SODL : 26|1@0+ (1,0) [0|0] "" ASDM
 SG_ PNC27_SODL : 27|1@0+ (1,0) [0|0] "" ASDM
 SG_ PNC28_SODL : 28|1@0+ (1,0) [0|0] "" ASDM
 SG_ PNC29_SODL : 29|1@0+ (1,0) [0|0] "" ASDM
 SG_ PNC30_SODL : 30|1@0+ (1,0) [0|0] "" ASDM
 SG_ PNC31_SODL : 31|1@0+ (1,0) [0|0] "" ASDM
 SG_ PNC32_SODL : 32|1@0+ (1,0) [0|0] "" ASDM
 SG_ PNC33_SODL : 33|1@0+ (1,0) [0|0] "" ASDM
 SG_ PNC34_SODL : 34|1@0+ (1,0) [0|0] "" ASDM
 SG_ PNC35_SODL : 35|1@0+ (1,0) [0|0] "" ASDM
 SG_ PNC36_SODL : 36|1@0+ (1,0) [0|0] "" ASDM
 SG_ PNC37_SODL : 37|1@0+ (1,0) [0|0] "" ASDM
 SG_ PNC38_SODL : 38|1@0+ (1,0) [0|0] "" ASDM
 SG_ PNC39_SODL : 39|1@0+ (1,0) [0|0] "" ASDM
 SG_ NM_PNI_SODL : 14|1@0+ (1,0) [0|0] "" ASDM
 SG_ NM_AW_SODL : 12|1@0+ (1,0) [0|0] "" ASDM
 SG_ NM_CS_SODL : 11|1@0+ (1,0) [0|0] "" ASDM
 SG_ NM_RMR_SODL : 8|1@0+ (1,0) [0|0] "" ASDM
 SG_ NM_NodeID_SODL : 7|8@0+ (1,0) [0|0] "" ASDM

BO_ 1616 SodlToAsdmSafetyCanFD3DiagResFrame1: 64 SODL
 SG_ SodlToAsdmSafetyCanFD3DiagResNpdu : 7|512@0+ (1,0) [0|0] "" ASDM

BO_ 1411 SodlToEtcXcpFr01: 8 SODL

BO_ 1425 SodlToEtcXcpFr02: 8 SODL

BO_ 302 SODRSafetyCANFD3Frame00: 64 SODR
 SG_ ReSideRdrRiSts_UB : 243|1@0+ (1,0) [0|1] "" ASDM,PAS
 SG_ ReSideRdrRiStsForDim : 127|3@0+ (1,0) [0|7] "" ASDM,PAS
 SG_ ReSideRdrRiStsForDim_UB : 116|1@0+ (1,0) [0|1] "" ASDM,PAS
 SG_ ReSideRdrRiStsRdrNrDetn : 207|8@0+ (1.0,0.0) [0.0|255.0] "Unitless" ASDM,PAS
 SG_ ReSideRdrRiStsRdrNrObj : 215|8@0+ (1.0,0.0) [0.0|255.0] "Unitless" ASDM,PAS
 SG_ ReSideRdrRiStsRdrStsBlkd0bin : 216|1@0+ (1,0) [0|1] "" ASDM,PAS
 SG_ ReSideRdrRiStsRdrStsBlkdConf : 223|7@0+ (1.0,0.0) [0.0|100.0] "%" ASDM,PAS
 SG_ ReSideRdrRiStsRdrStsChks : 135|8@0+ (1.0,0.0) [0.0|255.0] "Unitless" ASDM,PAS
 SG_ ReSideRdrRiStsRdrStsCntr : 143|4@0+ (1.0,0.0) [0.0|15.0] "Unitless" ASDM,PAS
 SG_ ReSideRdrRiStsRdrStsDstbc : 239|7@0+ (1.0,0.0) [0.0|100.0] "%" ASDM,PAS
 SG_ ReSideRdrRiStsRdrStsEna : 232|1@0+ (1,0) [0|1] "" ASDM,PAS
 SG_ ReSideRdrRiStsRdrStsFaulty : 247|1@0+ (1,0) [0|1] "" ASDM,PAS
 SG_ ReSideRdrRiStsRdrStsIfVersMajor : 139|4@0+ (1.0,0.0) [0.0|15.0] "Unitless" ASDM,PAS
 SG_ ReSideRdrRiStsRdrStsIfVersMinor : 151|4@0+ (1.0,0.0) [0.0|15.0] "Unitless" ASDM,PAS
 SG_ ReSideRdrRiStsRdrStsLatency : 191|16@0+ (1.0,0.0) [0.0|65535.0] "Unitless" ASDM,PAS
 SG_ ReSideRdrRiStsRdrStsMisAlign : 147|3@0+ (1,0) [0|7] "" ASDM,PAS
 SG_ ReSideRdrRiStsRdrStsMissCom : 144|1@0+ (1,0) [0|1] "" ASDM,PAS
 SG_ ReSideRdrRiStsRdrStsSftyFlt : 246|2@0+ (1,0) [0|3] "" ASDM,PAS
 SG_ ReSideRdrRiStsRdrStsTiStamp : 159|32@0+ (0.0001,0.0) [0.0|429496.7295] "s" ASDM,PAS
 SG_ ReSideRdrRiStsRdrStsTiStampStsGlbTiBas : 244|1@0+ (1,0) [0|1] "" ASDM,PAS
 SG_ ReSideRdrRiStsRdrStsTiStampStsSyncToGatewy : 224|1@0+ (1,0) [0|1] "" ASDM,PAS
 SG_ ReSideRdrRiStsRdrStsTiStampStsTiLeap : 225|1@0+ (1,0) [0|1] "" ASDM,PAS
 SG_ ReSideRdrRiStsRdrStsTiStampStsTiOut : 226|1@0+ (1,0) [0|1] "" ASDM,PAS
 SG_ ReSideRdrRiStsRdrStsWhlSpdCmpFac : 231|5@0+ (0.005,0.92) [0.92|1.075] "Unitless" ASDM,PAS

BO_ 305 SODRSafetyCANFD3Frame01: 64 SODR
 SG_ ReSideRdrRiDetn1_UB : 74|1@0+ (1,0) [0|1] "" ASDM,PAS
 SG_ ReSideRdrRiDetn1RdrDetnAzi : 31|11@0+ (0.1,-90.0) [-90.0|90.0] "Deg" ASDM,PAS
 SG_ ReSideRdrRiDetn1RdrDetnChks : 7|8@0+ (1.0,0.0) [0.0|255.0] "Unitless" ASDM,PAS
 SG_ ReSideRdrRiDetn1RdrDetnCntr : 15|4@0+ (1.0,0.0) [0.0|15.0] "Unitless" ASDM,PAS
 SG_ ReSideRdrRiDetn1RdrDetnConf : 71|7@0+ (1.0,0.0) [0.0|100.0] "%" ASDM,PAS
 SG_ ReSideRdrRiDetn1RdrDetnElevn : 79|5@0+ (1.0,-15.0) [-15.0|15.0] "Deg" ASDM,PAS
 SG_ ReSideRdrRiDetn1RdrDetnPwr : 8|9@0+ (0.1,0.0) [0.0|51.1] "dB" ASDM,PAS
 SG_ ReSideRdrRiDetn1RdrDetnRng : 55|14@0+ (0.02,-1.0) [-1.0|200.0] "m" ASDM,PAS
 SG_ ReSideRdrRiDetn1RdrDetnRngV : 36|13@0+ (0.02,-80.0) [-80.0|80.0] "m/s" ASDM,PAS
 SG_ ReSideRdrRiDetn1RdrDetnSts : 11|2@0+ (1,0) [0|3] "" ASDM,PAS
 SG_ ReSideRdrRiDetn2_UB : 154|1@0+ (1,0) [0|1] "" ASDM,PAS
 SG_ ReSideRdrRiDetn2RdrDetnAzi : 119|11@0+ (0.1,-90.0) [-90.0|90.0] "Deg" ASDM,PAS
 SG_ ReSideRdrRiDetn2RdrDetnChks : 87|8@0+ (1.0,0.0) [0.0|255.0] "Unitless" ASDM,PAS
 SG_ ReSideRdrRiDetn2RdrDetnCntr : 95|4@0+ (1.0,0.0) [0.0|15.0] "Unitless" ASDM,PAS
 SG_ ReSideRdrRiDetn2RdrDetnConf : 111|7@0+ (1.0,0.0) [0.0|100.0] "%" ASDM,PAS
 SG_ ReSideRdrRiDetn2RdrDetnElevn : 159|5@0+ (1.0,-15.0) [-15.0|15.0] "Deg" ASDM,PAS
 SG_ ReSideRdrRiDetn2RdrDetnPwr : 89|9@0+ (0.1,0.0) [0.0|51.1] "dB" ASDM,PAS
 SG_ ReSideRdrRiDetn2RdrDetnRng : 143|14@0+ (0.02,-1.0) [-1.0|200.0] "m" ASDM,PAS
 SG_ ReSideRdrRiDetn2RdrDetnRngV : 124|13@0+ (0.02,-80.0) [-80.0|80.0] "m/s" ASDM,PAS
 SG_ ReSideRdrRiDetn2RdrDetnSts : 91|2@0+ (1,0) [0|3] "" ASDM,PAS
 SG_ ReSideRdrRiDetn3_UB : 234|1@0+ (1,0) [0|1] "" ASDM,PAS
 SG_ ReSideRdrRiDetn3RdrDetnAzi : 199|11@0+ (0.1,-90.0) [-90.0|90.0] "Deg" ASDM,PAS
 SG_ ReSideRdrRiDetn3RdrDetnChks : 167|8@0+ (1.0,0.0) [0.0|255.0] "Unitless" ASDM,PAS
 SG_ ReSideRdrRiDetn3RdrDetnCntr : 175|4@0+ (1.0,0.0) [0.0|15.0] "Unitless" ASDM,PAS
 SG_ ReSideRdrRiDetn3RdrDetnConf : 191|7@0+ (1.0,0.0) [0.0|100.0] "%" ASDM,PAS
 SG_ ReSideRdrRiDetn3RdrDetnElevn : 239|5@0+ (1.0,-15.0) [-15.0|15.0] "Deg" ASDM,PAS
 SG_ ReSideRdrRiDetn3RdrDetnPwr : 169|9@0+ (0.1,0.0) [0.0|51.1] "dB" ASDM,PAS
 SG_ ReSideRdrRiDetn3RdrDetnRng : 223|14@0+ (0.02,-1.0) [-1.0|200.0] "m" ASDM,PAS
 SG_ ReSideRdrRiDetn3RdrDetnRngV : 204|13@0+ (0.02,-80.0) [-80.0|80.0] "m/s" ASDM,PAS
 SG_ ReSideRdrRiDetn3RdrDetnSts : 171|2@0+ (1,0) [0|3] "" ASDM,PAS
 SG_ ReSideRdrRiDetn4_UB : 314|1@0+ (1,0) [0|1] "" ASDM,PAS
 SG_ ReSideRdrRiDetn4RdrDetnAzi : 287|11@0+ (0.1,-90.0) [-90.0|90.0] "Deg" ASDM,PAS
 SG_ ReSideRdrRiDetn4RdrDetnChks : 247|8@0+ (1.0,0.0) [0.0|255.0] "Unitless" ASDM,PAS
 SG_ ReSideRdrRiDetn4RdrDetnCntr : 255|4@0+ (1.0,0.0) [0.0|15.0] "Unitless" ASDM,PAS
 SG_ ReSideRdrRiDetn4RdrDetnConf : 311|7@0+ (1.0,0.0) [0.0|100.0] "%" ASDM,PAS
 SG_ ReSideRdrRiDetn4RdrDetnElevn : 319|5@0+ (1.0,-15.0) [-15.0|15.0] "Deg" ASDM,PAS
 SG_ ReSideRdrRiDetn4RdrDetnPwr : 249|9@0+ (0.1,0.0) [0.0|51.1] "dB" ASDM,PAS
 SG_ ReSideRdrRiDetn4RdrDetnRng : 271|14@0+ (0.02,-1.0) [-1.0|200.0] "m" ASDM,PAS
 SG_ ReSideRdrRiDetn4RdrDetnRngV : 292|13@0+ (0.02,-80.0) [-80.0|80.0] "m/s" ASDM,PAS
 SG_ ReSideRdrRiDetn4RdrDetnSts : 251|2@0+ (1,0) [0|3] "" ASDM,PAS
 SG_ ReSideRdrRiDetn5_UB : 394|1@0+ (1,0) [0|1] "" ASDM,PAS
 SG_ ReSideRdrRiDetn5RdrDetnAzi : 351|11@0+ (0.1,-90.0) [-90.0|90.0] "Deg" ASDM,PAS
 SG_ ReSideRdrRiDetn5RdrDetnChks : 327|8@0+ (1.0,0.0) [0.0|255.0] "Unitless" ASDM,PAS
 SG_ ReSideRdrRiDetn5RdrDetnCntr : 335|4@0+ (1.0,0.0) [0.0|15.0] "Unitless" ASDM,PAS
 SG_ ReSideRdrRiDetn5RdrDetnConf : 391|7@0+ (1.0,0.0) [0.0|100.0] "%" ASDM,PAS
 SG_ ReSideRdrRiDetn5RdrDetnElevn : 399|5@0+ (1.0,-15.0) [-15.0|15.0] "Deg" ASDM,PAS
 SG_ ReSideRdrRiDetn5RdrDetnPwr : 329|9@0+ (0.1,0.0) [0.0|51.1] "dB" ASDM,PAS
 SG_ ReSideRdrRiDetn5RdrDetnRng : 375|14@0+ (0.02,-1.0) [-1.0|200.0] "m" ASDM,PAS
 SG_ ReSideRdrRiDetn5RdrDetnRngV : 356|13@0+ (0.02,-80.0) [-80.0|80.0] "m/s" ASDM,PAS
 SG_ ReSideRdrRiDetn5RdrDetnSts : 331|2@0+ (1,0) [0|3] "" ASDM,PAS
 SG_ ReSideRdrRiDetn6_UB : 474|1@0+ (1,0) [0|1] "" ASDM,PAS
 SG_ ReSideRdrRiDetn6RdrDetnAzi : 447|11@0+ (0.1,-90.0) [-90.0|90.0] "Deg" ASDM,PAS
 SG_ ReSideRdrRiDetn6RdrDetnChks : 407|8@0+ (1.0,0.0) [0.0|255.0] "Unitless" ASDM,PAS
 SG_ ReSideRdrRiDetn6RdrDetnCntr : 415|4@0+ (1.0,0.0) [0.0|15.0] "Unitless" ASDM,PAS
 SG_ ReSideRdrRiDetn6RdrDetnConf : 471|7@0+ (1.0,0.0) [0.0|100.0] "%" ASDM,PAS
 SG_ ReSideRdrRiDetn6RdrDetnElevn : 479|5@0+ (1.0,-15.0) [-15.0|15.0] "Deg" ASDM,PAS
 SG_ ReSideRdrRiDetn6RdrDetnPwr : 409|9@0+ (0.1,0.0) [0.0|51.1] "dB" ASDM,PAS
 SG_ ReSideRdrRiDetn6RdrDetnRng : 431|14@0+ (0.02,-1.0) [-1.0|200.0] "m" ASDM,PAS
 SG_ ReSideRdrRiDetn6RdrDetnRngV : 452|13@0+ (0.02,-80.0) [-80.0|80.0] "m/s" ASDM,PAS
 SG_ ReSideRdrRiDetn6RdrDetnSts : 411|2@0+ (1,0) [0|3] "" ASDM,PAS

BO_ 307 SODRSafetyCANFD3Frame02: 64 SODR
 SG_ ReSideRdrRiDetn10_UB : 314|1@0+ (1,0) [0|1] "" ASDM,PAS
 SG_ ReSideRdrRiDetn10RdrDetnAzi : 287|11@0+ (0.1,-90.0) [-90.0|90.0] "Deg" ASDM,PAS
 SG_ ReSideRdrRiDetn10RdrDetnChks : 247|8@0+ (1.0,0.0) [0.0|255.0] "Unitless" ASDM,PAS
 SG_ ReSideRdrRiDetn10RdrDetnCntr : 255|4@0+ (1.0,0.0) [0.0|15.0] "Unitless" ASDM,PAS
 SG_ ReSideRdrRiDetn10RdrDetnConf : 311|7@0+ (1.0,0.0) [0.0|100.0] "%" ASDM,PAS
 SG_ ReSideRdrRiDetn10RdrDetnElevn : 319|5@0+ (1.0,-15.0) [-15.0|15.0] "Deg" ASDM,PAS
 SG_ ReSideRdrRiDetn10RdrDetnPwr : 249|9@0+ (0.1,0.0) [0.0|51.1] "dB" ASDM,PAS
 SG_ ReSideRdrRiDetn10RdrDetnRng : 271|14@0+ (0.02,-1.0) [-1.0|200.0] "m" ASDM,PAS
 SG_ ReSideRdrRiDetn10RdrDetnRngV : 292|13@0+ (0.02,-80.0) [-80.0|80.0] "m/s" ASDM,PAS
 SG_ ReSideRdrRiDetn10RdrDetnSts : 251|2@0+ (1,0) [0|3] "" ASDM,PAS
 SG_ ReSideRdrRiDetn11_UB : 394|1@0+ (1,0) [0|1] "" ASDM,PAS
 SG_ ReSideRdrRiDetn11RdrDetnAzi : 351|11@0+ (0.1,-90.0) [-90.0|90.0] "Deg" ASDM,PAS
 SG_ ReSideRdrRiDetn11RdrDetnChks : 327|8@0+ (1.0,0.0) [0.0|255.0] "Unitless" ASDM,PAS
 SG_ ReSideRdrRiDetn11RdrDetnCntr : 335|4@0+ (1.0,0.0) [0.0|15.0] "Unitless" ASDM,PAS
 SG_ ReSideRdrRiDetn11RdrDetnConf : 391|7@0+ (1.0,0.0) [0.0|100.0] "%" ASDM,PAS
 SG_ ReSideRdrRiDetn11RdrDetnElevn : 399|5@0+ (1.0,-15.0) [-15.0|15.0] "Deg" ASDM,PAS
 SG_ ReSideRdrRiDetn11RdrDetnPwr : 329|9@0+ (0.1,0.0) [0.0|51.1] "dB" ASDM,PAS
 SG_ ReSideRdrRiDetn11RdrDetnRng : 375|14@0+ (0.02,-1.0) [-1.0|200.0] "m" ASDM,PAS
 SG_ ReSideRdrRiDetn11RdrDetnRngV : 356|13@0+ (0.02,-80.0) [-80.0|80.0] "m/s" ASDM,PAS
 SG_ ReSideRdrRiDetn11RdrDetnSts : 331|2@0+ (1,0) [0|3] "" ASDM,PAS
 SG_ ReSideRdrRiDetn12_UB : 474|1@0+ (1,0) [0|1] "" ASDM,PAS
 SG_ ReSideRdrRiDetn12RdrDetnAzi : 447|11@0+ (0.1,-90.0) [-90.0|90.0] "Deg" ASDM,PAS
 SG_ ReSideRdrRiDetn12RdrDetnChks : 407|8@0+ (1.0,0.0) [0.0|255.0] "Unitless" ASDM,PAS
 SG_ ReSideRdrRiDetn12RdrDetnCntr : 415|4@0+ (1.0,0.0) [0.0|15.0] "Unitless" ASDM,PAS
 SG_ ReSideRdrRiDetn12RdrDetnConf : 471|7@0+ (1.0,0.0) [0.0|100.0] "%" ASDM,PAS
 SG_ ReSideRdrRiDetn12RdrDetnElevn : 479|5@0+ (1.0,-15.0) [-15.0|15.0] "Deg" ASDM,PAS
 SG_ ReSideRdrRiDetn12RdrDetnPwr : 409|9@0+ (0.1,0.0) [0.0|51.1] "dB" ASDM,PAS
 SG_ ReSideRdrRiDetn12RdrDetnRng : 431|14@0+ (0.02,-1.0) [-1.0|200.0] "m" ASDM,PAS
 SG_ ReSideRdrRiDetn12RdrDetnRngV : 452|13@0+ (0.02,-80.0) [-80.0|80.0] "m/s" ASDM,PAS
 SG_ ReSideRdrRiDetn12RdrDetnSts : 411|2@0+ (1,0) [0|3] "" ASDM,PAS
 SG_ ReSideRdrRiDetn7_UB : 74|1@0+ (1,0) [0|1] "" ASDM,PAS
 SG_ ReSideRdrRiDetn7RdrDetnAzi : 31|11@0+ (0.1,-90.0) [-90.0|90.0] "Deg" ASDM,PAS
 SG_ ReSideRdrRiDetn7RdrDetnChks : 7|8@0+ (1.0,0.0) [0.0|255.0] "Unitless" ASDM,PAS
 SG_ ReSideRdrRiDetn7RdrDetnCntr : 15|4@0+ (1.0,0.0) [0.0|15.0] "Unitless" ASDM,PAS
 SG_ ReSideRdrRiDetn7RdrDetnConf : 71|7@0+ (1.0,0.0) [0.0|100.0] "%" ASDM,PAS
 SG_ ReSideRdrRiDetn7RdrDetnElevn : 79|5@0+ (1.0,-15.0) [-15.0|15.0] "Deg" ASDM,PAS
 SG_ ReSideRdrRiDetn7RdrDetnPwr : 8|9@0+ (0.1,0.0) [0.0|51.1] "dB" ASDM,PAS
 SG_ ReSideRdrRiDetn7RdrDetnRng : 55|14@0+ (0.02,-1.0) [-1.0|200.0] "m" ASDM,PAS
 SG_ ReSideRdrRiDetn7RdrDetnRngV : 36|13@0+ (0.02,-80.0) [-80.0|80.0] "m/s" ASDM,PAS
 SG_ ReSideRdrRiDetn7RdrDetnSts : 11|2@0+ (1,0) [0|3] "" ASDM,PAS
 SG_ ReSideRdrRiDetn8_UB : 154|1@0+ (1,0) [0|1] "" ASDM,PAS
 SG_ ReSideRdrRiDetn8RdrDetnAzi : 119|11@0+ (0.1,-90.0) [-90.0|90.0] "Deg" ASDM,PAS
 SG_ ReSideRdrRiDetn8RdrDetnChks : 87|8@0+ (1.0,0.0) [0.0|255.0] "Unitless" ASDM,PAS
 SG_ ReSideRdrRiDetn8RdrDetnCntr : 95|4@0+ (1.0,0.0) [0.0|15.0] "Unitless" ASDM,PAS
 SG_ ReSideRdrRiDetn8RdrDetnConf : 111|7@0+ (1.0,0.0) [0.0|100.0] "%" ASDM,PAS
 SG_ ReSideRdrRiDetn8RdrDetnElevn : 159|5@0+ (1.0,-15.0) [-15.0|15.0] "Deg" ASDM,PAS
 SG_ ReSideRdrRiDetn8RdrDetnPwr : 89|9@0+ (0.1,0.0) [0.0|51.1] "dB" ASDM,PAS
 SG_ ReSideRdrRiDetn8RdrDetnRng : 143|14@0+ (0.02,-1.0) [-1.0|200.0] "m" ASDM,PAS
 SG_ ReSideRdrRiDetn8RdrDetnRngV : 124|13@0+ (0.02,-80.0) [-80.0|80.0] "m/s" ASDM,PAS
 SG_ ReSideRdrRiDetn8RdrDetnSts : 91|2@0+ (1,0) [0|3] "" ASDM,PAS
 SG_ ReSideRdrRiDetn9_UB : 234|1@0+ (1,0) [0|1] "" ASDM,PAS
 SG_ ReSideRdrRiDetn9RdrDetnAzi : 199|11@0+ (0.1,-90.0) [-90.0|90.0] "Deg" ASDM,PAS
 SG_ ReSideRdrRiDetn9RdrDetnChks : 167|8@0+ (1.0,0.0) [0.0|255.0] "Unitless" ASDM,PAS
 SG_ ReSideRdrRiDetn9RdrDetnCntr : 175|4@0+ (1.0,0.0) [0.0|15.0] "Unitless" ASDM,PAS
 SG_ ReSideRdrRiDetn9RdrDetnConf : 191|7@0+ (1.0,0.0) [0.0|100.0] "%" ASDM,PAS
 SG_ ReSideRdrRiDetn9RdrDetnElevn : 239|5@0+ (1.0,-15.0) [-15.0|15.0] "Deg" ASDM,PAS
 SG_ ReSideRdrRiDetn9RdrDetnPwr : 169|9@0+ (0.1,0.0) [0.0|51.1] "dB" ASDM,PAS
 SG_ ReSideRdrRiDetn9RdrDetnRng : 223|14@0+ (0.02,-1.0) [-1.0|200.0] "m" ASDM,PAS
 SG_ ReSideRdrRiDetn9RdrDetnRngV : 204|13@0+ (0.02,-80.0) [-80.0|80.0] "m/s" ASDM,PAS
 SG_ ReSideRdrRiDetn9RdrDetnSts : 171|2@0+ (1,0) [0|3] "" ASDM,PAS

BO_ 309 SODRSafetyCANFD3Frame03: 64 SODR
 SG_ ReSideRdrRiDetn13_UB : 74|1@0+ (1,0) [0|1] "" ASDM,PAS
 SG_ ReSideRdrRiDetn13RdrDetnAzi : 31|11@0+ (0.1,-90.0) [-90.0|90.0] "Deg" ASDM,PAS
 SG_ ReSideRdrRiDetn13RdrDetnChks : 7|8@0+ (1.0,0.0) [0.0|255.0] "Unitless" ASDM,PAS
 SG_ ReSideRdrRiDetn13RdrDetnCntr : 15|4@0+ (1.0,0.0) [0.0|15.0] "Unitless" ASDM,PAS
 SG_ ReSideRdrRiDetn13RdrDetnConf : 71|7@0+ (1.0,0.0) [0.0|100.0] "%" ASDM,PAS
 SG_ ReSideRdrRiDetn13RdrDetnElevn : 79|5@0+ (1.0,-15.0) [-15.0|15.0] "Deg" ASDM,PAS
 SG_ ReSideRdrRiDetn13RdrDetnPwr : 8|9@0+ (0.1,0.0) [0.0|51.1] "dB" ASDM,PAS
 SG_ ReSideRdrRiDetn13RdrDetnRng : 55|14@0+ (0.02,-1.0) [-1.0|200.0] "m" ASDM,PAS
 SG_ ReSideRdrRiDetn13RdrDetnRngV : 36|13@0+ (0.02,-80.0) [-80.0|80.0] "m/s" ASDM,PAS
 SG_ ReSideRdrRiDetn13RdrDetnSts : 11|2@0+ (1,0) [0|3] "" ASDM,PAS
 SG_ ReSideRdrRiDetn14_UB : 154|1@0+ (1,0) [0|1] "" ASDM,PAS
 SG_ ReSideRdrRiDetn14RdrDetnAzi : 119|11@0+ (0.1,-90.0) [-90.0|90.0] "Deg" ASDM,PAS
 SG_ ReSideRdrRiDetn14RdrDetnChks : 87|8@0+ (1.0,0.0) [0.0|255.0] "Unitless" ASDM,PAS
 SG_ ReSideRdrRiDetn14RdrDetnCntr : 95|4@0+ (1.0,0.0) [0.0|15.0] "Unitless" ASDM,PAS
 SG_ ReSideRdrRiDetn14RdrDetnConf : 111|7@0+ (1.0,0.0) [0.0|100.0] "%" ASDM,PAS
 SG_ ReSideRdrRiDetn14RdrDetnElevn : 159|5@0+ (1.0,-15.0) [-15.0|15.0] "Deg" ASDM,PAS
 SG_ ReSideRdrRiDetn14RdrDetnPwr : 89|9@0+ (0.1,0.0) [0.0|51.1] "dB" ASDM,PAS
 SG_ ReSideRdrRiDetn14RdrDetnRng : 143|14@0+ (0.02,-1.0) [-1.0|200.0] "m" ASDM,PAS
 SG_ ReSideRdrRiDetn14RdrDetnRngV : 124|13@0+ (0.02,-80.0) [-80.0|80.0] "m/s" ASDM,PAS
 SG_ ReSideRdrRiDetn14RdrDetnSts : 91|2@0+ (1,0) [0|3] "" ASDM,PAS
 SG_ ReSideRdrRiDetn15_UB : 234|1@0+ (1,0) [0|1] "" ASDM,PAS
 SG_ ReSideRdrRiDetn15RdrDetnAzi : 199|11@0+ (0.1,-90.0) [-90.0|90.0] "Deg" ASDM,PAS
 SG_ ReSideRdrRiDetn15RdrDetnChks : 167|8@0+ (1.0,0.0) [0.0|255.0] "Unitless" ASDM,PAS
 SG_ ReSideRdrRiDetn15RdrDetnCntr : 175|4@0+ (1.0,0.0) [0.0|15.0] "Unitless" ASDM,PAS
 SG_ ReSideRdrRiDetn15RdrDetnConf : 191|7@0+ (1.0,0.0) [0.0|100.0] "%" ASDM,PAS
 SG_ ReSideRdrRiDetn15RdrDetnElevn : 239|5@0+ (1.0,-15.0) [-15.0|15.0] "Deg" ASDM,PAS
 SG_ ReSideRdrRiDetn15RdrDetnPwr : 169|9@0+ (0.1,0.0) [0.0|51.1] "dB" ASDM,PAS
 SG_ ReSideRdrRiDetn15RdrDetnRng : 223|14@0+ (0.02,-1.0) [-1.0|200.0] "m" ASDM,PAS
 SG_ ReSideRdrRiDetn15RdrDetnRngV : 204|13@0+ (0.02,-80.0) [-80.0|80.0] "m/s" ASDM,PAS
 SG_ ReSideRdrRiDetn15RdrDetnSts : 171|2@0+ (1,0) [0|3] "" ASDM,PAS
 SG_ ReSideRdrRiDetn16_UB : 314|1@0+ (1,0) [0|1] "" ASDM,PAS
 SG_ ReSideRdrRiDetn16RdrDetnAzi : 287|11@0+ (0.1,-90.0) [-90.0|90.0] "Deg" ASDM,PAS
 SG_ ReSideRdrRiDetn16RdrDetnChks : 247|8@0+ (1.0,0.0) [0.0|255.0] "Unitless" ASDM,PAS
 SG_ ReSideRdrRiDetn16RdrDetnCntr : 255|4@0+ (1.0,0.0) [0.0|15.0] "Unitless" ASDM,PAS
 SG_ ReSideRdrRiDetn16RdrDetnConf : 311|7@0+ (1.0,0.0) [0.0|100.0] "%" ASDM,PAS
 SG_ ReSideRdrRiDetn16RdrDetnElevn : 319|5@0+ (1.0,-15.0) [-15.0|15.0] "Deg" ASDM,PAS
 SG_ ReSideRdrRiDetn16RdrDetnPwr : 249|9@0+ (0.1,0.0) [0.0|51.1] "dB" ASDM,PAS
 SG_ ReSideRdrRiDetn16RdrDetnRng : 271|14@0+ (0.02,-1.0) [-1.0|200.0] "m" ASDM,PAS
 SG_ ReSideRdrRiDetn16RdrDetnRngV : 292|13@0+ (0.02,-80.0) [-80.0|80.0] "m/s" ASDM,PAS
 SG_ ReSideRdrRiDetn16RdrDetnSts : 251|2@0+ (1,0) [0|3] "" ASDM,PAS
 SG_ ReSideRdrRiDetn17_UB : 394|1@0+ (1,0) [0|1] "" ASDM,PAS
 SG_ ReSideRdrRiDetn17RdrDetnAzi : 351|11@0+ (0.1,-90.0) [-90.0|90.0] "Deg" ASDM,PAS
 SG_ ReSideRdrRiDetn17RdrDetnChks : 327|8@0+ (1.0,0.0) [0.0|255.0] "Unitless" ASDM,PAS
 SG_ ReSideRdrRiDetn17RdrDetnCntr : 335|4@0+ (1.0,0.0) [0.0|15.0] "Unitless" ASDM,PAS
 SG_ ReSideRdrRiDetn17RdrDetnConf : 391|7@0+ (1.0,0.0) [0.0|100.0] "%" ASDM,PAS
 SG_ ReSideRdrRiDetn17RdrDetnElevn : 399|5@0+ (1.0,-15.0) [-15.0|15.0] "Deg" ASDM,PAS
 SG_ ReSideRdrRiDetn17RdrDetnPwr : 329|9@0+ (0.1,0.0) [0.0|51.1] "dB" ASDM,PAS
 SG_ ReSideRdrRiDetn17RdrDetnRng : 375|14@0+ (0.02,-1.0) [-1.0|200.0] "m" ASDM,PAS
 SG_ ReSideRdrRiDetn17RdrDetnRngV : 356|13@0+ (0.02,-80.0) [-80.0|80.0] "m/s" ASDM,PAS
 SG_ ReSideRdrRiDetn17RdrDetnSts : 331|2@0+ (1,0) [0|3] "" ASDM,PAS
 SG_ ReSideRdrRiDetn18_UB : 474|1@0+ (1,0) [0|1] "" ASDM,PAS
 SG_ ReSideRdrRiDetn18RdrDetnAzi : 447|11@0+ (0.1,-90.0) [-90.0|90.0] "Deg" ASDM,PAS
 SG_ ReSideRdrRiDetn18RdrDetnChks : 407|8@0+ (1.0,0.0) [0.0|255.0] "Unitless" ASDM,PAS
 SG_ ReSideRdrRiDetn18RdrDetnCntr : 415|4@0+ (1.0,0.0) [0.0|15.0] "Unitless" ASDM,PAS
 SG_ ReSideRdrRiDetn18RdrDetnConf : 471|7@0+ (1.0,0.0) [0.0|100.0] "%" ASDM,PAS
 SG_ ReSideRdrRiDetn18RdrDetnElevn : 479|5@0+ (1.0,-15.0) [-15.0|15.0] "Deg" ASDM,PAS
 SG_ ReSideRdrRiDetn18RdrDetnPwr : 409|9@0+ (0.1,0.0) [0.0|51.1] "dB" ASDM,PAS
 SG_ ReSideRdrRiDetn18RdrDetnRng : 431|14@0+ (0.02,-1.0) [-1.0|200.0] "m" ASDM,PAS
 SG_ ReSideRdrRiDetn18RdrDetnRngV : 452|13@0+ (0.02,-80.0) [-80.0|80.0] "m/s" ASDM,PAS
 SG_ ReSideRdrRiDetn18RdrDetnSts : 411|2@0+ (1,0) [0|3] "" ASDM,PAS

BO_ 311 SODRSafetyCANFD3Frame04: 64 SODR
 SG_ ReSideRdrRiDetn19_UB : 74|1@0+ (1,0) [0|1] "" ASDM,PAS
 SG_ ReSideRdrRiDetn19RdrDetnAzi : 31|11@0+ (0.1,-90.0) [-90.0|90.0] "Deg" ASDM,PAS
 SG_ ReSideRdrRiDetn19RdrDetnChks : 7|8@0+ (1.0,0.0) [0.0|255.0] "Unitless" ASDM,PAS
 SG_ ReSideRdrRiDetn19RdrDetnCntr : 15|4@0+ (1.0,0.0) [0.0|15.0] "Unitless" ASDM,PAS
 SG_ ReSideRdrRiDetn19RdrDetnConf : 71|7@0+ (1.0,0.0) [0.0|100.0] "%" ASDM,PAS
 SG_ ReSideRdrRiDetn19RdrDetnElevn : 79|5@0+ (1.0,-15.0) [-15.0|15.0] "Deg" ASDM,PAS
 SG_ ReSideRdrRiDetn19RdrDetnPwr : 8|9@0+ (0.1,0.0) [0.0|51.1] "dB" ASDM,PAS
 SG_ ReSideRdrRiDetn19RdrDetnRng : 55|14@0+ (0.02,-1.0) [-1.0|200.0] "m" ASDM,PAS
 SG_ ReSideRdrRiDetn19RdrDetnRngV : 36|13@0+ (0.02,-80.0) [-80.0|80.0] "m/s" ASDM,PAS
 SG_ ReSideRdrRiDetn19RdrDetnSts : 11|2@0+ (1,0) [0|3] "" ASDM,PAS
 SG_ ReSideRdrRiDetn20_UB : 154|1@0+ (1,0) [0|1] "" ASDM,PAS
 SG_ ReSideRdrRiDetn20RdrDetnAzi : 119|11@0+ (0.1,-90.0) [-90.0|90.0] "Deg" ASDM,PAS
 SG_ ReSideRdrRiDetn20RdrDetnChks : 87|8@0+ (1.0,0.0) [0.0|255.0] "Unitless" ASDM,PAS
 SG_ ReSideRdrRiDetn20RdrDetnCntr : 95|4@0+ (1.0,0.0) [0.0|15.0] "Unitless" ASDM,PAS
 SG_ ReSideRdrRiDetn20RdrDetnConf : 111|7@0+ (1.0,0.0) [0.0|100.0] "%" ASDM,PAS
 SG_ ReSideRdrRiDetn20RdrDetnElevn : 159|5@0+ (1.0,-15.0) [-15.0|15.0] "Deg" ASDM,PAS
 SG_ ReSideRdrRiDetn20RdrDetnPwr : 89|9@0+ (0.1,0.0) [0.0|51.1] "dB" ASDM,PAS
 SG_ ReSideRdrRiDetn20RdrDetnRng : 143|14@0+ (0.02,-1.0) [-1.0|200.0] "m" ASDM,PAS
 SG_ ReSideRdrRiDetn20RdrDetnRngV : 124|13@0+ (0.02,-80.0) [-80.0|80.0] "m/s" ASDM,PAS
 SG_ ReSideRdrRiDetn20RdrDetnSts : 91|2@0+ (1,0) [0|3] "" ASDM,PAS
 SG_ ReSideRdrRiDetn21_UB : 234|1@0+ (1,0) [0|1] "" ASDM,PAS
 SG_ ReSideRdrRiDetn21RdrDetnAzi : 199|11@0+ (0.1,-90.0) [-90.0|90.0] "Deg" ASDM,PAS
 SG_ ReSideRdrRiDetn21RdrDetnChks : 167|8@0+ (1.0,0.0) [0.0|255.0] "Unitless" ASDM,PAS
 SG_ ReSideRdrRiDetn21RdrDetnCntr : 175|4@0+ (1.0,0.0) [0.0|15.0] "Unitless" ASDM,PAS
 SG_ ReSideRdrRiDetn21RdrDetnConf : 191|7@0+ (1.0,0.0) [0.0|100.0] "%" ASDM,PAS
 SG_ ReSideRdrRiDetn21RdrDetnElevn : 239|5@0+ (1.0,-15.0) [-15.0|15.0] "Deg" ASDM,PAS
 SG_ ReSideRdrRiDetn21RdrDetnPwr : 169|9@0+ (0.1,0.0) [0.0|51.1] "dB" ASDM,PAS
 SG_ ReSideRdrRiDetn21RdrDetnRng : 223|14@0+ (0.02,-1.0) [-1.0|200.0] "m" ASDM,PAS
 SG_ ReSideRdrRiDetn21RdrDetnRngV : 204|13@0+ (0.02,-80.0) [-80.0|80.0] "m/s" ASDM,PAS
 SG_ ReSideRdrRiDetn21RdrDetnSts : 171|2@0+ (1,0) [0|3] "" ASDM,PAS
 SG_ ReSideRdrRiDetn22_UB : 314|1@0+ (1,0) [0|1] "" ASDM,PAS
 SG_ ReSideRdrRiDetn22RdrDetnAzi : 287|11@0+ (0.1,-90.0) [-90.0|90.0] "Deg" ASDM,PAS
 SG_ ReSideRdrRiDetn22RdrDetnChks : 247|8@0+ (1.0,0.0) [0.0|255.0] "Unitless" ASDM,PAS
 SG_ ReSideRdrRiDetn22RdrDetnCntr : 255|4@0+ (1.0,0.0) [0.0|15.0] "Unitless" ASDM,PAS
 SG_ ReSideRdrRiDetn22RdrDetnConf : 311|7@0+ (1.0,0.0) [0.0|100.0] "%" ASDM,PAS
 SG_ ReSideRdrRiDetn22RdrDetnElevn : 319|5@0+ (1.0,-15.0) [-15.0|15.0] "Deg" ASDM,PAS
 SG_ ReSideRdrRiDetn22RdrDetnPwr : 249|9@0+ (0.1,0.0) [0.0|51.1] "dB" ASDM,PAS
 SG_ ReSideRdrRiDetn22RdrDetnRng : 271|14@0+ (0.02,-1.0) [-1.0|200.0] "m" ASDM,PAS
 SG_ ReSideRdrRiDetn22RdrDetnRngV : 292|13@0+ (0.02,-80.0) [-80.0|80.0] "m/s" ASDM,PAS
 SG_ ReSideRdrRiDetn22RdrDetnSts : 251|2@0+ (1,0) [0|3] "" ASDM,PAS
 SG_ ReSideRdrRiDetn23_UB : 394|1@0+ (1,0) [0|1] "" ASDM,PAS
 SG_ ReSideRdrRiDetn23RdrDetnAzi : 351|11@0+ (0.1,-90.0) [-90.0|90.0] "Deg" ASDM,PAS
 SG_ ReSideRdrRiDetn23RdrDetnChks : 327|8@0+ (1.0,0.0) [0.0|255.0] "Unitless" ASDM,PAS
 SG_ ReSideRdrRiDetn23RdrDetnCntr : 335|4@0+ (1.0,0.0) [0.0|15.0] "Unitless" ASDM,PAS
 SG_ ReSideRdrRiDetn23RdrDetnConf : 391|7@0+ (1.0,0.0) [0.0|100.0] "%" ASDM,PAS
 SG_ ReSideRdrRiDetn23RdrDetnElevn : 399|5@0+ (1.0,-15.0) [-15.0|15.0] "Deg" ASDM,PAS
 SG_ ReSideRdrRiDetn23RdrDetnPwr : 329|9@0+ (0.1,0.0) [0.0|51.1] "dB" ASDM,PAS
 SG_ ReSideRdrRiDetn23RdrDetnRng : 375|14@0+ (0.02,-1.0) [-1.0|200.0] "m" ASDM,PAS
 SG_ ReSideRdrRiDetn23RdrDetnRngV : 356|13@0+ (0.02,-80.0) [-80.0|80.0] "m/s" ASDM,PAS
 SG_ ReSideRdrRiDetn23RdrDetnSts : 331|2@0+ (1,0) [0|3] "" ASDM,PAS
 SG_ ReSideRdrRiDetn24_UB : 474|1@0+ (1,0) [0|1] "" ASDM,PAS
 SG_ ReSideRdrRiDetn24RdrDetnAzi : 447|11@0+ (0.1,-90.0) [-90.0|90.0] "Deg" ASDM,PAS
 SG_ ReSideRdrRiDetn24RdrDetnChks : 407|8@0+ (1.0,0.0) [0.0|255.0] "Unitless" ASDM,PAS
 SG_ ReSideRdrRiDetn24RdrDetnCntr : 415|4@0+ (1.0,0.0) [0.0|15.0] "Unitless" ASDM,PAS
 SG_ ReSideRdrRiDetn24RdrDetnConf : 471|7@0+ (1.0,0.0) [0.0|100.0] "%" ASDM,PAS
 SG_ ReSideRdrRiDetn24RdrDetnElevn : 479|5@0+ (1.0,-15.0) [-15.0|15.0] "Deg" ASDM,PAS
 SG_ ReSideRdrRiDetn24RdrDetnPwr : 409|9@0+ (0.1,0.0) [0.0|51.1] "dB" ASDM,PAS
 SG_ ReSideRdrRiDetn24RdrDetnRng : 431|14@0+ (0.02,-1.0) [-1.0|200.0] "m" ASDM,PAS
 SG_ ReSideRdrRiDetn24RdrDetnRngV : 452|13@0+ (0.02,-80.0) [-80.0|80.0] "m/s" ASDM,PAS
 SG_ ReSideRdrRiDetn24RdrDetnSts : 411|2@0+ (1,0) [0|3] "" ASDM,PAS

BO_ 313 SODRSafetyCANFD3Frame05: 64 SODR
 SG_ ReSideRdrRiDetn25_UB : 74|1@0+ (1,0) [0|1] "" ASDM,PAS
 SG_ ReSideRdrRiDetn25RdrDetnAzi : 31|11@0+ (0.1,-90.0) [-90.0|90.0] "Deg" ASDM,PAS
 SG_ ReSideRdrRiDetn25RdrDetnChks : 7|8@0+ (1.0,0.0) [0.0|255.0] "Unitless" ASDM,PAS
 SG_ ReSideRdrRiDetn25RdrDetnCntr : 15|4@0+ (1.0,0.0) [0.0|15.0] "Unitless" ASDM,PAS
 SG_ ReSideRdrRiDetn25RdrDetnConf : 71|7@0+ (1.0,0.0) [0.0|100.0] "%" ASDM,PAS
 SG_ ReSideRdrRiDetn25RdrDetnElevn : 79|5@0+ (1.0,-15.0) [-15.0|15.0] "Deg" ASDM,PAS
 SG_ ReSideRdrRiDetn25RdrDetnPwr : 8|9@0+ (0.1,0.0) [0.0|51.1] "dB" ASDM,PAS
 SG_ ReSideRdrRiDetn25RdrDetnRng : 55|14@0+ (0.02,-1.0) [-1.0|200.0] "m" ASDM,PAS
 SG_ ReSideRdrRiDetn25RdrDetnRngV : 36|13@0+ (0.02,-80.0) [-80.0|80.0] "m/s" ASDM,PAS
 SG_ ReSideRdrRiDetn25RdrDetnSts : 11|2@0+ (1,0) [0|3] "" ASDM,PAS
 SG_ ReSideRdrRiDetn26_UB : 154|1@0+ (1,0) [0|1] "" ASDM,PAS
 SG_ ReSideRdrRiDetn26RdrDetnAzi : 119|11@0+ (0.1,-90.0) [-90.0|90.0] "Deg" ASDM,PAS
 SG_ ReSideRdrRiDetn26RdrDetnChks : 87|8@0+ (1.0,0.0) [0.0|255.0] "Unitless" ASDM,PAS
 SG_ ReSideRdrRiDetn26RdrDetnCntr : 95|4@0+ (1.0,0.0) [0.0|15.0] "Unitless" ASDM,PAS
 SG_ ReSideRdrRiDetn26RdrDetnConf : 111|7@0+ (1.0,0.0) [0.0|100.0] "%" ASDM,PAS
 SG_ ReSideRdrRiDetn26RdrDetnElevn : 159|5@0+ (1.0,-15.0) [-15.0|15.0] "Deg" ASDM,PAS
 SG_ ReSideRdrRiDetn26RdrDetnPwr : 89|9@0+ (0.1,0.0) [0.0|51.1] "dB" ASDM,PAS
 SG_ ReSideRdrRiDetn26RdrDetnRng : 143|14@0+ (0.02,-1.0) [-1.0|200.0] "m" ASDM,PAS
 SG_ ReSideRdrRiDetn26RdrDetnRngV : 124|13@0+ (0.02,-80.0) [-80.0|80.0] "m/s" ASDM,PAS
 SG_ ReSideRdrRiDetn26RdrDetnSts : 91|2@0+ (1,0) [0|3] "" ASDM,PAS
 SG_ ReSideRdrRiDetn27_UB : 234|1@0+ (1,0) [0|1] "" ASDM,PAS
 SG_ ReSideRdrRiDetn27RdrDetnAzi : 199|11@0+ (0.1,-90.0) [-90.0|90.0] "Deg" ASDM,PAS
 SG_ ReSideRdrRiDetn27RdrDetnChks : 167|8@0+ (1.0,0.0) [0.0|255.0] "Unitless" ASDM,PAS
 SG_ ReSideRdrRiDetn27RdrDetnCntr : 175|4@0+ (1.0,0.0) [0.0|15.0] "Unitless" ASDM,PAS
 SG_ ReSideRdrRiDetn27RdrDetnConf : 191|7@0+ (1.0,0.0) [0.0|100.0] "%" ASDM,PAS
 SG_ ReSideRdrRiDetn27RdrDetnElevn : 239|5@0+ (1.0,-15.0) [-15.0|15.0] "Deg" ASDM,PAS
 SG_ ReSideRdrRiDetn27RdrDetnPwr : 169|9@0+ (0.1,0.0) [0.0|51.1] "dB" ASDM,PAS
 SG_ ReSideRdrRiDetn27RdrDetnRng : 223|14@0+ (0.02,-1.0) [-1.0|200.0] "m" ASDM,PAS
 SG_ ReSideRdrRiDetn27RdrDetnRngV : 204|13@0+ (0.02,-80.0) [-80.0|80.0] "m/s" ASDM,PAS
 SG_ ReSideRdrRiDetn27RdrDetnSts : 171|2@0+ (1,0) [0|3] "" ASDM,PAS
 SG_ ReSideRdrRiDetn28_UB : 314|1@0+ (1,0) [0|1] "" ASDM,PAS
 SG_ ReSideRdrRiDetn28RdrDetnAzi : 287|11@0+ (0.1,-90.0) [-90.0|90.0] "Deg" ASDM,PAS
 SG_ ReSideRdrRiDetn28RdrDetnChks : 247|8@0+ (1.0,0.0) [0.0|255.0] "Unitless" ASDM,PAS
 SG_ ReSideRdrRiDetn28RdrDetnCntr : 255|4@0+ (1.0,0.0) [0.0|15.0] "Unitless" ASDM,PAS
 SG_ ReSideRdrRiDetn28RdrDetnConf : 311|7@0+ (1.0,0.0) [0.0|100.0] "%" ASDM,PAS
 SG_ ReSideRdrRiDetn28RdrDetnElevn : 319|5@0+ (1.0,-15.0) [-15.0|15.0] "Deg" ASDM,PAS
 SG_ ReSideRdrRiDetn28RdrDetnPwr : 249|9@0+ (0.1,0.0) [0.0|51.1] "dB" ASDM,PAS
 SG_ ReSideRdrRiDetn28RdrDetnRng : 271|14@0+ (0.02,-1.0) [-1.0|200.0] "m" ASDM,PAS
 SG_ ReSideRdrRiDetn28RdrDetnRngV : 292|13@0+ (0.02,-80.0) [-80.0|80.0] "m/s" ASDM,PAS
 SG_ ReSideRdrRiDetn28RdrDetnSts : 251|2@0+ (1,0) [0|3] "" ASDM,PAS
 SG_ ReSideRdrRiDetn29_UB : 394|1@0+ (1,0) [0|1] "" ASDM,PAS
 SG_ ReSideRdrRiDetn29RdrDetnAzi : 351|11@0+ (0.1,-90.0) [-90.0|90.0] "Deg" ASDM,PAS
 SG_ ReSideRdrRiDetn29RdrDetnChks : 327|8@0+ (1.0,0.0) [0.0|255.0] "Unitless" ASDM,PAS
 SG_ ReSideRdrRiDetn29RdrDetnCntr : 335|4@0+ (1.0,0.0) [0.0|15.0] "Unitless" ASDM,PAS
 SG_ ReSideRdrRiDetn29RdrDetnConf : 391|7@0+ (1.0,0.0) [0.0|100.0] "%" ASDM,PAS
 SG_ ReSideRdrRiDetn29RdrDetnElevn : 399|5@0+ (1.0,-15.0) [-15.0|15.0] "Deg" ASDM,PAS
 SG_ ReSideRdrRiDetn29RdrDetnPwr : 329|9@0+ (0.1,0.0) [0.0|51.1] "dB" ASDM,PAS
 SG_ ReSideRdrRiDetn29RdrDetnRng : 375|14@0+ (0.02,-1.0) [-1.0|200.0] "m" ASDM,PAS
 SG_ ReSideRdrRiDetn29RdrDetnRngV : 356|13@0+ (0.02,-80.0) [-80.0|80.0] "m/s" ASDM,PAS
 SG_ ReSideRdrRiDetn29RdrDetnSts : 331|2@0+ (1,0) [0|3] "" ASDM,PAS
 SG_ ReSideRdrRiDetn30_UB : 474|1@0+ (1,0) [0|1] "" ASDM,PAS
 SG_ ReSideRdrRiDetn30RdrDetnAzi : 447|11@0+ (0.1,-90.0) [-90.0|90.0] "Deg" ASDM,PAS
 SG_ ReSideRdrRiDetn30RdrDetnChks : 407|8@0+ (1.0,0.0) [0.0|255.0] "Unitless" ASDM,PAS
 SG_ ReSideRdrRiDetn30RdrDetnCntr : 415|4@0+ (1.0,0.0) [0.0|15.0] "Unitless" ASDM,PAS
 SG_ ReSideRdrRiDetn30RdrDetnConf : 471|7@0+ (1.0,0.0) [0.0|100.0] "%" ASDM,PAS
 SG_ ReSideRdrRiDetn30RdrDetnElevn : 479|5@0+ (1.0,-15.0) [-15.0|15.0] "Deg" ASDM,PAS
 SG_ ReSideRdrRiDetn30RdrDetnPwr : 409|9@0+ (0.1,0.0) [0.0|51.1] "dB" ASDM,PAS
 SG_ ReSideRdrRiDetn30RdrDetnRng : 431|14@0+ (0.02,-1.0) [-1.0|200.0] "m" ASDM,PAS
 SG_ ReSideRdrRiDetn30RdrDetnRngV : 452|13@0+ (0.02,-80.0) [-80.0|80.0] "m/s" ASDM,PAS
 SG_ ReSideRdrRiDetn30RdrDetnSts : 411|2@0+ (1,0) [0|3] "" ASDM,PAS

BO_ 315 SODRSafetyCANFD3Frame06: 64 SODR
 SG_ ReSideRdrRiDetn31_UB : 74|1@0+ (1,0) [0|1] "" ASDM,PAS
 SG_ ReSideRdrRiDetn31RdrDetnAzi : 31|11@0+ (0.1,-90.0) [-90.0|90.0] "Deg" ASDM,PAS
 SG_ ReSideRdrRiDetn31RdrDetnChks : 7|8@0+ (1.0,0.0) [0.0|255.0] "Unitless" ASDM,PAS
 SG_ ReSideRdrRiDetn31RdrDetnCntr : 15|4@0+ (1.0,0.0) [0.0|15.0] "Unitless" ASDM,PAS
 SG_ ReSideRdrRiDetn31RdrDetnConf : 71|7@0+ (1.0,0.0) [0.0|100.0] "%" ASDM,PAS
 SG_ ReSideRdrRiDetn31RdrDetnElevn : 79|5@0+ (1.0,-15.0) [-15.0|15.0] "Deg" ASDM,PAS
 SG_ ReSideRdrRiDetn31RdrDetnPwr : 8|9@0+ (0.1,0.0) [0.0|51.1] "dB" ASDM,PAS
 SG_ ReSideRdrRiDetn31RdrDetnRng : 55|14@0+ (0.02,-1.0) [-1.0|200.0] "m" ASDM,PAS
 SG_ ReSideRdrRiDetn31RdrDetnRngV : 36|13@0+ (0.02,-80.0) [-80.0|80.0] "m/s" ASDM,PAS
 SG_ ReSideRdrRiDetn31RdrDetnSts : 11|2@0+ (1,0) [0|3] "" ASDM,PAS
 SG_ ReSideRdrRiDetn32_UB : 154|1@0+ (1,0) [0|1] "" ASDM,PAS
 SG_ ReSideRdrRiDetn32RdrDetnAzi : 119|11@0+ (0.1,-90.0) [-90.0|90.0] "Deg" ASDM,PAS
 SG_ ReSideRdrRiDetn32RdrDetnChks : 87|8@0+ (1.0,0.0) [0.0|255.0] "Unitless" ASDM,PAS
 SG_ ReSideRdrRiDetn32RdrDetnCntr : 95|4@0+ (1.0,0.0) [0.0|15.0] "Unitless" ASDM,PAS
 SG_ ReSideRdrRiDetn32RdrDetnConf : 111|7@0+ (1.0,0.0) [0.0|100.0] "%" ASDM,PAS
 SG_ ReSideRdrRiDetn32RdrDetnElevn : 159|5@0+ (1.0,-15.0) [-15.0|15.0] "Deg" ASDM,PAS
 SG_ ReSideRdrRiDetn32RdrDetnPwr : 89|9@0+ (0.1,0.0) [0.0|51.1] "dB" ASDM,PAS
 SG_ ReSideRdrRiDetn32RdrDetnRng : 143|14@0+ (0.02,-1.0) [-1.0|200.0] "m" ASDM,PAS
 SG_ ReSideRdrRiDetn32RdrDetnRngV : 124|13@0+ (0.02,-80.0) [-80.0|80.0] "m/s" ASDM,PAS
 SG_ ReSideRdrRiDetn32RdrDetnSts : 91|2@0+ (1,0) [0|3] "" ASDM,PAS
 SG_ ReSideRdrRiDetn33_UB : 234|1@0+ (1,0) [0|1] "" ASDM,PAS
 SG_ ReSideRdrRiDetn33RdrDetnAzi : 199|11@0+ (0.1,-90.0) [-90.0|90.0] "Deg" ASDM,PAS
 SG_ ReSideRdrRiDetn33RdrDetnChks : 167|8@0+ (1.0,0.0) [0.0|255.0] "Unitless" ASDM,PAS
 SG_ ReSideRdrRiDetn33RdrDetnCntr : 175|4@0+ (1.0,0.0) [0.0|15.0] "Unitless" ASDM,PAS
 SG_ ReSideRdrRiDetn33RdrDetnConf : 191|7@0+ (1.0,0.0) [0.0|100.0] "%" ASDM,PAS
 SG_ ReSideRdrRiDetn33RdrDetnElevn : 239|5@0+ (1.0,-15.0) [-15.0|15.0] "Deg" ASDM,PAS
 SG_ ReSideRdrRiDetn33RdrDetnPwr : 169|9@0+ (0.1,0.0) [0.0|51.1] "dB" ASDM,PAS
 SG_ ReSideRdrRiDetn33RdrDetnRng : 223|14@0+ (0.02,-1.0) [-1.0|200.0] "m" ASDM,PAS
 SG_ ReSideRdrRiDetn33RdrDetnRngV : 204|13@0+ (0.02,-80.0) [-80.0|80.0] "m/s" ASDM,PAS
 SG_ ReSideRdrRiDetn33RdrDetnSts : 171|2@0+ (1,0) [0|3] "" ASDM,PAS
 SG_ ReSideRdrRiDetn34_UB : 314|1@0+ (1,0) [0|1] "" ASDM,PAS
 SG_ ReSideRdrRiDetn34RdrDetnAzi : 287|11@0+ (0.1,-90.0) [-90.0|90.0] "Deg" ASDM,PAS
 SG_ ReSideRdrRiDetn34RdrDetnChks : 247|8@0+ (1.0,0.0) [0.0|255.0] "Unitless" ASDM,PAS
 SG_ ReSideRdrRiDetn34RdrDetnCntr : 255|4@0+ (1.0,0.0) [0.0|15.0] "Unitless" ASDM,PAS
 SG_ ReSideRdrRiDetn34RdrDetnConf : 311|7@0+ (1.0,0.0) [0.0|100.0] "%" ASDM,PAS
 SG_ ReSideRdrRiDetn34RdrDetnElevn : 319|5@0+ (1.0,-15.0) [-15.0|15.0] "Deg" ASDM,PAS
 SG_ ReSideRdrRiDetn34RdrDetnPwr : 249|9@0+ (0.1,0.0) [0.0|51.1] "dB" ASDM,PAS
 SG_ ReSideRdrRiDetn34RdrDetnRng : 271|14@0+ (0.02,-1.0) [-1.0|200.0] "m" ASDM,PAS
 SG_ ReSideRdrRiDetn34RdrDetnRngV : 292|13@0+ (0.02,-80.0) [-80.0|80.0] "m/s" ASDM,PAS
 SG_ ReSideRdrRiDetn34RdrDetnSts : 251|2@0+ (1,0) [0|3] "" ASDM,PAS
 SG_ ReSideRdrRiDetn35_UB : 394|1@0+ (1,0) [0|1] "" ASDM,PAS
 SG_ ReSideRdrRiDetn35RdrDetnAzi : 351|11@0+ (0.1,-90.0) [-90.0|90.0] "Deg" ASDM,PAS
 SG_ ReSideRdrRiDetn35RdrDetnChks : 327|8@0+ (1.0,0.0) [0.0|255.0] "Unitless" ASDM,PAS
 SG_ ReSideRdrRiDetn35RdrDetnCntr : 335|4@0+ (1.0,0.0) [0.0|15.0] "Unitless" ASDM,PAS
 SG_ ReSideRdrRiDetn35RdrDetnConf : 391|7@0+ (1.0,0.0) [0.0|100.0] "%" ASDM,PAS
 SG_ ReSideRdrRiDetn35RdrDetnElevn : 399|5@0+ (1.0,-15.0) [-15.0|15.0] "Deg" ASDM,PAS
 SG_ ReSideRdrRiDetn35RdrDetnPwr : 329|9@0+ (0.1,0.0) [0.0|51.1] "dB" ASDM,PAS
 SG_ ReSideRdrRiDetn35RdrDetnRng : 375|14@0+ (0.02,-1.0) [-1.0|200.0] "m" ASDM,PAS
 SG_ ReSideRdrRiDetn35RdrDetnRngV : 356|13@0+ (0.02,-80.0) [-80.0|80.0] "m/s" ASDM,PAS
 SG_ ReSideRdrRiDetn35RdrDetnSts : 331|2@0+ (1,0) [0|3] "" ASDM,PAS
 SG_ ReSideRdrRiDetn36_UB : 474|1@0+ (1,0) [0|1] "" ASDM,PAS
 SG_ ReSideRdrRiDetn36RdrDetnAzi : 447|11@0+ (0.1,-90.0) [-90.0|90.0] "Deg" ASDM,PAS
 SG_ ReSideRdrRiDetn36RdrDetnChks : 407|8@0+ (1.0,0.0) [0.0|255.0] "Unitless" ASDM,PAS
 SG_ ReSideRdrRiDetn36RdrDetnCntr : 415|4@0+ (1.0,0.0) [0.0|15.0] "Unitless" ASDM,PAS
 SG_ ReSideRdrRiDetn36RdrDetnConf : 471|7@0+ (1.0,0.0) [0.0|100.0] "%" ASDM,PAS
 SG_ ReSideRdrRiDetn36RdrDetnElevn : 479|5@0+ (1.0,-15.0) [-15.0|15.0] "Deg" ASDM,PAS
 SG_ ReSideRdrRiDetn36RdrDetnPwr : 409|9@0+ (0.1,0.0) [0.0|51.1] "dB" ASDM,PAS
 SG_ ReSideRdrRiDetn36RdrDetnRng : 431|14@0+ (0.02,-1.0) [-1.0|200.0] "m" ASDM,PAS
 SG_ ReSideRdrRiDetn36RdrDetnRngV : 452|13@0+ (0.02,-80.0) [-80.0|80.0] "m/s" ASDM,PAS
 SG_ ReSideRdrRiDetn36RdrDetnSts : 411|2@0+ (1,0) [0|3] "" ASDM,PAS

BO_ 317 SODRSafetyCANFD3Frame07: 64 SODR
 SG_ ReSideRdrRiDetn37_UB : 74|1@0+ (1,0) [0|1] "" ASDM,PAS
 SG_ ReSideRdrRiDetn37RdrDetnAzi : 31|11@0+ (0.1,-90.0) [-90.0|90.0] "Deg" ASDM,PAS
 SG_ ReSideRdrRiDetn37RdrDetnChks : 7|8@0+ (1.0,0.0) [0.0|255.0] "Unitless" ASDM,PAS
 SG_ ReSideRdrRiDetn37RdrDetnCntr : 15|4@0+ (1.0,0.0) [0.0|15.0] "Unitless" ASDM,PAS
 SG_ ReSideRdrRiDetn37RdrDetnConf : 71|7@0+ (1.0,0.0) [0.0|100.0] "%" ASDM,PAS
 SG_ ReSideRdrRiDetn37RdrDetnElevn : 79|5@0+ (1.0,-15.0) [-15.0|15.0] "Deg" ASDM,PAS
 SG_ ReSideRdrRiDetn37RdrDetnPwr : 8|9@0+ (0.1,0.0) [0.0|51.1] "dB" ASDM,PAS
 SG_ ReSideRdrRiDetn37RdrDetnRng : 55|14@0+ (0.02,-1.0) [-1.0|200.0] "m" ASDM,PAS
 SG_ ReSideRdrRiDetn37RdrDetnRngV : 36|13@0+ (0.02,-80.0) [-80.0|80.0] "m/s" ASDM,PAS
 SG_ ReSideRdrRiDetn37RdrDetnSts : 11|2@0+ (1,0) [0|3] "" ASDM,PAS
 SG_ ReSideRdrRiDetn38_UB : 154|1@0+ (1,0) [0|1] "" ASDM,PAS
 SG_ ReSideRdrRiDetn38RdrDetnAzi : 119|11@0+ (0.1,-90.0) [-90.0|90.0] "Deg" ASDM,PAS
 SG_ ReSideRdrRiDetn38RdrDetnChks : 87|8@0+ (1.0,0.0) [0.0|255.0] "Unitless" ASDM,PAS
 SG_ ReSideRdrRiDetn38RdrDetnCntr : 95|4@0+ (1.0,0.0) [0.0|15.0] "Unitless" ASDM,PAS
 SG_ ReSideRdrRiDetn38RdrDetnConf : 111|7@0+ (1.0,0.0) [0.0|100.0] "%" ASDM,PAS
 SG_ ReSideRdrRiDetn38RdrDetnElevn : 159|5@0+ (1.0,-15.0) [-15.0|15.0] "Deg" ASDM,PAS
 SG_ ReSideRdrRiDetn38RdrDetnPwr : 89|9@0+ (0.1,0.0) [0.0|51.1] "dB" ASDM,PAS
 SG_ ReSideRdrRiDetn38RdrDetnRng : 143|14@0+ (0.02,-1.0) [-1.0|200.0] "m" ASDM,PAS
 SG_ ReSideRdrRiDetn38RdrDetnRngV : 124|13@0+ (0.02,-80.0) [-80.0|80.0] "m/s" ASDM,PAS
 SG_ ReSideRdrRiDetn38RdrDetnSts : 91|2@0+ (1,0) [0|3] "" ASDM,PAS
 SG_ ReSideRdrRiDetn39_UB : 234|1@0+ (1,0) [0|1] "" ASDM,PAS
 SG_ ReSideRdrRiDetn39RdrDetnAzi : 199|11@0+ (0.1,-90.0) [-90.0|90.0] "Deg" ASDM,PAS
 SG_ ReSideRdrRiDetn39RdrDetnChks : 167|8@0+ (1.0,0.0) [0.0|255.0] "Unitless" ASDM,PAS
 SG_ ReSideRdrRiDetn39RdrDetnCntr : 175|4@0+ (1.0,0.0) [0.0|15.0] "Unitless" ASDM,PAS
 SG_ ReSideRdrRiDetn39RdrDetnConf : 191|7@0+ (1.0,0.0) [0.0|100.0] "%" ASDM,PAS
 SG_ ReSideRdrRiDetn39RdrDetnElevn : 239|5@0+ (1.0,-15.0) [-15.0|15.0] "Deg" ASDM,PAS
 SG_ ReSideRdrRiDetn39RdrDetnPwr : 169|9@0+ (0.1,0.0) [0.0|51.1] "dB" ASDM,PAS
 SG_ ReSideRdrRiDetn39RdrDetnRng : 223|14@0+ (0.02,-1.0) [-1.0|200.0] "m" ASDM,PAS
 SG_ ReSideRdrRiDetn39RdrDetnRngV : 204|13@0+ (0.02,-80.0) [-80.0|80.0] "m/s" ASDM,PAS
 SG_ ReSideRdrRiDetn39RdrDetnSts : 171|2@0+ (1,0) [0|3] "" ASDM,PAS
 SG_ ReSideRdrRiDetn40_UB : 314|1@0+ (1,0) [0|1] "" ASDM,PAS
 SG_ ReSideRdrRiDetn40RdrDetnAzi : 287|11@0+ (0.1,-90.0) [-90.0|90.0] "Deg" ASDM,PAS
 SG_ ReSideRdrRiDetn40RdrDetnChks : 247|8@0+ (1.0,0.0) [0.0|255.0] "Unitless" ASDM,PAS
 SG_ ReSideRdrRiDetn40RdrDetnCntr : 255|4@0+ (1.0,0.0) [0.0|15.0] "Unitless" ASDM,PAS
 SG_ ReSideRdrRiDetn40RdrDetnConf : 311|7@0+ (1.0,0.0) [0.0|100.0] "%" ASDM,PAS
 SG_ ReSideRdrRiDetn40RdrDetnElevn : 319|5@0+ (1.0,-15.0) [-15.0|15.0] "Deg" ASDM,PAS
 SG_ ReSideRdrRiDetn40RdrDetnPwr : 249|9@0+ (0.1,0.0) [0.0|51.1] "dB" ASDM,PAS
 SG_ ReSideRdrRiDetn40RdrDetnRng : 271|14@0+ (0.02,-1.0) [-1.0|200.0] "m" ASDM,PAS
 SG_ ReSideRdrRiDetn40RdrDetnRngV : 292|13@0+ (0.02,-80.0) [-80.0|80.0] "m/s" ASDM,PAS
 SG_ ReSideRdrRiDetn40RdrDetnSts : 251|2@0+ (1,0) [0|3] "" ASDM,PAS
 SG_ ReSideRdrRiDetn41_UB : 394|1@0+ (1,0) [0|1] "" ASDM,PAS
 SG_ ReSideRdrRiDetn41RdrDetnAzi : 351|11@0+ (0.1,-90.0) [-90.0|90.0] "Deg" ASDM,PAS
 SG_ ReSideRdrRiDetn41RdrDetnChks : 327|8@0+ (1.0,0.0) [0.0|255.0] "Unitless" ASDM,PAS
 SG_ ReSideRdrRiDetn41RdrDetnCntr : 335|4@0+ (1.0,0.0) [0.0|15.0] "Unitless" ASDM,PAS
 SG_ ReSideRdrRiDetn41RdrDetnConf : 391|7@0+ (1.0,0.0) [0.0|100.0] "%" ASDM,PAS
 SG_ ReSideRdrRiDetn41RdrDetnElevn : 399|5@0+ (1.0,-15.0) [-15.0|15.0] "Deg" ASDM,PAS
 SG_ ReSideRdrRiDetn41RdrDetnPwr : 329|9@0+ (0.1,0.0) [0.0|51.1] "dB" ASDM,PAS
 SG_ ReSideRdrRiDetn41RdrDetnRng : 375|14@0+ (0.02,-1.0) [-1.0|200.0] "m" ASDM,PAS
 SG_ ReSideRdrRiDetn41RdrDetnRngV : 356|13@0+ (0.02,-80.0) [-80.0|80.0] "m/s" ASDM,PAS
 SG_ ReSideRdrRiDetn41RdrDetnSts : 331|2@0+ (1,0) [0|3] "" ASDM,PAS
 SG_ ReSideRdrRiDetn42_UB : 474|1@0+ (1,0) [0|1] "" ASDM,PAS
 SG_ ReSideRdrRiDetn42RdrDetnAzi : 447|11@0+ (0.1,-90.0) [-90.0|90.0] "Deg" ASDM,PAS
 SG_ ReSideRdrRiDetn42RdrDetnChks : 407|8@0+ (1.0,0.0) [0.0|255.0] "Unitless" ASDM,PAS
 SG_ ReSideRdrRiDetn42RdrDetnCntr : 415|4@0+ (1.0,0.0) [0.0|15.0] "Unitless" ASDM,PAS
 SG_ ReSideRdrRiDetn42RdrDetnConf : 471|7@0+ (1.0,0.0) [0.0|100.0] "%" ASDM,PAS
 SG_ ReSideRdrRiDetn42RdrDetnElevn : 479|5@0+ (1.0,-15.0) [-15.0|15.0] "Deg" ASDM,PAS
 SG_ ReSideRdrRiDetn42RdrDetnPwr : 409|9@0+ (0.1,0.0) [0.0|51.1] "dB" ASDM,PAS
 SG_ ReSideRdrRiDetn42RdrDetnRng : 431|14@0+ (0.02,-1.0) [-1.0|200.0] "m" ASDM,PAS
 SG_ ReSideRdrRiDetn42RdrDetnRngV : 452|13@0+ (0.02,-80.0) [-80.0|80.0] "m/s" ASDM,PAS
 SG_ ReSideRdrRiDetn42RdrDetnSts : 411|2@0+ (1,0) [0|3] "" ASDM,PAS

CM_ SG_ 376 ReSideRdrLeObj15Heading "Refer to the data element description in ReSideRdrRiObj1 with the same data element name";
CM_ SG_ 376 ReSideRdrLeObj15ObjBoxCenterLat "Refer to the data element description in ReSideRdrLeObj1 with the same data element name";
CM_ SG_ 376 ReSideRdrLeObj15ObjBoxCenterLgt "Refer to the data element description in ReSideRdrLeObj1 with the same data element name";
CM_ SG_ 376 ReSideRdrLeObj15ObservationHist "Refer to the data element description in ReSideRdrRiObj1 with the same data element name";
CM_ SG_ 376 ReSideRdrLeObj15RdrObjAx "Refer to the data element description in ReSideRdrLeObj1 with the same data element name";
CM_ SG_ 376 ReSideRdrLeObj15RdrObjAy "Refer to the data element description in ReSideRdrLeObj1 with the same data element name";
CM_ SG_ 376 ReSideRdrLeObj15RdrObjBoxLength "Refer to the data element description in ReSideRdrRiObj1 with the same data element name";
CM_ SG_ 376 ReSideRdrLeObj15RdrObjBoxWidth "Refer to the data element description in ReSideRdrRiObj1 with the same data element name";
CM_ SG_ 376 ReSideRdrLeObj15RdrObjChks "Refer to the data element description in ReSideRdrLeObj1 with the same data element name";
CM_ SG_ 376 ReSideRdrLeObj15RdrObjCntr "Refer to the data element description in ReSideRdrLeObj1 with the same data element name";
CM_ SG_ 376 ReSideRdrLeObj15RdrObjCoastCnt "Refer to the data element description in ReSideRdrLeObj1 with the same data element name";
CM_ SG_ 376 ReSideRdrLeObj15RdrObjConf "Refer to the data element description in ReSideRdrLeObj1 with the same data element name";
CM_ SG_ 376 ReSideRdrLeObj15RdrObjDx "Refer to the data element description in ReSideRdrLeObj1 with the same data element name";
CM_ SG_ 376 ReSideRdrLeObj15RdrObjDxStdDe "Refer to the data element description in ReSideRdrLeObj1 with the same data element name";
CM_ SG_ 376 ReSideRdrLeObj15RdrObjDy "Refer to the data element description in ReSideRdrLeObj1 with the same data element name";
CM_ SG_ 376 ReSideRdrLeObj15RdrObjDyStdDe "Refer to the data element description in ReSideRdrLeObj1 with the same data element name";
CM_ SG_ 376 ReSideRdrLeObj15RdrObjElevnConf "Refer to the data element description in ReSideRdrLeObj1 with the same data element name";
CM_ SG_ 376 ReSideRdrLeObj15RdrObjElevnSts "Refer to the data element description in ReSideRdrLeObj1 with the same data element name";
CM_ SG_ 376 ReSideRdrLeObj15RdrObjID "Refer to the data element description in ReSideRdrLeObj1 with the same data element name";
CM_ SG_ 376 ReSideRdrLeObj15RdrObjIsInFreeSpace "Refer to the data element description in ReSideRdrLeObj1 with the same data element name";
CM_ SG_ 376 ReSideRdrLeObj15RdrObjMirrProblty "Refer to the data element description in ReSideRdrLeObj1 with the same data element name";
CM_ SG_ 376 ReSideRdrLeObj15RdrObjMtnPat "Refer to the data element description in ReSideRdrLeObj1 with the same data element name";
CM_ SG_ 376 ReSideRdrLeObj15RdrObjNotRealProblty "Refer to the data element description in ReSideRdrLeObj1 with the same data element name";
CM_ SG_ 376 ReSideRdrLeObj15RdrObjStatyCnt "Refer to the data element description in ReSideRdrLeObj1 with the same data element name";
CM_ SG_ 376 ReSideRdrLeObj15RdrObjTiAlv "Refer to the data element description in ReSideRdrLeObj1 with the same data element name";
CM_ SG_ 376 ReSideRdrLeObj15RdrObjTrackSts "Refer to the data element description in ReSideRdrLeObj1 with the same data element name";
CM_ SG_ 376 ReSideRdrLeObj15RdrObjTyp "Refer to the data element description in ReSideRdrLeObj1 with the same data element name";
CM_ SG_ 376 ReSideRdrLeObj15RdrObjTypConfBike "Refer to the data element description in ReSideRdrLeObj1 with the same data element name";
CM_ SG_ 376 ReSideRdrLeObj15RdrObjTypConfPed "Refer to the data element description in ReSideRdrLeObj1 with the same data element name";
CM_ SG_ 376 ReSideRdrLeObj15RdrObjTypConfVeh "Refer to the data element description in ReSideRdrLeObj1 with the same data element name";
CM_ SG_ 376 ReSideRdrLeObj15RdrObjVx "Refer to the data element description in ReSideRdrLeObj1 with the same data element name";
CM_ SG_ 376 ReSideRdrLeObj15RdrObjVxStdDe "Refer to the data element description in ReSideRdrLeObj1 with the same data element name";
CM_ SG_ 376 ReSideRdrLeObj15RdrObjVy "Refer to the data element description in ReSideRdrLeObj1 with the same data element name";
CM_ SG_ 376 ReSideRdrLeObj15RdrObjVyStdDe "Refer to the data element description in ReSideRdrLeObj1 with the same data element name";
CM_ SG_ 376 ReSideRdrLeObj15RelVx "Refer to the data element description in ReSideRdrRiObj1 with the same data element name";
CM_ SG_ 376 ReSideRdrLeObj15RelVy "Refer to the data element description in ReSideRdrRiObj1 with the same data element name";
CM_ SG_ 302 ReSideRdrRiStsForDim "Rear side right radar state information which will be shown on DIM or IHU";
CM_ SG_ 302 ReSideRdrRiStsRdrNrDetn "Number of detections";
CM_ SG_ 302 ReSideRdrRiStsRdrNrObj "Number of objects";
CM_ SG_ 302 ReSideRdrRiStsRdrStsBlkd0bin "Blockage flag for 0bin";
CM_ SG_ 302 ReSideRdrRiStsRdrStsBlkdConf "Confidence of radar blockage";
CM_ SG_ 302 ReSideRdrRiStsRdrStsChks "Checksum";
CM_ SG_ 302 ReSideRdrRiStsRdrStsCntr "Counter";
CM_ SG_ 302 ReSideRdrRiStsRdrStsDstbc "Indication of radar interference, 0 means no interference, 100 means the radar fully saturated from interference";
CM_ SG_ 302 ReSideRdrRiStsRdrStsEna "Indication whether radar functionality is enabled";
CM_ SG_ 302 ReSideRdrRiStsRdrStsFaulty "Indication whether radar is faulty";
CM_ SG_ 302 ReSideRdrRiStsRdrStsIfVersMajor "Interface version major";
CM_ SG_ 302 ReSideRdrRiStsRdrStsIfVersMinor "Interface version major";
CM_ SG_ 302 ReSideRdrRiStsRdrStsLatency "The latency definition is the time instance starting from the end of the last measurement acquisition per cycle to the CAN-FD frames being outputted on the CAN-FD bus. The unit of latency is ms.";
CM_ SG_ 302 ReSideRdrRiStsRdrStsMisAlign "Indication whether 0, calibration not start. After the corner radar is assembled at the factory, RdrStsMisAlign is always in this state until the corner radar been calibrated successfully in factory. If the corner radar calibration failed, RdrStsMisAlign is still in this state. 1, calibration in progress. After the corner radar is calibrated by the factory, RdrStsMisAlign will be transferred to this state. this state has not yet met the state after the Auto-aligment calibration. 2, successfully calibrated. After the vehicle assembled with corner radar is delivered to the user, the user normally travels for several tens of kilometers, and the Auto-aligment condition is satisfied during the driving. When the corner radar calibration accuracy reaches the Auto-aligment calibration state, RdrStsMisAlign will be transferred to this state. 3, misalignment degree is larger than threshold, static calibration fail. 4, can not be calibrated statically cause other reason. 5, auto-calibrate fail (cause misalignment degree is larger than threshold or other reason). 6, misalignment degree is larger than threshold, dynamic calibration fail in factory or after-sales. 7, can not be calibrated dynamically cause other reason.";
CM_ SG_ 302 ReSideRdrRiStsRdrStsMissCom "Signal used to detect missing communication from radar.Reserved/";
CM_ SG_ 302 ReSideRdrRiStsRdrStsSftyFlt "Safety faulty status";
CM_ SG_ 302 ReSideRdrRiStsRdrStsTiStamp "Timestamp";
CM_ SG_ 302 ReSideRdrRiStsRdrStsTiStampStsGlbTiBas "Time synchronization status - synchronized to global time base";
CM_ SG_ 302 ReSideRdrRiStsRdrStsTiStampStsSyncToGatewy "Time synchronization status - synchronized to gateway";
CM_ SG_ 302 ReSideRdrRiStsRdrStsTiStampStsTiLeap "Time synchronization status - time leap";
CM_ SG_ 302 ReSideRdrRiStsRdrStsTiStampStsTiOut "Time synchronization status - time out";
CM_ SG_ 302 ReSideRdrRiStsRdrStsWhlSpdCmpFac "reserved, not use";
CM_ SG_ 305 ReSideRdrRiDetn1RdrDetnAzi "Azimuth Angle";
CM_ SG_ 305 ReSideRdrRiDetn1RdrDetnChks "CRC";
CM_ SG_ 305 ReSideRdrRiDetn1RdrDetnCntr "Counter";
CM_ SG_ 305 ReSideRdrRiDetn1RdrDetnConf "Quality";
CM_ SG_ 305 ReSideRdrRiDetn1RdrDetnElevn "Elevation Angle";
CM_ SG_ 305 ReSideRdrRiDetn1RdrDetnPwr "Signal noise ratio";
CM_ SG_ 305 ReSideRdrRiDetn1RdrDetnRng "Range";
CM_ SG_ 305 ReSideRdrRiDetn1RdrDetnRngV "Range Velocity";
CM_ SG_ 305 ReSideRdrRiDetn1RdrDetnSts "Detection type";
CM_ SG_ 305 ReSideRdrRiDetn2RdrDetnAzi "Refer to the data element description in ReSideRdrRiDetn1 with the same data element name";
CM_ SG_ 305 ReSideRdrRiDetn2RdrDetnChks "Refer to the data element description in ReSideRdrRiDetn1 with the same data element name";
CM_ SG_ 305 ReSideRdrRiDetn2RdrDetnCntr "Refer to the data element description in ReSideRdrRiDetn1 with the same data element name";
CM_ SG_ 305 ReSideRdrRiDetn2RdrDetnConf "Refer to the data element description in ReSideRdrRiDetn1 with the same data element name";
CM_ SG_ 305 ReSideRdrRiDetn2RdrDetnElevn "Refer to the data element description in ReSideRdrRiDetn1 with the same data element name";
CM_ SG_ 305 ReSideRdrRiDetn2RdrDetnPwr "Refer to the data element description in ReSideRdrRiDetn1 with the same data element name";
CM_ SG_ 305 ReSideRdrRiDetn2RdrDetnRng "Refer to the data element description in ReSideRdrRiDetn1 with the same data element name";
CM_ SG_ 305 ReSideRdrRiDetn2RdrDetnRngV "Range Velocity";
CM_ SG_ 305 ReSideRdrRiDetn2RdrDetnSts "Refer to the data element description in ReSideRdrRiDetn1 with the same data element name";
CM_ SG_ 305 ReSideRdrRiDetn3RdrDetnAzi "Refer to the data element description in ReSideRdrRiDetn1 with the same data element name";
CM_ SG_ 305 ReSideRdrRiDetn3RdrDetnChks "Refer to the data element description in ReSideRdrRiDetn1 with the same data element name";
CM_ SG_ 305 ReSideRdrRiDetn3RdrDetnCntr "Refer to the data element description in ReSideRdrRiDetn1 with the same data element name";
CM_ SG_ 305 ReSideRdrRiDetn3RdrDetnConf "Refer to the data element description in ReSideRdrRiDetn1 with the same data element name";
CM_ SG_ 305 ReSideRdrRiDetn3RdrDetnElevn "Refer to the data element description in ReSideRdrRiDetn1 with the same data element name";
CM_ SG_ 305 ReSideRdrRiDetn3RdrDetnPwr "Refer to the data element description in ReSideRdrRiDetn1 with the same data element name";
CM_ SG_ 305 ReSideRdrRiDetn3RdrDetnRng "Refer to the data element description in ReSideRdrRiDetn1 with the same data element name";
CM_ SG_ 305 ReSideRdrRiDetn3RdrDetnRngV "Range Velocity";
CM_ SG_ 305 ReSideRdrRiDetn3RdrDetnSts "Refer to the data element description in ReSideRdrRiDetn1 with the same data element name";
CM_ SG_ 305 ReSideRdrRiDetn4RdrDetnAzi "Refer to the data element description in ReSideRdrRiDetn1 with the same data element name";
CM_ SG_ 305 ReSideRdrRiDetn4RdrDetnChks "Refer to the data element description in ReSideRdrRiDetn1 with the same data element name";
CM_ SG_ 305 ReSideRdrRiDetn4RdrDetnCntr "Refer to the data element description in ReSideRdrRiDetn1 with the same data element name";
CM_ SG_ 305 ReSideRdrRiDetn4RdrDetnConf "Refer to the data element description in ReSideRdrRiDetn1 with the same data element name";
CM_ SG_ 305 ReSideRdrRiDetn4RdrDetnElevn "Refer to the data element description in ReSideRdrRiDetn1 with the same data element name";
CM_ SG_ 305 ReSideRdrRiDetn4RdrDetnPwr "Refer to the data element description in ReSideRdrRiDetn1 with the same data element name";
CM_ SG_ 305 ReSideRdrRiDetn4RdrDetnRng "Refer to the data element description in ReSideRdrRiDetn1 with the same data element name";
CM_ SG_ 305 ReSideRdrRiDetn4RdrDetnRngV "Range Velocity";
CM_ SG_ 305 ReSideRdrRiDetn4RdrDetnSts "Refer to the data element description in ReSideRdrRiDetn1 with the same data element name";
CM_ SG_ 305 ReSideRdrRiDetn5RdrDetnAzi "Refer to the data element description in ReSideRdrRiDetn1 with the same data element name";
CM_ SG_ 305 ReSideRdrRiDetn5RdrDetnChks "Refer to the data element description in ReSideRdrRiDetn1 with the same data element name";
CM_ SG_ 305 ReSideRdrRiDetn5RdrDetnCntr "Refer to the data element description in ReSideRdrRiDetn1 with the same data element name";
CM_ SG_ 305 ReSideRdrRiDetn5RdrDetnConf "Refer to the data element description in ReSideRdrRiDetn1 with the same data element name";
CM_ SG_ 305 ReSideRdrRiDetn5RdrDetnElevn "Refer to the data element description in ReSideRdrRiDetn1 with the same data element name";
CM_ SG_ 305 ReSideRdrRiDetn5RdrDetnPwr "Refer to the data element description in ReSideRdrRiDetn1 with the same data element name";
CM_ SG_ 305 ReSideRdrRiDetn5RdrDetnRng "Refer to the data element description in ReSideRdrRiDetn1 with the same data element name";
CM_ SG_ 305 ReSideRdrRiDetn5RdrDetnRngV "Range Velocity";
CM_ SG_ 305 ReSideRdrRiDetn5RdrDetnSts "Refer to the data element description in ReSideRdrRiDetn1 with the same data element name";
CM_ SG_ 305 ReSideRdrRiDetn6RdrDetnAzi "Refer to the data element description in ReSideRdrRiDetn1 with the same data element name";
CM_ SG_ 305 ReSideRdrRiDetn6RdrDetnChks "Refer to the data element description in ReSideRdrRiDetn1 with the same data element name";
CM_ SG_ 305 ReSideRdrRiDetn6RdrDetnCntr "Refer to the data element description in ReSideRdrRiDetn1 with the same data element name";
CM_ SG_ 305 ReSideRdrRiDetn6RdrDetnConf "Refer to the data element description in ReSideRdrRiDetn1 with the same data element name";
CM_ SG_ 305 ReSideRdrRiDetn6RdrDetnElevn "Refer to the data element description in ReSideRdrRiDetn1 with the same data element name";
CM_ SG_ 305 ReSideRdrRiDetn6RdrDetnPwr "Refer to the data element description in ReSideRdrRiDetn1 with the same data element name";
CM_ SG_ 305 ReSideRdrRiDetn6RdrDetnRng "Refer to the data element description in ReSideRdrRiDetn1 with the same data element name";
CM_ SG_ 305 ReSideRdrRiDetn6RdrDetnRngV "Range Velocity";
CM_ SG_ 305 ReSideRdrRiDetn6RdrDetnSts "Refer to the data element description in ReSideRdrRiDetn1 with the same data element name";
CM_ SG_ 307 ReSideRdrRiDetn10RdrDetnAzi "Refer to the data element description in ReSideRdrRiDetn1 with the same data element name";
CM_ SG_ 307 ReSideRdrRiDetn10RdrDetnChks "Refer to the data element description in ReSideRdrRiDetn1 with the same data element name";
CM_ SG_ 307 ReSideRdrRiDetn10RdrDetnCntr "Refer to the data element description in ReSideRdrRiDetn1 with the same data element name";
CM_ SG_ 307 ReSideRdrRiDetn10RdrDetnConf "Refer to the data element description in ReSideRdrRiDetn1 with the same data element name";
CM_ SG_ 307 ReSideRdrRiDetn10RdrDetnElevn "Refer to the data element description in ReSideRdrRiDetn1 with the same data element name";
CM_ SG_ 307 ReSideRdrRiDetn10RdrDetnPwr "Refer to the data element description in ReSideRdrRiDetn1 with the same data element name";
CM_ SG_ 307 ReSideRdrRiDetn10RdrDetnRng "Refer to the data element description in ReSideRdrRiDetn1 with the same data element name";
CM_ SG_ 307 ReSideRdrRiDetn10RdrDetnRngV "Range Velocity";
CM_ SG_ 307 ReSideRdrRiDetn10RdrDetnSts "Refer to the data element description in ReSideRdrRiDetn1 with the same data element name";
CM_ SG_ 307 ReSideRdrRiDetn11RdrDetnAzi "Refer to the data element description in ReSideRdrRiDetn1 with the same data element name";
CM_ SG_ 307 ReSideRdrRiDetn11RdrDetnChks "Refer to the data element description in ReSideRdrRiDetn1 with the same data element name";
CM_ SG_ 307 ReSideRdrRiDetn11RdrDetnCntr "Refer to the data element description in ReSideRdrRiDetn1 with the same data element name";
CM_ SG_ 307 ReSideRdrRiDetn11RdrDetnConf "Refer to the data element description in ReSideRdrRiDetn1 with the same data element name";
CM_ SG_ 307 ReSideRdrRiDetn11RdrDetnElevn "Refer to the data element description in ReSideRdrRiDetn1 with the same data element name";
CM_ SG_ 307 ReSideRdrRiDetn11RdrDetnPwr "Refer to the data element description in ReSideRdrRiDetn1 with the same data element name";
CM_ SG_ 307 ReSideRdrRiDetn11RdrDetnRng "Refer to the data element description in ReSideRdrRiDetn1 with the same data element name";
CM_ SG_ 307 ReSideRdrRiDetn11RdrDetnRngV "Range Velocity";
CM_ SG_ 307 ReSideRdrRiDetn11RdrDetnSts "Refer to the data element description in ReSideRdrRiDetn1 with the same data element name";
CM_ SG_ 307 ReSideRdrRiDetn12RdrDetnAzi "Refer to the data element description in ReSideRdrRiDetn1 with the same data element name";
CM_ SG_ 307 ReSideRdrRiDetn12RdrDetnChks "Refer to the data element description in ReSideRdrRiDetn1 with the same data element name";
CM_ SG_ 307 ReSideRdrRiDetn12RdrDetnCntr "Refer to the data element description in ReSideRdrRiDetn1 with the same data element name";
CM_ SG_ 307 ReSideRdrRiDetn12RdrDetnConf "Refer to the data element description in ReSideRdrRiDetn1 with the same data element name";
CM_ SG_ 307 ReSideRdrRiDetn12RdrDetnElevn "Refer to the data element description in ReSideRdrRiDetn1 with the same data element name";
CM_ SG_ 307 ReSideRdrRiDetn12RdrDetnPwr "Refer to the data element description in ReSideRdrRiDetn1 with the same data element name";
CM_ SG_ 307 ReSideRdrRiDetn12RdrDetnRng "Refer to the data element description in ReSideRdrRiDetn1 with the same data element name";
CM_ SG_ 307 ReSideRdrRiDetn12RdrDetnRngV "Range Velocity";
CM_ SG_ 307 ReSideRdrRiDetn12RdrDetnSts "Refer to the data element description in ReSideRdrRiDetn1 with the same data element name";
CM_ SG_ 307 ReSideRdrRiDetn7RdrDetnAzi "Refer to the data element description in ReSideRdrRiDetn1 with the same data element name";
CM_ SG_ 307 ReSideRdrRiDetn7RdrDetnChks "Refer to the data element description in ReSideRdrRiDetn1 with the same data element name";
CM_ SG_ 307 ReSideRdrRiDetn7RdrDetnCntr "Refer to the data element description in ReSideRdrRiDetn1 with the same data element name";
CM_ SG_ 307 ReSideRdrRiDetn7RdrDetnConf "Refer to the data element description in ReSideRdrRiDetn1 with the same data element name";
CM_ SG_ 307 ReSideRdrRiDetn7RdrDetnElevn "Refer to the data element description in ReSideRdrRiDetn1 with the same data element name";
CM_ SG_ 307 ReSideRdrRiDetn7RdrDetnPwr "Refer to the data element description in ReSideRdrRiDetn1 with the same data element name";
CM_ SG_ 307 ReSideRdrRiDetn7RdrDetnRng "Refer to the data element description in ReSideRdrRiDetn1 with the same data element name";
CM_ SG_ 307 ReSideRdrRiDetn7RdrDetnRngV "Range Velocity";
CM_ SG_ 307 ReSideRdrRiDetn7RdrDetnSts "Refer to the data element description in ReSideRdrRiDetn1 with the same data element name";
CM_ SG_ 307 ReSideRdrRiDetn8RdrDetnAzi "Refer to the data element description in ReSideRdrRiDetn1 with the same data element name";
CM_ SG_ 307 ReSideRdrRiDetn8RdrDetnChks "Refer to the data element description in ReSideRdrRiDetn1 with the same data element name";
CM_ SG_ 307 ReSideRdrRiDetn8RdrDetnCntr "Refer to the data element description in ReSideRdrRiDetn1 with the same data element name";
CM_ SG_ 307 ReSideRdrRiDetn8RdrDetnConf "Refer to the data element description in ReSideRdrRiDetn1 with the same data element name";
CM_ SG_ 307 ReSideRdrRiDetn8RdrDetnElevn "Refer to the data element description in ReSideRdrRiDetn1 with the same data element name";
CM_ SG_ 307 ReSideRdrRiDetn8RdrDetnPwr "Refer to the data element description in ReSideRdrRiDetn1 with the same data element name";
CM_ SG_ 307 ReSideRdrRiDetn8RdrDetnRng "Refer to the data element description in ReSideRdrRiDetn1 with the same data element name";
CM_ SG_ 307 ReSideRdrRiDetn8RdrDetnRngV "Range Velocity";
CM_ SG_ 307 ReSideRdrRiDetn8RdrDetnSts "Refer to the data element description in ReSideRdrRiDetn1 with the same data element name";
CM_ SG_ 307 ReSideRdrRiDetn9RdrDetnAzi "Refer to the data element description in ReSideRdrRiDetn1 with the same data element name";
CM_ SG_ 307 ReSideRdrRiDetn9RdrDetnChks "Refer to the data element description in ReSideRdrRiDetn1 with the same data element name";
CM_ SG_ 307 ReSideRdrRiDetn9RdrDetnCntr "Refer to the data element description in ReSideRdrRiDetn1 with the same data element name";
CM_ SG_ 307 ReSideRdrRiDetn9RdrDetnConf "Refer to the data element description in ReSideRdrRiDetn1 with the same data element name";
CM_ SG_ 307 ReSideRdrRiDetn9RdrDetnElevn "Refer to the data element description in ReSideRdrRiDetn1 with the same data element name";
CM_ SG_ 307 ReSideRdrRiDetn9RdrDetnPwr "Refer to the data element description in ReSideRdrRiDetn1 with the same data element name";
CM_ SG_ 307 ReSideRdrRiDetn9RdrDetnRng "Refer to the data element description in ReSideRdrRiDetn1 with the same data element name";
CM_ SG_ 307 ReSideRdrRiDetn9RdrDetnRngV "Range Velocity";
CM_ SG_ 307 ReSideRdrRiDetn9RdrDetnSts "Refer to the data element description in ReSideRdrRiDetn1 with the same data element name";
CM_ SG_ 309 ReSideRdrRiDetn13RdrDetnAzi "Refer to the data element description in ReSideRdrRiDetn1 with the same data element name";
CM_ SG_ 309 ReSideRdrRiDetn13RdrDetnChks "Refer to the data element description in ReSideRdrRiDetn1 with the same data element name";
CM_ SG_ 309 ReSideRdrRiDetn13RdrDetnCntr "Refer to the data element description in ReSideRdrRiDetn1 with the same data element name";
CM_ SG_ 309 ReSideRdrRiDetn13RdrDetnConf "Refer to the data element description in ReSideRdrRiDetn1 with the same data element name";
CM_ SG_ 309 ReSideRdrRiDetn13RdrDetnElevn "Refer to the data element description in ReSideRdrRiDetn1 with the same data element name";
CM_ SG_ 309 ReSideRdrRiDetn13RdrDetnPwr "Refer to the data element description in ReSideRdrRiDetn1 with the same data element name";
CM_ SG_ 309 ReSideRdrRiDetn13RdrDetnRng "Refer to the data element description in ReSideRdrRiDetn1 with the same data element name";
CM_ SG_ 309 ReSideRdrRiDetn13RdrDetnRngV "Range Velocity";
CM_ SG_ 309 ReSideRdrRiDetn13RdrDetnSts "Refer to the data element description in ReSideRdrRiDetn1 with the same data element name";
CM_ SG_ 309 ReSideRdrRiDetn14RdrDetnAzi "Refer to the data element description in ReSideRdrRiDetn1 with the same data element name";
CM_ SG_ 309 ReSideRdrRiDetn14RdrDetnChks "Refer to the data element description in ReSideRdrRiDetn1 with the same data element name";
CM_ SG_ 309 ReSideRdrRiDetn14RdrDetnCntr "Refer to the data element description in ReSideRdrRiDetn1 with the same data element name";
CM_ SG_ 309 ReSideRdrRiDetn14RdrDetnConf "Refer to the data element description in ReSideRdrRiDetn1 with the same data element name";
CM_ SG_ 309 ReSideRdrRiDetn14RdrDetnElevn "Refer to the data element description in ReSideRdrRiDetn1 with the same data element name";
CM_ SG_ 309 ReSideRdrRiDetn14RdrDetnPwr "Refer to the data element description in ReSideRdrRiDetn1 with the same data element name";
CM_ SG_ 309 ReSideRdrRiDetn14RdrDetnRng "Refer to the data element description in ReSideRdrRiDetn1 with the same data element name";
CM_ SG_ 309 ReSideRdrRiDetn14RdrDetnRngV "Range Velocity";
CM_ SG_ 309 ReSideRdrRiDetn14RdrDetnSts "Refer to the data element description in ReSideRdrRiDetn1 with the same data element name";
CM_ SG_ 309 ReSideRdrRiDetn15RdrDetnAzi "Refer to the data element description in ReSideRdrRiDetn1 with the same data element name";
CM_ SG_ 309 ReSideRdrRiDetn15RdrDetnChks "Refer to the data element description in ReSideRdrRiDetn1 with the same data element name";
CM_ SG_ 309 ReSideRdrRiDetn15RdrDetnCntr "Refer to the data element description in ReSideRdrRiDetn1 with the same data element name";
CM_ SG_ 309 ReSideRdrRiDetn15RdrDetnConf "Refer to the data element description in ReSideRdrRiDetn1 with the same data element name";
CM_ SG_ 309 ReSideRdrRiDetn15RdrDetnElevn "Refer to the data element description in ReSideRdrRiDetn1 with the same data element name";
CM_ SG_ 309 ReSideRdrRiDetn15RdrDetnPwr "Refer to the data element description in ReSideRdrRiDetn1 with the same data element name";
CM_ SG_ 309 ReSideRdrRiDetn15RdrDetnRng "Refer to the data element description in ReSideRdrRiDetn1 with the same data element name";
CM_ SG_ 309 ReSideRdrRiDetn15RdrDetnRngV "Range Velocity";
CM_ SG_ 309 ReSideRdrRiDetn15RdrDetnSts "Refer to the data element description in ReSideRdrRiDetn1 with the same data element name";
CM_ SG_ 309 ReSideRdrRiDetn16RdrDetnAzi "Refer to the data element description in ReSideRdrRiDetn1 with the same data element name";
CM_ SG_ 309 ReSideRdrRiDetn16RdrDetnChks "Refer to the data element description in ReSideRdrRiDetn1 with the same data element name";
CM_ SG_ 309 ReSideRdrRiDetn16RdrDetnCntr "Refer to the data element description in ReSideRdrRiDetn1 with the same data element name";
CM_ SG_ 309 ReSideRdrRiDetn16RdrDetnConf "Refer to the data element description in ReSideRdrRiDetn1 with the same data element name";
CM_ SG_ 309 ReSideRdrRiDetn16RdrDetnElevn "Refer to the data element description in ReSideRdrRiDetn1 with the same data element name";
CM_ SG_ 309 ReSideRdrRiDetn16RdrDetnPwr "Refer to the data element description in ReSideRdrRiDetn1 with the same data element name";
CM_ SG_ 309 ReSideRdrRiDetn16RdrDetnRng "Refer to the data element description in ReSideRdrRiDetn1 with the same data element name";
CM_ SG_ 309 ReSideRdrRiDetn16RdrDetnRngV "Range Velocity";
CM_ SG_ 309 ReSideRdrRiDetn16RdrDetnSts "Refer to the data element description in ReSideRdrRiDetn1 with the same data element name";
CM_ SG_ 309 ReSideRdrRiDetn17RdrDetnAzi "Refer to the data element description in ReSideRdrRiDetn1 with the same data element name";
CM_ SG_ 309 ReSideRdrRiDetn17RdrDetnChks "Refer to the data element description in ReSideRdrRiDetn1 with the same data element name";
CM_ SG_ 309 ReSideRdrRiDetn17RdrDetnCntr "Refer to the data element description in ReSideRdrRiDetn1 with the same data element name";
CM_ SG_ 309 ReSideRdrRiDetn17RdrDetnConf "Refer to the data element description in ReSideRdrRiDetn1 with the same data element name";
CM_ SG_ 309 ReSideRdrRiDetn17RdrDetnElevn "Refer to the data element description in ReSideRdrRiDetn1 with the same data element name";
CM_ SG_ 309 ReSideRdrRiDetn17RdrDetnPwr "Refer to the data element description in ReSideRdrRiDetn1 with the same data element name";
CM_ SG_ 309 ReSideRdrRiDetn17RdrDetnRng "Refer to the data element description in ReSideRdrRiDetn1 with the same data element name";
CM_ SG_ 309 ReSideRdrRiDetn17RdrDetnRngV "Range Velocity";
CM_ SG_ 309 ReSideRdrRiDetn17RdrDetnSts "Refer to the data element description in ReSideRdrRiDetn1 with the same data element name";
CM_ SG_ 309 ReSideRdrRiDetn18RdrDetnAzi "Refer to the data element description in ReSideRdrRiDetn1 with the same data element name";
CM_ SG_ 309 ReSideRdrRiDetn18RdrDetnChks "Refer to the data element description in ReSideRdrRiDetn1 with the same data element name";
CM_ SG_ 309 ReSideRdrRiDetn18RdrDetnCntr "Refer to the data element description in ReSideRdrRiDetn1 with the same data element name";
CM_ SG_ 309 ReSideRdrRiDetn18RdrDetnConf "Refer to the data element description in ReSideRdrRiDetn1 with the same data element name";
CM_ SG_ 309 ReSideRdrRiDetn18RdrDetnElevn "Refer to the data element description in ReSideRdrRiDetn1 with the same data element name";
CM_ SG_ 309 ReSideRdrRiDetn18RdrDetnPwr "Refer to the data element description in ReSideRdrRiDetn1 with the same data element name";
CM_ SG_ 309 ReSideRdrRiDetn18RdrDetnRng "Refer to the data element description in ReSideRdrRiDetn1 with the same data element name";
CM_ SG_ 309 ReSideRdrRiDetn18RdrDetnRngV "Range Velocity";
CM_ SG_ 309 ReSideRdrRiDetn18RdrDetnSts "Refer to the data element description in ReSideRdrRiDetn1 with the same data element name";
CM_ SG_ 311 ReSideRdrRiDetn19RdrDetnAzi "Refer to the data element description in ReSideRdrRiDetn1 with the same data element name";
CM_ SG_ 311 ReSideRdrRiDetn19RdrDetnChks "Refer to the data element description in ReSideRdrRiDetn1 with the same data element name";
CM_ SG_ 311 ReSideRdrRiDetn19RdrDetnCntr "Refer to the data element description in ReSideRdrRiDetn1 with the same data element name";
CM_ SG_ 311 ReSideRdrRiDetn19RdrDetnConf "Refer to the data element description in ReSideRdrRiDetn1 with the same data element name";
CM_ SG_ 311 ReSideRdrRiDetn19RdrDetnElevn "Refer to the data element description in ReSideRdrRiDetn1 with the same data element name";
CM_ SG_ 311 ReSideRdrRiDetn19RdrDetnPwr "Refer to the data element description in ReSideRdrRiDetn1 with the same data element name";
CM_ SG_ 311 ReSideRdrRiDetn19RdrDetnRng "Refer to the data element description in ReSideRdrRiDetn1 with the same data element name";
CM_ SG_ 311 ReSideRdrRiDetn19RdrDetnRngV "Range Velocity";
CM_ SG_ 311 ReSideRdrRiDetn19RdrDetnSts "Refer to the data element description in ReSideRdrRiDetn1 with the same data element name";
CM_ SG_ 311 ReSideRdrRiDetn20RdrDetnAzi "Refer to the data element description in ReSideRdrRiDetn1 with the same data element name";
CM_ SG_ 311 ReSideRdrRiDetn20RdrDetnChks "Refer to the data element description in ReSideRdrRiDetn1 with the same data element name";
CM_ SG_ 311 ReSideRdrRiDetn20RdrDetnCntr "Refer to the data element description in ReSideRdrRiDetn1 with the same data element name";
CM_ SG_ 311 ReSideRdrRiDetn20RdrDetnConf "Refer to the data element description in ReSideRdrRiDetn1 with the same data element name";
CM_ SG_ 311 ReSideRdrRiDetn20RdrDetnElevn "Refer to the data element description in ReSideRdrRiDetn1 with the same data element name";
CM_ SG_ 311 ReSideRdrRiDetn20RdrDetnPwr "Refer to the data element description in ReSideRdrRiDetn1 with the same data element name";
CM_ SG_ 311 ReSideRdrRiDetn20RdrDetnRng "Refer to the data element description in ReSideRdrRiDetn1 with the same data element name";
CM_ SG_ 311 ReSideRdrRiDetn20RdrDetnRngV "Range Velocity";
CM_ SG_ 311 ReSideRdrRiDetn20RdrDetnSts "Refer to the data element description in ReSideRdrRiDetn1 with the same data element name";
CM_ SG_ 311 ReSideRdrRiDetn21RdrDetnAzi "Refer to the data element description in ReSideRdrRiDetn1 with the same data element name";
CM_ SG_ 311 ReSideRdrRiDetn21RdrDetnChks "Refer to the data element description in ReSideRdrRiDetn1 with the same data element name";
CM_ SG_ 311 ReSideRdrRiDetn21RdrDetnCntr "Refer to the data element description in ReSideRdrRiDetn1 with the same data element name";
CM_ SG_ 311 ReSideRdrRiDetn21RdrDetnConf "Refer to the data element description in ReSideRdrRiDetn1 with the same data element name";
CM_ SG_ 311 ReSideRdrRiDetn21RdrDetnElevn "Refer to the data element description in ReSideRdrRiDetn1 with the same data element name";
CM_ SG_ 311 ReSideRdrRiDetn21RdrDetnPwr "Refer to the data element description in ReSideRdrRiDetn1 with the same data element name";
CM_ SG_ 311 ReSideRdrRiDetn21RdrDetnRng "Refer to the data element description in ReSideRdrRiDetn1 with the same data element name";
CM_ SG_ 311 ReSideRdrRiDetn21RdrDetnRngV "Range Velocity";
CM_ SG_ 311 ReSideRdrRiDetn21RdrDetnSts "Refer to the data element description in ReSideRdrRiDetn1 with the same data element name";
CM_ SG_ 311 ReSideRdrRiDetn22RdrDetnAzi "Refer to the data element description in ReSideRdrRiDetn1 with the same data element name";
CM_ SG_ 311 ReSideRdrRiDetn22RdrDetnChks "Refer to the data element description in ReSideRdrRiDetn1 with the same data element name";
CM_ SG_ 311 ReSideRdrRiDetn22RdrDetnCntr "Refer to the data element description in ReSideRdrRiDetn1 with the same data element name";
CM_ SG_ 311 ReSideRdrRiDetn22RdrDetnConf "Refer to the data element description in ReSideRdrRiDetn1 with the same data element name";
CM_ SG_ 311 ReSideRdrRiDetn22RdrDetnElevn "Refer to the data element description in ReSideRdrRiDetn1 with the same data element name";
CM_ SG_ 311 ReSideRdrRiDetn22RdrDetnPwr "Refer to the data element description in ReSideRdrRiDetn1 with the same data element name";
CM_ SG_ 311 ReSideRdrRiDetn22RdrDetnRng "Refer to the data element description in ReSideRdrRiDetn1 with the same data element name";
CM_ SG_ 311 ReSideRdrRiDetn22RdrDetnRngV "Range Velocity";
CM_ SG_ 311 ReSideRdrRiDetn22RdrDetnSts "Refer to the data element description in ReSideRdrRiDetn1 with the same data element name";
CM_ SG_ 311 ReSideRdrRiDetn23RdrDetnAzi "Refer to the data element description in ReSideRdrRiDetn1 with the same data element name";
CM_ SG_ 311 ReSideRdrRiDetn23RdrDetnChks "Refer to the data element description in ReSideRdrRiDetn1 with the same data element name";
CM_ SG_ 311 ReSideRdrRiDetn23RdrDetnCntr "Refer to the data element description in ReSideRdrRiDetn1 with the same data element name";
CM_ SG_ 311 ReSideRdrRiDetn23RdrDetnConf "Refer to the data element description in ReSideRdrRiDetn1 with the same data element name";
CM_ SG_ 311 ReSideRdrRiDetn23RdrDetnElevn "Refer to the data element description in ReSideRdrRiDetn1 with the same data element name";
CM_ SG_ 311 ReSideRdrRiDetn23RdrDetnPwr "Refer to the data element description in ReSideRdrRiDetn1 with the same data element name";
CM_ SG_ 311 ReSideRdrRiDetn23RdrDetnRng "Refer to the data element description in ReSideRdrRiDetn1 with the same data element name";
CM_ SG_ 311 ReSideRdrRiDetn23RdrDetnRngV "Range Velocity";
CM_ SG_ 311 ReSideRdrRiDetn23RdrDetnSts "Refer to the data element description in ReSideRdrRiDetn1 with the same data element name";
CM_ SG_ 311 ReSideRdrRiDetn24RdrDetnAzi "Refer to the data element description in ReSideRdrRiDetn1 with the same data element name";
CM_ SG_ 311 ReSideRdrRiDetn24RdrDetnChks "Refer to the data element description in ReSideRdrRiDetn1 with the same data element name";
CM_ SG_ 311 ReSideRdrRiDetn24RdrDetnCntr "Refer to the data element description in ReSideRdrRiDetn1 with the same data element name";
CM_ SG_ 311 ReSideRdrRiDetn24RdrDetnConf "Refer to the data element description in ReSideRdrRiDetn1 with the same data element name";
CM_ SG_ 311 ReSideRdrRiDetn24RdrDetnElevn "Refer to the data element description in ReSideRdrRiDetn1 with the same data element name";
CM_ SG_ 311 ReSideRdrRiDetn24RdrDetnPwr "Refer to the data element description in ReSideRdrRiDetn1 with the same data element name";
CM_ SG_ 311 ReSideRdrRiDetn24RdrDetnRng "Refer to the data element description in ReSideRdrRiDetn1 with the same data element name";
CM_ SG_ 311 ReSideRdrRiDetn24RdrDetnRngV "Range Velocity";
CM_ SG_ 311 ReSideRdrRiDetn24RdrDetnSts "Refer to the data element description in ReSideRdrRiDetn1 with the same data element name";
CM_ SG_ 313 ReSideRdrRiDetn25RdrDetnAzi "Refer to the data element description in ReSideRdrRiDetn1 with the same data element name";
CM_ SG_ 313 ReSideRdrRiDetn25RdrDetnChks "Refer to the data element description in ReSideRdrRiDetn1 with the same data element name";
CM_ SG_ 313 ReSideRdrRiDetn25RdrDetnCntr "Refer to the data element description in ReSideRdrRiDetn1 with the same data element name";
CM_ SG_ 313 ReSideRdrRiDetn25RdrDetnConf "Refer to the data element description in ReSideRdrRiDetn1 with the same data element name";
CM_ SG_ 313 ReSideRdrRiDetn25RdrDetnElevn "Refer to the data element description in ReSideRdrRiDetn1 with the same data element name";
CM_ SG_ 313 ReSideRdrRiDetn25RdrDetnPwr "Refer to the data element description in ReSideRdrRiDetn1 with the same data element name";
CM_ SG_ 313 ReSideRdrRiDetn25RdrDetnRng "Refer to the data element description in ReSideRdrRiDetn1 with the same data element name";
CM_ SG_ 313 ReSideRdrRiDetn25RdrDetnRngV "Range Velocity";
CM_ SG_ 313 ReSideRdrRiDetn25RdrDetnSts "Refer to the data element description in ReSideRdrRiDetn1 with the same data element name";
CM_ SG_ 313 ReSideRdrRiDetn26RdrDetnAzi "Refer to the data element description in ReSideRdrRiDetn1 with the same data element name";
CM_ SG_ 313 ReSideRdrRiDetn26RdrDetnChks "Refer to the data element description in ReSideRdrRiDetn1 with the same data element name";
CM_ SG_ 313 ReSideRdrRiDetn26RdrDetnCntr "Refer to the data element description in ReSideRdrRiDetn1 with the same data element name";
CM_ SG_ 313 ReSideRdrRiDetn26RdrDetnConf "Refer to the data element description in ReSideRdrRiDetn1 with the same data element name";
CM_ SG_ 313 ReSideRdrRiDetn26RdrDetnElevn "Refer to the data element description in ReSideRdrRiDetn1 with the same data element name";
CM_ SG_ 313 ReSideRdrRiDetn26RdrDetnPwr "Refer to the data element description in ReSideRdrRiDetn1 with the same data element name";
CM_ SG_ 313 ReSideRdrRiDetn26RdrDetnRng "Refer to the data element description in ReSideRdrRiDetn1 with the same data element name";
CM_ SG_ 313 ReSideRdrRiDetn26RdrDetnRngV "Range Velocity";
CM_ SG_ 313 ReSideRdrRiDetn26RdrDetnSts "Refer to the data element description in ReSideRdrRiDetn1 with the same data element name";
CM_ SG_ 313 ReSideRdrRiDetn27RdrDetnAzi "Refer to the data element description in ReSideRdrRiDetn1 with the same data element name";
CM_ SG_ 313 ReSideRdrRiDetn27RdrDetnChks "Refer to the data element description in ReSideRdrRiDetn1 with the same data element name";
CM_ SG_ 313 ReSideRdrRiDetn27RdrDetnCntr "Refer to the data element description in ReSideRdrRiDetn1 with the same data element name";
CM_ SG_ 313 ReSideRdrRiDetn27RdrDetnConf "Refer to the data element description in ReSideRdrRiDetn1 with the same data element name";
CM_ SG_ 313 ReSideRdrRiDetn27RdrDetnElevn "Refer to the data element description in ReSideRdrRiDetn1 with the same data element name";
CM_ SG_ 313 ReSideRdrRiDetn27RdrDetnPwr "Refer to the data element description in ReSideRdrRiDetn1 with the same data element name";
CM_ SG_ 313 ReSideRdrRiDetn27RdrDetnRng "Refer to the data element description in ReSideRdrRiDetn1 with the same data element name";
CM_ SG_ 313 ReSideRdrRiDetn27RdrDetnRngV "Range Velocity";
CM_ SG_ 313 ReSideRdrRiDetn27RdrDetnSts "Refer to the data element description in ReSideRdrRiDetn1 with the same data element name";
CM_ SG_ 313 ReSideRdrRiDetn28RdrDetnAzi "Refer to the data element description in ReSideRdrRiDetn1 with the same data element name";
CM_ SG_ 313 ReSideRdrRiDetn28RdrDetnChks "Refer to the data element description in ReSideRdrRiDetn1 with the same data element name";
CM_ SG_ 313 ReSideRdrRiDetn28RdrDetnCntr "Refer to the data element description in ReSideRdrRiDetn1 with the same data element name";
CM_ SG_ 313 ReSideRdrRiDetn28RdrDetnConf "Refer to the data element description in ReSideRdrRiDetn1 with the same data element name";
CM_ SG_ 313 ReSideRdrRiDetn28RdrDetnElevn "Refer to the data element description in ReSideRdrRiDetn1 with the same data element name";
CM_ SG_ 313 ReSideRdrRiDetn28RdrDetnPwr "Refer to the data element description in ReSideRdrRiDetn1 with the same data element name";
CM_ SG_ 313 ReSideRdrRiDetn28RdrDetnRng "Refer to the data element description in ReSideRdrRiDetn1 with the same data element name";
CM_ SG_ 313 ReSideRdrRiDetn28RdrDetnRngV "Range Velocity";
CM_ SG_ 313 ReSideRdrRiDetn28RdrDetnSts "Refer to the data element description in ReSideRdrRiDetn1 with the same data element name";
CM_ SG_ 313 ReSideRdrRiDetn29RdrDetnAzi "Refer to the data element description in ReSideRdrRiDetn1 with the same data element name";
CM_ SG_ 313 ReSideRdrRiDetn29RdrDetnChks "Refer to the data element description in ReSideRdrRiDetn1 with the same data element name";
CM_ SG_ 313 ReSideRdrRiDetn29RdrDetnCntr "Refer to the data element description in ReSideRdrRiDetn1 with the same data element name";
CM_ SG_ 313 ReSideRdrRiDetn29RdrDetnConf "Refer to the data element description in ReSideRdrRiDetn1 with the same data element name";
CM_ SG_ 313 ReSideRdrRiDetn29RdrDetnElevn "Refer to the data element description in ReSideRdrRiDetn1 with the same data element name";
CM_ SG_ 313 ReSideRdrRiDetn29RdrDetnPwr "Refer to the data element description in ReSideRdrRiDetn1 with the same data element name";
CM_ SG_ 313 ReSideRdrRiDetn29RdrDetnRng "Refer to the data element description in ReSideRdrRiDetn1 with the same data element name";
CM_ SG_ 313 ReSideRdrRiDetn29RdrDetnRngV "Range Velocity";
CM_ SG_ 313 ReSideRdrRiDetn29RdrDetnSts "Refer to the data element description in ReSideRdrRiDetn1 with the same data element name";
CM_ SG_ 313 ReSideRdrRiDetn30RdrDetnAzi "Refer to the data element description in ReSideRdrRiDetn1 with the same data element name";
CM_ SG_ 313 ReSideRdrRiDetn30RdrDetnChks "Refer to the data element description in ReSideRdrRiDetn1 with the same data element name";
CM_ SG_ 313 ReSideRdrRiDetn30RdrDetnCntr "Refer to the data element description in ReSideRdrRiDetn1 with the same data element name";
CM_ SG_ 313 ReSideRdrRiDetn30RdrDetnConf "Refer to the data element description in ReSideRdrRiDetn1 with the same data element name";
CM_ SG_ 313 ReSideRdrRiDetn30RdrDetnElevn "Refer to the data element description in ReSideRdrRiDetn1 with the same data element name";
CM_ SG_ 313 ReSideRdrRiDetn30RdrDetnPwr "Refer to the data element description in ReSideRdrRiDetn1 with the same data element name";
CM_ SG_ 313 ReSideRdrRiDetn30RdrDetnRng "Refer to the data element description in ReSideRdrRiDetn1 with the same data element name";
CM_ SG_ 313 ReSideRdrRiDetn30RdrDetnRngV "Range Velocity";
CM_ SG_ 313 ReSideRdrRiDetn30RdrDetnSts "Refer to the data element description in ReSideRdrRiDetn1 with the same data element name";
CM_ SG_ 315 ReSideRdrRiDetn31RdrDetnAzi "Refer to the data element description in ReSideRdrRiDetn1 with the same data element name";
CM_ SG_ 315 ReSideRdrRiDetn31RdrDetnChks "Refer to the data element description in ReSideRdrRiDetn1 with the same data element name";
CM_ SG_ 315 ReSideRdrRiDetn31RdrDetnCntr "Refer to the data element description in ReSideRdrRiDetn1 with the same data element name";
CM_ SG_ 315 ReSideRdrRiDetn31RdrDetnConf "Refer to the data element description in ReSideRdrRiDetn1 with the same data element name";
CM_ SG_ 315 ReSideRdrRiDetn31RdrDetnElevn "Refer to the data element description in ReSideRdrRiDetn1 with the same data element name";
CM_ SG_ 315 ReSideRdrRiDetn31RdrDetnPwr "Refer to the data element description in ReSideRdrRiDetn1 with the same data element name";
CM_ SG_ 315 ReSideRdrRiDetn31RdrDetnRng "Refer to the data element description in ReSideRdrRiDetn1 with the same data element name";
CM_ SG_ 315 ReSideRdrRiDetn31RdrDetnRngV "Range Velocity";
CM_ SG_ 315 ReSideRdrRiDetn31RdrDetnSts "Refer to the data element description in ReSideRdrRiDetn1 with the same data element name";
CM_ SG_ 315 ReSideRdrRiDetn32RdrDetnAzi "Refer to the data element description in ReSideRdrRiDetn1 with the same data element name";
CM_ SG_ 315 ReSideRdrRiDetn32RdrDetnChks "Refer to the data element description in ReSideRdrRiDetn1 with the same data element name";
CM_ SG_ 315 ReSideRdrRiDetn32RdrDetnCntr "Refer to the data element description in ReSideRdrRiDetn1 with the same data element name";
CM_ SG_ 315 ReSideRdrRiDetn32RdrDetnConf "Refer to the data element description in ReSideRdrRiDetn1 with the same data element name";
CM_ SG_ 315 ReSideRdrRiDetn32RdrDetnElevn "Refer to the data element description in ReSideRdrRiDetn1 with the same data element name";
CM_ SG_ 315 ReSideRdrRiDetn32RdrDetnPwr "Refer to the data element description in ReSideRdrRiDetn1 with the same data element name";
CM_ SG_ 315 ReSideRdrRiDetn32RdrDetnRng "Refer to the data element description in ReSideRdrRiDetn1 with the same data element name";
CM_ SG_ 315 ReSideRdrRiDetn32RdrDetnRngV "Range Velocity";
CM_ SG_ 315 ReSideRdrRiDetn32RdrDetnSts "Refer to the data element description in ReSideRdrRiDetn1 with the same data element name";
CM_ SG_ 315 ReSideRdrRiDetn33RdrDetnAzi "Refer to the data element description in ReSideRdrRiDetn1 with the same data element name";
CM_ SG_ 315 ReSideRdrRiDetn33RdrDetnChks "Refer to the data element description in ReSideRdrRiDetn1 with the same data element name";
CM_ SG_ 315 ReSideRdrRiDetn33RdrDetnCntr "Refer to the data element description in ReSideRdrRiDetn1 with the same data element name";
CM_ SG_ 315 ReSideRdrRiDetn33RdrDetnConf "Refer to the data element description in ReSideRdrRiDetn1 with the same data element name";
CM_ SG_ 315 ReSideRdrRiDetn33RdrDetnElevn "Refer to the data element description in ReSideRdrRiDetn1 with the same data element name";
CM_ SG_ 315 ReSideRdrRiDetn33RdrDetnPwr "Refer to the data element description in ReSideRdrRiDetn1 with the same data element name";
CM_ SG_ 315 ReSideRdrRiDetn33RdrDetnRng "Refer to the data element description in ReSideRdrRiDetn1 with the same data element name";
CM_ SG_ 315 ReSideRdrRiDetn33RdrDetnRngV "Range Velocity";
CM_ SG_ 315 ReSideRdrRiDetn33RdrDetnSts "Refer to the data element description in ReSideRdrRiDetn1 with the same data element name";
CM_ SG_ 315 ReSideRdrRiDetn34RdrDetnAzi "Refer to the data element description in ReSideRdrRiDetn1 with the same data element name";
CM_ SG_ 315 ReSideRdrRiDetn34RdrDetnChks "Refer to the data element description in ReSideRdrRiDetn1 with the same data element name";
CM_ SG_ 315 ReSideRdrRiDetn34RdrDetnCntr "Refer to the data element description in ReSideRdrRiDetn1 with the same data element name";
CM_ SG_ 315 ReSideRdrRiDetn34RdrDetnConf "Refer to the data element description in ReSideRdrRiDetn1 with the same data element name";
CM_ SG_ 315 ReSideRdrRiDetn34RdrDetnElevn "Refer to the data element description in ReSideRdrRiDetn1 with the same data element name";
CM_ SG_ 315 ReSideRdrRiDetn34RdrDetnPwr "Refer to the data element description in ReSideRdrRiDetn1 with the same data element name";
CM_ SG_ 315 ReSideRdrRiDetn34RdrDetnRng "Refer to the data element description in ReSideRdrRiDetn1 with the same data element name";
CM_ SG_ 315 ReSideRdrRiDetn34RdrDetnRngV "Range Velocity";
CM_ SG_ 315 ReSideRdrRiDetn34RdrDetnSts "Refer to the data element description in ReSideRdrRiDetn1 with the same data element name";
CM_ SG_ 315 ReSideRdrRiDetn35RdrDetnAzi "Refer to the data element description in ReSideRdrRiDetn1 with the same data element name";
CM_ SG_ 315 ReSideRdrRiDetn35RdrDetnChks "Refer to the data element description in ReSideRdrRiDetn1 with the same data element name";
CM_ SG_ 315 ReSideRdrRiDetn35RdrDetnCntr "Refer to the data element description in ReSideRdrRiDetn1 with the same data element name";
CM_ SG_ 315 ReSideRdrRiDetn35RdrDetnConf "Refer to the data element description in ReSideRdrRiDetn1 with the same data element name";
CM_ SG_ 315 ReSideRdrRiDetn35RdrDetnElevn "Refer to the data element description in ReSideRdrRiDetn1 with the same data element name";
CM_ SG_ 315 ReSideRdrRiDetn35RdrDetnPwr "Refer to the data element description in ReSideRdrRiDetn1 with the same data element name";
CM_ SG_ 315 ReSideRdrRiDetn35RdrDetnRng "Refer to the data element description in ReSideRdrRiDetn1 with the same data element name";
CM_ SG_ 315 ReSideRdrRiDetn35RdrDetnRngV "Range Velocity";
CM_ SG_ 315 ReSideRdrRiDetn35RdrDetnSts "Refer to the data element description in ReSideRdrRiDetn1 with the same data element name";
CM_ SG_ 315 ReSideRdrRiDetn36RdrDetnAzi "Refer to the data element description in ReSideRdrRiDetn1 with the same data element name";
CM_ SG_ 315 ReSideRdrRiDetn36RdrDetnChks "Refer to the data element description in ReSideRdrRiDetn1 with the same data element name";
CM_ SG_ 315 ReSideRdrRiDetn36RdrDetnCntr "Refer to the data element description in ReSideRdrRiDetn1 with the same data element name";
CM_ SG_ 315 ReSideRdrRiDetn36RdrDetnConf "Refer to the data element description in ReSideRdrRiDetn1 with the same data element name";
CM_ SG_ 315 ReSideRdrRiDetn36RdrDetnElevn "Refer to the data element description in ReSideRdrRiDetn1 with the same data element name";
CM_ SG_ 315 ReSideRdrRiDetn36RdrDetnPwr "Refer to the data element description in ReSideRdrRiDetn1 with the same data element name";
CM_ SG_ 315 ReSideRdrRiDetn36RdrDetnRng "Refer to the data element description in ReSideRdrRiDetn1 with the same data element name";
CM_ SG_ 315 ReSideRdrRiDetn36RdrDetnRngV "Range Velocity";
CM_ SG_ 315 ReSideRdrRiDetn36RdrDetnSts "Refer to the data element description in ReSideRdrRiDetn1 with the same data element name";
CM_ SG_ 317 ReSideRdrRiDetn37RdrDetnAzi "Refer to the data element description in ReSideRdrRiDetn1 with the same data element name";
CM_ SG_ 317 ReSideRdrRiDetn37RdrDetnChks "Refer to the data element description in ReSideRdrRiDetn1 with the same data element name";
CM_ SG_ 317 ReSideRdrRiDetn37RdrDetnCntr "Refer to the data element description in ReSideRdrRiDetn1 with the same data element name";
CM_ SG_ 317 ReSideRdrRiDetn37RdrDetnConf "Refer to the data element description in ReSideRdrRiDetn1 with the same data element name";
CM_ SG_ 317 ReSideRdrRiDetn37RdrDetnElevn "Refer to the data element description in ReSideRdrRiDetn1 with the same data element name";
CM_ SG_ 317 ReSideRdrRiDetn37RdrDetnPwr "Refer to the data element description in ReSideRdrRiDetn1 with the same data element name";
CM_ SG_ 317 ReSideRdrRiDetn37RdrDetnRng "Refer to the data element description in ReSideRdrRiDetn1 with the same data element name";
CM_ SG_ 317 ReSideRdrRiDetn37RdrDetnRngV "Range Velocity";
CM_ SG_ 317 ReSideRdrRiDetn37RdrDetnSts "Refer to the data element description in ReSideRdrRiDetn1 with the same data element name";
CM_ SG_ 317 ReSideRdrRiDetn38RdrDetnAzi "Refer to the data element description in ReSideRdrRiDetn1 with the same data element name";
CM_ SG_ 317 ReSideRdrRiDetn38RdrDetnChks "Refer to the data element description in ReSideRdrRiDetn1 with the same data element name";
CM_ SG_ 317 ReSideRdrRiDetn38RdrDetnCntr "Refer to the data element description in ReSideRdrRiDetn1 with the same data element name";
CM_ SG_ 317 ReSideRdrRiDetn38RdrDetnConf "Refer to the data element description in ReSideRdrRiDetn1 with the same data element name";
CM_ SG_ 317 ReSideRdrRiDetn38RdrDetnElevn "Refer to the data element description in ReSideRdrRiDetn1 with the same data element name";
CM_ SG_ 317 ReSideRdrRiDetn38RdrDetnPwr "Refer to the data element description in ReSideRdrRiDetn1 with the same data element name";
CM_ SG_ 317 ReSideRdrRiDetn38RdrDetnRng "Refer to the data element description in ReSideRdrRiDetn1 with the same data element name";
CM_ SG_ 317 ReSideRdrRiDetn38RdrDetnRngV "Range Velocity";
CM_ SG_ 317 ReSideRdrRiDetn38RdrDetnSts "Refer to the data element description in ReSideRdrRiDetn1 with the same data element name";
CM_ SG_ 317 ReSideRdrRiDetn39RdrDetnAzi "Refer to the data element description in ReSideRdrRiDetn1 with the same data element name";
CM_ SG_ 317 ReSideRdrRiDetn39RdrDetnChks "Refer to the data element description in ReSideRdrRiDetn1 with the same data element name";
CM_ SG_ 317 ReSideRdrRiDetn39RdrDetnCntr "Refer to the data element description in ReSideRdrRiDetn1 with the same data element name";
CM_ SG_ 317 ReSideRdrRiDetn39RdrDetnConf "Refer to the data element description in ReSideRdrRiDetn1 with the same data element name";
CM_ SG_ 317 ReSideRdrRiDetn39RdrDetnElevn "Refer to the data element description in ReSideRdrRiDetn1 with the same data element name";
CM_ SG_ 317 ReSideRdrRiDetn39RdrDetnPwr "Refer to the data element description in ReSideRdrRiDetn1 with the same data element name";
CM_ SG_ 317 ReSideRdrRiDetn39RdrDetnRng "Refer to the data element description in ReSideRdrRiDetn1 with the same data element name";
CM_ SG_ 317 ReSideRdrRiDetn39RdrDetnRngV "Range Velocity";
CM_ SG_ 317 ReSideRdrRiDetn39RdrDetnSts "Refer to the data element description in ReSideRdrRiDetn1 with the same data element name";
CM_ SG_ 317 ReSideRdrRiDetn40RdrDetnAzi "Refer to the data element description in ReSideRdrRiDetn1 with the same data element name";
CM_ SG_ 317 ReSideRdrRiDetn40RdrDetnChks "Refer to the data element description in ReSideRdrRiDetn1 with the same data element name";
CM_ SG_ 317 ReSideRdrRiDetn40RdrDetnCntr "Refer to the data element description in ReSideRdrRiDetn1 with the same data element name";
CM_ SG_ 317 ReSideRdrRiDetn40RdrDetnConf "Refer to the data element description in ReSideRdrRiDetn1 with the same data element name";
CM_ SG_ 317 ReSideRdrRiDetn40RdrDetnElevn "Refer to the data element description in ReSideRdrRiDetn1 with the same data element name";
CM_ SG_ 317 ReSideRdrRiDetn40RdrDetnPwr "Refer to the data element description in ReSideRdrRiDetn1 with the same data element name";
CM_ SG_ 317 ReSideRdrRiDetn40RdrDetnRng "Refer to the data element description in ReSideRdrRiDetn1 with the same data element name";
CM_ SG_ 317 ReSideRdrRiDetn40RdrDetnRngV "Range Velocity";
CM_ SG_ 317 ReSideRdrRiDetn40RdrDetnSts "Refer to the data element description in ReSideRdrRiDetn1 with the same data element name";
CM_ SG_ 317 ReSideRdrRiDetn41RdrDetnAzi "Refer to the data element description in ReSideRdrRiDetn1 with the same data element name";
CM_ SG_ 317 ReSideRdrRiDetn41RdrDetnChks "Refer to the data element description in ReSideRdrRiDetn1 with the same data element name";
CM_ SG_ 317 ReSideRdrRiDetn41RdrDetnCntr "Refer to the data element description in ReSideRdrRiDetn1 with the same data element name";
CM_ SG_ 317 ReSideRdrRiDetn41RdrDetnConf "Refer to the data element description in ReSideRdrRiDetn1 with the same data element name";
CM_ SG_ 317 ReSideRdrRiDetn41RdrDetnElevn "Refer to the data element description in ReSideRdrRiDetn1 with the same data element name";
CM_ SG_ 317 ReSideRdrRiDetn41RdrDetnPwr "Refer to the data element description in ReSideRdrRiDetn1 with the same data element name";
CM_ SG_ 317 ReSideRdrRiDetn41RdrDetnRng "Refer to the data element description in ReSideRdrRiDetn1 with the same data element name";
CM_ SG_ 317 ReSideRdrRiDetn41RdrDetnRngV "Range Velocity";
CM_ SG_ 317 ReSideRdrRiDetn41RdrDetnSts "Refer to the data element description in ReSideRdrRiDetn1 with the same data element name";
CM_ SG_ 317 ReSideRdrRiDetn42RdrDetnAzi "Refer to the data element description in ReSideRdrRiDetn1 with the same data element name";
CM_ SG_ 317 ReSideRdrRiDetn42RdrDetnChks "Refer to the data element description in ReSideRdrRiDetn1 with the same data element name";
CM_ SG_ 317 ReSideRdrRiDetn42RdrDetnCntr "Refer to the data element description in ReSideRdrRiDetn1 with the same data element name";
CM_ SG_ 317 ReSideRdrRiDetn42RdrDetnConf "Refer to the data element description in ReSideRdrRiDetn1 with the same data element name";
CM_ SG_ 317 ReSideRdrRiDetn42RdrDetnElevn "Refer to the data element description in ReSideRdrRiDetn1 with the same data element name";
CM_ SG_ 317 ReSideRdrRiDetn42RdrDetnPwr "Refer to the data element description in ReSideRdrRiDetn1 with the same data element name";
CM_ SG_ 317 ReSideRdrRiDetn42RdrDetnRng "Refer to the data element description in ReSideRdrRiDetn1 with the same data element name";
CM_ SG_ 317 ReSideRdrRiDetn42RdrDetnRngV "Range Velocity";
CM_ SG_ 317 ReSideRdrRiDetn42RdrDetnSts "Refer to the data element description in ReSideRdrRiDetn1 with the same data element name";
BA_DEF_ BO_ "VFrameFormat" ENUM "StandardCAN","ExtendedCAN","reserved","J1939PG","reserved","reserved","reserved","reserved","reserved","reserved","reserved","reserved","reserved","reserved","StandardCAN_FD","ExtendedCAN_FD";
BA_DEF_ BO_ "CANFD_BRS" ENUM "0","1";
BA_DEF_ BO_ "GenMsgSendType" ENUM "cyclic", "spontaneous", "not-used", "not-used", "not-used", "cyclicAndSpontaneous", "not-used", "cyclicIfActive", "NoMsgSendType"; // [us]
BA_DEF_ BO_ "GenMsgCycleTime" INT 0 65536; // [ms]
BA_DEF_ BO_ "GenMsgStartDelayTime" INT 0 65536; // [ms]
BA_DEF_ BO_ "GenMsgDelayTime" INT 0 65536; // [ms]
BA_DEF_ SG_ "GenSigSendType" ENUM "Cyclic","OnWrite","OnWriteWithRepetition","OnChange","OnChangeWithRepetition","IfActive","IfActiveWithRepetition","NoSigSendType";
BA_DEF_ SG_ "GenSigStartValue" HEX 0 80000000;
BA_DEF_ BO_ "GenMsgILSupport" ENUM "No","Yes";
BA_DEF_ BO_ "NmAsrMessage" ENUM "No","Yes";
BA_DEF_ SG_ "GenSigFuncType" ENUM "NoFunction","n/a","n/a","n/a","n/a","n/a","n/a","n/a","n/a","n/a","n/a","n/a","n/a","n/a","n/a","CHK","CNTR","n/a","n/a","n/a","CNTR_AR_01","CRC_AR_01_BOTH","CRC_AR_01_ALT","CRC_AR_01_LOW","CRC_AR_01_NIBBLE","CNTR_AR_04","CRC_AR_04A","CNTR_AR_05","CRC_AR_05";
BA_DEF_ SG_ "GenSigDataID" STRING;

BA_DEF_DEF_ "VFrameFormat" "J1939PG";
BA_DEF_DEF_ "CANFD_BRS" "1";
BA_DEF_DEF_ "GenSigStartValue" 0;
BA_DEF_DEF_ "GenSigSendType" "NoSigSendType";
BA_DEF_DEF_ "GenMsgCycleTime" 0;
BA_DEF_DEF_ "GenMsgDelayTime" 0;
BA_DEF_DEF_ "GenMsgStartDelayTime" 0;
BA_DEF_DEF_ "GenMsgSendType" "NoMsgSendType";
BA_DEF_DEF_ "GenMsgILSupport" "Yes";
BA_DEF_DEF_ "NmAsrMessage" "No";
BA_DEF_DEF_ "GenSigFuncType" "NoFunction";
BA_DEF_DEF_ "GenSigDataID" "";
// Frame: SODLSafetyCANFD3Frame37
BA_ "VFrameFormat" BO_ 376 14;
BA_ "GenMsgSendType" BO_ 376 0;
BA_ "GenMsgCycleTime" BO_ 376 50.000;
BA_ "GenSigStartValue" SG_ 376 ReSideRdrLeObj15Heading 1800;
BA_ "GenSigSendType" SG_ 376 ReSideRdrLeObj15Heading 0;
BA_ "GenSigStartValue" SG_ 376 ReSideRdrLeObj15ObjBoxCenterLat 250;
BA_ "GenSigSendType" SG_ 376 ReSideRdrLeObj15ObjBoxCenterLat 0;
BA_ "GenSigStartValue" SG_ 376 ReSideRdrLeObj15ObjBoxCenterLgt 250;
BA_ "GenSigSendType" SG_ 376 ReSideRdrLeObj15ObjBoxCenterLgt 0;
BA_ "GenSigSendType" SG_ 376 ReSideRdrLeObj15ObservationHist 0;
BA_ "GenSigSendType" SG_ 376 ReSideRdrLeObj15RdrObjAx 0;
BA_ "GenSigSendType" SG_ 376 ReSideRdrLeObj15RdrObjAy 0;
BA_ "GenSigSendType" SG_ 376 ReSideRdrLeObj15RdrObjBoxLength 0;
BA_ "GenSigSendType" SG_ 376 ReSideRdrLeObj15RdrObjBoxWidth 0;
BA_ "GenSigSendType" SG_ 376 ReSideRdrLeObj15RdrObjChks 0;
BA_ "GenSigFuncType" SG_ 376 ReSideRdrLeObj15RdrObjChks 15;
BA_ "GenSigDataID" SG_ 376 ReSideRdrLeObj15RdrObjChks "0xA20";
BA_ "GenSigSendType" SG_ 376 ReSideRdrLeObj15RdrObjCntr 0;
BA_ "GenSigFuncType" SG_ 376 ReSideRdrLeObj15RdrObjCntr 16;
BA_ "GenSigStartValue" SG_ 376 ReSideRdrLeObj15RdrObjCoastCnt 31;
BA_ "GenSigSendType" SG_ 376 ReSideRdrLeObj15RdrObjCoastCnt 0;
BA_ "GenSigSendType" SG_ 376 ReSideRdrLeObj15RdrObjConf 0;
BA_ "GenSigSendType" SG_ 376 ReSideRdrLeObj15RdrObjDx 0;
BA_ "GenSigSendType" SG_ 376 ReSideRdrLeObj15RdrObjDxStdDe 0;
BA_ "GenSigStartValue" SG_ 376 ReSideRdrLeObj15RdrObjDy 4000;
BA_ "GenSigSendType" SG_ 376 ReSideRdrLeObj15RdrObjDy 0;
BA_ "GenSigSendType" SG_ 376 ReSideRdrLeObj15RdrObjDyStdDe 0;
BA_ "GenSigSendType" SG_ 376 ReSideRdrLeObj15RdrObjElevnConf 0;
BA_ "GenSigSendType" SG_ 376 ReSideRdrLeObj15RdrObjElevnSts 0;
BA_ "GenSigSendType" SG_ 376 ReSideRdrLeObj15RdrObjID 0;
BA_ "GenSigStartValue" SG_ 376 ReSideRdrLeObj15RdrObjIsInFreeSpace 1;
BA_ "GenSigSendType" SG_ 376 ReSideRdrLeObj15RdrObjIsInFreeSpace 0;
BA_ "GenSigSendType" SG_ 376 ReSideRdrLeObj15RdrObjMirrProblty 0;
BA_ "GenSigStartValue" SG_ 376 ReSideRdrLeObj15RdrObjMtnPat 3;
BA_ "GenSigSendType" SG_ 376 ReSideRdrLeObj15RdrObjMtnPat 0;
BA_ "GenSigSendType" SG_ 376 ReSideRdrLeObj15RdrObjNotRealProblty 0;
BA_ "GenSigSendType" SG_ 376 ReSideRdrLeObj15RdrObjStatyCnt 0;
BA_ "GenSigSendType" SG_ 376 ReSideRdrLeObj15RdrObjTiAlv 0;
BA_ "GenSigSendType" SG_ 376 ReSideRdrLeObj15RdrObjTrackSts 0;
BA_ "GenSigSendType" SG_ 376 ReSideRdrLeObj15RdrObjTyp 0;
BA_ "GenSigSendType" SG_ 376 ReSideRdrLeObj15RdrObjTypConfBike 0;
BA_ "GenSigSendType" SG_ 376 ReSideRdrLeObj15RdrObjTypConfPed 0;
BA_ "GenSigSendType" SG_ 376 ReSideRdrLeObj15RdrObjTypConfVeh 0;
BA_ "GenSigStartValue" SG_ 376 ReSideRdrLeObj15RdrObjVx 6400;
BA_ "GenSigSendType" SG_ 376 ReSideRdrLeObj15RdrObjVx 0;
BA_ "GenSigSendType" SG_ 376 ReSideRdrLeObj15RdrObjVxStdDe 0;
BA_ "GenSigStartValue" SG_ 376 ReSideRdrLeObj15RdrObjVy 6400;
BA_ "GenSigSendType" SG_ 376 ReSideRdrLeObj15RdrObjVy 0;
BA_ "GenSigSendType" SG_ 376 ReSideRdrLeObj15RdrObjVyStdDe 0;
BA_ "GenSigStartValue" SG_ 376 ReSideRdrLeObj15RelVx 1780;
BA_ "GenSigSendType" SG_ 376 ReSideRdrLeObj15RelVx 0;
BA_ "GenSigStartValue" SG_ 376 ReSideRdrLeObj15RelVy 1780;
BA_ "GenSigSendType" SG_ 376 ReSideRdrLeObj15RelVy 0;
// Frame: SodlSafetyCanFD3NmFr
BA_ "VFrameFormat" BO_ 1282 0;
BA_ "GenMsgSendType" BO_ 1282 1;
BA_ "GenMsgDelayTime" BO_ 1282 20.000;
BA_ "GenMsgILSupport" BO_ 1282 0;
BA_ "NmAsrMessage" BO_ 1282 1;
// Frame: SodlToAsdmSafetyCanFD3DiagResFrame1
BA_ "VFrameFormat" BO_ 1616 14;
BA_ "GenMsgSendType" BO_ 1616 1;
BA_ "GenMsgDelayTime" BO_ 1616 5.000;
// Frame: SodlToEtcXcpFr01
BA_ "VFrameFormat" BO_ 1411 0;
BA_ "GenMsgSendType" BO_ 1411 1;
BA_ "GenMsgDelayTime" BO_ 1411 10.000;
// Frame: SodlToEtcXcpFr02
BA_ "VFrameFormat" BO_ 1425 0;
BA_ "GenMsgSendType" BO_ 1425 1;
BA_ "GenMsgDelayTime" BO_ 1425 10.000;
// Frame: SODRSafetyCANFD3Frame00
BA_ "VFrameFormat" BO_ 302 14;
BA_ "GenMsgSendType" BO_ 302 0;
BA_ "GenMsgCycleTime" BO_ 302 50.000;
BA_ "GenSigStartValue" SG_ 302 ReSideRdrRiStsForDim 1;
BA_ "GenSigSendType" SG_ 302 ReSideRdrRiStsForDim 0;
BA_ "GenSigSendType" SG_ 302 ReSideRdrRiStsRdrNrDetn 0;
BA_ "GenSigSendType" SG_ 302 ReSideRdrRiStsRdrNrObj 0;
BA_ "GenSigSendType" SG_ 302 ReSideRdrRiStsRdrStsBlkd0bin 0;
BA_ "GenSigSendType" SG_ 302 ReSideRdrRiStsRdrStsBlkdConf 0;
BA_ "GenSigSendType" SG_ 302 ReSideRdrRiStsRdrStsChks 0;
BA_ "GenSigFuncType" SG_ 302 ReSideRdrRiStsRdrStsChks 15;
BA_ "GenSigDataID" SG_ 302 ReSideRdrRiStsRdrStsChks "0xAEE";
BA_ "GenSigSendType" SG_ 302 ReSideRdrRiStsRdrStsCntr 0;
BA_ "GenSigFuncType" SG_ 302 ReSideRdrRiStsRdrStsCntr 16;
BA_ "GenSigSendType" SG_ 302 ReSideRdrRiStsRdrStsDstbc 0;
BA_ "GenSigSendType" SG_ 302 ReSideRdrRiStsRdrStsEna 0;
BA_ "GenSigSendType" SG_ 302 ReSideRdrRiStsRdrStsFaulty 0;
BA_ "GenSigSendType" SG_ 302 ReSideRdrRiStsRdrStsIfVersMajor 0;
BA_ "GenSigSendType" SG_ 302 ReSideRdrRiStsRdrStsIfVersMinor 0;
BA_ "GenSigStartValue" SG_ 302 ReSideRdrRiStsRdrStsLatency 65535;
BA_ "GenSigSendType" SG_ 302 ReSideRdrRiStsRdrStsLatency 0;
BA_ "GenSigSendType" SG_ 302 ReSideRdrRiStsRdrStsMisAlign 0;
BA_ "GenSigSendType" SG_ 302 ReSideRdrRiStsRdrStsMissCom 0;
BA_ "GenSigStartValue" SG_ 302 ReSideRdrRiStsRdrStsSftyFlt 1;
BA_ "GenSigSendType" SG_ 302 ReSideRdrRiStsRdrStsSftyFlt 0;
BA_ "GenSigSendType" SG_ 302 ReSideRdrRiStsRdrStsTiStamp 0;
BA_ "GenSigSendType" SG_ 302 ReSideRdrRiStsRdrStsTiStampStsGlbTiBas 0;
BA_ "GenSigSendType" SG_ 302 ReSideRdrRiStsRdrStsTiStampStsSyncToGatewy 0;
BA_ "GenSigSendType" SG_ 302 ReSideRdrRiStsRdrStsTiStampStsTiLeap 0;
BA_ "GenSigSendType" SG_ 302 ReSideRdrRiStsRdrStsTiStampStsTiOut 0;
BA_ "GenSigStartValue" SG_ 302 ReSideRdrRiStsRdrStsWhlSpdCmpFac 16;
BA_ "GenSigSendType" SG_ 302 ReSideRdrRiStsRdrStsWhlSpdCmpFac 0;
// Frame: SODRSafetyCANFD3Frame01
BA_ "VFrameFormat" BO_ 305 14;
BA_ "GenMsgSendType" BO_ 305 0;
BA_ "GenMsgCycleTime" BO_ 305 50.000;
BA_ "GenSigStartValue" SG_ 305 ReSideRdrRiDetn1RdrDetnAzi 900;
BA_ "GenSigSendType" SG_ 305 ReSideRdrRiDetn1RdrDetnAzi 0;
BA_ "GenSigSendType" SG_ 305 ReSideRdrRiDetn1RdrDetnChks 0;
BA_ "GenSigFuncType" SG_ 305 ReSideRdrRiDetn1RdrDetnChks 15;
BA_ "GenSigDataID" SG_ 305 ReSideRdrRiDetn1RdrDetnChks "0xA41";
BA_ "GenSigSendType" SG_ 305 ReSideRdrRiDetn1RdrDetnCntr 0;
BA_ "GenSigFuncType" SG_ 305 ReSideRdrRiDetn1RdrDetnCntr 16;
BA_ "GenSigSendType" SG_ 305 ReSideRdrRiDetn1RdrDetnConf 0;
BA_ "GenSigStartValue" SG_ 305 ReSideRdrRiDetn1RdrDetnElevn 15;
BA_ "GenSigSendType" SG_ 305 ReSideRdrRiDetn1RdrDetnElevn 0;
BA_ "GenSigSendType" SG_ 305 ReSideRdrRiDetn1RdrDetnPwr 0;
BA_ "GenSigStartValue" SG_ 305 ReSideRdrRiDetn1RdrDetnRng 10050;
BA_ "GenSigSendType" SG_ 305 ReSideRdrRiDetn1RdrDetnRng 0;
BA_ "GenSigStartValue" SG_ 305 ReSideRdrRiDetn1RdrDetnRngV 4000;
BA_ "GenSigSendType" SG_ 305 ReSideRdrRiDetn1RdrDetnRngV 0;
BA_ "GenSigStartValue" SG_ 305 ReSideRdrRiDetn1RdrDetnSts 3;
BA_ "GenSigSendType" SG_ 305 ReSideRdrRiDetn1RdrDetnSts 0;
BA_ "GenSigStartValue" SG_ 305 ReSideRdrRiDetn2RdrDetnAzi 900;
BA_ "GenSigSendType" SG_ 305 ReSideRdrRiDetn2RdrDetnAzi 0;
BA_ "GenSigSendType" SG_ 305 ReSideRdrRiDetn2RdrDetnChks 0;
BA_ "GenSigFuncType" SG_ 305 ReSideRdrRiDetn2RdrDetnChks 15;
BA_ "GenSigDataID" SG_ 305 ReSideRdrRiDetn2RdrDetnChks "0xA42";
BA_ "GenSigSendType" SG_ 305 ReSideRdrRiDetn2RdrDetnCntr 0;
BA_ "GenSigFuncType" SG_ 305 ReSideRdrRiDetn2RdrDetnCntr 16;
BA_ "GenSigSendType" SG_ 305 ReSideRdrRiDetn2RdrDetnConf 0;
BA_ "GenSigStartValue" SG_ 305 ReSideRdrRiDetn2RdrDetnElevn 15;
BA_ "GenSigSendType" SG_ 305 ReSideRdrRiDetn2RdrDetnElevn 0;
BA_ "GenSigSendType" SG_ 305 ReSideRdrRiDetn2RdrDetnPwr 0;
BA_ "GenSigStartValue" SG_ 305 ReSideRdrRiDetn2RdrDetnRng 10050;
BA_ "GenSigSendType" SG_ 305 ReSideRdrRiDetn2RdrDetnRng 0;
BA_ "GenSigStartValue" SG_ 305 ReSideRdrRiDetn2RdrDetnRngV 4000;
BA_ "GenSigSendType" SG_ 305 ReSideRdrRiDetn2RdrDetnRngV 0;
BA_ "GenSigStartValue" SG_ 305 ReSideRdrRiDetn2RdrDetnSts 3;
BA_ "GenSigSendType" SG_ 305 ReSideRdrRiDetn2RdrDetnSts 0;
BA_ "GenSigStartValue" SG_ 305 ReSideRdrRiDetn3RdrDetnAzi 900;
BA_ "GenSigSendType" SG_ 305 ReSideRdrRiDetn3RdrDetnAzi 0;
BA_ "GenSigSendType" SG_ 305 ReSideRdrRiDetn3RdrDetnChks 0;
BA_ "GenSigFuncType" SG_ 305 ReSideRdrRiDetn3RdrDetnChks 15;
BA_ "GenSigDataID" SG_ 305 ReSideRdrRiDetn3RdrDetnChks "0xA43";
BA_ "GenSigSendType" SG_ 305 ReSideRdrRiDetn3RdrDetnCntr 0;
BA_ "GenSigFuncType" SG_ 305 ReSideRdrRiDetn3RdrDetnCntr 16;
BA_ "GenSigSendType" SG_ 305 ReSideRdrRiDetn3RdrDetnConf 0;
BA_ "GenSigStartValue" SG_ 305 ReSideRdrRiDetn3RdrDetnElevn 15;
BA_ "GenSigSendType" SG_ 305 ReSideRdrRiDetn3RdrDetnElevn 0;
BA_ "GenSigSendType" SG_ 305 ReSideRdrRiDetn3RdrDetnPwr 0;
BA_ "GenSigStartValue" SG_ 305 ReSideRdrRiDetn3RdrDetnRng 10050;
BA_ "GenSigSendType" SG_ 305 ReSideRdrRiDetn3RdrDetnRng 0;
BA_ "GenSigStartValue" SG_ 305 ReSideRdrRiDetn3RdrDetnRngV 4000;
BA_ "GenSigSendType" SG_ 305 ReSideRdrRiDetn3RdrDetnRngV 0;
BA_ "GenSigStartValue" SG_ 305 ReSideRdrRiDetn3RdrDetnSts 3;
BA_ "GenSigSendType" SG_ 305 ReSideRdrRiDetn3RdrDetnSts 0;
BA_ "GenSigStartValue" SG_ 305 ReSideRdrRiDetn4RdrDetnAzi 900;
BA_ "GenSigSendType" SG_ 305 ReSideRdrRiDetn4RdrDetnAzi 0;
BA_ "GenSigSendType" SG_ 305 ReSideRdrRiDetn4RdrDetnChks 0;
BA_ "GenSigFuncType" SG_ 305 ReSideRdrRiDetn4RdrDetnChks 15;
BA_ "GenSigDataID" SG_ 305 ReSideRdrRiDetn4RdrDetnChks "0xA44";
BA_ "GenSigSendType" SG_ 305 ReSideRdrRiDetn4RdrDetnCntr 0;
BA_ "GenSigFuncType" SG_ 305 ReSideRdrRiDetn4RdrDetnCntr 16;
BA_ "GenSigSendType" SG_ 305 ReSideRdrRiDetn4RdrDetnConf 0;
BA_ "GenSigStartValue" SG_ 305 ReSideRdrRiDetn4RdrDetnElevn 15;
BA_ "GenSigSendType" SG_ 305 ReSideRdrRiDetn4RdrDetnElevn 0;
BA_ "GenSigSendType" SG_ 305 ReSideRdrRiDetn4RdrDetnPwr 0;
BA_ "GenSigStartValue" SG_ 305 ReSideRdrRiDetn4RdrDetnRng 10050;
BA_ "GenSigSendType" SG_ 305 ReSideRdrRiDetn4RdrDetnRng 0;
BA_ "GenSigStartValue" SG_ 305 ReSideRdrRiDetn4RdrDetnRngV 4000;
BA_ "GenSigSendType" SG_ 305 ReSideRdrRiDetn4RdrDetnRngV 0;
BA_ "GenSigStartValue" SG_ 305 ReSideRdrRiDetn4RdrDetnSts 3;
BA_ "GenSigSendType" SG_ 305 ReSideRdrRiDetn4RdrDetnSts 0;
BA_ "GenSigStartValue" SG_ 305 ReSideRdrRiDetn5RdrDetnAzi 900;
BA_ "GenSigSendType" SG_ 305 ReSideRdrRiDetn5RdrDetnAzi 0;
BA_ "GenSigSendType" SG_ 305 ReSideRdrRiDetn5RdrDetnChks 0;
BA_ "GenSigFuncType" SG_ 305 ReSideRdrRiDetn5RdrDetnChks 15;
BA_ "GenSigDataID" SG_ 305 ReSideRdrRiDetn5RdrDetnChks "0xA45";
BA_ "GenSigSendType" SG_ 305 ReSideRdrRiDetn5RdrDetnCntr 0;
BA_ "GenSigFuncType" SG_ 305 ReSideRdrRiDetn5RdrDetnCntr 16;
BA_ "GenSigSendType" SG_ 305 ReSideRdrRiDetn5RdrDetnConf 0;
BA_ "GenSigStartValue" SG_ 305 ReSideRdrRiDetn5RdrDetnElevn 15;
BA_ "GenSigSendType" SG_ 305 ReSideRdrRiDetn5RdrDetnElevn 0;
BA_ "GenSigSendType" SG_ 305 ReSideRdrRiDetn5RdrDetnPwr 0;
BA_ "GenSigStartValue" SG_ 305 ReSideRdrRiDetn5RdrDetnRng 10050;
BA_ "GenSigSendType" SG_ 305 ReSideRdrRiDetn5RdrDetnRng 0;
BA_ "GenSigStartValue" SG_ 305 ReSideRdrRiDetn5RdrDetnRngV 4000;
BA_ "GenSigSendType" SG_ 305 ReSideRdrRiDetn5RdrDetnRngV 0;
BA_ "GenSigStartValue" SG_ 305 ReSideRdrRiDetn5RdrDetnSts 3;
BA_ "GenSigSendType" SG_ 305 ReSideRdrRiDetn5RdrDetnSts 0;
BA_ "GenSigStartValue" SG_ 305 ReSideRdrRiDetn6RdrDetnAzi 900;
BA_ "GenSigSendType" SG_ 305 ReSideRdrRiDetn6RdrDetnAzi 0;
BA_ "GenSigSendType" SG_ 305 ReSideRdrRiDetn6RdrDetnChks 0;
BA_ "GenSigFuncType" SG_ 305 ReSideRdrRiDetn6RdrDetnChks 15;
BA_ "GenSigDataID" SG_ 305 ReSideRdrRiDetn6RdrDetnChks "0xA46";
BA_ "GenSigSendType" SG_ 305 ReSideRdrRiDetn6RdrDetnCntr 0;
BA_ "GenSigFuncType" SG_ 305 ReSideRdrRiDetn6RdrDetnCntr 16;
BA_ "GenSigSendType" SG_ 305 ReSideRdrRiDetn6RdrDetnConf 0;
BA_ "GenSigStartValue" SG_ 305 ReSideRdrRiDetn6RdrDetnElevn 15;
BA_ "GenSigSendType" SG_ 305 ReSideRdrRiDetn6RdrDetnElevn 0;
BA_ "GenSigSendType" SG_ 305 ReSideRdrRiDetn6RdrDetnPwr 0;
BA_ "GenSigStartValue" SG_ 305 ReSideRdrRiDetn6RdrDetnRng 10050;
BA_ "GenSigSendType" SG_ 305 ReSideRdrRiDetn6RdrDetnRng 0;
BA_ "GenSigStartValue" SG_ 305 ReSideRdrRiDetn6RdrDetnRngV 4000;
BA_ "GenSigSendType" SG_ 305 ReSideRdrRiDetn6RdrDetnRngV 0;
BA_ "GenSigStartValue" SG_ 305 ReSideRdrRiDetn6RdrDetnSts 3;
BA_ "GenSigSendType" SG_ 305 ReSideRdrRiDetn6RdrDetnSts 0;
// Frame: SODRSafetyCANFD3Frame02
BA_ "VFrameFormat" BO_ 307 14;
BA_ "GenMsgSendType" BO_ 307 0;
BA_ "GenMsgCycleTime" BO_ 307 50.000;
BA_ "GenSigStartValue" SG_ 307 ReSideRdrRiDetn10RdrDetnAzi 900;
BA_ "GenSigSendType" SG_ 307 ReSideRdrRiDetn10RdrDetnAzi 0;
BA_ "GenSigSendType" SG_ 307 ReSideRdrRiDetn10RdrDetnChks 0;
BA_ "GenSigFuncType" SG_ 307 ReSideRdrRiDetn10RdrDetnChks 15;
BA_ "GenSigDataID" SG_ 307 ReSideRdrRiDetn10RdrDetnChks "0xA4A";
BA_ "GenSigSendType" SG_ 307 ReSideRdrRiDetn10RdrDetnCntr 0;
BA_ "GenSigFuncType" SG_ 307 ReSideRdrRiDetn10RdrDetnCntr 16;
BA_ "GenSigSendType" SG_ 307 ReSideRdrRiDetn10RdrDetnConf 0;
BA_ "GenSigStartValue" SG_ 307 ReSideRdrRiDetn10RdrDetnElevn 15;
BA_ "GenSigSendType" SG_ 307 ReSideRdrRiDetn10RdrDetnElevn 0;
BA_ "GenSigSendType" SG_ 307 ReSideRdrRiDetn10RdrDetnPwr 0;
BA_ "GenSigStartValue" SG_ 307 ReSideRdrRiDetn10RdrDetnRng 10050;
BA_ "GenSigSendType" SG_ 307 ReSideRdrRiDetn10RdrDetnRng 0;
BA_ "GenSigStartValue" SG_ 307 ReSideRdrRiDetn10RdrDetnRngV 4000;
BA_ "GenSigSendType" SG_ 307 ReSideRdrRiDetn10RdrDetnRngV 0;
BA_ "GenSigStartValue" SG_ 307 ReSideRdrRiDetn10RdrDetnSts 3;
BA_ "GenSigSendType" SG_ 307 ReSideRdrRiDetn10RdrDetnSts 0;
BA_ "GenSigStartValue" SG_ 307 ReSideRdrRiDetn11RdrDetnAzi 900;
BA_ "GenSigSendType" SG_ 307 ReSideRdrRiDetn11RdrDetnAzi 0;
BA_ "GenSigSendType" SG_ 307 ReSideRdrRiDetn11RdrDetnChks 0;
BA_ "GenSigFuncType" SG_ 307 ReSideRdrRiDetn11RdrDetnChks 15;
BA_ "GenSigDataID" SG_ 307 ReSideRdrRiDetn11RdrDetnChks "0xA4B";
BA_ "GenSigSendType" SG_ 307 ReSideRdrRiDetn11RdrDetnCntr 0;
BA_ "GenSigFuncType" SG_ 307 ReSideRdrRiDetn11RdrDetnCntr 16;
BA_ "GenSigSendType" SG_ 307 ReSideRdrRiDetn11RdrDetnConf 0;
BA_ "GenSigStartValue" SG_ 307 ReSideRdrRiDetn11RdrDetnElevn 15;
BA_ "GenSigSendType" SG_ 307 ReSideRdrRiDetn11RdrDetnElevn 0;
BA_ "GenSigSendType" SG_ 307 ReSideRdrRiDetn11RdrDetnPwr 0;
BA_ "GenSigStartValue" SG_ 307 ReSideRdrRiDetn11RdrDetnRng 10050;
BA_ "GenSigSendType" SG_ 307 ReSideRdrRiDetn11RdrDetnRng 0;
BA_ "GenSigStartValue" SG_ 307 ReSideRdrRiDetn11RdrDetnRngV 4000;
BA_ "GenSigSendType" SG_ 307 ReSideRdrRiDetn11RdrDetnRngV 0;
BA_ "GenSigStartValue" SG_ 307 ReSideRdrRiDetn11RdrDetnSts 3;
BA_ "GenSigSendType" SG_ 307 ReSideRdrRiDetn11RdrDetnSts 0;
BA_ "GenSigStartValue" SG_ 307 ReSideRdrRiDetn12RdrDetnAzi 900;
BA_ "GenSigSendType" SG_ 307 ReSideRdrRiDetn12RdrDetnAzi 0;
BA_ "GenSigSendType" SG_ 307 ReSideRdrRiDetn12RdrDetnChks 0;
BA_ "GenSigFuncType" SG_ 307 ReSideRdrRiDetn12RdrDetnChks 15;
BA_ "GenSigDataID" SG_ 307 ReSideRdrRiDetn12RdrDetnChks "0xA4C";
BA_ "GenSigSendType" SG_ 307 ReSideRdrRiDetn12RdrDetnCntr 0;
BA_ "GenSigFuncType" SG_ 307 ReSideRdrRiDetn12RdrDetnCntr 16;
BA_ "GenSigSendType" SG_ 307 ReSideRdrRiDetn12RdrDetnConf 0;
BA_ "GenSigStartValue" SG_ 307 ReSideRdrRiDetn12RdrDetnElevn 15;
BA_ "GenSigSendType" SG_ 307 ReSideRdrRiDetn12RdrDetnElevn 0;
BA_ "GenSigSendType" SG_ 307 ReSideRdrRiDetn12RdrDetnPwr 0;
BA_ "GenSigStartValue" SG_ 307 ReSideRdrRiDetn12RdrDetnRng 10050;
BA_ "GenSigSendType" SG_ 307 ReSideRdrRiDetn12RdrDetnRng 0;
BA_ "GenSigStartValue" SG_ 307 ReSideRdrRiDetn12RdrDetnRngV 4000;
BA_ "GenSigSendType" SG_ 307 ReSideRdrRiDetn12RdrDetnRngV 0;
BA_ "GenSigStartValue" SG_ 307 ReSideRdrRiDetn12RdrDetnSts 3;
BA_ "GenSigSendType" SG_ 307 ReSideRdrRiDetn12RdrDetnSts 0;
BA_ "GenSigStartValue" SG_ 307 ReSideRdrRiDetn7RdrDetnAzi 900;
BA_ "GenSigSendType" SG_ 307 ReSideRdrRiDetn7RdrDetnAzi 0;
BA_ "GenSigSendType" SG_ 307 ReSideRdrRiDetn7RdrDetnChks 0;
BA_ "GenSigFuncType" SG_ 307 ReSideRdrRiDetn7RdrDetnChks 15;
BA_ "GenSigDataID" SG_ 307 ReSideRdrRiDetn7RdrDetnChks "0xA47";
BA_ "GenSigSendType" SG_ 307 ReSideRdrRiDetn7RdrDetnCntr 0;
BA_ "GenSigFuncType" SG_ 307 ReSideRdrRiDetn7RdrDetnCntr 16;
BA_ "GenSigSendType" SG_ 307 ReSideRdrRiDetn7RdrDetnConf 0;
BA_ "GenSigStartValue" SG_ 307 ReSideRdrRiDetn7RdrDetnElevn 15;
BA_ "GenSigSendType" SG_ 307 ReSideRdrRiDetn7RdrDetnElevn 0;
BA_ "GenSigSendType" SG_ 307 ReSideRdrRiDetn7RdrDetnPwr 0;
BA_ "GenSigStartValue" SG_ 307 ReSideRdrRiDetn7RdrDetnRng 10050;
BA_ "GenSigSendType" SG_ 307 ReSideRdrRiDetn7RdrDetnRng 0;
BA_ "GenSigStartValue" SG_ 307 ReSideRdrRiDetn7RdrDetnRngV 4000;
BA_ "GenSigSendType" SG_ 307 ReSideRdrRiDetn7RdrDetnRngV 0;
BA_ "GenSigStartValue" SG_ 307 ReSideRdrRiDetn7RdrDetnSts 3;
BA_ "GenSigSendType" SG_ 307 ReSideRdrRiDetn7RdrDetnSts 0;
BA_ "GenSigStartValue" SG_ 307 ReSideRdrRiDetn8RdrDetnAzi 900;
BA_ "GenSigSendType" SG_ 307 ReSideRdrRiDetn8RdrDetnAzi 0;
BA_ "GenSigSendType" SG_ 307 ReSideRdrRiDetn8RdrDetnChks 0;
BA_ "GenSigFuncType" SG_ 307 ReSideRdrRiDetn8RdrDetnChks 15;
BA_ "GenSigDataID" SG_ 307 ReSideRdrRiDetn8RdrDetnChks "0xA48";
BA_ "GenSigSendType" SG_ 307 ReSideRdrRiDetn8RdrDetnCntr 0;
BA_ "GenSigFuncType" SG_ 307 ReSideRdrRiDetn8RdrDetnCntr 16;
BA_ "GenSigSendType" SG_ 307 ReSideRdrRiDetn8RdrDetnConf 0;
BA_ "GenSigStartValue" SG_ 307 ReSideRdrRiDetn8RdrDetnElevn 15;
BA_ "GenSigSendType" SG_ 307 ReSideRdrRiDetn8RdrDetnElevn 0;
BA_ "GenSigSendType" SG_ 307 ReSideRdrRiDetn8RdrDetnPwr 0;
BA_ "GenSigStartValue" SG_ 307 ReSideRdrRiDetn8RdrDetnRng 10050;
BA_ "GenSigSendType" SG_ 307 ReSideRdrRiDetn8RdrDetnRng 0;
BA_ "GenSigStartValue" SG_ 307 ReSideRdrRiDetn8RdrDetnRngV 4000;
BA_ "GenSigSendType" SG_ 307 ReSideRdrRiDetn8RdrDetnRngV 0;
BA_ "GenSigStartValue" SG_ 307 ReSideRdrRiDetn8RdrDetnSts 3;
BA_ "GenSigSendType" SG_ 307 ReSideRdrRiDetn8RdrDetnSts 0;
BA_ "GenSigStartValue" SG_ 307 ReSideRdrRiDetn9RdrDetnAzi 900;
BA_ "GenSigSendType" SG_ 307 ReSideRdrRiDetn9RdrDetnAzi 0;
BA_ "GenSigSendType" SG_ 307 ReSideRdrRiDetn9RdrDetnChks 0;
BA_ "GenSigFuncType" SG_ 307 ReSideRdrRiDetn9RdrDetnChks 15;
BA_ "GenSigDataID" SG_ 307 ReSideRdrRiDetn9RdrDetnChks "0xA49";
BA_ "GenSigSendType" SG_ 307 ReSideRdrRiDetn9RdrDetnCntr 0;
BA_ "GenSigFuncType" SG_ 307 ReSideRdrRiDetn9RdrDetnCntr 16;
BA_ "GenSigSendType" SG_ 307 ReSideRdrRiDetn9RdrDetnConf 0;
BA_ "GenSigStartValue" SG_ 307 ReSideRdrRiDetn9RdrDetnElevn 15;
BA_ "GenSigSendType" SG_ 307 ReSideRdrRiDetn9RdrDetnElevn 0;
BA_ "GenSigSendType" SG_ 307 ReSideRdrRiDetn9RdrDetnPwr 0;
BA_ "GenSigStartValue" SG_ 307 ReSideRdrRiDetn9RdrDetnRng 10050;
BA_ "GenSigSendType" SG_ 307 ReSideRdrRiDetn9RdrDetnRng 0;
BA_ "GenSigStartValue" SG_ 307 ReSideRdrRiDetn9RdrDetnRngV 4000;
BA_ "GenSigSendType" SG_ 307 ReSideRdrRiDetn9RdrDetnRngV 0;
BA_ "GenSigStartValue" SG_ 307 ReSideRdrRiDetn9RdrDetnSts 3;
BA_ "GenSigSendType" SG_ 307 ReSideRdrRiDetn9RdrDetnSts 0;
// Frame: SODRSafetyCANFD3Frame03
BA_ "VFrameFormat" BO_ 309 14;
BA_ "GenMsgSendType" BO_ 309 0;
BA_ "GenMsgCycleTime" BO_ 309 50.000;
BA_ "GenSigStartValue" SG_ 309 ReSideRdrRiDetn13RdrDetnAzi 900;
BA_ "GenSigSendType" SG_ 309 ReSideRdrRiDetn13RdrDetnAzi 0;
BA_ "GenSigSendType" SG_ 309 ReSideRdrRiDetn13RdrDetnChks 0;
BA_ "GenSigFuncType" SG_ 309 ReSideRdrRiDetn13RdrDetnChks 15;
BA_ "GenSigDataID" SG_ 309 ReSideRdrRiDetn13RdrDetnChks "0xA4D";
BA_ "GenSigSendType" SG_ 309 ReSideRdrRiDetn13RdrDetnCntr 0;
BA_ "GenSigFuncType" SG_ 309 ReSideRdrRiDetn13RdrDetnCntr 16;
BA_ "GenSigSendType" SG_ 309 ReSideRdrRiDetn13RdrDetnConf 0;
BA_ "GenSigStartValue" SG_ 309 ReSideRdrRiDetn13RdrDetnElevn 15;
BA_ "GenSigSendType" SG_ 309 ReSideRdrRiDetn13RdrDetnElevn 0;
BA_ "GenSigSendType" SG_ 309 ReSideRdrRiDetn13RdrDetnPwr 0;
BA_ "GenSigStartValue" SG_ 309 ReSideRdrRiDetn13RdrDetnRng 10050;
BA_ "GenSigSendType" SG_ 309 ReSideRdrRiDetn13RdrDetnRng 0;
BA_ "GenSigStartValue" SG_ 309 ReSideRdrRiDetn13RdrDetnRngV 4000;
BA_ "GenSigSendType" SG_ 309 ReSideRdrRiDetn13RdrDetnRngV 0;
BA_ "GenSigStartValue" SG_ 309 ReSideRdrRiDetn13RdrDetnSts 3;
BA_ "GenSigSendType" SG_ 309 ReSideRdrRiDetn13RdrDetnSts 0;
BA_ "GenSigStartValue" SG_ 309 ReSideRdrRiDetn14RdrDetnAzi 900;
BA_ "GenSigSendType" SG_ 309 ReSideRdrRiDetn14RdrDetnAzi 0;
BA_ "GenSigSendType" SG_ 309 ReSideRdrRiDetn14RdrDetnChks 0;
BA_ "GenSigFuncType" SG_ 309 ReSideRdrRiDetn14RdrDetnChks 15;
BA_ "GenSigDataID" SG_ 309 ReSideRdrRiDetn14RdrDetnChks "0xA4E";
BA_ "GenSigSendType" SG_ 309 ReSideRdrRiDetn14RdrDetnCntr 0;
BA_ "GenSigFuncType" SG_ 309 ReSideRdrRiDetn14RdrDetnCntr 16;
BA_ "GenSigSendType" SG_ 309 ReSideRdrRiDetn14RdrDetnConf 0;
BA_ "GenSigStartValue" SG_ 309 ReSideRdrRiDetn14RdrDetnElevn 15;
BA_ "GenSigSendType" SG_ 309 ReSideRdrRiDetn14RdrDetnElevn 0;
BA_ "GenSigSendType" SG_ 309 ReSideRdrRiDetn14RdrDetnPwr 0;
BA_ "GenSigStartValue" SG_ 309 ReSideRdrRiDetn14RdrDetnRng 10050;
BA_ "GenSigSendType" SG_ 309 ReSideRdrRiDetn14RdrDetnRng 0;
BA_ "GenSigStartValue" SG_ 309 ReSideRdrRiDetn14RdrDetnRngV 4000;
BA_ "GenSigSendType" SG_ 309 ReSideRdrRiDetn14RdrDetnRngV 0;
BA_ "GenSigStartValue" SG_ 309 ReSideRdrRiDetn14RdrDetnSts 3;
BA_ "GenSigSendType" SG_ 309 ReSideRdrRiDetn14RdrDetnSts 0;
BA_ "GenSigStartValue" SG_ 309 ReSideRdrRiDetn15RdrDetnAzi 900;
BA_ "GenSigSendType" SG_ 309 ReSideRdrRiDetn15RdrDetnAzi 0;
BA_ "GenSigSendType" SG_ 309 ReSideRdrRiDetn15RdrDetnChks 0;
BA_ "GenSigFuncType" SG_ 309 ReSideRdrRiDetn15RdrDetnChks 15;
BA_ "GenSigDataID" SG_ 309 ReSideRdrRiDetn15RdrDetnChks "0xA4F";
BA_ "GenSigSendType" SG_ 309 ReSideRdrRiDetn15RdrDetnCntr 0;
BA_ "GenSigFuncType" SG_ 309 ReSideRdrRiDetn15RdrDetnCntr 16;
BA_ "GenSigSendType" SG_ 309 ReSideRdrRiDetn15RdrDetnConf 0;
BA_ "GenSigStartValue" SG_ 309 ReSideRdrRiDetn15RdrDetnElevn 15;
BA_ "GenSigSendType" SG_ 309 ReSideRdrRiDetn15RdrDetnElevn 0;
BA_ "GenSigSendType" SG_ 309 ReSideRdrRiDetn15RdrDetnPwr 0;
BA_ "GenSigStartValue" SG_ 309 ReSideRdrRiDetn15RdrDetnRng 10050;
BA_ "GenSigSendType" SG_ 309 ReSideRdrRiDetn15RdrDetnRng 0;
BA_ "GenSigStartValue" SG_ 309 ReSideRdrRiDetn15RdrDetnRngV 4000;
BA_ "GenSigSendType" SG_ 309 ReSideRdrRiDetn15RdrDetnRngV 0;
BA_ "GenSigStartValue" SG_ 309 ReSideRdrRiDetn15RdrDetnSts 3;
BA_ "GenSigSendType" SG_ 309 ReSideRdrRiDetn15RdrDetnSts 0;
BA_ "GenSigStartValue" SG_ 309 ReSideRdrRiDetn16RdrDetnAzi 900;
BA_ "GenSigSendType" SG_ 309 ReSideRdrRiDetn16RdrDetnAzi 0;
BA_ "GenSigSendType" SG_ 309 ReSideRdrRiDetn16RdrDetnChks 0;
BA_ "GenSigFuncType" SG_ 309 ReSideRdrRiDetn16RdrDetnChks 15;
BA_ "GenSigDataID" SG_ 309 ReSideRdrRiDetn16RdrDetnChks "0xA50";
BA_ "GenSigSendType" SG_ 309 ReSideRdrRiDetn16RdrDetnCntr 0;
BA_ "GenSigFuncType" SG_ 309 ReSideRdrRiDetn16RdrDetnCntr 16;
BA_ "GenSigSendType" SG_ 309 ReSideRdrRiDetn16RdrDetnConf 0;
BA_ "GenSigStartValue" SG_ 309 ReSideRdrRiDetn16RdrDetnElevn 15;
BA_ "GenSigSendType" SG_ 309 ReSideRdrRiDetn16RdrDetnElevn 0;
BA_ "GenSigSendType" SG_ 309 ReSideRdrRiDetn16RdrDetnPwr 0;
BA_ "GenSigStartValue" SG_ 309 ReSideRdrRiDetn16RdrDetnRng 10050;
BA_ "GenSigSendType" SG_ 309 ReSideRdrRiDetn16RdrDetnRng 0;
BA_ "GenSigStartValue" SG_ 309 ReSideRdrRiDetn16RdrDetnRngV 4000;
BA_ "GenSigSendType" SG_ 309 ReSideRdrRiDetn16RdrDetnRngV 0;
BA_ "GenSigStartValue" SG_ 309 ReSideRdrRiDetn16RdrDetnSts 3;
BA_ "GenSigSendType" SG_ 309 ReSideRdrRiDetn16RdrDetnSts 0;
BA_ "GenSigStartValue" SG_ 309 ReSideRdrRiDetn17RdrDetnAzi 900;
BA_ "GenSigSendType" SG_ 309 ReSideRdrRiDetn17RdrDetnAzi 0;
BA_ "GenSigSendType" SG_ 309 ReSideRdrRiDetn17RdrDetnChks 0;
BA_ "GenSigFuncType" SG_ 309 ReSideRdrRiDetn17RdrDetnChks 15;
BA_ "GenSigDataID" SG_ 309 ReSideRdrRiDetn17RdrDetnChks "0xA51";
BA_ "GenSigSendType" SG_ 309 ReSideRdrRiDetn17RdrDetnCntr 0;
BA_ "GenSigFuncType" SG_ 309 ReSideRdrRiDetn17RdrDetnCntr 16;
BA_ "GenSigSendType" SG_ 309 ReSideRdrRiDetn17RdrDetnConf 0;
BA_ "GenSigStartValue" SG_ 309 ReSideRdrRiDetn17RdrDetnElevn 15;
BA_ "GenSigSendType" SG_ 309 ReSideRdrRiDetn17RdrDetnElevn 0;
BA_ "GenSigSendType" SG_ 309 ReSideRdrRiDetn17RdrDetnPwr 0;
BA_ "GenSigStartValue" SG_ 309 ReSideRdrRiDetn17RdrDetnRng 10050;
BA_ "GenSigSendType" SG_ 309 ReSideRdrRiDetn17RdrDetnRng 0;
BA_ "GenSigStartValue" SG_ 309 ReSideRdrRiDetn17RdrDetnRngV 4000;
BA_ "GenSigSendType" SG_ 309 ReSideRdrRiDetn17RdrDetnRngV 0;
BA_ "GenSigStartValue" SG_ 309 ReSideRdrRiDetn17RdrDetnSts 3;
BA_ "GenSigSendType" SG_ 309 ReSideRdrRiDetn17RdrDetnSts 0;
BA_ "GenSigStartValue" SG_ 309 ReSideRdrRiDetn18RdrDetnAzi 900;
BA_ "GenSigSendType" SG_ 309 ReSideRdrRiDetn18RdrDetnAzi 0;
BA_ "GenSigSendType" SG_ 309 ReSideRdrRiDetn18RdrDetnChks 0;
BA_ "GenSigFuncType" SG_ 309 ReSideRdrRiDetn18RdrDetnChks 15;
BA_ "GenSigDataID" SG_ 309 ReSideRdrRiDetn18RdrDetnChks "0xA52";
BA_ "GenSigSendType" SG_ 309 ReSideRdrRiDetn18RdrDetnCntr 0;
BA_ "GenSigFuncType" SG_ 309 ReSideRdrRiDetn18RdrDetnCntr 16;
BA_ "GenSigSendType" SG_ 309 ReSideRdrRiDetn18RdrDetnConf 0;
BA_ "GenSigStartValue" SG_ 309 ReSideRdrRiDetn18RdrDetnElevn 15;
BA_ "GenSigSendType" SG_ 309 ReSideRdrRiDetn18RdrDetnElevn 0;
BA_ "GenSigSendType" SG_ 309 ReSideRdrRiDetn18RdrDetnPwr 0;
BA_ "GenSigStartValue" SG_ 309 ReSideRdrRiDetn18RdrDetnRng 10050;
BA_ "GenSigSendType" SG_ 309 ReSideRdrRiDetn18RdrDetnRng 0;
BA_ "GenSigStartValue" SG_ 309 ReSideRdrRiDetn18RdrDetnRngV 4000;
BA_ "GenSigSendType" SG_ 309 ReSideRdrRiDetn18RdrDetnRngV 0;
BA_ "GenSigStartValue" SG_ 309 ReSideRdrRiDetn18RdrDetnSts 3;
BA_ "GenSigSendType" SG_ 309 ReSideRdrRiDetn18RdrDetnSts 0;
// Frame: SODRSafetyCANFD3Frame04
BA_ "VFrameFormat" BO_ 311 14;
BA_ "GenMsgSendType" BO_ 311 0;
BA_ "GenMsgCycleTime" BO_ 311 50.000;
BA_ "GenSigStartValue" SG_ 311 ReSideRdrRiDetn19RdrDetnAzi 900;
BA_ "GenSigSendType" SG_ 311 ReSideRdrRiDetn19RdrDetnAzi 0;
BA_ "GenSigSendType" SG_ 311 ReSideRdrRiDetn19RdrDetnChks 0;
BA_ "GenSigFuncType" SG_ 311 ReSideRdrRiDetn19RdrDetnChks 15;
BA_ "GenSigDataID" SG_ 311 ReSideRdrRiDetn19RdrDetnChks "0xA53";
BA_ "GenSigSendType" SG_ 311 ReSideRdrRiDetn19RdrDetnCntr 0;
BA_ "GenSigFuncType" SG_ 311 ReSideRdrRiDetn19RdrDetnCntr 16;
BA_ "GenSigSendType" SG_ 311 ReSideRdrRiDetn19RdrDetnConf 0;
BA_ "GenSigStartValue" SG_ 311 ReSideRdrRiDetn19RdrDetnElevn 15;
BA_ "GenSigSendType" SG_ 311 ReSideRdrRiDetn19RdrDetnElevn 0;
BA_ "GenSigSendType" SG_ 311 ReSideRdrRiDetn19RdrDetnPwr 0;
BA_ "GenSigStartValue" SG_ 311 ReSideRdrRiDetn19RdrDetnRng 10050;
BA_ "GenSigSendType" SG_ 311 ReSideRdrRiDetn19RdrDetnRng 0;
BA_ "GenSigStartValue" SG_ 311 ReSideRdrRiDetn19RdrDetnRngV 4000;
BA_ "GenSigSendType" SG_ 311 ReSideRdrRiDetn19RdrDetnRngV 0;
BA_ "GenSigStartValue" SG_ 311 ReSideRdrRiDetn19RdrDetnSts 3;
BA_ "GenSigSendType" SG_ 311 ReSideRdrRiDetn19RdrDetnSts 0;
BA_ "GenSigStartValue" SG_ 311 ReSideRdrRiDetn20RdrDetnAzi 900;
BA_ "GenSigSendType" SG_ 311 ReSideRdrRiDetn20RdrDetnAzi 0;
BA_ "GenSigSendType" SG_ 311 ReSideRdrRiDetn20RdrDetnChks 0;
BA_ "GenSigFuncType" SG_ 311 ReSideRdrRiDetn20RdrDetnChks 15;
BA_ "GenSigDataID" SG_ 311 ReSideRdrRiDetn20RdrDetnChks "0xA54";
BA_ "GenSigSendType" SG_ 311 ReSideRdrRiDetn20RdrDetnCntr 0;
BA_ "GenSigFuncType" SG_ 311 ReSideRdrRiDetn20RdrDetnCntr 16;
BA_ "GenSigSendType" SG_ 311 ReSideRdrRiDetn20RdrDetnConf 0;
BA_ "GenSigStartValue" SG_ 311 ReSideRdrRiDetn20RdrDetnElevn 15;
BA_ "GenSigSendType" SG_ 311 ReSideRdrRiDetn20RdrDetnElevn 0;
BA_ "GenSigSendType" SG_ 311 ReSideRdrRiDetn20RdrDetnPwr 0;
BA_ "GenSigStartValue" SG_ 311 ReSideRdrRiDetn20RdrDetnRng 10050;
BA_ "GenSigSendType" SG_ 311 ReSideRdrRiDetn20RdrDetnRng 0;
BA_ "GenSigStartValue" SG_ 311 ReSideRdrRiDetn20RdrDetnRngV 4000;
BA_ "GenSigSendType" SG_ 311 ReSideRdrRiDetn20RdrDetnRngV 0;
BA_ "GenSigStartValue" SG_ 311 ReSideRdrRiDetn20RdrDetnSts 3;
BA_ "GenSigSendType" SG_ 311 ReSideRdrRiDetn20RdrDetnSts 0;
BA_ "GenSigStartValue" SG_ 311 ReSideRdrRiDetn21RdrDetnAzi 900;
BA_ "GenSigSendType" SG_ 311 ReSideRdrRiDetn21RdrDetnAzi 0;
BA_ "GenSigSendType" SG_ 311 ReSideRdrRiDetn21RdrDetnChks 0;
BA_ "GenSigFuncType" SG_ 311 ReSideRdrRiDetn21RdrDetnChks 15;
BA_ "GenSigDataID" SG_ 311 ReSideRdrRiDetn21RdrDetnChks "0xA55";
BA_ "GenSigSendType" SG_ 311 ReSideRdrRiDetn21RdrDetnCntr 0;
BA_ "GenSigFuncType" SG_ 311 ReSideRdrRiDetn21RdrDetnCntr 16;
BA_ "GenSigSendType" SG_ 311 ReSideRdrRiDetn21RdrDetnConf 0;
BA_ "GenSigStartValue" SG_ 311 ReSideRdrRiDetn21RdrDetnElevn 15;
BA_ "GenSigSendType" SG_ 311 ReSideRdrRiDetn21RdrDetnElevn 0;
BA_ "GenSigSendType" SG_ 311 ReSideRdrRiDetn21RdrDetnPwr 0;
BA_ "GenSigStartValue" SG_ 311 ReSideRdrRiDetn21RdrDetnRng 10050;
BA_ "GenSigSendType" SG_ 311 ReSideRdrRiDetn21RdrDetnRng 0;
BA_ "GenSigStartValue" SG_ 311 ReSideRdrRiDetn21RdrDetnRngV 4000;
BA_ "GenSigSendType" SG_ 311 ReSideRdrRiDetn21RdrDetnRngV 0;
BA_ "GenSigStartValue" SG_ 311 ReSideRdrRiDetn21RdrDetnSts 3;
BA_ "GenSigSendType" SG_ 311 ReSideRdrRiDetn21RdrDetnSts 0;
BA_ "GenSigStartValue" SG_ 311 ReSideRdrRiDetn22RdrDetnAzi 900;
BA_ "GenSigSendType" SG_ 311 ReSideRdrRiDetn22RdrDetnAzi 0;
BA_ "GenSigSendType" SG_ 311 ReSideRdrRiDetn22RdrDetnChks 0;
BA_ "GenSigFuncType" SG_ 311 ReSideRdrRiDetn22RdrDetnChks 15;
BA_ "GenSigDataID" SG_ 311 ReSideRdrRiDetn22RdrDetnChks "0xA56";
BA_ "GenSigSendType" SG_ 311 ReSideRdrRiDetn22RdrDetnCntr 0;
BA_ "GenSigFuncType" SG_ 311 ReSideRdrRiDetn22RdrDetnCntr 16;
BA_ "GenSigSendType" SG_ 311 ReSideRdrRiDetn22RdrDetnConf 0;
BA_ "GenSigStartValue" SG_ 311 ReSideRdrRiDetn22RdrDetnElevn 15;
BA_ "GenSigSendType" SG_ 311 ReSideRdrRiDetn22RdrDetnElevn 0;
BA_ "GenSigSendType" SG_ 311 ReSideRdrRiDetn22RdrDetnPwr 0;
BA_ "GenSigStartValue" SG_ 311 ReSideRdrRiDetn22RdrDetnRng 10050;
BA_ "GenSigSendType" SG_ 311 ReSideRdrRiDetn22RdrDetnRng 0;
BA_ "GenSigStartValue" SG_ 311 ReSideRdrRiDetn22RdrDetnRngV 4000;
BA_ "GenSigSendType" SG_ 311 ReSideRdrRiDetn22RdrDetnRngV 0;
BA_ "GenSigStartValue" SG_ 311 ReSideRdrRiDetn22RdrDetnSts 3;
BA_ "GenSigSendType" SG_ 311 ReSideRdrRiDetn22RdrDetnSts 0;
BA_ "GenSigStartValue" SG_ 311 ReSideRdrRiDetn23RdrDetnAzi 900;
BA_ "GenSigSendType" SG_ 311 ReSideRdrRiDetn23RdrDetnAzi 0;
BA_ "GenSigSendType" SG_ 311 ReSideRdrRiDetn23RdrDetnChks 0;
BA_ "GenSigFuncType" SG_ 311 ReSideRdrRiDetn23RdrDetnChks 15;
BA_ "GenSigDataID" SG_ 311 ReSideRdrRiDetn23RdrDetnChks "0xA57";
BA_ "GenSigSendType" SG_ 311 ReSideRdrRiDetn23RdrDetnCntr 0;
BA_ "GenSigFuncType" SG_ 311 ReSideRdrRiDetn23RdrDetnCntr 16;
BA_ "GenSigSendType" SG_ 311 ReSideRdrRiDetn23RdrDetnConf 0;
BA_ "GenSigStartValue" SG_ 311 ReSideRdrRiDetn23RdrDetnElevn 15;
BA_ "GenSigSendType" SG_ 311 ReSideRdrRiDetn23RdrDetnElevn 0;
BA_ "GenSigSendType" SG_ 311 ReSideRdrRiDetn23RdrDetnPwr 0;
BA_ "GenSigStartValue" SG_ 311 ReSideRdrRiDetn23RdrDetnRng 10050;
BA_ "GenSigSendType" SG_ 311 ReSideRdrRiDetn23RdrDetnRng 0;
BA_ "GenSigStartValue" SG_ 311 ReSideRdrRiDetn23RdrDetnRngV 4000;
BA_ "GenSigSendType" SG_ 311 ReSideRdrRiDetn23RdrDetnRngV 0;
BA_ "GenSigStartValue" SG_ 311 ReSideRdrRiDetn23RdrDetnSts 3;
BA_ "GenSigSendType" SG_ 311 ReSideRdrRiDetn23RdrDetnSts 0;
BA_ "GenSigStartValue" SG_ 311 ReSideRdrRiDetn24RdrDetnAzi 900;
BA_ "GenSigSendType" SG_ 311 ReSideRdrRiDetn24RdrDetnAzi 0;
BA_ "GenSigSendType" SG_ 311 ReSideRdrRiDetn24RdrDetnChks 0;
BA_ "GenSigFuncType" SG_ 311 ReSideRdrRiDetn24RdrDetnChks 15;
BA_ "GenSigDataID" SG_ 311 ReSideRdrRiDetn24RdrDetnChks "0xA58";
BA_ "GenSigSendType" SG_ 311 ReSideRdrRiDetn24RdrDetnCntr 0;
BA_ "GenSigFuncType" SG_ 311 ReSideRdrRiDetn24RdrDetnCntr 16;
BA_ "GenSigSendType" SG_ 311 ReSideRdrRiDetn24RdrDetnConf 0;
BA_ "GenSigStartValue" SG_ 311 ReSideRdrRiDetn24RdrDetnElevn 15;
BA_ "GenSigSendType" SG_ 311 ReSideRdrRiDetn24RdrDetnElevn 0;
BA_ "GenSigSendType" SG_ 311 ReSideRdrRiDetn24RdrDetnPwr 0;
BA_ "GenSigStartValue" SG_ 311 ReSideRdrRiDetn24RdrDetnRng 10050;
BA_ "GenSigSendType" SG_ 311 ReSideRdrRiDetn24RdrDetnRng 0;
BA_ "GenSigStartValue" SG_ 311 ReSideRdrRiDetn24RdrDetnRngV 4000;
BA_ "GenSigSendType" SG_ 311 ReSideRdrRiDetn24RdrDetnRngV 0;
BA_ "GenSigStartValue" SG_ 311 ReSideRdrRiDetn24RdrDetnSts 3;
BA_ "GenSigSendType" SG_ 311 ReSideRdrRiDetn24RdrDetnSts 0;
// Frame: SODRSafetyCANFD3Frame05
BA_ "VFrameFormat" BO_ 313 14;
BA_ "GenMsgSendType" BO_ 313 0;
BA_ "GenMsgCycleTime" BO_ 313 50.000;
BA_ "GenSigStartValue" SG_ 313 ReSideRdrRiDetn25RdrDetnAzi 900;
BA_ "GenSigSendType" SG_ 313 ReSideRdrRiDetn25RdrDetnAzi 0;
BA_ "GenSigSendType" SG_ 313 ReSideRdrRiDetn25RdrDetnChks 0;
BA_ "GenSigFuncType" SG_ 313 ReSideRdrRiDetn25RdrDetnChks 15;
BA_ "GenSigDataID" SG_ 313 ReSideRdrRiDetn25RdrDetnChks "0xA59";
BA_ "GenSigSendType" SG_ 313 ReSideRdrRiDetn25RdrDetnCntr 0;
BA_ "GenSigFuncType" SG_ 313 ReSideRdrRiDetn25RdrDetnCntr 16;
BA_ "GenSigSendType" SG_ 313 ReSideRdrRiDetn25RdrDetnConf 0;
BA_ "GenSigStartValue" SG_ 313 ReSideRdrRiDetn25RdrDetnElevn 15;
BA_ "GenSigSendType" SG_ 313 ReSideRdrRiDetn25RdrDetnElevn 0;
BA_ "GenSigSendType" SG_ 313 ReSideRdrRiDetn25RdrDetnPwr 0;
BA_ "GenSigStartValue" SG_ 313 ReSideRdrRiDetn25RdrDetnRng 10050;
BA_ "GenSigSendType" SG_ 313 ReSideRdrRiDetn25RdrDetnRng 0;
BA_ "GenSigStartValue" SG_ 313 ReSideRdrRiDetn25RdrDetnRngV 4000;
BA_ "GenSigSendType" SG_ 313 ReSideRdrRiDetn25RdrDetnRngV 0;
BA_ "GenSigStartValue" SG_ 313 ReSideRdrRiDetn25RdrDetnSts 3;
BA_ "GenSigSendType" SG_ 313 ReSideRdrRiDetn25RdrDetnSts 0;
BA_ "GenSigStartValue" SG_ 313 ReSideRdrRiDetn26RdrDetnAzi 900;
BA_ "GenSigSendType" SG_ 313 ReSideRdrRiDetn26RdrDetnAzi 0;
BA_ "GenSigSendType" SG_ 313 ReSideRdrRiDetn26RdrDetnChks 0;
BA_ "GenSigFuncType" SG_ 313 ReSideRdrRiDetn26RdrDetnChks 15;
BA_ "GenSigDataID" SG_ 313 ReSideRdrRiDetn26RdrDetnChks "0xA5A";
BA_ "GenSigSendType" SG_ 313 ReSideRdrRiDetn26RdrDetnCntr 0;
BA_ "GenSigFuncType" SG_ 313 ReSideRdrRiDetn26RdrDetnCntr 16;
BA_ "GenSigSendType" SG_ 313 ReSideRdrRiDetn26RdrDetnConf 0;
BA_ "GenSigStartValue" SG_ 313 ReSideRdrRiDetn26RdrDetnElevn 15;
BA_ "GenSigSendType" SG_ 313 ReSideRdrRiDetn26RdrDetnElevn 0;
BA_ "GenSigSendType" SG_ 313 ReSideRdrRiDetn26RdrDetnPwr 0;
BA_ "GenSigStartValue" SG_ 313 ReSideRdrRiDetn26RdrDetnRng 10050;
BA_ "GenSigSendType" SG_ 313 ReSideRdrRiDetn26RdrDetnRng 0;
BA_ "GenSigStartValue" SG_ 313 ReSideRdrRiDetn26RdrDetnRngV 4000;
BA_ "GenSigSendType" SG_ 313 ReSideRdrRiDetn26RdrDetnRngV 0;
BA_ "GenSigStartValue" SG_ 313 ReSideRdrRiDetn26RdrDetnSts 3;
BA_ "GenSigSendType" SG_ 313 ReSideRdrRiDetn26RdrDetnSts 0;
BA_ "GenSigStartValue" SG_ 313 ReSideRdrRiDetn27RdrDetnAzi 900;
BA_ "GenSigSendType" SG_ 313 ReSideRdrRiDetn27RdrDetnAzi 0;
BA_ "GenSigSendType" SG_ 313 ReSideRdrRiDetn27RdrDetnChks 0;
BA_ "GenSigFuncType" SG_ 313 ReSideRdrRiDetn27RdrDetnChks 15;
BA_ "GenSigDataID" SG_ 313 ReSideRdrRiDetn27RdrDetnChks "0xA5B";
BA_ "GenSigSendType" SG_ 313 ReSideRdrRiDetn27RdrDetnCntr 0;
BA_ "GenSigFuncType" SG_ 313 ReSideRdrRiDetn27RdrDetnCntr 16;
BA_ "GenSigSendType" SG_ 313 ReSideRdrRiDetn27RdrDetnConf 0;
BA_ "GenSigStartValue" SG_ 313 ReSideRdrRiDetn27RdrDetnElevn 15;
BA_ "GenSigSendType" SG_ 313 ReSideRdrRiDetn27RdrDetnElevn 0;
BA_ "GenSigSendType" SG_ 313 ReSideRdrRiDetn27RdrDetnPwr 0;
BA_ "GenSigStartValue" SG_ 313 ReSideRdrRiDetn27RdrDetnRng 10050;
BA_ "GenSigSendType" SG_ 313 ReSideRdrRiDetn27RdrDetnRng 0;
BA_ "GenSigStartValue" SG_ 313 ReSideRdrRiDetn27RdrDetnRngV 4000;
BA_ "GenSigSendType" SG_ 313 ReSideRdrRiDetn27RdrDetnRngV 0;
BA_ "GenSigStartValue" SG_ 313 ReSideRdrRiDetn27RdrDetnSts 3;
BA_ "GenSigSendType" SG_ 313 ReSideRdrRiDetn27RdrDetnSts 0;
BA_ "GenSigStartValue" SG_ 313 ReSideRdrRiDetn28RdrDetnAzi 900;
BA_ "GenSigSendType" SG_ 313 ReSideRdrRiDetn28RdrDetnAzi 0;
BA_ "GenSigSendType" SG_ 313 ReSideRdrRiDetn28RdrDetnChks 0;
BA_ "GenSigFuncType" SG_ 313 ReSideRdrRiDetn28RdrDetnChks 15;
BA_ "GenSigDataID" SG_ 313 ReSideRdrRiDetn28RdrDetnChks "0xA5C";
BA_ "GenSigSendType" SG_ 313 ReSideRdrRiDetn28RdrDetnCntr 0;
BA_ "GenSigFuncType" SG_ 313 ReSideRdrRiDetn28RdrDetnCntr 16;
BA_ "GenSigSendType" SG_ 313 ReSideRdrRiDetn28RdrDetnConf 0;
BA_ "GenSigStartValue" SG_ 313 ReSideRdrRiDetn28RdrDetnElevn 15;
BA_ "GenSigSendType" SG_ 313 ReSideRdrRiDetn28RdrDetnElevn 0;
BA_ "GenSigSendType" SG_ 313 ReSideRdrRiDetn28RdrDetnPwr 0;
BA_ "GenSigStartValue" SG_ 313 ReSideRdrRiDetn28RdrDetnRng 10050;
BA_ "GenSigSendType" SG_ 313 ReSideRdrRiDetn28RdrDetnRng 0;
BA_ "GenSigStartValue" SG_ 313 ReSideRdrRiDetn28RdrDetnRngV 4000;
BA_ "GenSigSendType" SG_ 313 ReSideRdrRiDetn28RdrDetnRngV 0;
BA_ "GenSigStartValue" SG_ 313 ReSideRdrRiDetn28RdrDetnSts 3;
BA_ "GenSigSendType" SG_ 313 ReSideRdrRiDetn28RdrDetnSts 0;
BA_ "GenSigStartValue" SG_ 313 ReSideRdrRiDetn29RdrDetnAzi 900;
BA_ "GenSigSendType" SG_ 313 ReSideRdrRiDetn29RdrDetnAzi 0;
BA_ "GenSigSendType" SG_ 313 ReSideRdrRiDetn29RdrDetnChks 0;
BA_ "GenSigFuncType" SG_ 313 ReSideRdrRiDetn29RdrDetnChks 15;
BA_ "GenSigDataID" SG_ 313 ReSideRdrRiDetn29RdrDetnChks "0xA5D";
BA_ "GenSigSendType" SG_ 313 ReSideRdrRiDetn29RdrDetnCntr 0;
BA_ "GenSigFuncType" SG_ 313 ReSideRdrRiDetn29RdrDetnCntr 16;
BA_ "GenSigSendType" SG_ 313 ReSideRdrRiDetn29RdrDetnConf 0;
BA_ "GenSigStartValue" SG_ 313 ReSideRdrRiDetn29RdrDetnElevn 15;
BA_ "GenSigSendType" SG_ 313 ReSideRdrRiDetn29RdrDetnElevn 0;
BA_ "GenSigSendType" SG_ 313 ReSideRdrRiDetn29RdrDetnPwr 0;
BA_ "GenSigStartValue" SG_ 313 ReSideRdrRiDetn29RdrDetnRng 10050;
BA_ "GenSigSendType" SG_ 313 ReSideRdrRiDetn29RdrDetnRng 0;
BA_ "GenSigStartValue" SG_ 313 ReSideRdrRiDetn29RdrDetnRngV 4000;
BA_ "GenSigSendType" SG_ 313 ReSideRdrRiDetn29RdrDetnRngV 0;
BA_ "GenSigStartValue" SG_ 313 ReSideRdrRiDetn29RdrDetnSts 3;
BA_ "GenSigSendType" SG_ 313 ReSideRdrRiDetn29RdrDetnSts 0;
BA_ "GenSigStartValue" SG_ 313 ReSideRdrRiDetn30RdrDetnAzi 900;
BA_ "GenSigSendType" SG_ 313 ReSideRdrRiDetn30RdrDetnAzi 0;
BA_ "GenSigSendType" SG_ 313 ReSideRdrRiDetn30RdrDetnChks 0;
BA_ "GenSigFuncType" SG_ 313 ReSideRdrRiDetn30RdrDetnChks 15;
BA_ "GenSigDataID" SG_ 313 ReSideRdrRiDetn30RdrDetnChks "0xA5E";
BA_ "GenSigSendType" SG_ 313 ReSideRdrRiDetn30RdrDetnCntr 0;
BA_ "GenSigFuncType" SG_ 313 ReSideRdrRiDetn30RdrDetnCntr 16;
BA_ "GenSigSendType" SG_ 313 ReSideRdrRiDetn30RdrDetnConf 0;
BA_ "GenSigStartValue" SG_ 313 ReSideRdrRiDetn30RdrDetnElevn 15;
BA_ "GenSigSendType" SG_ 313 ReSideRdrRiDetn30RdrDetnElevn 0;
BA_ "GenSigSendType" SG_ 313 ReSideRdrRiDetn30RdrDetnPwr 0;
BA_ "GenSigStartValue" SG_ 313 ReSideRdrRiDetn30RdrDetnRng 10050;
BA_ "GenSigSendType" SG_ 313 ReSideRdrRiDetn30RdrDetnRng 0;
BA_ "GenSigStartValue" SG_ 313 ReSideRdrRiDetn30RdrDetnRngV 4000;
BA_ "GenSigSendType" SG_ 313 ReSideRdrRiDetn30RdrDetnRngV 0;
BA_ "GenSigStartValue" SG_ 313 ReSideRdrRiDetn30RdrDetnSts 3;
BA_ "GenSigSendType" SG_ 313 ReSideRdrRiDetn30RdrDetnSts 0;
// Frame: SODRSafetyCANFD3Frame06
BA_ "VFrameFormat" BO_ 315 14;
BA_ "GenMsgSendType" BO_ 315 0;
BA_ "GenMsgCycleTime" BO_ 315 50.000;
BA_ "GenSigStartValue" SG_ 315 ReSideRdrRiDetn31RdrDetnAzi 900;
BA_ "GenSigSendType" SG_ 315 ReSideRdrRiDetn31RdrDetnAzi 0;
BA_ "GenSigSendType" SG_ 315 ReSideRdrRiDetn31RdrDetnChks 0;
BA_ "GenSigFuncType" SG_ 315 ReSideRdrRiDetn31RdrDetnChks 15;
BA_ "GenSigDataID" SG_ 315 ReSideRdrRiDetn31RdrDetnChks "0xA5F";
BA_ "GenSigSendType" SG_ 315 ReSideRdrRiDetn31RdrDetnCntr 0;
BA_ "GenSigFuncType" SG_ 315 ReSideRdrRiDetn31RdrDetnCntr 16;
BA_ "GenSigSendType" SG_ 315 ReSideRdrRiDetn31RdrDetnConf 0;
BA_ "GenSigStartValue" SG_ 315 ReSideRdrRiDetn31RdrDetnElevn 15;
BA_ "GenSigSendType" SG_ 315 ReSideRdrRiDetn31RdrDetnElevn 0;
BA_ "GenSigSendType" SG_ 315 ReSideRdrRiDetn31RdrDetnPwr 0;
BA_ "GenSigStartValue" SG_ 315 ReSideRdrRiDetn31RdrDetnRng 10050;
BA_ "GenSigSendType" SG_ 315 ReSideRdrRiDetn31RdrDetnRng 0;
BA_ "GenSigStartValue" SG_ 315 ReSideRdrRiDetn31RdrDetnRngV 4000;
BA_ "GenSigSendType" SG_ 315 ReSideRdrRiDetn31RdrDetnRngV 0;
BA_ "GenSigStartValue" SG_ 315 ReSideRdrRiDetn31RdrDetnSts 3;
BA_ "GenSigSendType" SG_ 315 ReSideRdrRiDetn31RdrDetnSts 0;
BA_ "GenSigStartValue" SG_ 315 ReSideRdrRiDetn32RdrDetnAzi 900;
BA_ "GenSigSendType" SG_ 315 ReSideRdrRiDetn32RdrDetnAzi 0;
BA_ "GenSigSendType" SG_ 315 ReSideRdrRiDetn32RdrDetnChks 0;
BA_ "GenSigFuncType" SG_ 315 ReSideRdrRiDetn32RdrDetnChks 15;
BA_ "GenSigDataID" SG_ 315 ReSideRdrRiDetn32RdrDetnChks "0xA60";
BA_ "GenSigSendType" SG_ 315 ReSideRdrRiDetn32RdrDetnCntr 0;
BA_ "GenSigFuncType" SG_ 315 ReSideRdrRiDetn32RdrDetnCntr 16;
BA_ "GenSigSendType" SG_ 315 ReSideRdrRiDetn32RdrDetnConf 0;
BA_ "GenSigStartValue" SG_ 315 ReSideRdrRiDetn32RdrDetnElevn 15;
BA_ "GenSigSendType" SG_ 315 ReSideRdrRiDetn32RdrDetnElevn 0;
BA_ "GenSigSendType" SG_ 315 ReSideRdrRiDetn32RdrDetnPwr 0;
BA_ "GenSigStartValue" SG_ 315 ReSideRdrRiDetn32RdrDetnRng 10050;
BA_ "GenSigSendType" SG_ 315 ReSideRdrRiDetn32RdrDetnRng 0;
BA_ "GenSigStartValue" SG_ 315 ReSideRdrRiDetn32RdrDetnRngV 4000;
BA_ "GenSigSendType" SG_ 315 ReSideRdrRiDetn32RdrDetnRngV 0;
BA_ "GenSigStartValue" SG_ 315 ReSideRdrRiDetn32RdrDetnSts 3;
BA_ "GenSigSendType" SG_ 315 ReSideRdrRiDetn32RdrDetnSts 0;
BA_ "GenSigStartValue" SG_ 315 ReSideRdrRiDetn33RdrDetnAzi 900;
BA_ "GenSigSendType" SG_ 315 ReSideRdrRiDetn33RdrDetnAzi 0;
BA_ "GenSigSendType" SG_ 315 ReSideRdrRiDetn33RdrDetnChks 0;
BA_ "GenSigFuncType" SG_ 315 ReSideRdrRiDetn33RdrDetnChks 15;
BA_ "GenSigDataID" SG_ 315 ReSideRdrRiDetn33RdrDetnChks "0xA61";
BA_ "GenSigSendType" SG_ 315 ReSideRdrRiDetn33RdrDetnCntr 0;
BA_ "GenSigFuncType" SG_ 315 ReSideRdrRiDetn33RdrDetnCntr 16;
BA_ "GenSigSendType" SG_ 315 ReSideRdrRiDetn33RdrDetnConf 0;
BA_ "GenSigStartValue" SG_ 315 ReSideRdrRiDetn33RdrDetnElevn 15;
BA_ "GenSigSendType" SG_ 315 ReSideRdrRiDetn33RdrDetnElevn 0;
BA_ "GenSigSendType" SG_ 315 ReSideRdrRiDetn33RdrDetnPwr 0;
BA_ "GenSigStartValue" SG_ 315 ReSideRdrRiDetn33RdrDetnRng 10050;
BA_ "GenSigSendType" SG_ 315 ReSideRdrRiDetn33RdrDetnRng 0;
BA_ "GenSigStartValue" SG_ 315 ReSideRdrRiDetn33RdrDetnRngV 4000;
BA_ "GenSigSendType" SG_ 315 ReSideRdrRiDetn33RdrDetnRngV 0;
BA_ "GenSigStartValue" SG_ 315 ReSideRdrRiDetn33RdrDetnSts 3;
BA_ "GenSigSendType" SG_ 315 ReSideRdrRiDetn33RdrDetnSts 0;
BA_ "GenSigStartValue" SG_ 315 ReSideRdrRiDetn34RdrDetnAzi 900;
BA_ "GenSigSendType" SG_ 315 ReSideRdrRiDetn34RdrDetnAzi 0;
BA_ "GenSigSendType" SG_ 315 ReSideRdrRiDetn34RdrDetnChks 0;
BA_ "GenSigFuncType" SG_ 315 ReSideRdrRiDetn34RdrDetnChks 15;
BA_ "GenSigDataID" SG_ 315 ReSideRdrRiDetn34RdrDetnChks "0xA62";
BA_ "GenSigSendType" SG_ 315 ReSideRdrRiDetn34RdrDetnCntr 0;
BA_ "GenSigFuncType" SG_ 315 ReSideRdrRiDetn34RdrDetnCntr 16;
BA_ "GenSigSendType" SG_ 315 ReSideRdrRiDetn34RdrDetnConf 0;
BA_ "GenSigStartValue" SG_ 315 ReSideRdrRiDetn34RdrDetnElevn 15;
BA_ "GenSigSendType" SG_ 315 ReSideRdrRiDetn34RdrDetnElevn 0;
BA_ "GenSigSendType" SG_ 315 ReSideRdrRiDetn34RdrDetnPwr 0;
BA_ "GenSigStartValue" SG_ 315 ReSideRdrRiDetn34RdrDetnRng 10050;
BA_ "GenSigSendType" SG_ 315 ReSideRdrRiDetn34RdrDetnRng 0;
BA_ "GenSigStartValue" SG_ 315 ReSideRdrRiDetn34RdrDetnRngV 4000;
BA_ "GenSigSendType" SG_ 315 ReSideRdrRiDetn34RdrDetnRngV 0;
BA_ "GenSigStartValue" SG_ 315 ReSideRdrRiDetn34RdrDetnSts 3;
BA_ "GenSigSendType" SG_ 315 ReSideRdrRiDetn34RdrDetnSts 0;
BA_ "GenSigStartValue" SG_ 315 ReSideRdrRiDetn35RdrDetnAzi 900;
BA_ "GenSigSendType" SG_ 315 ReSideRdrRiDetn35RdrDetnAzi 0;
BA_ "GenSigSendType" SG_ 315 ReSideRdrRiDetn35RdrDetnChks 0;
BA_ "GenSigFuncType" SG_ 315 ReSideRdrRiDetn35RdrDetnChks 15;
BA_ "GenSigDataID" SG_ 315 ReSideRdrRiDetn35RdrDetnChks "0xA63";
BA_ "GenSigSendType" SG_ 315 ReSideRdrRiDetn35RdrDetnCntr 0;
BA_ "GenSigFuncType" SG_ 315 ReSideRdrRiDetn35RdrDetnCntr 16;
BA_ "GenSigSendType" SG_ 315 ReSideRdrRiDetn35RdrDetnConf 0;
BA_ "GenSigStartValue" SG_ 315 ReSideRdrRiDetn35RdrDetnElevn 15;
BA_ "GenSigSendType" SG_ 315 ReSideRdrRiDetn35RdrDetnElevn 0;
BA_ "GenSigSendType" SG_ 315 ReSideRdrRiDetn35RdrDetnPwr 0;
BA_ "GenSigStartValue" SG_ 315 ReSideRdrRiDetn35RdrDetnRng 10050;
BA_ "GenSigSendType" SG_ 315 ReSideRdrRiDetn35RdrDetnRng 0;
BA_ "GenSigStartValue" SG_ 315 ReSideRdrRiDetn35RdrDetnRngV 4000;
BA_ "GenSigSendType" SG_ 315 ReSideRdrRiDetn35RdrDetnRngV 0;
BA_ "GenSigStartValue" SG_ 315 ReSideRdrRiDetn35RdrDetnSts 3;
BA_ "GenSigSendType" SG_ 315 ReSideRdrRiDetn35RdrDetnSts 0;
BA_ "GenSigStartValue" SG_ 315 ReSideRdrRiDetn36RdrDetnAzi 900;
BA_ "GenSigSendType" SG_ 315 ReSideRdrRiDetn36RdrDetnAzi 0;
BA_ "GenSigSendType" SG_ 315 ReSideRdrRiDetn36RdrDetnChks 0;
BA_ "GenSigFuncType" SG_ 315 ReSideRdrRiDetn36RdrDetnChks 15;
BA_ "GenSigDataID" SG_ 315 ReSideRdrRiDetn36RdrDetnChks "0xA64";
BA_ "GenSigSendType" SG_ 315 ReSideRdrRiDetn36RdrDetnCntr 0;
BA_ "GenSigFuncType" SG_ 315 ReSideRdrRiDetn36RdrDetnCntr 16;
BA_ "GenSigSendType" SG_ 315 ReSideRdrRiDetn36RdrDetnConf 0;
BA_ "GenSigStartValue" SG_ 315 ReSideRdrRiDetn36RdrDetnElevn 15;
BA_ "GenSigSendType" SG_ 315 ReSideRdrRiDetn36RdrDetnElevn 0;
BA_ "GenSigSendType" SG_ 315 ReSideRdrRiDetn36RdrDetnPwr 0;
BA_ "GenSigStartValue" SG_ 315 ReSideRdrRiDetn36RdrDetnRng 10050;
BA_ "GenSigSendType" SG_ 315 ReSideRdrRiDetn36RdrDetnRng 0;
BA_ "GenSigStartValue" SG_ 315 ReSideRdrRiDetn36RdrDetnRngV 4000;
BA_ "GenSigSendType" SG_ 315 ReSideRdrRiDetn36RdrDetnRngV 0;
BA_ "GenSigStartValue" SG_ 315 ReSideRdrRiDetn36RdrDetnSts 3;
BA_ "GenSigSendType" SG_ 315 ReSideRdrRiDetn36RdrDetnSts 0;
// Frame: SODRSafetyCANFD3Frame07
BA_ "VFrameFormat" BO_ 317 14;
BA_ "GenMsgSendType" BO_ 317 0;
BA_ "GenMsgCycleTime" BO_ 317 50.000;
BA_ "GenSigStartValue" SG_ 317 ReSideRdrRiDetn37RdrDetnAzi 900;
BA_ "GenSigSendType" SG_ 317 ReSideRdrRiDetn37RdrDetnAzi 0;
BA_ "GenSigSendType" SG_ 317 ReSideRdrRiDetn37RdrDetnChks 0;
BA_ "GenSigFuncType" SG_ 317 ReSideRdrRiDetn37RdrDetnChks 15;
BA_ "GenSigDataID" SG_ 317 ReSideRdrRiDetn37RdrDetnChks "0xA65";
BA_ "GenSigSendType" SG_ 317 ReSideRdrRiDetn37RdrDetnCntr 0;
BA_ "GenSigFuncType" SG_ 317 ReSideRdrRiDetn37RdrDetnCntr 16;
BA_ "GenSigSendType" SG_ 317 ReSideRdrRiDetn37RdrDetnConf 0;
BA_ "GenSigStartValue" SG_ 317 ReSideRdrRiDetn37RdrDetnElevn 15;
BA_ "GenSigSendType" SG_ 317 ReSideRdrRiDetn37RdrDetnElevn 0;
BA_ "GenSigSendType" SG_ 317 ReSideRdrRiDetn37RdrDetnPwr 0;
BA_ "GenSigStartValue" SG_ 317 ReSideRdrRiDetn37RdrDetnRng 10050;
BA_ "GenSigSendType" SG_ 317 ReSideRdrRiDetn37RdrDetnRng 0;
BA_ "GenSigStartValue" SG_ 317 ReSideRdrRiDetn37RdrDetnRngV 4000;
BA_ "GenSigSendType" SG_ 317 ReSideRdrRiDetn37RdrDetnRngV 0;
BA_ "GenSigStartValue" SG_ 317 ReSideRdrRiDetn37RdrDetnSts 3;
BA_ "GenSigSendType" SG_ 317 ReSideRdrRiDetn37RdrDetnSts 0;
BA_ "GenSigStartValue" SG_ 317 ReSideRdrRiDetn38RdrDetnAzi 900;
BA_ "GenSigSendType" SG_ 317 ReSideRdrRiDetn38RdrDetnAzi 0;
BA_ "GenSigSendType" SG_ 317 ReSideRdrRiDetn38RdrDetnChks 0;
BA_ "GenSigFuncType" SG_ 317 ReSideRdrRiDetn38RdrDetnChks 15;
BA_ "GenSigDataID" SG_ 317 ReSideRdrRiDetn38RdrDetnChks "0xA66";
BA_ "GenSigSendType" SG_ 317 ReSideRdrRiDetn38RdrDetnCntr 0;
BA_ "GenSigFuncType" SG_ 317 ReSideRdrRiDetn38RdrDetnCntr 16;
BA_ "GenSigSendType" SG_ 317 ReSideRdrRiDetn38RdrDetnConf 0;
BA_ "GenSigStartValue" SG_ 317 ReSideRdrRiDetn38RdrDetnElevn 15;
BA_ "GenSigSendType" SG_ 317 ReSideRdrRiDetn38RdrDetnElevn 0;
BA_ "GenSigSendType" SG_ 317 ReSideRdrRiDetn38RdrDetnPwr 0;
BA_ "GenSigStartValue" SG_ 317 ReSideRdrRiDetn38RdrDetnRng 10050;
BA_ "GenSigSendType" SG_ 317 ReSideRdrRiDetn38RdrDetnRng 0;
BA_ "GenSigStartValue" SG_ 317 ReSideRdrRiDetn38RdrDetnRngV 4000;
BA_ "GenSigSendType" SG_ 317 ReSideRdrRiDetn38RdrDetnRngV 0;
BA_ "GenSigStartValue" SG_ 317 ReSideRdrRiDetn38RdrDetnSts 3;
BA_ "GenSigSendType" SG_ 317 ReSideRdrRiDetn38RdrDetnSts 0;
BA_ "GenSigStartValue" SG_ 317 ReSideRdrRiDetn39RdrDetnAzi 900;
BA_ "GenSigSendType" SG_ 317 ReSideRdrRiDetn39RdrDetnAzi 0;
BA_ "GenSigSendType" SG_ 317 ReSideRdrRiDetn39RdrDetnChks 0;
BA_ "GenSigFuncType" SG_ 317 ReSideRdrRiDetn39RdrDetnChks 15;
BA_ "GenSigDataID" SG_ 317 ReSideRdrRiDetn39RdrDetnChks "0xA67";
BA_ "GenSigSendType" SG_ 317 ReSideRdrRiDetn39RdrDetnCntr 0;
BA_ "GenSigFuncType" SG_ 317 ReSideRdrRiDetn39RdrDetnCntr 16;
BA_ "GenSigSendType" SG_ 317 ReSideRdrRiDetn39RdrDetnConf 0;
BA_ "GenSigStartValue" SG_ 317 ReSideRdrRiDetn39RdrDetnElevn 15;
BA_ "GenSigSendType" SG_ 317 ReSideRdrRiDetn39RdrDetnElevn 0;
BA_ "GenSigSendType" SG_ 317 ReSideRdrRiDetn39RdrDetnPwr 0;
BA_ "GenSigStartValue" SG_ 317 ReSideRdrRiDetn39RdrDetnRng 10050;
BA_ "GenSigSendType" SG_ 317 ReSideRdrRiDetn39RdrDetnRng 0;
BA_ "GenSigStartValue" SG_ 317 ReSideRdrRiDetn39RdrDetnRngV 4000;
BA_ "GenSigSendType" SG_ 317 ReSideRdrRiDetn39RdrDetnRngV 0;
BA_ "GenSigStartValue" SG_ 317 ReSideRdrRiDetn39RdrDetnSts 3;
BA_ "GenSigSendType" SG_ 317 ReSideRdrRiDetn39RdrDetnSts 0;
BA_ "GenSigStartValue" SG_ 317 ReSideRdrRiDetn40RdrDetnAzi 900;
BA_ "GenSigSendType" SG_ 317 ReSideRdrRiDetn40RdrDetnAzi 0;
BA_ "GenSigSendType" SG_ 317 ReSideRdrRiDetn40RdrDetnChks 0;
BA_ "GenSigFuncType" SG_ 317 ReSideRdrRiDetn40RdrDetnChks 15;
BA_ "GenSigDataID" SG_ 317 ReSideRdrRiDetn40RdrDetnChks "0xA68";
BA_ "GenSigSendType" SG_ 317 ReSideRdrRiDetn40RdrDetnCntr 0;
BA_ "GenSigFuncType" SG_ 317 ReSideRdrRiDetn40RdrDetnCntr 16;
BA_ "GenSigSendType" SG_ 317 ReSideRdrRiDetn40RdrDetnConf 0;
BA_ "GenSigStartValue" SG_ 317 ReSideRdrRiDetn40RdrDetnElevn 15;
BA_ "GenSigSendType" SG_ 317 ReSideRdrRiDetn40RdrDetnElevn 0;
BA_ "GenSigSendType" SG_ 317 ReSideRdrRiDetn40RdrDetnPwr 0;
BA_ "GenSigStartValue" SG_ 317 ReSideRdrRiDetn40RdrDetnRng 10050;
BA_ "GenSigSendType" SG_ 317 ReSideRdrRiDetn40RdrDetnRng 0;
BA_ "GenSigStartValue" SG_ 317 ReSideRdrRiDetn40RdrDetnRngV 4000;
BA_ "GenSigSendType" SG_ 317 ReSideRdrRiDetn40RdrDetnRngV 0;
BA_ "GenSigStartValue" SG_ 317 ReSideRdrRiDetn40RdrDetnSts 3;
BA_ "GenSigSendType" SG_ 317 ReSideRdrRiDetn40RdrDetnSts 0;
BA_ "GenSigStartValue" SG_ 317 ReSideRdrRiDetn41RdrDetnAzi 900;
BA_ "GenSigSendType" SG_ 317 ReSideRdrRiDetn41RdrDetnAzi 0;
BA_ "GenSigSendType" SG_ 317 ReSideRdrRiDetn41RdrDetnChks 0;
BA_ "GenSigFuncType" SG_ 317 ReSideRdrRiDetn41RdrDetnChks 15;
BA_ "GenSigDataID" SG_ 317 ReSideRdrRiDetn41RdrDetnChks "0xA69";
BA_ "GenSigSendType" SG_ 317 ReSideRdrRiDetn41RdrDetnCntr 0;
BA_ "GenSigFuncType" SG_ 317 ReSideRdrRiDetn41RdrDetnCntr 16;
BA_ "GenSigSendType" SG_ 317 ReSideRdrRiDetn41RdrDetnConf 0;
BA_ "GenSigStartValue" SG_ 317 ReSideRdrRiDetn41RdrDetnElevn 15;
BA_ "GenSigSendType" SG_ 317 ReSideRdrRiDetn41RdrDetnElevn 0;
BA_ "GenSigSendType" SG_ 317 ReSideRdrRiDetn41RdrDetnPwr 0;
BA_ "GenSigStartValue" SG_ 317 ReSideRdrRiDetn41RdrDetnRng 10050;
BA_ "GenSigSendType" SG_ 317 ReSideRdrRiDetn41RdrDetnRng 0;
BA_ "GenSigStartValue" SG_ 317 ReSideRdrRiDetn41RdrDetnRngV 4000;
BA_ "GenSigSendType" SG_ 317 ReSideRdrRiDetn41RdrDetnRngV 0;
BA_ "GenSigStartValue" SG_ 317 ReSideRdrRiDetn41RdrDetnSts 3;
BA_ "GenSigSendType" SG_ 317 ReSideRdrRiDetn41RdrDetnSts 0;
BA_ "GenSigStartValue" SG_ 317 ReSideRdrRiDetn42RdrDetnAzi 900;
BA_ "GenSigSendType" SG_ 317 ReSideRdrRiDetn42RdrDetnAzi 0;
BA_ "GenSigSendType" SG_ 317 ReSideRdrRiDetn42RdrDetnChks 0;
BA_ "GenSigFuncType" SG_ 317 ReSideRdrRiDetn42RdrDetnChks 15;
BA_ "GenSigDataID" SG_ 317 ReSideRdrRiDetn42RdrDetnChks "0xA6A";
BA_ "GenSigSendType" SG_ 317 ReSideRdrRiDetn42RdrDetnCntr 0;
BA_ "GenSigFuncType" SG_ 317 ReSideRdrRiDetn42RdrDetnCntr 16;
BA_ "GenSigSendType" SG_ 317 ReSideRdrRiDetn42RdrDetnConf 0;
BA_ "GenSigStartValue" SG_ 317 ReSideRdrRiDetn42RdrDetnElevn 15;
BA_ "GenSigSendType" SG_ 317 ReSideRdrRiDetn42RdrDetnElevn 0;
BA_ "GenSigSendType" SG_ 317 ReSideRdrRiDetn42RdrDetnPwr 0;
BA_ "GenSigStartValue" SG_ 317 ReSideRdrRiDetn42RdrDetnRng 10050;
BA_ "GenSigSendType" SG_ 317 ReSideRdrRiDetn42RdrDetnRng 0;
BA_ "GenSigStartValue" SG_ 317 ReSideRdrRiDetn42RdrDetnRngV 4000;
BA_ "GenSigSendType" SG_ 317 ReSideRdrRiDetn42RdrDetnRngV 0;
BA_ "GenSigStartValue" SG_ 317 ReSideRdrRiDetn42RdrDetnSts 3;
BA_ "GenSigSendType" SG_ 317 ReSideRdrRiDetn42RdrDetnSts 0;
VAL_ 376 ReSideRdrLeObj15RdrObjElevnSts 0 "RdrObjElevnSts_Unknown" 1 "RdrObjElevnSts_OverRidable" 2 "RdrObjElevnSts_Rlv" 3 "RdrObjElevnSts_UnderRidable";
VAL_ 376 ReSideRdrLeObj15RdrObjIsInFreeSpace 0 "YesNo2_No" 1 "YesNo2_Yes";
VAL_ 376 ReSideRdrLeObj15RdrObjMtnPat 0 "RdrObjMtnPat_Ukwn" 1 "RdrObjMtnPat_Staty" 2 "RdrObjMtnPat_StatyFromMovg" 3 "RdrObjMtnPat_Movg" 4 "RdrObjMtnPat_Receding" 5 "RdrObjMtnPat_Oncoming" 6 "RdrObjMtnPat_CrossingFromLe" 7 "RdrObjMtnPat_CrossingFromRi";
VAL_ 376 ReSideRdrLeObj15RdrObjTrackSts 0 "RdrObjTrackSts_Invld" 1 "RdrObjTrackSts_Updated" 2 "RdrObjTrackSts_New" 3 "RdrObjTrackSts_Coasted";
VAL_ 376 ReSideRdrLeObj15RdrObjTyp 0 "RdrObjTyp_Ukwn" 1 "RdrObjTyp_Car" 2 "RdrObjTyp_MotorCycle" 3 "RdrObjTyp_Truck" 4 "RdrObjTyp_Ped" 5 "RdrObjTyp_ObstdVert1" 6 "RdrObjTyp_ObstdVert2" 7 "RdrObjTyp_Anim" 8 "RdrObjTyp_ObjGen" 9 "RdrObjTyp_Bicycle" 10 "RdrObjTyp_VehofUkwnClass" 11 "RdrObjTyp_Reserved";
VAL_ 302 ReSideRdrRiStsForDim 0 "RsdsMstSt_Cfg" 1 "RsdsMstSt_StrtUp" 2 "RsdsMstSt_Runng" 3 "RsdsMstSt_Blkd" 4 "RsdsMstSt_Faulty" 5 "RsdsMstSt_Shutdown" 6 "RsdsMstSt_Hot" 7 "RsdsMstSt_Cal";
VAL_ 302 ReSideRdrRiStsRdrStsBlkd0bin 0 "YesNo2_No" 1 "YesNo2_Yes";
VAL_ 302 ReSideRdrRiStsRdrStsEna 0 "YesNo2_No" 1 "YesNo2_Yes";
VAL_ 302 ReSideRdrRiStsRdrStsFaulty 0 "YesNo2_No" 1 "YesNo2_Yes";
VAL_ 302 ReSideRdrRiStsRdrStsMisAlign 0 "MisAlign_Unknown" 1 "MisAlign_RadarIsFullyCalibrated" 2 "MisAlign_RadarMisalignmentDetected" 3 "MisAlign_RadarCalibrationInProgress" 4 "MisAlign_RadarIsCompletelyMisalignedAndNotPossibleToCalibrateIt" 5 "MisAlign_Reserved1" 6 "MisAlign_Reserved2" 7 "MisAlign_Reserved3";
VAL_ 302 ReSideRdrRiStsRdrStsMissCom 0 "YesNo2_No" 1 "YesNo2_Yes";
VAL_ 302 ReSideRdrRiStsRdrStsSftyFlt 0 "SftyFlt_Undefined" 1 "SftyFlt_NoSafetyFault" 2 "SftyFlt_SafetyFault" 3 "SftyFlt_Reserved";
VAL_ 302 ReSideRdrRiStsRdrStsTiStampStsGlbTiBas 0 "YesNo2_No" 1 "YesNo2_Yes";
VAL_ 302 ReSideRdrRiStsRdrStsTiStampStsSyncToGatewy 0 "YesNo2_No" 1 "YesNo2_Yes";
VAL_ 302 ReSideRdrRiStsRdrStsTiStampStsTiLeap 0 "YesNo2_No" 1 "YesNo2_Yes";
VAL_ 302 ReSideRdrRiStsRdrStsTiStampStsTiOut 0 "YesNo2_No" 1 "YesNo2_Yes";
VAL_ 305 ReSideRdrRiDetn1RdrDetnSts 0 "RdrDetnSts_Ukwn" 1 "RdrDetnSts_Movg" 2 "RdrDetnSts_Staty" 3 "RdrDetnSts_Invalid";
VAL_ 305 ReSideRdrRiDetn2RdrDetnSts 0 "RdrDetnSts_Ukwn" 1 "RdrDetnSts_Movg" 2 "RdrDetnSts_Staty" 3 "RdrDetnSts_Invalid";
VAL_ 305 ReSideRdrRiDetn3RdrDetnSts 0 "RdrDetnSts_Ukwn" 1 "RdrDetnSts_Movg" 2 "RdrDetnSts_Staty" 3 "RdrDetnSts_Invalid";
VAL_ 305 ReSideRdrRiDetn4RdrDetnSts 0 "RdrDetnSts_Ukwn" 1 "RdrDetnSts_Movg" 2 "RdrDetnSts_Staty" 3 "RdrDetnSts_Invalid";
VAL_ 305 ReSideRdrRiDetn5RdrDetnSts 0 "RdrDetnSts_Ukwn" 1 "RdrDetnSts_Movg" 2 "RdrDetnSts_Staty" 3 "RdrDetnSts_Invalid";
VAL_ 305 ReSideRdrRiDetn6RdrDetnSts 0 "RdrDetnSts_Ukwn" 1 "RdrDetnSts_Movg" 2 "RdrDetnSts_Staty" 3 "RdrDetnSts_Invalid";
VAL_ 307 ReSideRdrRiDetn10RdrDetnSts 0 "RdrDetnSts_Ukwn" 1 "RdrDetnSts_Movg" 2 "RdrDetnSts_Staty" 3 "RdrDetnSts_Invalid";
VAL_ 307 ReSideRdrRiDetn11RdrDetnSts 0 "RdrDetnSts_Ukwn" 1 "RdrDetnSts_Movg" 2 "RdrDetnSts_Staty" 3 "RdrDetnSts_Invalid";
VAL_ 307 ReSideRdrRiDetn12RdrDetnSts 0 "RdrDetnSts_Ukwn" 1 "RdrDetnSts_Movg" 2 "RdrDetnSts_Staty" 3 "RdrDetnSts_Invalid";
VAL_ 307 ReSideRdrRiDetn7RdrDetnSts 0 "RdrDetnSts_Ukwn" 1 "RdrDetnSts_Movg" 2 "RdrDetnSts_Staty" 3 "RdrDetnSts_Invalid";
VAL_ 307 ReSideRdrRiDetn8RdrDetnSts 0 "RdrDetnSts_Ukwn" 1 "RdrDetnSts_Movg" 2 "RdrDetnSts_Staty" 3 "RdrDetnSts_Invalid";
VAL_ 307 ReSideRdrRiDetn9RdrDetnSts 0 "RdrDetnSts_Ukwn" 1 "RdrDetnSts_Movg" 2 "RdrDetnSts_Staty" 3 "RdrDetnSts_Invalid";
VAL_ 309 ReSideRdrRiDetn13RdrDetnSts 0 "RdrDetnSts_Ukwn" 1 "RdrDetnSts_Movg" 2 "RdrDetnSts_Staty" 3 "RdrDetnSts_Invalid";
VAL_ 309 ReSideRdrRiDetn14RdrDetnSts 0 "RdrDetnSts_Ukwn" 1 "RdrDetnSts_Movg" 2 "RdrDetnSts_Staty" 3 "RdrDetnSts_Invalid";
VAL_ 309 ReSideRdrRiDetn15RdrDetnSts 0 "RdrDetnSts_Ukwn" 1 "RdrDetnSts_Movg" 2 "RdrDetnSts_Staty" 3 "RdrDetnSts_Invalid";
VAL_ 309 ReSideRdrRiDetn16RdrDetnSts 0 "RdrDetnSts_Ukwn" 1 "RdrDetnSts_Movg" 2 "RdrDetnSts_Staty" 3 "RdrDetnSts_Invalid";
VAL_ 309 ReSideRdrRiDetn17RdrDetnSts 0 "RdrDetnSts_Ukwn" 1 "RdrDetnSts_Movg" 2 "RdrDetnSts_Staty" 3 "RdrDetnSts_Invalid";
VAL_ 309 ReSideRdrRiDetn18RdrDetnSts 0 "RdrDetnSts_Ukwn" 1 "RdrDetnSts_Movg" 2 "RdrDetnSts_Staty" 3 "RdrDetnSts_Invalid";
VAL_ 311 ReSideRdrRiDetn19RdrDetnSts 0 "RdrDetnSts_Ukwn" 1 "RdrDetnSts_Movg" 2 "RdrDetnSts_Staty" 3 "RdrDetnSts_Invalid";
VAL_ 311 ReSideRdrRiDetn20RdrDetnSts 0 "RdrDetnSts_Ukwn" 1 "RdrDetnSts_Movg" 2 "RdrDetnSts_Staty" 3 "RdrDetnSts_Invalid";
VAL_ 311 ReSideRdrRiDetn21RdrDetnSts 0 "RdrDetnSts_Ukwn" 1 "RdrDetnSts_Movg" 2 "RdrDetnSts_Staty" 3 "RdrDetnSts_Invalid";
VAL_ 311 ReSideRdrRiDetn22RdrDetnSts 0 "RdrDetnSts_Ukwn" 1 "RdrDetnSts_Movg" 2 "RdrDetnSts_Staty" 3 "RdrDetnSts_Invalid";
VAL_ 311 ReSideRdrRiDetn23RdrDetnSts 0 "RdrDetnSts_Ukwn" 1 "RdrDetnSts_Movg" 2 "RdrDetnSts_Staty" 3 "RdrDetnSts_Invalid";
VAL_ 311 ReSideRdrRiDetn24RdrDetnSts 0 "RdrDetnSts_Ukwn" 1 "RdrDetnSts_Movg" 2 "RdrDetnSts_Staty" 3 "RdrDetnSts_Invalid";
VAL_ 313 ReSideRdrRiDetn25RdrDetnSts 0 "RdrDetnSts_Ukwn" 1 "RdrDetnSts_Movg" 2 "RdrDetnSts_Staty" 3 "RdrDetnSts_Invalid";
VAL_ 313 ReSideRdrRiDetn26RdrDetnSts 0 "RdrDetnSts_Ukwn" 1 "RdrDetnSts_Movg" 2 "RdrDetnSts_Staty" 3 "RdrDetnSts_Invalid";
VAL_ 313 ReSideRdrRiDetn27RdrDetnSts 0 "RdrDetnSts_Ukwn" 1 "RdrDetnSts_Movg" 2 "RdrDetnSts_Staty" 3 "RdrDetnSts_Invalid";
VAL_ 313 ReSideRdrRiDetn28RdrDetnSts 0 "RdrDetnSts_Ukwn" 1 "RdrDetnSts_Movg" 2 "RdrDetnSts_Staty" 3 "RdrDetnSts_Invalid";
VAL_ 313 ReSideRdrRiDetn29RdrDetnSts 0 "RdrDetnSts_Ukwn" 1 "RdrDetnSts_Movg" 2 "RdrDetnSts_Staty" 3 "RdrDetnSts_Invalid";
VAL_ 313 ReSideRdrRiDetn30RdrDetnSts 0 "RdrDetnSts_Ukwn" 1 "RdrDetnSts_Movg" 2 "RdrDetnSts_Staty" 3 "RdrDetnSts_Invalid";
VAL_ 315 ReSideRdrRiDetn31RdrDetnSts 0 "RdrDetnSts_Ukwn" 1 "RdrDetnSts_Movg" 2 "RdrDetnSts_Staty" 3 "RdrDetnSts_Invalid";
VAL_ 315 ReSideRdrRiDetn32RdrDetnSts 0 "RdrDetnSts_Ukwn" 1 "RdrDetnSts_Movg" 2 "RdrDetnSts_Staty" 3 "RdrDetnSts_Invalid";
VAL_ 315 ReSideRdrRiDetn33RdrDetnSts 0 "RdrDetnSts_Ukwn" 1 "RdrDetnSts_Movg" 2 "RdrDetnSts_Staty" 3 "RdrDetnSts_Invalid";
VAL_ 315 ReSideRdrRiDetn34RdrDetnSts 0 "RdrDetnSts_Ukwn" 1 "RdrDetnSts_Movg" 2 "RdrDetnSts_Staty" 3 "RdrDetnSts_Invalid";
VAL_ 315 ReSideRdrRiDetn35RdrDetnSts 0 "RdrDetnSts_Ukwn" 1 "RdrDetnSts_Movg" 2 "RdrDetnSts_Staty" 3 "RdrDetnSts_Invalid";
VAL_ 315 ReSideRdrRiDetn36RdrDetnSts 0 "RdrDetnSts_Ukwn" 1 "RdrDetnSts_Movg" 2 "RdrDetnSts_Staty" 3 "RdrDetnSts_Invalid";
VAL_ 317 ReSideRdrRiDetn37RdrDetnSts 0 "RdrDetnSts_Ukwn" 1 "RdrDetnSts_Movg" 2 "RdrDetnSts_Staty" 3 "RdrDetnSts_Invalid";
VAL_ 317 ReSideRdrRiDetn38RdrDetnSts 0 "RdrDetnSts_Ukwn" 1 "RdrDetnSts_Movg" 2 "RdrDetnSts_Staty" 3 "RdrDetnSts_Invalid";
VAL_ 317 ReSideRdrRiDetn39RdrDetnSts 0 "RdrDetnSts_Ukwn" 1 "RdrDetnSts_Movg" 2 "RdrDetnSts_Staty" 3 "RdrDetnSts_Invalid";
VAL_ 317 ReSideRdrRiDetn40RdrDetnSts 0 "RdrDetnSts_Ukwn" 1 "RdrDetnSts_Movg" 2 "RdrDetnSts_Staty" 3 "RdrDetnSts_Invalid";
VAL_ 317 ReSideRdrRiDetn41RdrDetnSts 0 "RdrDetnSts_Ukwn" 1 "RdrDetnSts_Movg" 2 "RdrDetnSts_Staty" 3 "RdrDetnSts_Invalid";
VAL_ 317 ReSideRdrRiDetn42RdrDetnSts 0 "RdrDetnSts_Ukwn" 1 "RdrDetnSts_Movg" 2 "RdrDetnSts_Staty" 3 "RdrDetnSts_Invalid";
SIG_GROUP_ 376 ReSideRdrLeObj15 1 : ReSideRdrLeObj15Heading ReSideRdrLeObj15ObjBoxCenterLat ReSideRdrLeObj15ObjBoxCenterLgt ReSideRdrLeObj15ObservationHist ReSideRdrLeObj15RdrObjAx ReSideRdrLeObj15RdrObjAy ReSideRdrLeObj15RdrObjBoxLength ReSideRdrLeObj15RdrObjBoxWidth ReSideRdrLeObj15RdrObjChks ReSideRdrLeObj15RdrObjCntr ReSideRdrLeObj15RdrObjCoastCnt ReSideRdrLeObj15RdrObjConf ReSideRdrLeObj15RdrObjDx ReSideRdrLeObj15RdrObjDxStdDe ReSideRdrLeObj15RdrObjDy ReSideRdrLeObj15RdrObjDyStdDe ReSideRdrLeObj15RdrObjElevnConf ReSideRdrLeObj15RdrObjElevnSts ReSideRdrLeObj15RdrObjID ReSideRdrLeObj15RdrObjIsInFreeSpace ReSideRdrLeObj15RdrObjMirrProblty ReSideRdrLeObj15RdrObjMtnPat ReSideRdrLeObj15RdrObjNotRealProblty ReSideRdrLeObj15RdrObjStatyCnt ReSideRdrLeObj15RdrObjTiAlv ReSideRdrLeObj15RdrObjTrackSts ReSideRdrLeObj15RdrObjTyp ReSideRdrLeObj15RdrObjTypConfBike ReSideRdrLeObj15RdrObjTypConfPed ReSideRdrLeObj15RdrObjTypConfVeh ReSideRdrLeObj15RdrObjVx ReSideRdrLeObj15RdrObjVxStdDe ReSideRdrLeObj15RdrObjVy ReSideRdrLeObj15RdrObjVyStdDe ReSideRdrLeObj15RelVx ReSideRdrLeObj15RelVy;
SIG_GROUP_ 305 ReSideRdrRiDetn1 1 : ReSideRdrRiDetn1RdrDetnAzi ReSideRdrRiDetn1RdrDetnChks ReSideRdrRiDetn1RdrDetnCntr ReSideRdrRiDetn1RdrDetnConf ReSideRdrRiDetn1RdrDetnElevn ReSideRdrRiDetn1RdrDetnPwr ReSideRdrRiDetn1RdrDetnRng ReSideRdrRiDetn1RdrDetnRngV ReSideRdrRiDetn1RdrDetnSts;
SIG_GROUP_ 307 ReSideRdrRiDetn10 1 : ReSideRdrRiDetn10RdrDetnAzi ReSideRdrRiDetn10RdrDetnChks ReSideRdrRiDetn10RdrDetnCntr ReSideRdrRiDetn10RdrDetnConf ReSideRdrRiDetn10RdrDetnElevn ReSideRdrRiDetn10RdrDetnPwr ReSideRdrRiDetn10RdrDetnRng ReSideRdrRiDetn10RdrDetnRngV ReSideRdrRiDetn10RdrDetnSts;
SIG_GROUP_ 307 ReSideRdrRiDetn11 1 : ReSideRdrRiDetn11RdrDetnAzi ReSideRdrRiDetn11RdrDetnChks ReSideRdrRiDetn11RdrDetnCntr ReSideRdrRiDetn11RdrDetnConf ReSideRdrRiDetn11RdrDetnElevn ReSideRdrRiDetn11RdrDetnPwr ReSideRdrRiDetn11RdrDetnRng ReSideRdrRiDetn11RdrDetnRngV ReSideRdrRiDetn11RdrDetnSts;
SIG_GROUP_ 307 ReSideRdrRiDetn12 1 : ReSideRdrRiDetn12RdrDetnAzi ReSideRdrRiDetn12RdrDetnChks ReSideRdrRiDetn12RdrDetnCntr ReSideRdrRiDetn12RdrDetnConf ReSideRdrRiDetn12RdrDetnElevn ReSideRdrRiDetn12RdrDetnPwr ReSideRdrRiDetn12RdrDetnRng ReSideRdrRiDetn12RdrDetnRngV ReSideRdrRiDetn12RdrDetnSts;
SIG_GROUP_ 309 ReSideRdrRiDetn13 1 : ReSideRdrRiDetn13RdrDetnAzi ReSideRdrRiDetn13RdrDetnChks ReSideRdrRiDetn13RdrDetnCntr ReSideRdrRiDetn13RdrDetnConf ReSideRdrRiDetn13RdrDetnElevn ReSideRdrRiDetn13RdrDetnPwr ReSideRdrRiDetn13RdrDetnRng ReSideRdrRiDetn13RdrDetnRngV ReSideRdrRiDetn13RdrDetnSts;
SIG_GROUP_ 309 ReSideRdrRiDetn14 1 : ReSideRdrRiDetn14RdrDetnAzi ReSideRdrRiDetn14RdrDetnChks ReSideRdrRiDetn14RdrDetnCntr ReSideRdrRiDetn14RdrDetnConf ReSideRdrRiDetn14RdrDetnElevn ReSideRdrRiDetn14RdrDetnPwr ReSideRdrRiDetn14RdrDetnRng ReSideRdrRiDetn14RdrDetnRngV ReSideRdrRiDetn14RdrDetnSts;
SIG_GROUP_ 309 ReSideRdrRiDetn15 1 : ReSideRdrRiDetn15RdrDetnAzi ReSideRdrRiDetn15RdrDetnChks ReSideRdrRiDetn15RdrDetnCntr ReSideRdrRiDetn15RdrDetnConf ReSideRdrRiDetn15RdrDetnElevn ReSideRdrRiDetn15RdrDetnPwr ReSideRdrRiDetn15RdrDetnRng ReSideRdrRiDetn15RdrDetnRngV ReSideRdrRiDetn15RdrDetnSts;
SIG_GROUP_ 309 ReSideRdrRiDetn16 1 : ReSideRdrRiDetn16RdrDetnAzi ReSideRdrRiDetn16RdrDetnChks ReSideRdrRiDetn16RdrDetnCntr ReSideRdrRiDetn16RdrDetnConf ReSideRdrRiDetn16RdrDetnElevn ReSideRdrRiDetn16RdrDetnPwr ReSideRdrRiDetn16RdrDetnRng ReSideRdrRiDetn16RdrDetnRngV ReSideRdrRiDetn16RdrDetnSts;
SIG_GROUP_ 309 ReSideRdrRiDetn17 1 : ReSideRdrRiDetn17RdrDetnAzi ReSideRdrRiDetn17RdrDetnChks ReSideRdrRiDetn17RdrDetnCntr ReSideRdrRiDetn17RdrDetnConf ReSideRdrRiDetn17RdrDetnElevn ReSideRdrRiDetn17RdrDetnPwr ReSideRdrRiDetn17RdrDetnRng ReSideRdrRiDetn17RdrDetnRngV ReSideRdrRiDetn17RdrDetnSts;
SIG_GROUP_ 309 ReSideRdrRiDetn18 1 : ReSideRdrRiDetn18RdrDetnAzi ReSideRdrRiDetn18RdrDetnChks ReSideRdrRiDetn18RdrDetnCntr ReSideRdrRiDetn18RdrDetnConf ReSideRdrRiDetn18RdrDetnElevn ReSideRdrRiDetn18RdrDetnPwr ReSideRdrRiDetn18RdrDetnRng ReSideRdrRiDetn18RdrDetnRngV ReSideRdrRiDetn18RdrDetnSts;
SIG_GROUP_ 311 ReSideRdrRiDetn19 1 : ReSideRdrRiDetn19RdrDetnAzi ReSideRdrRiDetn19RdrDetnChks ReSideRdrRiDetn19RdrDetnCntr ReSideRdrRiDetn19RdrDetnConf ReSideRdrRiDetn19RdrDetnElevn ReSideRdrRiDetn19RdrDetnPwr ReSideRdrRiDetn19RdrDetnRng ReSideRdrRiDetn19RdrDetnRngV ReSideRdrRiDetn19RdrDetnSts;
SIG_GROUP_ 305 ReSideRdrRiDetn2 1 : ReSideRdrRiDetn2RdrDetnAzi ReSideRdrRiDetn2RdrDetnChks ReSideRdrRiDetn2RdrDetnCntr ReSideRdrRiDetn2RdrDetnConf ReSideRdrRiDetn2RdrDetnElevn ReSideRdrRiDetn2RdrDetnPwr ReSideRdrRiDetn2RdrDetnRng ReSideRdrRiDetn2RdrDetnRngV ReSideRdrRiDetn2RdrDetnSts;
SIG_GROUP_ 311 ReSideRdrRiDetn20 1 : ReSideRdrRiDetn20RdrDetnAzi ReSideRdrRiDetn20RdrDetnChks ReSideRdrRiDetn20RdrDetnCntr ReSideRdrRiDetn20RdrDetnConf ReSideRdrRiDetn20RdrDetnElevn ReSideRdrRiDetn20RdrDetnPwr ReSideRdrRiDetn20RdrDetnRng ReSideRdrRiDetn20RdrDetnRngV ReSideRdrRiDetn20RdrDetnSts;
SIG_GROUP_ 311 ReSideRdrRiDetn21 1 : ReSideRdrRiDetn21RdrDetnAzi ReSideRdrRiDetn21RdrDetnChks ReSideRdrRiDetn21RdrDetnCntr ReSideRdrRiDetn21RdrDetnConf ReSideRdrRiDetn21RdrDetnElevn ReSideRdrRiDetn21RdrDetnPwr ReSideRdrRiDetn21RdrDetnRng ReSideRdrRiDetn21RdrDetnRngV ReSideRdrRiDetn21RdrDetnSts;
SIG_GROUP_ 311 ReSideRdrRiDetn22 1 : ReSideRdrRiDetn22RdrDetnAzi ReSideRdrRiDetn22RdrDetnChks ReSideRdrRiDetn22RdrDetnCntr ReSideRdrRiDetn22RdrDetnConf ReSideRdrRiDetn22RdrDetnElevn ReSideRdrRiDetn22RdrDetnPwr ReSideRdrRiDetn22RdrDetnRng ReSideRdrRiDetn22RdrDetnRngV ReSideRdrRiDetn22RdrDetnSts;
SIG_GROUP_ 311 ReSideRdrRiDetn23 1 : ReSideRdrRiDetn23RdrDetnAzi ReSideRdrRiDetn23RdrDetnChks ReSideRdrRiDetn23RdrDetnCntr ReSideRdrRiDetn23RdrDetnConf ReSideRdrRiDetn23RdrDetnElevn ReSideRdrRiDetn23RdrDetnPwr ReSideRdrRiDetn23RdrDetnRng ReSideRdrRiDetn23RdrDetnRngV ReSideRdrRiDetn23RdrDetnSts;
SIG_GROUP_ 311 ReSideRdrRiDetn24 1 : ReSideRdrRiDetn24RdrDetnAzi ReSideRdrRiDetn24RdrDetnChks ReSideRdrRiDetn24RdrDetnCntr ReSideRdrRiDetn24RdrDetnConf ReSideRdrRiDetn24RdrDetnElevn ReSideRdrRiDetn24RdrDetnPwr ReSideRdrRiDetn24RdrDetnRng ReSideRdrRiDetn24RdrDetnRngV ReSideRdrRiDetn24RdrDetnSts;
SIG_GROUP_ 313 ReSideRdrRiDetn25 1 : ReSideRdrRiDetn25RdrDetnAzi ReSideRdrRiDetn25RdrDetnChks ReSideRdrRiDetn25RdrDetnCntr ReSideRdrRiDetn25RdrDetnConf ReSideRdrRiDetn25RdrDetnElevn ReSideRdrRiDetn25RdrDetnPwr ReSideRdrRiDetn25RdrDetnRng ReSideRdrRiDetn25RdrDetnRngV ReSideRdrRiDetn25RdrDetnSts;
SIG_GROUP_ 313 ReSideRdrRiDetn26 1 : ReSideRdrRiDetn26RdrDetnAzi ReSideRdrRiDetn26RdrDetnChks ReSideRdrRiDetn26RdrDetnCntr ReSideRdrRiDetn26RdrDetnConf ReSideRdrRiDetn26RdrDetnElevn ReSideRdrRiDetn26RdrDetnPwr ReSideRdrRiDetn26RdrDetnRng ReSideRdrRiDetn26RdrDetnRngV ReSideRdrRiDetn26RdrDetnSts;
SIG_GROUP_ 313 ReSideRdrRiDetn27 1 : ReSideRdrRiDetn27RdrDetnAzi ReSideRdrRiDetn27RdrDetnChks ReSideRdrRiDetn27RdrDetnCntr ReSideRdrRiDetn27RdrDetnConf ReSideRdrRiDetn27RdrDetnElevn ReSideRdrRiDetn27RdrDetnPwr ReSideRdrRiDetn27RdrDetnRng ReSideRdrRiDetn27RdrDetnRngV ReSideRdrRiDetn27RdrDetnSts;
SIG_GROUP_ 313 ReSideRdrRiDetn28 1 : ReSideRdrRiDetn28RdrDetnAzi ReSideRdrRiDetn28RdrDetnChks ReSideRdrRiDetn28RdrDetnCntr ReSideRdrRiDetn28RdrDetnConf ReSideRdrRiDetn28RdrDetnElevn ReSideRdrRiDetn28RdrDetnPwr ReSideRdrRiDetn28RdrDetnRng ReSideRdrRiDetn28RdrDetnRngV ReSideRdrRiDetn28RdrDetnSts;
SIG_GROUP_ 313 ReSideRdrRiDetn29 1 : ReSideRdrRiDetn29RdrDetnAzi ReSideRdrRiDetn29RdrDetnChks ReSideRdrRiDetn29RdrDetnCntr ReSideRdrRiDetn29RdrDetnConf ReSideRdrRiDetn29RdrDetnElevn ReSideRdrRiDetn29RdrDetnPwr ReSideRdrRiDetn29RdrDetnRng ReSideRdrRiDetn29RdrDetnRngV ReSideRdrRiDetn29RdrDetnSts;
SIG_GROUP_ 305 ReSideRdrRiDetn3 1 : ReSideRdrRiDetn3RdrDetnAzi ReSideRdrRiDetn3RdrDetnChks ReSideRdrRiDetn3RdrDetnCntr ReSideRdrRiDetn3RdrDetnConf ReSideRdrRiDetn3RdrDetnElevn ReSideRdrRiDetn3RdrDetnPwr ReSideRdrRiDetn3RdrDetnRng ReSideRdrRiDetn3RdrDetnRngV ReSideRdrRiDetn3RdrDetnSts;
SIG_GROUP_ 313 ReSideRdrRiDetn30 1 : ReSideRdrRiDetn30RdrDetnAzi ReSideRdrRiDetn30RdrDetnChks ReSideRdrRiDetn30RdrDetnCntr ReSideRdrRiDetn30RdrDetnConf ReSideRdrRiDetn30RdrDetnElevn ReSideRdrRiDetn30RdrDetnPwr ReSideRdrRiDetn30RdrDetnRng ReSideRdrRiDetn30RdrDetnRngV ReSideRdrRiDetn30RdrDetnSts;
SIG_GROUP_ 315 ReSideRdrRiDetn31 1 : ReSideRdrRiDetn31RdrDetnAzi ReSideRdrRiDetn31RdrDetnChks ReSideRdrRiDetn31RdrDetnCntr ReSideRdrRiDetn31RdrDetnConf ReSideRdrRiDetn31RdrDetnElevn ReSideRdrRiDetn31RdrDetnPwr ReSideRdrRiDetn31RdrDetnRng ReSideRdrRiDetn31RdrDetnRngV ReSideRdrRiDetn31RdrDetnSts;
SIG_GROUP_ 315 ReSideRdrRiDetn32 1 : ReSideRdrRiDetn32RdrDetnAzi ReSideRdrRiDetn32RdrDetnChks ReSideRdrRiDetn32RdrDetnCntr ReSideRdrRiDetn32RdrDetnConf ReSideRdrRiDetn32RdrDetnElevn ReSideRdrRiDetn32RdrDetnPwr ReSideRdrRiDetn32RdrDetnRng ReSideRdrRiDetn32RdrDetnRngV ReSideRdrRiDetn32RdrDetnSts;
SIG_GROUP_ 315 ReSideRdrRiDetn33 1 : ReSideRdrRiDetn33RdrDetnAzi ReSideRdrRiDetn33RdrDetnChks ReSideRdrRiDetn33RdrDetnCntr ReSideRdrRiDetn33RdrDetnConf ReSideRdrRiDetn33RdrDetnElevn ReSideRdrRiDetn33RdrDetnPwr ReSideRdrRiDetn33RdrDetnRng ReSideRdrRiDetn33RdrDetnRngV ReSideRdrRiDetn33RdrDetnSts;
SIG_GROUP_ 315 ReSideRdrRiDetn34 1 : ReSideRdrRiDetn34RdrDetnAzi ReSideRdrRiDetn34RdrDetnChks ReSideRdrRiDetn34RdrDetnCntr ReSideRdrRiDetn34RdrDetnConf ReSideRdrRiDetn34RdrDetnElevn ReSideRdrRiDetn34RdrDetnPwr ReSideRdrRiDetn34RdrDetnRng ReSideRdrRiDetn34RdrDetnRngV ReSideRdrRiDetn34RdrDetnSts;
SIG_GROUP_ 315 ReSideRdrRiDetn35 1 : ReSideRdrRiDetn35RdrDetnAzi ReSideRdrRiDetn35RdrDetnChks ReSideRdrRiDetn35RdrDetnCntr ReSideRdrRiDetn35RdrDetnConf ReSideRdrRiDetn35RdrDetnElevn ReSideRdrRiDetn35RdrDetnPwr ReSideRdrRiDetn35RdrDetnRng ReSideRdrRiDetn35RdrDetnRngV ReSideRdrRiDetn35RdrDetnSts;
SIG_GROUP_ 315 ReSideRdrRiDetn36 1 : ReSideRdrRiDetn36RdrDetnAzi ReSideRdrRiDetn36RdrDetnChks ReSideRdrRiDetn36RdrDetnCntr ReSideRdrRiDetn36RdrDetnConf ReSideRdrRiDetn36RdrDetnElevn ReSideRdrRiDetn36RdrDetnPwr ReSideRdrRiDetn36RdrDetnRng ReSideRdrRiDetn36RdrDetnRngV ReSideRdrRiDetn36RdrDetnSts;
SIG_GROUP_ 317 ReSideRdrRiDetn37 1 : ReSideRdrRiDetn37RdrDetnAzi ReSideRdrRiDetn37RdrDetnChks ReSideRdrRiDetn37RdrDetnCntr ReSideRdrRiDetn37RdrDetnConf ReSideRdrRiDetn37RdrDetnElevn ReSideRdrRiDetn37RdrDetnPwr ReSideRdrRiDetn37RdrDetnRng ReSideRdrRiDetn37RdrDetnRngV ReSideRdrRiDetn37RdrDetnSts;
SIG_GROUP_ 317 ReSideRdrRiDetn38 1 : ReSideRdrRiDetn38RdrDetnAzi ReSideRdrRiDetn38RdrDetnChks ReSideRdrRiDetn38RdrDetnCntr ReSideRdrRiDetn38RdrDetnConf ReSideRdrRiDetn38RdrDetnElevn ReSideRdrRiDetn38RdrDetnPwr ReSideRdrRiDetn38RdrDetnRng ReSideRdrRiDetn38RdrDetnRngV ReSideRdrRiDetn38RdrDetnSts;
SIG_GROUP_ 317 ReSideRdrRiDetn39 1 : ReSideRdrRiDetn39RdrDetnAzi ReSideRdrRiDetn39RdrDetnChks ReSideRdrRiDetn39RdrDetnCntr ReSideRdrRiDetn39RdrDetnConf ReSideRdrRiDetn39RdrDetnElevn ReSideRdrRiDetn39RdrDetnPwr ReSideRdrRiDetn39RdrDetnRng ReSideRdrRiDetn39RdrDetnRngV ReSideRdrRiDetn39RdrDetnSts;
SIG_GROUP_ 305 ReSideRdrRiDetn4 1 : ReSideRdrRiDetn4RdrDetnAzi ReSideRdrRiDetn4RdrDetnChks ReSideRdrRiDetn4RdrDetnCntr ReSideRdrRiDetn4RdrDetnConf ReSideRdrRiDetn4RdrDetnElevn ReSideRdrRiDetn4RdrDetnPwr ReSideRdrRiDetn4RdrDetnRng ReSideRdrRiDetn4RdrDetnRngV ReSideRdrRiDetn4RdrDetnSts;
SIG_GROUP_ 317 ReSideRdrRiDetn40 1 : ReSideRdrRiDetn40RdrDetnAzi ReSideRdrRiDetn40RdrDetnChks ReSideRdrRiDetn40RdrDetnCntr ReSideRdrRiDetn40RdrDetnConf ReSideRdrRiDetn40RdrDetnElevn ReSideRdrRiDetn40RdrDetnPwr ReSideRdrRiDetn40RdrDetnRng ReSideRdrRiDetn40RdrDetnRngV ReSideRdrRiDetn40RdrDetnSts;
SIG_GROUP_ 317 ReSideRdrRiDetn41 1 : ReSideRdrRiDetn41RdrDetnAzi ReSideRdrRiDetn41RdrDetnChks ReSideRdrRiDetn41RdrDetnCntr ReSideRdrRiDetn41RdrDetnConf ReSideRdrRiDetn41RdrDetnElevn ReSideRdrRiDetn41RdrDetnPwr ReSideRdrRiDetn41RdrDetnRng ReSideRdrRiDetn41RdrDetnRngV ReSideRdrRiDetn41RdrDetnSts;
SIG_GROUP_ 317 ReSideRdrRiDetn42 1 : ReSideRdrRiDetn42RdrDetnAzi ReSideRdrRiDetn42RdrDetnChks ReSideRdrRiDetn42RdrDetnCntr ReSideRdrRiDetn42RdrDetnConf ReSideRdrRiDetn42RdrDetnElevn ReSideRdrRiDetn42RdrDetnPwr ReSideRdrRiDetn42RdrDetnRng ReSideRdrRiDetn42RdrDetnRngV ReSideRdrRiDetn42RdrDetnSts;
SIG_GROUP_ 305 ReSideRdrRiDetn5 1 : ReSideRdrRiDetn5RdrDetnAzi ReSideRdrRiDetn5RdrDetnChks ReSideRdrRiDetn5RdrDetnCntr ReSideRdrRiDetn5RdrDetnConf ReSideRdrRiDetn5RdrDetnElevn ReSideRdrRiDetn5RdrDetnPwr ReSideRdrRiDetn5RdrDetnRng ReSideRdrRiDetn5RdrDetnRngV ReSideRdrRiDetn5RdrDetnSts;
SIG_GROUP_ 305 ReSideRdrRiDetn6 1 : ReSideRdrRiDetn6RdrDetnAzi ReSideRdrRiDetn6RdrDetnChks ReSideRdrRiDetn6RdrDetnCntr ReSideRdrRiDetn6RdrDetnConf ReSideRdrRiDetn6RdrDetnElevn ReSideRdrRiDetn6RdrDetnPwr ReSideRdrRiDetn6RdrDetnRng ReSideRdrRiDetn6RdrDetnRngV ReSideRdrRiDetn6RdrDetnSts;
SIG_GROUP_ 307 ReSideRdrRiDetn7 1 : ReSideRdrRiDetn7RdrDetnAzi ReSideRdrRiDetn7RdrDetnChks ReSideRdrRiDetn7RdrDetnCntr ReSideRdrRiDetn7RdrDetnConf ReSideRdrRiDetn7RdrDetnElevn ReSideRdrRiDetn7RdrDetnPwr ReSideRdrRiDetn7RdrDetnRng ReSideRdrRiDetn7RdrDetnRngV ReSideRdrRiDetn7RdrDetnSts;
SIG_GROUP_ 307 ReSideRdrRiDetn8 1 : ReSideRdrRiDetn8RdrDetnAzi ReSideRdrRiDetn8RdrDetnChks ReSideRdrRiDetn8RdrDetnCntr ReSideRdrRiDetn8RdrDetnConf ReSideRdrRiDetn8RdrDetnElevn ReSideRdrRiDetn8RdrDetnPwr ReSideRdrRiDetn8RdrDetnRng ReSideRdrRiDetn8RdrDetnRngV ReSideRdrRiDetn8RdrDetnSts;
SIG_GROUP_ 307 ReSideRdrRiDetn9 1 : ReSideRdrRiDetn9RdrDetnAzi ReSideRdrRiDetn9RdrDetnChks ReSideRdrRiDetn9RdrDetnCntr ReSideRdrRiDetn9RdrDetnConf ReSideRdrRiDetn9RdrDetnElevn ReSideRdrRiDetn9RdrDetnPwr ReSideRdrRiDetn9RdrDetnRng ReSideRdrRiDetn9RdrDetnRngV ReSideRdrRiDetn9RdrDetnSts;
SIG_GROUP_ 302 ReSideRdrRiSts 1 : ReSideRdrRiStsRdrNrDetn ReSideRdrRiStsRdrNrObj ReSideRdrRiStsRdrStsBlkd0bin ReSideRdrRiStsRdrStsBlkdConf ReSideRdrRiStsRdrStsChks ReSideRdrRiStsRdrStsCntr ReSideRdrRiStsRdrStsDstbc ReSideRdrRiStsRdrStsEna ReSideRdrRiStsRdrStsFaulty ReSideRdrRiStsRdrStsIfVersMajor ReSideRdrRiStsRdrStsIfVersMinor ReSideRdrRiStsRdrStsLatency ReSideRdrRiStsRdrStsMisAlign ReSideRdrRiStsRdrStsMissCom ReSideRdrRiStsRdrStsSftyFlt ReSideRdrRiStsRdrStsTiStamp ReSideRdrRiStsRdrStsTiStampStsGlbTiBas ReSideRdrRiStsRdrStsTiStampStsSyncToGatewy ReSideRdrRiStsRdrStsTiStampStsTiLeap ReSideRdrRiStsRdrStsTiStampStsTiOut ReSideRdrRiStsRdrStsWhlSpdCmpFac;
