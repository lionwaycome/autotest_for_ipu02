// *************************************************************************** *
// *                                                                           *
// *                      Mentor Graphics Corporation                          *
// *                          All rights reserved                              *
// *                                                                           *
// *************************************************************************** *
// *                                                                           *
// * Description:         CANDB File                                           *
// * Generated at:        2020-04-14 13:14:03                                  *
// * System:              SDB20010                                             *
// * Variant:             EX11_AVP                                             *
// * Network:             SafetyCANFD3                                         *
// *                                                                           *
// *************************************************************************** *
// *                                                                           *
// *             THIS CONFIGURATION MIGHT CONTAIN SOME ERRORS                  *
// *              IF THE INPUT MODEL WAS NOT PROPERLY FORMED!                  *
// *                    Do Not Use this File directly!                         *
// *                                                                           *
// *************************************************************************** *
VERSION "SafetyCANFD3"

NS_ :

BS_:

BU_:  ASDM ETC PAS SODL SODR

BO_ 33 ASDMCanFD3TimeSynchFr: 8 ASDM

BO_ 288 ASDMSafetyCANFD3Frame1: 64 ASDM
 SG_ ADataRawSafe_UB : 56|1@0+ (1,0) [0|1] "" SODL,SODR
 SG_ ADataRawSafeALat : 23|15@0- (0.0085,0.0) [-138.99200000000002|139.00050000000002] "m/s^2" SODL,SODR
 SG_ ADataRawSafeALat1Qf : 11|2@0+ (1,0) [0|3] "" SODL,SODR
 SG_ ADataRawSafeALgt : 38|15@0- (0.0085,0.0) [-138.99200000000002|139.00050000000002] "m/s^2" SODL,SODR
 SG_ ADataRawSafeALgt1Qf : 9|2@0+ (1,0) [0|3] "" SODL,SODR
 SG_ ADataRawSafeAVert : 55|15@0- (0.0085,0.0) [-138.99200000000002|139.00050000000002] "m/s^2" SODL,SODR
 SG_ ADataRawSafeAVertQf : 24|2@0+ (1,0) [0|3] "" SODL,SODR
 SG_ ADataRawSafeChks : 7|8@0+ (1.0,0.0) [0.0|255.0] "Unitless" SODL,SODR
 SG_ ADataRawSafeCntr : 15|4@0+ (1.0,0.0) [0.0|15.0] "Unitless" SODL,SODR
 SG_ ALgtStdFromWhlSpd_UB : 318|1@0+ (1,0) [0|1] "" SODL,SODR
 SG_ ALgtStdFromWhlSpdALgtStdFromWhlSpd : 335|16@0- (0.0009765625,0.0) [-18.0|18.0] "m/s^2" SODL,SODR
 SG_ ALgtStdFromWhlSpdChks : 327|8@0+ (1.0,0.0) [0.0|255.0] "Unitless" SODL,SODR
 SG_ ALgtStdFromWhlSpdCntr : 315|4@0+ (1.0,0.0) [0.0|15.0] "Unitless" SODL,SODR
 SG_ ALgtStdFromWhlSpdQf : 317|2@0+ (1,0) [0|3] "" SODL,SODR
 SG_ AmbTRaw_UB : 106|1@0+ (1,0) [0|1] "" SODL,SODR
 SG_ AmbTRawAmbTVal : 234|11@0+ (0.1,-70.0) [-70.0|134.70000000000002] "degC" SODL,SODR
 SG_ AmbTRawQly : 236|2@0+ (1,0) [0|3] "" SODL,SODR
 SG_ AsyDataWithCmpSafe_UB : 168|1@0+ (1,0) [0|1] "" SODL,SODR
 SG_ AsyDataWithCmpSafeALat1Qf : 153|2@0+ (1,0) [0|3] "" SODL,SODR
 SG_ AsyDataWithCmpSafeALatWithCmp : 167|15@0- (0.0085,0.0) [-138.99200000000002|139.00050000000002] "m/s^2" SODL,SODR
 SG_ AsyDataWithCmpSafeALgt1Qf : 155|2@0+ (1,0) [0|3] "" SODL,SODR
 SG_ AsyDataWithCmpSafeChks : 135|8@0+ (1.0,0.0) [0.0|255.0] "Unitless" SODL,SODR
 SG_ AsyDataWithCmpSafeCntr : 159|4@0+ (1.0,0.0) [0.0|15.0] "Unitless" SODL,SODR
 SG_ AsyDataWithCmpSafeGrdtOfALgt : 143|14@0- (0.00390625,0.0) [-30.0|30.0] "m/s^3" SODL,SODR
 SG_ AsyDataWithCmpSafeYawRateQf : 145|2@0+ (1,0) [0|3] "" SODL,SODR
 SG_ AsyDataWithCmpSafeYawRateWithCmp : 119|16@0- (0.000244140625,0.0) [-6.0|6.0] "rad/s" SODL,SODR
 SG_ BkpOfDstTrvld : 416|21@0+ (1.0,0.0) [0.0|2000000.0] "km" SODL,SODR
 SG_ BkpOfDstTrvld_UB : 319|1@0+ (1,0) [0|1] "" SODL,SODR
 SG_ CarTiGlb : 391|32@0+ (0.1,0.0) [0.0|429496729.5] "s" SODL,SODR
 SG_ CarTiGlb_UB : 107|1@0+ (1,0) [0|1] "" SODL,SODR
 SG_ DrvModReq : 227|4@0+ (1,0) [0|15] "" SODL,SODR
 SG_ DrvModReq_UB : 105|1@0+ (1,0) [0|1] "" SODL,SODR
 SG_ PinionSteerAgGroup_UB : 305|1@0+ (1,0) [0|1] "" SODL,SODR
 SG_ PinionSteerAgGroupChks : 255|8@0+ (1.0,0.0) [0.0|255.0] "Unitless" SODL,SODR
 SG_ PinionSteerAgGroupCntr : 311|4@0+ (1.0,0.0) [0.0|15.0] "Unitless" SODL,SODR
 SG_ PinionSteerAgGroupPinionSteerAg1 : 294|15@0- (0.0009765625,0.0) [-14.5|14.5] "rad" SODL,SODR
 SG_ PinionSteerAgGroupPinionSteerAg1Qf : 263|2@0+ (1,0) [0|3] "" SODL,SODR
 SG_ PinionSteerAgGroupPinionSteerAgSpd1 : 261|14@0- (0.0078125,0.0) [-50.0|50.0] "rad/s" SODL,SODR
 SG_ PinionSteerAgGroupPinionSteerAgSpd1Qf : 279|2@0+ (1,0) [0|3] "" SODL,SODR
 SG_ PinionSteerAgGroupSteerWhlTq : 277|14@0- (0.00390625,0.0) [-30.0|30.0] "NewtonMeter" SODL,SODR
 SG_ PinionSteerAgGroupSteerWhlTqQf : 307|2@0+ (1,0) [0|3] "" SODL,SODR
 SG_ SteerWhlSnsr_UB : 71|1@0+ (1,0) [0|1] "" SODL,SODR
 SG_ SteerWhlSnsrAg : 70|15@0- (0.0009765625,0.0) [-14.5|14.5] "rad" SODL,SODR
 SG_ SteerWhlSnsrAgSpd : 85|14@0- (0.0078125,0.0) [-50.0|50.0] "rad/s" SODL,SODR
 SG_ SteerWhlSnsrChks : 103|8@0+ (1.0,0.0) [0.0|255.0] "Unitless" SODL,SODR
 SG_ SteerWhlSnsrCntr : 111|4@0+ (1.0,0.0) [0.0|15.0] "Unitless" SODL,SODR
 SG_ SteerWhlSnsrQf : 87|2@0+ (1,0) [0|3] "" SODL,SODR
 SG_ VehBattU_UB : 442|1@0+ (1,0) [0|1] "" SODL,SODR
 SG_ VehBattUSysU : 455|8@0+ (0.1,0.0) [0.0|25.0] "Volt" SODL,SODR
 SG_ VehBattUSysUQf : 441|2@0+ (1,0) [0|3] "" SODL,SODR
 SG_ VehModMngtGlbSafe1_UB : 376|1@0+ (1,0) [0|1] "" SODL,SODR
 SG_ VehModMngtGlbSafe1CarModSts1 : 383|3@0+ (1,0) [0|7] "" SODL,SODR
 SG_ VehModMngtGlbSafe1CarModSubtypWdCarModSubtyp : 380|3@0+ (1.0,0.0) [0.0|7.0] "Unitless" SODL,SODR
 SG_ VehModMngtGlbSafe1Chks : 351|8@0+ (1.0,0.0) [0.0|255.0] "Unitless" SODL,SODR
 SG_ VehModMngtGlbSafe1Cntr : 359|4@0+ (1.0,0.0) [0.0|15.0] "Unitless" SODL,SODR
 SG_ VehModMngtGlbSafe1EgyLvlElecMai : 355|4@0+ (1.0,0.0) [0.0|15.0] "Unitless" SODL,SODR
 SG_ VehModMngtGlbSafe1EgyLvlElecSubtyp : 367|4@0+ (1.0,0.0) [0.0|15.0] "Unitless" SODL,SODR
 SG_ VehModMngtGlbSafe1FltEgyCnsWdSts : 377|1@0+ (1,0) [0|1] "" SODL,SODR
 SG_ VehModMngtGlbSafe1PwrLvlElecMai : 363|4@0+ (1.0,0.0) [0.0|15.0] "Unitless" SODL,SODR
 SG_ VehModMngtGlbSafe1PwrLvlElecSubtyp : 375|4@0+ (1.0,0.0) [0.0|15.0] "Unitless" SODL,SODR
 SG_ VehModMngtGlbSafe1UsgModSts : 371|4@0+ (1,0) [0|15] "" SODL,SODR
 SG_ VehMtnSt_UB : 183|1@0+ (1,0) [0|1] "" SODL,SODR
 SG_ VehMtnStChks : 191|8@0+ (1.0,0.0) [0.0|255.0] "Unitless" SODL,SODR
 SG_ VehMtnStCntr : 182|4@0+ (1.0,0.0) [0.0|15.0] "Unitless" SODL,SODR
 SG_ VehMtnStVehMtnSt : 178|3@0+ (1,0) [0|7] "" SODL,SODR
 SG_ VehSpdLgt_UB : 199|1@0+ (1,0) [0|1] "" SODL,SODR
 SG_ VehSpdLgtA : 198|15@0+ (0.00391,0.0) [0.0|125.0027] "m/s" SODL,SODR
 SG_ VehSpdLgtChks : 215|8@0+ (1.0,0.0) [0.0|255.0] "Unitless" SODL,SODR
 SG_ VehSpdLgtCntr : 223|4@0+ (1.0,0.0) [0.0|15.0] "Unitless" SODL,SODR
 SG_ VehSpdLgtQf : 219|2@0+ (1,0) [0|3] "" SODL,SODR
 SG_ WipgInfo_UB : 461|1@0+ (1,0) [0|1] "" SODL,SODR
 SG_ WipgInfoWipgSpdInfo : 458|3@0+ (1,0) [0|7] "" SODL,SODR
 SG_ WipgInfoWiprActv : 459|1@0+ (1,0) [0|1] "" SODL,SODR
 SG_ WipgInfoWiprInWipgAr : 460|1@0+ (1,0) [0|1] "" SODL,SODR

BO_ 1007 ASDMSafetyCANFD3Frame2: 64 ASDM
 SG_ ReSideRdrLeVehPrm_UB : 147|1@0+ (1,0) [0|1] "" SODL
 SG_ ReSideRdrLeVehPrmRdrVehPrmChks : 7|8@0+ (1.0,0.0) [0.0|255.0] "Unitless" SODL
 SG_ ReSideRdrLeVehPrmRdrVehPrmCntr : 15|4@0+ (1.0,0.0) [0.0|15.0] "Unitless" SODL
 SG_ ReSideRdrLeVehPrmRdrVehPrmRdrDynCalPrmForAgOffs : 71|8@0+ (0.1,-12.8) [-12.8|12.7] "Deg" SODL
 SG_ ReSideRdrLeVehPrmRdrVehPrmRdrDynCalPrmForAxleDstReToVehFrnt : 109|9@0+ (0.01,1.0) [1.0|6.0] "m" SODL
 SG_ ReSideRdrLeVehPrmRdrVehPrmRdrDynCalPrmForPinoinAgRat : 95|8@0+ (0.05,8.0) [8.0|20.75] "Unitless" SODL
 SG_ ReSideRdrLeVehPrmRdrVehPrmRdrDynCalPrmForRollAgGain : 79|14@0+ (0.0001,0.0) [0.0|1.0] "Unitless" SODL
 SG_ ReSideRdrLeVehPrmRdrVehPrmRdrDynCalPrmForSnsrDir : 81|1@0+ (1,0) [0|1] "" SODL
 SG_ ReSideRdrLeVehPrmRdrVehPrmRdrDynCalPrmForSnsrOrntn : 80|1@0+ (1,0) [0|1] "" SODL
 SG_ ReSideRdrLeVehPrmRdrVehPrmRdrDynCalPrmForSnsrPosnLat : 11|12@0+ (0.001,-2.0) [-2.0|2.0] "m" SODL
 SG_ ReSideRdrLeVehPrmRdrVehPrmRdrDynCalPrmForSnsrPosnLgt : 135|14@0+ (0.001,-5.0) [-5.0|5.0] "m" SODL
 SG_ ReSideRdrLeVehPrmRdrVehPrmRdrDynCalPrmForSnsrPosnVert : 31|11@0+ (0.001,0.0) [0.0|2.0] "m" SODL
 SG_ ReSideRdrLeVehPrmRdrVehPrmRdrDynCalPrmForSnsrRot1 : 36|11@0+ (0.1,-90.0) [-90.0|90.0] "Deg" SODL
 SG_ ReSideRdrLeVehPrmRdrVehPrmRdrDynCalPrmForVehLen : 41|10@0+ (0.01,0.0) [0.0|10.0] "m" SODL
 SG_ ReSideRdrLeVehPrmRdrVehPrmRdrDynCalPrmForVehTyp : 63|8@0+ (1.0,0.0) [0.0|255.0] "Unitless" SODL
 SG_ ReSideRdrLeVehPrmRdrVehPrmRdrDynCalPrmForVehWidth : 116|9@0+ (0.01,0.0) [0.0|5.0] "m" SODL
 SG_ ReSideRdrLeVehPrmRdrVehPrmRdrDynCalPrmForVersMajor : 123|4@0+ (1.0,0.0) [0.0|15.0] "Unitless" SODL
 SG_ ReSideRdrLeVehPrmRdrVehPrmRdrDynCalPrmForVersMinor : 151|4@0+ (1.0,0.0) [0.0|15.0] "Unitless" SODL
 SG_ ReSideRdrLeVehPrmRdrVehPrmRdrDynCalPrmForWhlBas : 103|10@0+ (0.01,0.0) [0.0|10.0] "m" SODL
 SG_ ReSideRdrLeVehPrmRdrVehPrmVld : 137|1@0+ (1,0) [0|1] "" SODL
 SG_ ReSideRdrRiVehPrm_UB : 299|1@0+ (1,0) [0|1] "" SODR
 SG_ ReSideRdrRiVehPrmRdrVehPrmChks : 159|8@0+ (1.0,0.0) [0.0|255.0] "Unitless" SODR
 SG_ ReSideRdrRiVehPrmRdrVehPrmCntr : 167|4@0+ (1.0,0.0) [0.0|15.0] "Unitless" SODR
 SG_ ReSideRdrRiVehPrmRdrVehPrmRdrDynCalPrmForAgOffs : 175|8@0+ (0.1,-12.8) [-12.8|12.7] "Deg" SODR
 SG_ ReSideRdrRiVehPrmRdrVehPrmRdrDynCalPrmForAxleDstReToVehFrnt : 208|9@0+ (0.01,1.0) [1.0|6.0] "m" SODR
 SG_ ReSideRdrRiVehPrmRdrVehPrmRdrDynCalPrmForPinoinAgRat : 183|8@0+ (0.05,8.0) [8.0|20.75] "Unitless" SODR
 SG_ ReSideRdrRiVehPrmRdrVehPrmRdrDynCalPrmForRollAgGain : 231|14@0+ (0.0001,0.0) [0.0|1.0] "Unitless" SODR
 SG_ ReSideRdrRiVehPrmRdrVehPrmRdrDynCalPrmForSnsrDir : 233|1@0+ (1,0) [0|1] "" SODR
 SG_ ReSideRdrRiVehPrmRdrVehPrmRdrDynCalPrmForSnsrOrntn : 232|1@0+ (1,0) [0|1] "" SODR
 SG_ ReSideRdrRiVehPrmRdrVehPrmRdrDynCalPrmForSnsrPosnLat : 271|12@0+ (0.001,-2.0) [-2.0|2.0] "m" SODR
 SG_ ReSideRdrRiVehPrmRdrVehPrmRdrDynCalPrmForSnsrPosnLgt : 247|14@0+ (0.001,-5.0) [-5.0|5.0] "m" SODR
 SG_ ReSideRdrRiVehPrmRdrVehPrmRdrDynCalPrmForSnsrPosnVert : 203|11@0+ (0.001,0.0) [0.0|2.0] "m" SODR
 SG_ ReSideRdrRiVehPrmRdrVehPrmRdrDynCalPrmForSnsrRot1 : 275|11@0+ (0.1,-90.0) [-90.0|90.0] "Deg" SODR
 SG_ ReSideRdrRiVehPrmRdrVehPrmRdrDynCalPrmForVehLen : 197|10@0+ (0.01,0.0) [0.0|10.0] "m" SODR
 SG_ ReSideRdrRiVehPrmRdrVehPrmRdrDynCalPrmForVehTyp : 295|8@0+ (1.0,0.0) [0.0|255.0] "Unitless" SODR
 SG_ ReSideRdrRiVehPrmRdrVehPrmRdrDynCalPrmForVehWidth : 249|9@0+ (0.01,0.0) [0.0|5.0] "m" SODR
 SG_ ReSideRdrRiVehPrmRdrVehPrmRdrDynCalPrmForVersMajor : 163|4@0+ (1.0,0.0) [0.0|15.0] "Unitless" SODR
 SG_ ReSideRdrRiVehPrmRdrVehPrmRdrDynCalPrmForVersMinor : 303|4@0+ (1.0,0.0) [0.0|15.0] "Unitless" SODR
 SG_ ReSideRdrRiVehPrmRdrVehPrmRdrDynCalPrmForWhlBas : 191|10@0+ (0.01,0.0) [0.0|10.0] "m" SODR
 SG_ ReSideRdrRiVehPrmRdrVehPrmVld : 256|1@0+ (1,0) [0|1] "" SODR

BO_ 1281 AsdmSafetyCanFD3NmFr: 8 ASDM
 SG_ PNC16_ASDM : 16|1@0+ (1,0) [0|0] "" SODR
 SG_ PNC17_ASDM : 17|1@0+ (1,0) [0|0] "" SODR
 SG_ PNC18_ASDM : 18|1@0+ (1,0) [0|0] "" SODR
 SG_ PNC19_ASDM : 19|1@0+ (1,0) [0|0] "" SODR
 SG_ PNC20_ASDM : 20|1@0+ (1,0) [0|0] "" SODR
 SG_ PNC21_ASDM : 21|1@0+ (1,0) [0|0] "" SODR
 SG_ PNC22_ASDM : 22|1@0+ (1,0) [0|0] "" SODR
 SG_ PNC23_ASDM : 23|1@0+ (1,0) [0|0] "" SODR
 SG_ PNC24_ASDM : 24|1@0+ (1,0) [0|0] "" SODR
 SG_ PNC25_ASDM : 25|1@0+ (1,0) [0|0] "" SODR
 SG_ PNC26_ASDM : 26|1@0+ (1,0) [0|0] "" SODR
 SG_ PNC27_ASDM : 27|1@0+ (1,0) [0|0] "" SODR
 SG_ PNC28_ASDM : 28|1@0+ (1,0) [0|0] "" SODR
 SG_ PNC29_ASDM : 29|1@0+ (1,0) [0|0] "" SODR
 SG_ PNC30_ASDM : 30|1@0+ (1,0) [0|0] "" SODR
 SG_ PNC31_ASDM : 31|1@0+ (1,0) [0|0] "" SODR
 SG_ PNC32_ASDM : 32|1@0+ (1,0) [0|0] "" SODR
 SG_ PNC33_ASDM : 33|1@0+ (1,0) [0|0] "" SODR
 SG_ PNC34_ASDM : 34|1@0+ (1,0) [0|0] "" SODR
 SG_ PNC35_ASDM : 35|1@0+ (1,0) [0|0] "" SODR
 SG_ PNC36_ASDM : 36|1@0+ (1,0) [0|0] "" SODR
 SG_ PNC37_ASDM : 37|1@0+ (1,0) [0|0] "" SODR
 SG_ PNC38_ASDM : 38|1@0+ (1,0) [0|0] "" SODR
 SG_ PNC39_ASDM : 39|1@0+ (1,0) [0|0] "" SODR
 SG_ NM_PNI_ASDM : 14|1@0+ (1,0) [0|0] "" SODR
 SG_ NM_AW_ASDM : 12|1@0+ (1,0) [0|0] "" SODR
 SG_ NM_CS_ASDM : 11|1@0+ (1,0) [0|0] "" SODR
 SG_ NM_RMR_ASDM : 8|1@0+ (1,0) [0|0] "" SODR
 SG_ NM_NodeID_ASDM : 7|8@0+ (1,0) [0|0] "" SODR

BO_ 2047 AsdmToAllFuncSafetyCanFD3DiagReqFrame1: 8 ASDM
 SG_ AsdmToAllFuncSafetyCanFD3DiagReqNpdu : 7|64@0+ (1,0) [0|0] "" SODL, SODR

BO_ 1872 AsdmToSodlSafetyCanFD3DiagReqFrame1: 64 ASDM
 SG_ AsdmToSodlSafetyCanFD3DiagReqNpdu : 7|512@0+ (1,0) [0|0] "" SODL

BO_ 1873 AsdmToSodrSafetyCanFD3DiagReqFrame1: 64 ASDM
 SG_ AsdmToSodrSafetyCanFD3DiagReqNpdu : 7|512@0+ (1,0) [0|0] "" SODR

BO_ 1409 EtcToSodlXcpFr01: 8 ETC

BO_ 1410 EtcToSodrXcpFr01: 8 ETC

BO_ 297 SODLSafetyCANFD3Frame00: 64 SODL
 SG_ ReSideRdrLeSts_UB : 243|1@0+ (1,0) [0|1] "" ASDM,PAS
 SG_ ReSideRdrLeStsForDim : 127|3@0+ (1,0) [0|7] "" ASDM,PAS
 SG_ ReSideRdrLeStsForDim_UB : 116|1@0+ (1,0) [0|1] "" ASDM,PAS
 SG_ ReSideRdrLeStsRdrNrDetn : 207|8@0+ (1.0,0.0) [0.0|255.0] "Unitless" ASDM,PAS
 SG_ ReSideRdrLeStsRdrNrObj : 215|8@0+ (1.0,0.0) [0.0|255.0] "Unitless" ASDM,PAS
 SG_ ReSideRdrLeStsRdrStsBlkd0bin : 216|1@0+ (1,0) [0|1] "" ASDM,PAS
 SG_ ReSideRdrLeStsRdrStsBlkdConf : 223|7@0+ (1.0,0.0) [0.0|100.0] "%" ASDM,PAS
 SG_ ReSideRdrLeStsRdrStsChks : 135|8@0+ (1.0,0.0) [0.0|255.0] "Unitless" ASDM,PAS
 SG_ ReSideRdrLeStsRdrStsCntr : 143|4@0+ (1.0,0.0) [0.0|15.0] "Unitless" ASDM,PAS
 SG_ ReSideRdrLeStsRdrStsDstbc : 239|7@0+ (1.0,0.0) [0.0|100.0] "%" ASDM,PAS
 SG_ ReSideRdrLeStsRdrStsEna : 232|1@0+ (1,0) [0|1] "" ASDM,PAS
 SG_ ReSideRdrLeStsRdrStsFaulty : 247|1@0+ (1,0) [0|1] "" ASDM,PAS
 SG_ ReSideRdrLeStsRdrStsIfVersMajor : 139|4@0+ (1.0,0.0) [0.0|15.0] "Unitless" ASDM,PAS
 SG_ ReSideRdrLeStsRdrStsIfVersMinor : 151|4@0+ (1.0,0.0) [0.0|15.0] "Unitless" ASDM,PAS
 SG_ ReSideRdrLeStsRdrStsLatency : 191|16@0+ (1.0,0.0) [0.0|65535.0] "Unitless" ASDM,PAS
 SG_ ReSideRdrLeStsRdrStsMisAlign : 147|3@0+ (1,0) [0|7] "" ASDM,PAS
 SG_ ReSideRdrLeStsRdrStsMissCom : 144|1@0+ (1,0) [0|1] "" ASDM,PAS
 SG_ ReSideRdrLeStsRdrStsSftyFlt : 246|2@0+ (1,0) [0|3] "" ASDM,PAS
 SG_ ReSideRdrLeStsRdrStsTiStamp : 159|32@0+ (0.0001,0.0) [0.0|429496.7295] "s" ASDM,PAS
 SG_ ReSideRdrLeStsRdrStsTiStampStsGlbTiBas : 244|1@0+ (1,0) [0|1] "" ASDM,PAS
 SG_ ReSideRdrLeStsRdrStsTiStampStsSyncToGatewy : 224|1@0+ (1,0) [0|1] "" ASDM,PAS
 SG_ ReSideRdrLeStsRdrStsTiStampStsTiLeap : 225|1@0+ (1,0) [0|1] "" ASDM,PAS
 SG_ ReSideRdrLeStsRdrStsTiStampStsTiOut : 226|1@0+ (1,0) [0|1] "" ASDM,PAS
 SG_ ReSideRdrLeStsRdrStsWhlSpdCmpFac : 231|5@0+ (0.005,0.92) [0.92|1.075] "Unitless" ASDM,PAS

BO_ 304 SODLSafetyCANFD3Frame01: 64 SODL
 SG_ ReSideRdrLeDetn1_UB : 74|1@0+ (1,0) [0|1] "" ASDM,PAS
 SG_ ReSideRdrLeDetn1RdrDetnAzi : 31|11@0+ (0.1,-90.0) [-90.0|90.0] "Deg" ASDM,PAS
 SG_ ReSideRdrLeDetn1RdrDetnChks : 7|8@0+ (1.0,0.0) [0.0|255.0] "Unitless" ASDM,PAS
 SG_ ReSideRdrLeDetn1RdrDetnCntr : 15|4@0+ (1.0,0.0) [0.0|15.0] "Unitless" ASDM,PAS
 SG_ ReSideRdrLeDetn1RdrDetnConf : 71|7@0+ (1.0,0.0) [0.0|100.0] "%" ASDM,PAS
 SG_ ReSideRdrLeDetn1RdrDetnElevn : 79|5@0+ (1.0,-15.0) [-15.0|15.0] "Deg" ASDM,PAS
 SG_ ReSideRdrLeDetn1RdrDetnPwr : 8|9@0+ (0.1,0.0) [0.0|51.1] "dB" ASDM,PAS
 SG_ ReSideRdrLeDetn1RdrDetnRng : 55|14@0+ (0.02,-1.0) [-1.0|200.0] "m" ASDM,PAS
 SG_ ReSideRdrLeDetn1RdrDetnRngV : 36|13@0+ (0.02,-80.0) [-80.0|80.0] "m/s" ASDM,PAS
 SG_ ReSideRdrLeDetn1RdrDetnSts : 11|2@0+ (1,0) [0|3] "" ASDM,PAS
 SG_ ReSideRdrLeDetn2_UB : 154|1@0+ (1,0) [0|1] "" ASDM,PAS
 SG_ ReSideRdrLeDetn2RdrDetnAzi : 119|11@0+ (0.1,-90.0) [-90.0|90.0] "Deg" ASDM,PAS
 SG_ ReSideRdrLeDetn2RdrDetnChks : 87|8@0+ (1.0,0.0) [0.0|255.0] "Unitless" ASDM,PAS
 SG_ ReSideRdrLeDetn2RdrDetnCntr : 95|4@0+ (1.0,0.0) [0.0|15.0] "Unitless" ASDM,PAS
 SG_ ReSideRdrLeDetn2RdrDetnConf : 111|7@0+ (1.0,0.0) [0.0|100.0] "%" ASDM,PAS
 SG_ ReSideRdrLeDetn2RdrDetnElevn : 159|5@0+ (1.0,-15.0) [-15.0|15.0] "Deg" ASDM,PAS
 SG_ ReSideRdrLeDetn2RdrDetnPwr : 89|9@0+ (0.1,0.0) [0.0|51.1] "dB" ASDM,PAS
 SG_ ReSideRdrLeDetn2RdrDetnRng : 143|14@0+ (0.02,-1.0) [-1.0|200.0] "m" ASDM,PAS
 SG_ ReSideRdrLeDetn2RdrDetnRngV : 124|13@0+ (0.02,-80.0) [-80.0|80.0] "m/s" ASDM,PAS
 SG_ ReSideRdrLeDetn2RdrDetnSts : 91|2@0+ (1,0) [0|3] "" ASDM,PAS
 SG_ ReSideRdrLeDetn3_UB : 234|1@0+ (1,0) [0|1] "" ASDM,PAS
 SG_ ReSideRdrLeDetn3RdrDetnAzi : 199|11@0+ (0.1,-90.0) [-90.0|90.0] "Deg" ASDM,PAS
 SG_ ReSideRdrLeDetn3RdrDetnChks : 167|8@0+ (1.0,0.0) [0.0|255.0] "Unitless" ASDM,PAS
 SG_ ReSideRdrLeDetn3RdrDetnCntr : 175|4@0+ (1.0,0.0) [0.0|15.0] "Unitless" ASDM,PAS
 SG_ ReSideRdrLeDetn3RdrDetnConf : 191|7@0+ (1.0,0.0) [0.0|100.0] "%" ASDM,PAS
 SG_ ReSideRdrLeDetn3RdrDetnElevn : 239|5@0+ (1.0,-15.0) [-15.0|15.0] "Deg" ASDM,PAS
 SG_ ReSideRdrLeDetn3RdrDetnPwr : 169|9@0+ (0.1,0.0) [0.0|51.1] "dB" ASDM,PAS
 SG_ ReSideRdrLeDetn3RdrDetnRng : 223|14@0+ (0.02,-1.0) [-1.0|200.0] "m" ASDM,PAS
 SG_ ReSideRdrLeDetn3RdrDetnRngV : 204|13@0+ (0.02,-80.0) [-80.0|80.0] "m/s" ASDM,PAS
 SG_ ReSideRdrLeDetn3RdrDetnSts : 171|2@0+ (1,0) [0|3] "" ASDM,PAS
 SG_ ReSideRdrLeDetn4_UB : 314|1@0+ (1,0) [0|1] "" ASDM,PAS
 SG_ ReSideRdrLeDetn4RdrDetnAzi : 287|11@0+ (0.1,-90.0) [-90.0|90.0] "Deg" ASDM,PAS
 SG_ ReSideRdrLeDetn4RdrDetnChks : 247|8@0+ (1.0,0.0) [0.0|255.0] "Unitless" ASDM,PAS
 SG_ ReSideRdrLeDetn4RdrDetnCntr : 255|4@0+ (1.0,0.0) [0.0|15.0] "Unitless" ASDM,PAS
 SG_ ReSideRdrLeDetn4RdrDetnConf : 311|7@0+ (1.0,0.0) [0.0|100.0] "%" ASDM,PAS
 SG_ ReSideRdrLeDetn4RdrDetnElevn : 319|5@0+ (1.0,-15.0) [-15.0|15.0] "Deg" ASDM,PAS
 SG_ ReSideRdrLeDetn4RdrDetnPwr : 249|9@0+ (0.1,0.0) [0.0|51.1] "dB" ASDM,PAS
 SG_ ReSideRdrLeDetn4RdrDetnRng : 271|14@0+ (0.02,-1.0) [-1.0|200.0] "m" ASDM,PAS
 SG_ ReSideRdrLeDetn4RdrDetnRngV : 292|13@0+ (0.02,-80.0) [-80.0|80.0] "m/s" ASDM,PAS
 SG_ ReSideRdrLeDetn4RdrDetnSts : 251|2@0+ (1,0) [0|3] "" ASDM,PAS
 SG_ ReSideRdrLeDetn5_UB : 394|1@0+ (1,0) [0|1] "" ASDM,PAS
 SG_ ReSideRdrLeDetn5RdrDetnAzi : 351|11@0+ (0.1,-90.0) [-90.0|90.0] "Deg" ASDM,PAS
 SG_ ReSideRdrLeDetn5RdrDetnChks : 327|8@0+ (1.0,0.0) [0.0|255.0] "Unitless" ASDM,PAS
 SG_ ReSideRdrLeDetn5RdrDetnCntr : 335|4@0+ (1.0,0.0) [0.0|15.0] "Unitless" ASDM,PAS
 SG_ ReSideRdrLeDetn5RdrDetnConf : 391|7@0+ (1.0,0.0) [0.0|100.0] "%" ASDM,PAS
 SG_ ReSideRdrLeDetn5RdrDetnElevn : 399|5@0+ (1.0,-15.0) [-15.0|15.0] "Deg" ASDM,PAS
 SG_ ReSideRdrLeDetn5RdrDetnPwr : 329|9@0+ (0.1,0.0) [0.0|51.1] "dB" ASDM,PAS
 SG_ ReSideRdrLeDetn5RdrDetnRng : 375|14@0+ (0.02,-1.0) [-1.0|200.0] "m" ASDM,PAS
 SG_ ReSideRdrLeDetn5RdrDetnRngV : 356|13@0+ (0.02,-80.0) [-80.0|80.0] "m/s" ASDM,PAS
 SG_ ReSideRdrLeDetn5RdrDetnSts : 331|2@0+ (1,0) [0|3] "" ASDM,PAS
 SG_ ReSideRdrLeDetn6_UB : 474|1@0+ (1,0) [0|1] "" ASDM,PAS
 SG_ ReSideRdrLeDetn6RdrDetnAzi : 447|11@0+ (0.1,-90.0) [-90.0|90.0] "Deg" ASDM,PAS
 SG_ ReSideRdrLeDetn6RdrDetnChks : 407|8@0+ (1.0,0.0) [0.0|255.0] "Unitless" ASDM,PAS
 SG_ ReSideRdrLeDetn6RdrDetnCntr : 415|4@0+ (1.0,0.0) [0.0|15.0] "Unitless" ASDM,PAS
 SG_ ReSideRdrLeDetn6RdrDetnConf : 471|7@0+ (1.0,0.0) [0.0|100.0] "%" ASDM,PAS
 SG_ ReSideRdrLeDetn6RdrDetnElevn : 479|5@0+ (1.0,-15.0) [-15.0|15.0] "Deg" ASDM,PAS
 SG_ ReSideRdrLeDetn6RdrDetnPwr : 409|9@0+ (0.1,0.0) [0.0|51.1] "dB" ASDM,PAS
 SG_ ReSideRdrLeDetn6RdrDetnRng : 431|14@0+ (0.02,-1.0) [-1.0|200.0] "m" ASDM,PAS
 SG_ ReSideRdrLeDetn6RdrDetnRngV : 452|13@0+ (0.02,-80.0) [-80.0|80.0] "m/s" ASDM,PAS
 SG_ ReSideRdrLeDetn6RdrDetnSts : 411|2@0+ (1,0) [0|3] "" ASDM,PAS

BO_ 306 SODLSafetyCANFD3Frame02: 64 SODL
 SG_ ReSideRdrLeDetn10_UB : 314|1@0+ (1,0) [0|1] "" ASDM,PAS
 SG_ ReSideRdrLeDetn10RdrDetnAzi : 287|11@0+ (0.1,-90.0) [-90.0|90.0] "Deg" ASDM,PAS
 SG_ ReSideRdrLeDetn10RdrDetnChks : 247|8@0+ (1.0,0.0) [0.0|255.0] "Unitless" ASDM,PAS
 SG_ ReSideRdrLeDetn10RdrDetnCntr : 255|4@0+ (1.0,0.0) [0.0|15.0] "Unitless" ASDM,PAS
 SG_ ReSideRdrLeDetn10RdrDetnConf : 311|7@0+ (1.0,0.0) [0.0|100.0] "%" ASDM,PAS
 SG_ ReSideRdrLeDetn10RdrDetnElevn : 319|5@0+ (1.0,-15.0) [-15.0|15.0] "Deg" ASDM,PAS
 SG_ ReSideRdrLeDetn10RdrDetnPwr : 249|9@0+ (0.1,0.0) [0.0|51.1] "dB" ASDM,PAS
 SG_ ReSideRdrLeDetn10RdrDetnRng : 271|14@0+ (0.02,-1.0) [-1.0|200.0] "m" ASDM,PAS
 SG_ ReSideRdrLeDetn10RdrDetnRngV : 292|13@0+ (0.02,-80.0) [-80.0|80.0] "m/s" ASDM,PAS
 SG_ ReSideRdrLeDetn10RdrDetnSts : 251|2@0+ (1,0) [0|3] "" ASDM,PAS
 SG_ ReSideRdrLeDetn11_UB : 394|1@0+ (1,0) [0|1] "" ASDM,PAS
 SG_ ReSideRdrLeDetn11RdrDetnAzi : 351|11@0+ (0.1,-90.0) [-90.0|90.0] "Deg" ASDM,PAS
 SG_ ReSideRdrLeDetn11RdrDetnChks : 327|8@0+ (1.0,0.0) [0.0|255.0] "Unitless" ASDM,PAS
 SG_ ReSideRdrLeDetn11RdrDetnCntr : 335|4@0+ (1.0,0.0) [0.0|15.0] "Unitless" ASDM,PAS
 SG_ ReSideRdrLeDetn11RdrDetnConf : 391|7@0+ (1.0,0.0) [0.0|100.0] "%" ASDM,PAS
 SG_ ReSideRdrLeDetn11RdrDetnElevn : 399|5@0+ (1.0,-15.0) [-15.0|15.0] "Deg" ASDM,PAS
 SG_ ReSideRdrLeDetn11RdrDetnPwr : 329|9@0+ (0.1,0.0) [0.0|51.1] "dB" ASDM,PAS
 SG_ ReSideRdrLeDetn11RdrDetnRng : 375|14@0+ (0.02,-1.0) [-1.0|200.0] "m" ASDM,PAS
 SG_ ReSideRdrLeDetn11RdrDetnRngV : 356|13@0+ (0.02,-80.0) [-80.0|80.0] "m/s" ASDM,PAS
 SG_ ReSideRdrLeDetn11RdrDetnSts : 331|2@0+ (1,0) [0|3] "" ASDM,PAS
 SG_ ReSideRdrLeDetn12_UB : 474|1@0+ (1,0) [0|1] "" ASDM,PAS
 SG_ ReSideRdrLeDetn12RdrDetnAzi : 447|11@0+ (0.1,-90.0) [-90.0|90.0] "Deg" ASDM,PAS
 SG_ ReSideRdrLeDetn12RdrDetnChks : 407|8@0+ (1.0,0.0) [0.0|255.0] "Unitless" ASDM,PAS
 SG_ ReSideRdrLeDetn12RdrDetnCntr : 415|4@0+ (1.0,0.0) [0.0|15.0] "Unitless" ASDM,PAS
 SG_ ReSideRdrLeDetn12RdrDetnConf : 471|7@0+ (1.0,0.0) [0.0|100.0] "%" ASDM,PAS
 SG_ ReSideRdrLeDetn12RdrDetnElevn : 479|5@0+ (1.0,-15.0) [-15.0|15.0] "Deg" ASDM,PAS
 SG_ ReSideRdrLeDetn12RdrDetnPwr : 409|9@0+ (0.1,0.0) [0.0|51.1] "dB" ASDM,PAS
 SG_ ReSideRdrLeDetn12RdrDetnRng : 431|14@0+ (0.02,-1.0) [-1.0|200.0] "m" ASDM,PAS
 SG_ ReSideRdrLeDetn12RdrDetnRngV : 452|13@0+ (0.02,-80.0) [-80.0|80.0] "m/s" ASDM,PAS
 SG_ ReSideRdrLeDetn12RdrDetnSts : 411|2@0+ (1,0) [0|3] "" ASDM,PAS
 SG_ ReSideRdrLeDetn7_UB : 74|1@0+ (1,0) [0|1] "" ASDM,PAS
 SG_ ReSideRdrLeDetn7RdrDetnAzi : 31|11@0+ (0.1,-90.0) [-90.0|90.0] "Deg" ASDM,PAS
 SG_ ReSideRdrLeDetn7RdrDetnChks : 7|8@0+ (1.0,0.0) [0.0|255.0] "Unitless" ASDM,PAS
 SG_ ReSideRdrLeDetn7RdrDetnCntr : 15|4@0+ (1.0,0.0) [0.0|15.0] "Unitless" ASDM,PAS
 SG_ ReSideRdrLeDetn7RdrDetnConf : 71|7@0+ (1.0,0.0) [0.0|100.0] "%" ASDM,PAS
 SG_ ReSideRdrLeDetn7RdrDetnElevn : 79|5@0+ (1.0,-15.0) [-15.0|15.0] "Deg" ASDM,PAS
 SG_ ReSideRdrLeDetn7RdrDetnPwr : 8|9@0+ (0.1,0.0) [0.0|51.1] "dB" ASDM,PAS
 SG_ ReSideRdrLeDetn7RdrDetnRng : 55|14@0+ (0.02,-1.0) [-1.0|200.0] "m" ASDM,PAS
 SG_ ReSideRdrLeDetn7RdrDetnRngV : 36|13@0+ (0.02,-80.0) [-80.0|80.0] "m/s" ASDM,PAS
 SG_ ReSideRdrLeDetn7RdrDetnSts : 11|2@0+ (1,0) [0|3] "" ASDM,PAS
 SG_ ReSideRdrLeDetn8_UB : 154|1@0+ (1,0) [0|1] "" ASDM,PAS
 SG_ ReSideRdrLeDetn8RdrDetnAzi : 119|11@0+ (0.1,-90.0) [-90.0|90.0] "Deg" ASDM,PAS
 SG_ ReSideRdrLeDetn8RdrDetnChks : 87|8@0+ (1.0,0.0) [0.0|255.0] "Unitless" ASDM,PAS
 SG_ ReSideRdrLeDetn8RdrDetnCntr : 95|4@0+ (1.0,0.0) [0.0|15.0] "Unitless" ASDM,PAS
 SG_ ReSideRdrLeDetn8RdrDetnConf : 111|7@0+ (1.0,0.0) [0.0|100.0] "%" ASDM,PAS
 SG_ ReSideRdrLeDetn8RdrDetnElevn : 159|5@0+ (1.0,-15.0) [-15.0|15.0] "Deg" ASDM,PAS
 SG_ ReSideRdrLeDetn8RdrDetnPwr : 89|9@0+ (0.1,0.0) [0.0|51.1] "dB" ASDM,PAS
 SG_ ReSideRdrLeDetn8RdrDetnRng : 143|14@0+ (0.02,-1.0) [-1.0|200.0] "m" ASDM,PAS
 SG_ ReSideRdrLeDetn8RdrDetnRngV : 124|13@0+ (0.02,-80.0) [-80.0|80.0] "m/s" ASDM,PAS
 SG_ ReSideRdrLeDetn8RdrDetnSts : 91|2@0+ (1,0) [0|3] "" ASDM,PAS
 SG_ ReSideRdrLeDetn9_UB : 234|1@0+ (1,0) [0|1] "" ASDM,PAS
 SG_ ReSideRdrLeDetn9RdrDetnAzi : 199|11@0+ (0.1,-90.0) [-90.0|90.0] "Deg" ASDM,PAS
 SG_ ReSideRdrLeDetn9RdrDetnChks : 167|8@0+ (1.0,0.0) [0.0|255.0] "Unitless" ASDM,PAS
 SG_ ReSideRdrLeDetn9RdrDetnCntr : 175|4@0+ (1.0,0.0) [0.0|15.0] "Unitless" ASDM,PAS
 SG_ ReSideRdrLeDetn9RdrDetnConf : 191|7@0+ (1.0,0.0) [0.0|100.0] "%" ASDM,PAS
 SG_ ReSideRdrLeDetn9RdrDetnElevn : 239|5@0+ (1.0,-15.0) [-15.0|15.0] "Deg" ASDM,PAS
 SG_ ReSideRdrLeDetn9RdrDetnPwr : 169|9@0+ (0.1,0.0) [0.0|51.1] "dB" ASDM,PAS
 SG_ ReSideRdrLeDetn9RdrDetnRng : 223|14@0+ (0.02,-1.0) [-1.0|200.0] "m" ASDM,PAS
 SG_ ReSideRdrLeDetn9RdrDetnRngV : 204|13@0+ (0.02,-80.0) [-80.0|80.0] "m/s" ASDM,PAS
 SG_ ReSideRdrLeDetn9RdrDetnSts : 171|2@0+ (1,0) [0|3] "" ASDM,PAS

BO_ 308 SODLSafetyCANFD3Frame03: 64 SODL
 SG_ ReSideRdrLeDetn13_UB : 74|1@0+ (1,0) [0|1] "" ASDM,PAS
 SG_ ReSideRdrLeDetn13RdrDetnAzi : 31|11@0+ (0.1,-90.0) [-90.0|90.0] "Deg" ASDM,PAS
 SG_ ReSideRdrLeDetn13RdrDetnChks : 7|8@0+ (1.0,0.0) [0.0|255.0] "Unitless" ASDM,PAS
 SG_ ReSideRdrLeDetn13RdrDetnCntr : 15|4@0+ (1.0,0.0) [0.0|15.0] "Unitless" ASDM,PAS
 SG_ ReSideRdrLeDetn13RdrDetnConf : 71|7@0+ (1.0,0.0) [0.0|100.0] "%" ASDM,PAS
 SG_ ReSideRdrLeDetn13RdrDetnElevn : 79|5@0+ (1.0,-15.0) [-15.0|15.0] "Deg" ASDM,PAS
 SG_ ReSideRdrLeDetn13RdrDetnPwr : 8|9@0+ (0.1,0.0) [0.0|51.1] "dB" ASDM,PAS
 SG_ ReSideRdrLeDetn13RdrDetnRng : 55|14@0+ (0.02,-1.0) [-1.0|200.0] "m" ASDM,PAS
 SG_ ReSideRdrLeDetn13RdrDetnRngV : 36|13@0+ (0.02,-80.0) [-80.0|80.0] "m/s" ASDM,PAS
 SG_ ReSideRdrLeDetn13RdrDetnSts : 11|2@0+ (1,0) [0|3] "" ASDM,PAS
 SG_ ReSideRdrLeDetn14_UB : 154|1@0+ (1,0) [0|1] "" ASDM,PAS
 SG_ ReSideRdrLeDetn14RdrDetnAzi : 119|11@0+ (0.1,-90.0) [-90.0|90.0] "Deg" ASDM,PAS
 SG_ ReSideRdrLeDetn14RdrDetnChks : 87|8@0+ (1.0,0.0) [0.0|255.0] "Unitless" ASDM,PAS
 SG_ ReSideRdrLeDetn14RdrDetnCntr : 95|4@0+ (1.0,0.0) [0.0|15.0] "Unitless" ASDM,PAS
 SG_ ReSideRdrLeDetn14RdrDetnConf : 111|7@0+ (1.0,0.0) [0.0|100.0] "%" ASDM,PAS
 SG_ ReSideRdrLeDetn14RdrDetnElevn : 159|5@0+ (1.0,-15.0) [-15.0|15.0] "Deg" ASDM,PAS
 SG_ ReSideRdrLeDetn14RdrDetnPwr : 89|9@0+ (0.1,0.0) [0.0|51.1] "dB" ASDM,PAS
 SG_ ReSideRdrLeDetn14RdrDetnRng : 143|14@0+ (0.02,-1.0) [-1.0|200.0] "m" ASDM,PAS
 SG_ ReSideRdrLeDetn14RdrDetnRngV : 124|13@0+ (0.02,-80.0) [-80.0|80.0] "m/s" ASDM,PAS
 SG_ ReSideRdrLeDetn14RdrDetnSts : 91|2@0+ (1,0) [0|3] "" ASDM,PAS
 SG_ ReSideRdrLeDetn15_UB : 234|1@0+ (1,0) [0|1] "" ASDM,PAS
 SG_ ReSideRdrLeDetn15RdrDetnAzi : 199|11@0+ (0.1,-90.0) [-90.0|90.0] "Deg" ASDM,PAS
 SG_ ReSideRdrLeDetn15RdrDetnChks : 167|8@0+ (1.0,0.0) [0.0|255.0] "Unitless" ASDM,PAS
 SG_ ReSideRdrLeDetn15RdrDetnCntr : 175|4@0+ (1.0,0.0) [0.0|15.0] "Unitless" ASDM,PAS
 SG_ ReSideRdrLeDetn15RdrDetnConf : 191|7@0+ (1.0,0.0) [0.0|100.0] "%" ASDM,PAS
 SG_ ReSideRdrLeDetn15RdrDetnElevn : 239|5@0+ (1.0,-15.0) [-15.0|15.0] "Deg" ASDM,PAS
 SG_ ReSideRdrLeDetn15RdrDetnPwr : 169|9@0+ (0.1,0.0) [0.0|51.1] "dB" ASDM,PAS
 SG_ ReSideRdrLeDetn15RdrDetnRng : 223|14@0+ (0.02,-1.0) [-1.0|200.0] "m" ASDM,PAS
 SG_ ReSideRdrLeDetn15RdrDetnRngV : 204|13@0+ (0.02,-80.0) [-80.0|80.0] "m/s" ASDM,PAS
 SG_ ReSideRdrLeDetn15RdrDetnSts : 171|2@0+ (1,0) [0|3] "" ASDM,PAS
 SG_ ReSideRdrLeDetn16_UB : 314|1@0+ (1,0) [0|1] "" ASDM,PAS
 SG_ ReSideRdrLeDetn16RdrDetnAzi : 287|11@0+ (0.1,-90.0) [-90.0|90.0] "Deg" ASDM,PAS
 SG_ ReSideRdrLeDetn16RdrDetnChks : 247|8@0+ (1.0,0.0) [0.0|255.0] "Unitless" ASDM,PAS
 SG_ ReSideRdrLeDetn16RdrDetnCntr : 255|4@0+ (1.0,0.0) [0.0|15.0] "Unitless" ASDM,PAS
 SG_ ReSideRdrLeDetn16RdrDetnConf : 311|7@0+ (1.0,0.0) [0.0|100.0] "%" ASDM,PAS
 SG_ ReSideRdrLeDetn16RdrDetnElevn : 319|5@0+ (1.0,-15.0) [-15.0|15.0] "Deg" ASDM,PAS
 SG_ ReSideRdrLeDetn16RdrDetnPwr : 249|9@0+ (0.1,0.0) [0.0|51.1] "dB" ASDM,PAS
 SG_ ReSideRdrLeDetn16RdrDetnRng : 271|14@0+ (0.02,-1.0) [-1.0|200.0] "m" ASDM,PAS
 SG_ ReSideRdrLeDetn16RdrDetnRngV : 292|13@0+ (0.02,-80.0) [-80.0|80.0] "m/s" ASDM,PAS
 SG_ ReSideRdrLeDetn16RdrDetnSts : 251|2@0+ (1,0) [0|3] "" ASDM,PAS
 SG_ ReSideRdrLeDetn17_UB : 394|1@0+ (1,0) [0|1] "" ASDM,PAS
 SG_ ReSideRdrLeDetn17RdrDetnAzi : 351|11@0+ (0.1,-90.0) [-90.0|90.0] "Deg" ASDM,PAS
 SG_ ReSideRdrLeDetn17RdrDetnChks : 327|8@0+ (1.0,0.0) [0.0|255.0] "Unitless" ASDM,PAS
 SG_ ReSideRdrLeDetn17RdrDetnCntr : 335|4@0+ (1.0,0.0) [0.0|15.0] "Unitless" ASDM,PAS
 SG_ ReSideRdrLeDetn17RdrDetnConf : 391|7@0+ (1.0,0.0) [0.0|100.0] "%" ASDM,PAS
 SG_ ReSideRdrLeDetn17RdrDetnElevn : 399|5@0+ (1.0,-15.0) [-15.0|15.0] "Deg" ASDM,PAS
 SG_ ReSideRdrLeDetn17RdrDetnPwr : 329|9@0+ (0.1,0.0) [0.0|51.1] "dB" ASDM,PAS
 SG_ ReSideRdrLeDetn17RdrDetnRng : 375|14@0+ (0.02,-1.0) [-1.0|200.0] "m" ASDM,PAS
 SG_ ReSideRdrLeDetn17RdrDetnRngV : 356|13@0+ (0.02,-80.0) [-80.0|80.0] "m/s" ASDM,PAS
 SG_ ReSideRdrLeDetn17RdrDetnSts : 331|2@0+ (1,0) [0|3] "" ASDM,PAS
 SG_ ReSideRdrLeDetn18_UB : 474|1@0+ (1,0) [0|1] "" ASDM,PAS
 SG_ ReSideRdrLeDetn18RdrDetnAzi : 447|11@0+ (0.1,-90.0) [-90.0|90.0] "Deg" ASDM,PAS
 SG_ ReSideRdrLeDetn18RdrDetnChks : 407|8@0+ (1.0,0.0) [0.0|255.0] "Unitless" ASDM,PAS
 SG_ ReSideRdrLeDetn18RdrDetnCntr : 415|4@0+ (1.0,0.0) [0.0|15.0] "Unitless" ASDM,PAS
 SG_ ReSideRdrLeDetn18RdrDetnConf : 471|7@0+ (1.0,0.0) [0.0|100.0] "%" ASDM,PAS
 SG_ ReSideRdrLeDetn18RdrDetnElevn : 479|5@0+ (1.0,-15.0) [-15.0|15.0] "Deg" ASDM,PAS
 SG_ ReSideRdrLeDetn18RdrDetnPwr : 409|9@0+ (0.1,0.0) [0.0|51.1] "dB" ASDM,PAS
 SG_ ReSideRdrLeDetn18RdrDetnRng : 431|14@0+ (0.02,-1.0) [-1.0|200.0] "m" ASDM,PAS
 SG_ ReSideRdrLeDetn18RdrDetnRngV : 452|13@0+ (0.02,-80.0) [-80.0|80.0] "m/s" ASDM,PAS
 SG_ ReSideRdrLeDetn18RdrDetnSts : 411|2@0+ (1,0) [0|3] "" ASDM,PAS

BO_ 310 SODLSafetyCANFD3Frame04: 64 SODL
 SG_ ReSideRdrLeDetn19_UB : 74|1@0+ (1,0) [0|1] "" ASDM,PAS
 SG_ ReSideRdrLeDetn19RdrDetnAzi : 31|11@0+ (0.1,-90.0) [-90.0|90.0] "Deg" ASDM,PAS
 SG_ ReSideRdrLeDetn19RdrDetnChks : 7|8@0+ (1.0,0.0) [0.0|255.0] "Unitless" ASDM,PAS
 SG_ ReSideRdrLeDetn19RdrDetnCntr : 15|4@0+ (1.0,0.0) [0.0|15.0] "Unitless" ASDM,PAS
 SG_ ReSideRdrLeDetn19RdrDetnConf : 71|7@0+ (1.0,0.0) [0.0|100.0] "%" ASDM,PAS
 SG_ ReSideRdrLeDetn19RdrDetnElevn : 79|5@0+ (1.0,-15.0) [-15.0|15.0] "Deg" ASDM,PAS
 SG_ ReSideRdrLeDetn19RdrDetnPwr : 8|9@0+ (0.1,0.0) [0.0|51.1] "dB" ASDM,PAS
 SG_ ReSideRdrLeDetn19RdrDetnRng : 55|14@0+ (0.02,-1.0) [-1.0|200.0] "m" ASDM,PAS
 SG_ ReSideRdrLeDetn19RdrDetnRngV : 36|13@0+ (0.02,-80.0) [-80.0|80.0] "m/s" ASDM,PAS
 SG_ ReSideRdrLeDetn19RdrDetnSts : 11|2@0+ (1,0) [0|3] "" ASDM,PAS
 SG_ ReSideRdrLeDetn20_UB : 154|1@0+ (1,0) [0|1] "" ASDM,PAS
 SG_ ReSideRdrLeDetn20RdrDetnAzi : 119|11@0+ (0.1,-90.0) [-90.0|90.0] "Deg" ASDM,PAS
 SG_ ReSideRdrLeDetn20RdrDetnChks : 87|8@0+ (1.0,0.0) [0.0|255.0] "Unitless" ASDM,PAS
 SG_ ReSideRdrLeDetn20RdrDetnCntr : 95|4@0+ (1.0,0.0) [0.0|15.0] "Unitless" ASDM,PAS
 SG_ ReSideRdrLeDetn20RdrDetnConf : 111|7@0+ (1.0,0.0) [0.0|100.0] "%" ASDM,PAS
 SG_ ReSideRdrLeDetn20RdrDetnElevn : 159|5@0+ (1.0,-15.0) [-15.0|15.0] "Deg" ASDM,PAS
 SG_ ReSideRdrLeDetn20RdrDetnPwr : 89|9@0+ (0.1,0.0) [0.0|51.1] "dB" ASDM,PAS
 SG_ ReSideRdrLeDetn20RdrDetnRng : 143|14@0+ (0.02,-1.0) [-1.0|200.0] "m" ASDM,PAS
 SG_ ReSideRdrLeDetn20RdrDetnRngV : 124|13@0+ (0.02,-80.0) [-80.0|80.0] "m/s" ASDM,PAS
 SG_ ReSideRdrLeDetn20RdrDetnSts : 91|2@0+ (1,0) [0|3] "" ASDM,PAS
 SG_ ReSideRdrLeDetn21_UB : 234|1@0+ (1,0) [0|1] "" ASDM,PAS
 SG_ ReSideRdrLeDetn21RdrDetnAzi : 199|11@0+ (0.1,-90.0) [-90.0|90.0] "Deg" ASDM,PAS
 SG_ ReSideRdrLeDetn21RdrDetnChks : 167|8@0+ (1.0,0.0) [0.0|255.0] "Unitless" ASDM,PAS
 SG_ ReSideRdrLeDetn21RdrDetnCntr : 175|4@0+ (1.0,0.0) [0.0|15.0] "Unitless" ASDM,PAS
 SG_ ReSideRdrLeDetn21RdrDetnConf : 191|7@0+ (1.0,0.0) [0.0|100.0] "%" ASDM,PAS
 SG_ ReSideRdrLeDetn21RdrDetnElevn : 239|5@0+ (1.0,-15.0) [-15.0|15.0] "Deg" ASDM,PAS
 SG_ ReSideRdrLeDetn21RdrDetnPwr : 169|9@0+ (0.1,0.0) [0.0|51.1] "dB" ASDM,PAS
 SG_ ReSideRdrLeDetn21RdrDetnRng : 223|14@0+ (0.02,-1.0) [-1.0|200.0] "m" ASDM,PAS
 SG_ ReSideRdrLeDetn21RdrDetnRngV : 204|13@0+ (0.02,-80.0) [-80.0|80.0] "m/s" ASDM,PAS
 SG_ ReSideRdrLeDetn21RdrDetnSts : 171|2@0+ (1,0) [0|3] "" ASDM,PAS
 SG_ ReSideRdrLeDetn22_UB : 314|1@0+ (1,0) [0|1] "" ASDM,PAS
 SG_ ReSideRdrLeDetn22RdrDetnAzi : 287|11@0+ (0.1,-90.0) [-90.0|90.0] "Deg" ASDM,PAS
 SG_ ReSideRdrLeDetn22RdrDetnChks : 247|8@0+ (1.0,0.0) [0.0|255.0] "Unitless" ASDM,PAS
 SG_ ReSideRdrLeDetn22RdrDetnCntr : 255|4@0+ (1.0,0.0) [0.0|15.0] "Unitless" ASDM,PAS
 SG_ ReSideRdrLeDetn22RdrDetnConf : 311|7@0+ (1.0,0.0) [0.0|100.0] "%" ASDM,PAS
 SG_ ReSideRdrLeDetn22RdrDetnElevn : 319|5@0+ (1.0,-15.0) [-15.0|15.0] "Deg" ASDM,PAS
 SG_ ReSideRdrLeDetn22RdrDetnPwr : 249|9@0+ (0.1,0.0) [0.0|51.1] "dB" ASDM,PAS
 SG_ ReSideRdrLeDetn22RdrDetnRng : 271|14@0+ (0.02,-1.0) [-1.0|200.0] "m" ASDM,PAS
 SG_ ReSideRdrLeDetn22RdrDetnRngV : 292|13@0+ (0.02,-80.0) [-80.0|80.0] "m/s" ASDM,PAS
 SG_ ReSideRdrLeDetn22RdrDetnSts : 251|2@0+ (1,0) [0|3] "" ASDM,PAS
 SG_ ReSideRdrLeDetn23_UB : 394|1@0+ (1,0) [0|1] "" ASDM,PAS
 SG_ ReSideRdrLeDetn23RdrDetnAzi : 351|11@0+ (0.1,-90.0) [-90.0|90.0] "Deg" ASDM,PAS
 SG_ ReSideRdrLeDetn23RdrDetnChks : 327|8@0+ (1.0,0.0) [0.0|255.0] "Unitless" ASDM,PAS
 SG_ ReSideRdrLeDetn23RdrDetnCntr : 335|4@0+ (1.0,0.0) [0.0|15.0] "Unitless" ASDM,PAS
 SG_ ReSideRdrLeDetn23RdrDetnConf : 391|7@0+ (1.0,0.0) [0.0|100.0] "%" ASDM,PAS
 SG_ ReSideRdrLeDetn23RdrDetnElevn : 399|5@0+ (1.0,-15.0) [-15.0|15.0] "Deg" ASDM,PAS
 SG_ ReSideRdrLeDetn23RdrDetnPwr : 329|9@0+ (0.1,0.0) [0.0|51.1] "dB" ASDM,PAS
 SG_ ReSideRdrLeDetn23RdrDetnRng : 375|14@0+ (0.02,-1.0) [-1.0|200.0] "m" ASDM,PAS
 SG_ ReSideRdrLeDetn23RdrDetnRngV : 356|13@0+ (0.02,-80.0) [-80.0|80.0] "m/s" ASDM,PAS
 SG_ ReSideRdrLeDetn23RdrDetnSts : 331|2@0+ (1,0) [0|3] "" ASDM,PAS
 SG_ ReSideRdrLeDetn24_UB : 474|1@0+ (1,0) [0|1] "" ASDM,PAS
 SG_ ReSideRdrLeDetn24RdrDetnAzi : 447|11@0+ (0.1,-90.0) [-90.0|90.0] "Deg" ASDM,PAS
 SG_ ReSideRdrLeDetn24RdrDetnChks : 407|8@0+ (1.0,0.0) [0.0|255.0] "Unitless" ASDM,PAS
 SG_ ReSideRdrLeDetn24RdrDetnCntr : 415|4@0+ (1.0,0.0) [0.0|15.0] "Unitless" ASDM,PAS
 SG_ ReSideRdrLeDetn24RdrDetnConf : 471|7@0+ (1.0,0.0) [0.0|100.0] "%" ASDM,PAS
 SG_ ReSideRdrLeDetn24RdrDetnElevn : 479|5@0+ (1.0,-15.0) [-15.0|15.0] "Deg" ASDM,PAS
 SG_ ReSideRdrLeDetn24RdrDetnPwr : 409|9@0+ (0.1,0.0) [0.0|51.1] "dB" ASDM,PAS
 SG_ ReSideRdrLeDetn24RdrDetnRng : 431|14@0+ (0.02,-1.0) [-1.0|200.0] "m" ASDM,PAS
 SG_ ReSideRdrLeDetn24RdrDetnRngV : 452|13@0+ (0.02,-80.0) [-80.0|80.0] "m/s" ASDM,PAS
 SG_ ReSideRdrLeDetn24RdrDetnSts : 411|2@0+ (1,0) [0|3] "" ASDM,PAS

BO_ 312 SODLSafetyCANFD3Frame05: 64 SODL
 SG_ ReSideRdrLeDetn25_UB : 74|1@0+ (1,0) [0|1] "" ASDM,PAS
 SG_ ReSideRdrLeDetn25RdrDetnAzi : 31|11@0+ (0.1,-90.0) [-90.0|90.0] "Deg" ASDM,PAS
 SG_ ReSideRdrLeDetn25RdrDetnChks : 7|8@0+ (1.0,0.0) [0.0|255.0] "Unitless" ASDM,PAS
 SG_ ReSideRdrLeDetn25RdrDetnCntr : 15|4@0+ (1.0,0.0) [0.0|15.0] "Unitless" ASDM,PAS
 SG_ ReSideRdrLeDetn25RdrDetnConf : 71|7@0+ (1.0,0.0) [0.0|100.0] "%" ASDM,PAS
 SG_ ReSideRdrLeDetn25RdrDetnElevn : 79|5@0+ (1.0,-15.0) [-15.0|15.0] "Deg" ASDM,PAS
 SG_ ReSideRdrLeDetn25RdrDetnPwr : 8|9@0+ (0.1,0.0) [0.0|51.1] "dB" ASDM,PAS
 SG_ ReSideRdrLeDetn25RdrDetnRng : 55|14@0+ (0.02,-1.0) [-1.0|200.0] "m" ASDM,PAS
 SG_ ReSideRdrLeDetn25RdrDetnRngV : 36|13@0+ (0.02,-80.0) [-80.0|80.0] "m/s" ASDM,PAS
 SG_ ReSideRdrLeDetn25RdrDetnSts : 11|2@0+ (1,0) [0|3] "" ASDM,PAS
 SG_ ReSideRdrLeDetn26_UB : 154|1@0+ (1,0) [0|1] "" ASDM,PAS
 SG_ ReSideRdrLeDetn26RdrDetnAzi : 119|11@0+ (0.1,-90.0) [-90.0|90.0] "Deg" ASDM,PAS
 SG_ ReSideRdrLeDetn26RdrDetnChks : 87|8@0+ (1.0,0.0) [0.0|255.0] "Unitless" ASDM,PAS
 SG_ ReSideRdrLeDetn26RdrDetnCntr : 95|4@0+ (1.0,0.0) [0.0|15.0] "Unitless" ASDM,PAS
 SG_ ReSideRdrLeDetn26RdrDetnConf : 111|7@0+ (1.0,0.0) [0.0|100.0] "%" ASDM,PAS
 SG_ ReSideRdrLeDetn26RdrDetnElevn : 159|5@0+ (1.0,-15.0) [-15.0|15.0] "Deg" ASDM,PAS
 SG_ ReSideRdrLeDetn26RdrDetnPwr : 89|9@0+ (0.1,0.0) [0.0|51.1] "dB" ASDM,PAS
 SG_ ReSideRdrLeDetn26RdrDetnRng : 143|14@0+ (0.02,-1.0) [-1.0|200.0] "m" ASDM,PAS
 SG_ ReSideRdrLeDetn26RdrDetnRngV : 124|13@0+ (0.02,-80.0) [-80.0|80.0] "m/s" ASDM,PAS
 SG_ ReSideRdrLeDetn26RdrDetnSts : 91|2@0+ (1,0) [0|3] "" ASDM,PAS
 SG_ ReSideRdrLeDetn27_UB : 234|1@0+ (1,0) [0|1] "" ASDM,PAS
 SG_ ReSideRdrLeDetn27RdrDetnAzi : 199|11@0+ (0.1,-90.0) [-90.0|90.0] "Deg" ASDM,PAS
 SG_ ReSideRdrLeDetn27RdrDetnChks : 167|8@0+ (1.0,0.0) [0.0|255.0] "Unitless" ASDM,PAS
 SG_ ReSideRdrLeDetn27RdrDetnCntr : 175|4@0+ (1.0,0.0) [0.0|15.0] "Unitless" ASDM,PAS
 SG_ ReSideRdrLeDetn27RdrDetnConf : 191|7@0+ (1.0,0.0) [0.0|100.0] "%" ASDM,PAS
 SG_ ReSideRdrLeDetn27RdrDetnElevn : 239|5@0+ (1.0,-15.0) [-15.0|15.0] "Deg" ASDM,PAS
 SG_ ReSideRdrLeDetn27RdrDetnPwr : 169|9@0+ (0.1,0.0) [0.0|51.1] "dB" ASDM,PAS
 SG_ ReSideRdrLeDetn27RdrDetnRng : 223|14@0+ (0.02,-1.0) [-1.0|200.0] "m" ASDM,PAS
 SG_ ReSideRdrLeDetn27RdrDetnRngV : 204|13@0+ (0.02,-80.0) [-80.0|80.0] "m/s" ASDM,PAS
 SG_ ReSideRdrLeDetn27RdrDetnSts : 171|2@0+ (1,0) [0|3] "" ASDM,PAS
 SG_ ReSideRdrLeDetn28_UB : 314|1@0+ (1,0) [0|1] "" ASDM,PAS
 SG_ ReSideRdrLeDetn28RdrDetnAzi : 287|11@0+ (0.1,-90.0) [-90.0|90.0] "Deg" ASDM,PAS
 SG_ ReSideRdrLeDetn28RdrDetnChks : 247|8@0+ (1.0,0.0) [0.0|255.0] "Unitless" ASDM,PAS
 SG_ ReSideRdrLeDetn28RdrDetnCntr : 255|4@0+ (1.0,0.0) [0.0|15.0] "Unitless" ASDM,PAS
 SG_ ReSideRdrLeDetn28RdrDetnConf : 311|7@0+ (1.0,0.0) [0.0|100.0] "%" ASDM,PAS
 SG_ ReSideRdrLeDetn28RdrDetnElevn : 319|5@0+ (1.0,-15.0) [-15.0|15.0] "Deg" ASDM,PAS
 SG_ ReSideRdrLeDetn28RdrDetnPwr : 249|9@0+ (0.1,0.0) [0.0|51.1] "dB" ASDM,PAS
 SG_ ReSideRdrLeDetn28RdrDetnRng : 271|14@0+ (0.02,-1.0) [-1.0|200.0] "m" ASDM,PAS
 SG_ ReSideRdrLeDetn28RdrDetnRngV : 292|13@0+ (0.02,-80.0) [-80.0|80.0] "m/s" ASDM,PAS
 SG_ ReSideRdrLeDetn28RdrDetnSts : 251|2@0+ (1,0) [0|3] "" ASDM,PAS
 SG_ ReSideRdrLeDetn29_UB : 394|1@0+ (1,0) [0|1] "" ASDM,PAS
 SG_ ReSideRdrLeDetn29RdrDetnAzi : 351|11@0+ (0.1,-90.0) [-90.0|90.0] "Deg" ASDM,PAS
 SG_ ReSideRdrLeDetn29RdrDetnChks : 327|8@0+ (1.0,0.0) [0.0|255.0] "Unitless" ASDM,PAS
 SG_ ReSideRdrLeDetn29RdrDetnCntr : 335|4@0+ (1.0,0.0) [0.0|15.0] "Unitless" ASDM,PAS
 SG_ ReSideRdrLeDetn29RdrDetnConf : 391|7@0+ (1.0,0.0) [0.0|100.0] "%" ASDM,PAS
 SG_ ReSideRdrLeDetn29RdrDetnElevn : 399|5@0+ (1.0,-15.0) [-15.0|15.0] "Deg" ASDM,PAS
 SG_ ReSideRdrLeDetn29RdrDetnPwr : 329|9@0+ (0.1,0.0) [0.0|51.1] "dB" ASDM,PAS
 SG_ ReSideRdrLeDetn29RdrDetnRng : 375|14@0+ (0.02,-1.0) [-1.0|200.0] "m" ASDM,PAS
 SG_ ReSideRdrLeDetn29RdrDetnRngV : 356|13@0+ (0.02,-80.0) [-80.0|80.0] "m/s" ASDM,PAS
 SG_ ReSideRdrLeDetn29RdrDetnSts : 331|2@0+ (1,0) [0|3] "" ASDM,PAS
 SG_ ReSideRdrLeDetn30_UB : 474|1@0+ (1,0) [0|1] "" ASDM,PAS
 SG_ ReSideRdrLeDetn30RdrDetnAzi : 447|11@0+ (0.1,-90.0) [-90.0|90.0] "Deg" ASDM,PAS
 SG_ ReSideRdrLeDetn30RdrDetnChks : 407|8@0+ (1.0,0.0) [0.0|255.0] "Unitless" ASDM,PAS
 SG_ ReSideRdrLeDetn30RdrDetnCntr : 415|4@0+ (1.0,0.0) [0.0|15.0] "Unitless" ASDM,PAS
 SG_ ReSideRdrLeDetn30RdrDetnConf : 471|7@0+ (1.0,0.0) [0.0|100.0] "%" ASDM,PAS
 SG_ ReSideRdrLeDetn30RdrDetnElevn : 479|5@0+ (1.0,-15.0) [-15.0|15.0] "Deg" ASDM,PAS
 SG_ ReSideRdrLeDetn30RdrDetnPwr : 409|9@0+ (0.1,0.0) [0.0|51.1] "dB" ASDM,PAS
 SG_ ReSideRdrLeDetn30RdrDetnRng : 431|14@0+ (0.02,-1.0) [-1.0|200.0] "m" ASDM,PAS
 SG_ ReSideRdrLeDetn30RdrDetnRngV : 452|13@0+ (0.02,-80.0) [-80.0|80.0] "m/s" ASDM,PAS
 SG_ ReSideRdrLeDetn30RdrDetnSts : 411|2@0+ (1,0) [0|3] "" ASDM,PAS

BO_ 314 SODLSafetyCANFD3Frame06: 64 SODL
 SG_ ReSideRdrLeDetn31_UB : 74|1@0+ (1,0) [0|1] "" ASDM,PAS
 SG_ ReSideRdrLeDetn31RdrDetnAzi : 31|11@0+ (0.1,-90.0) [-90.0|90.0] "Deg" ASDM,PAS
 SG_ ReSideRdrLeDetn31RdrDetnChks : 7|8@0+ (1.0,0.0) [0.0|255.0] "Unitless" ASDM,PAS
 SG_ ReSideRdrLeDetn31RdrDetnCntr : 15|4@0+ (1.0,0.0) [0.0|15.0] "Unitless" ASDM,PAS
 SG_ ReSideRdrLeDetn31RdrDetnConf : 71|7@0+ (1.0,0.0) [0.0|100.0] "%" ASDM,PAS
 SG_ ReSideRdrLeDetn31RdrDetnElevn : 79|5@0+ (1.0,-15.0) [-15.0|15.0] "Deg" ASDM,PAS
 SG_ ReSideRdrLeDetn31RdrDetnPwr : 8|9@0+ (0.1,0.0) [0.0|51.1] "dB" ASDM,PAS
 SG_ ReSideRdrLeDetn31RdrDetnRng : 55|14@0+ (0.02,-1.0) [-1.0|200.0] "m" ASDM,PAS
 SG_ ReSideRdrLeDetn31RdrDetnRngV : 36|13@0+ (0.02,-80.0) [-80.0|80.0] "m/s" ASDM,PAS
 SG_ ReSideRdrLeDetn31RdrDetnSts : 11|2@0+ (1,0) [0|3] "" ASDM,PAS
 SG_ ReSideRdrLeDetn32_UB : 154|1@0+ (1,0) [0|1] "" ASDM,PAS
 SG_ ReSideRdrLeDetn32RdrDetnAzi : 119|11@0+ (0.1,-90.0) [-90.0|90.0] "Deg" ASDM,PAS
 SG_ ReSideRdrLeDetn32RdrDetnChks : 87|8@0+ (1.0,0.0) [0.0|255.0] "Unitless" ASDM,PAS
 SG_ ReSideRdrLeDetn32RdrDetnCntr : 95|4@0+ (1.0,0.0) [0.0|15.0] "Unitless" ASDM,PAS
 SG_ ReSideRdrLeDetn32RdrDetnConf : 111|7@0+ (1.0,0.0) [0.0|100.0] "%" ASDM,PAS
 SG_ ReSideRdrLeDetn32RdrDetnElevn : 159|5@0+ (1.0,-15.0) [-15.0|15.0] "Deg" ASDM,PAS
 SG_ ReSideRdrLeDetn32RdrDetnPwr : 89|9@0+ (0.1,0.0) [0.0|51.1] "dB" ASDM,PAS
 SG_ ReSideRdrLeDetn32RdrDetnRng : 143|14@0+ (0.02,-1.0) [-1.0|200.0] "m" ASDM,PAS
 SG_ ReSideRdrLeDetn32RdrDetnRngV : 124|13@0+ (0.02,-80.0) [-80.0|80.0] "m/s" ASDM,PAS
 SG_ ReSideRdrLeDetn32RdrDetnSts : 91|2@0+ (1,0) [0|3] "" ASDM,PAS
 SG_ ReSideRdrLeDetn33_UB : 234|1@0+ (1,0) [0|1] "" ASDM,PAS
 SG_ ReSideRdrLeDetn33RdrDetnAzi : 199|11@0+ (0.1,-90.0) [-90.0|90.0] "Deg" ASDM,PAS
 SG_ ReSideRdrLeDetn33RdrDetnChks : 167|8@0+ (1.0,0.0) [0.0|255.0] "Unitless" ASDM,PAS
 SG_ ReSideRdrLeDetn33RdrDetnCntr : 175|4@0+ (1.0,0.0) [0.0|15.0] "Unitless" ASDM,PAS
 SG_ ReSideRdrLeDetn33RdrDetnConf : 191|7@0+ (1.0,0.0) [0.0|100.0] "%" ASDM,PAS
 SG_ ReSideRdrLeDetn33RdrDetnElevn : 239|5@0+ (1.0,-15.0) [-15.0|15.0] "Deg" ASDM,PAS
 SG_ ReSideRdrLeDetn33RdrDetnPwr : 169|9@0+ (0.1,0.0) [0.0|51.1] "dB" ASDM,PAS
 SG_ ReSideRdrLeDetn33RdrDetnRng : 223|14@0+ (0.02,-1.0) [-1.0|200.0] "m" ASDM,PAS
 SG_ ReSideRdrLeDetn33RdrDetnRngV : 204|13@0+ (0.02,-80.0) [-80.0|80.0] "m/s" ASDM,PAS
 SG_ ReSideRdrLeDetn33RdrDetnSts : 171|2@0+ (1,0) [0|3] "" ASDM,PAS
 SG_ ReSideRdrLeDetn34_UB : 314|1@0+ (1,0) [0|1] "" ASDM,PAS
 SG_ ReSideRdrLeDetn34RdrDetnAzi : 287|11@0+ (0.1,-90.0) [-90.0|90.0] "Deg" ASDM,PAS
 SG_ ReSideRdrLeDetn34RdrDetnChks : 247|8@0+ (1.0,0.0) [0.0|255.0] "Unitless" ASDM,PAS
 SG_ ReSideRdrLeDetn34RdrDetnCntr : 255|4@0+ (1.0,0.0) [0.0|15.0] "Unitless" ASDM,PAS
 SG_ ReSideRdrLeDetn34RdrDetnConf : 311|7@0+ (1.0,0.0) [0.0|100.0] "%" ASDM,PAS
 SG_ ReSideRdrLeDetn34RdrDetnElevn : 319|5@0+ (1.0,-15.0) [-15.0|15.0] "Deg" ASDM,PAS
 SG_ ReSideRdrLeDetn34RdrDetnPwr : 249|9@0+ (0.1,0.0) [0.0|51.1] "dB" ASDM,PAS
 SG_ ReSideRdrLeDetn34RdrDetnRng : 271|14@0+ (0.02,-1.0) [-1.0|200.0] "m" ASDM,PAS
 SG_ ReSideRdrLeDetn34RdrDetnRngV : 292|13@0+ (0.02,-80.0) [-80.0|80.0] "m/s" ASDM,PAS
 SG_ ReSideRdrLeDetn34RdrDetnSts : 251|2@0+ (1,0) [0|3] "" ASDM,PAS
 SG_ ReSideRdrLeDetn35_UB : 394|1@0+ (1,0) [0|1] "" ASDM,PAS
 SG_ ReSideRdrLeDetn35RdrDetnAzi : 351|11@0+ (0.1,-90.0) [-90.0|90.0] "Deg" ASDM,PAS
 SG_ ReSideRdrLeDetn35RdrDetnChks : 327|8@0+ (1.0,0.0) [0.0|255.0] "Unitless" ASDM,PAS
 SG_ ReSideRdrLeDetn35RdrDetnCntr : 335|4@0+ (1.0,0.0) [0.0|15.0] "Unitless" ASDM,PAS
 SG_ ReSideRdrLeDetn35RdrDetnConf : 391|7@0+ (1.0,0.0) [0.0|100.0] "%" ASDM,PAS
 SG_ ReSideRdrLeDetn35RdrDetnElevn : 399|5@0+ (1.0,-15.0) [-15.0|15.0] "Deg" ASDM,PAS
 SG_ ReSideRdrLeDetn35RdrDetnPwr : 329|9@0+ (0.1,0.0) [0.0|51.1] "dB" ASDM,PAS
 SG_ ReSideRdrLeDetn35RdrDetnRng : 375|14@0+ (0.02,-1.0) [-1.0|200.0] "m" ASDM,PAS
 SG_ ReSideRdrLeDetn35RdrDetnRngV : 356|13@0+ (0.02,-80.0) [-80.0|80.0] "m/s" ASDM,PAS
 SG_ ReSideRdrLeDetn35RdrDetnSts : 331|2@0+ (1,0) [0|3] "" ASDM,PAS
 SG_ ReSideRdrLeDetn36_UB : 474|1@0+ (1,0) [0|1] "" ASDM,PAS
 SG_ ReSideRdrLeDetn36RdrDetnAzi : 447|11@0+ (0.1,-90.0) [-90.0|90.0] "Deg" ASDM,PAS
 SG_ ReSideRdrLeDetn36RdrDetnChks : 407|8@0+ (1.0,0.0) [0.0|255.0] "Unitless" ASDM,PAS
 SG_ ReSideRdrLeDetn36RdrDetnCntr : 415|4@0+ (1.0,0.0) [0.0|15.0] "Unitless" ASDM,PAS
 SG_ ReSideRdrLeDetn36RdrDetnConf : 471|7@0+ (1.0,0.0) [0.0|100.0] "%" ASDM,PAS
 SG_ ReSideRdrLeDetn36RdrDetnElevn : 479|5@0+ (1.0,-15.0) [-15.0|15.0] "Deg" ASDM,PAS
 SG_ ReSideRdrLeDetn36RdrDetnPwr : 409|9@0+ (0.1,0.0) [0.0|51.1] "dB" ASDM,PAS
 SG_ ReSideRdrLeDetn36RdrDetnRng : 431|14@0+ (0.02,-1.0) [-1.0|200.0] "m" ASDM,PAS
 SG_ ReSideRdrLeDetn36RdrDetnRngV : 452|13@0+ (0.02,-80.0) [-80.0|80.0] "m/s" ASDM,PAS
 SG_ ReSideRdrLeDetn36RdrDetnSts : 411|2@0+ (1,0) [0|3] "" ASDM,PAS

// Node Comments
CM_ BU_ ETC "External Tester Connector";

// Signal Comments
CM_ SG_ 288 ADataRawSafeALat "IMU acceleration data Lateral acceleration";
CM_ SG_ 288 ADataRawSafeALat1Qf "IMU acceleration data Quality factor for Lateral acceleration signal";
CM_ SG_ 288 ADataRawSafeALgt "IMU acceleration data Longitudinal acceleration";
CM_ SG_ 288 ADataRawSafeALgt1Qf "IMU acceleration data Quality factor for Longitudinal acceleration";
CM_ SG_ 288 ADataRawSafeAVert "IMU acceleration data Vertical acceleration";
CM_ SG_ 288 ADataRawSafeAVertQf "IMU acceleration data Quality factor for Vertical acceleration";
CM_ SG_ 288 ADataRawSafeChks "IMU acceleration data Check sum";
CM_ SG_ 288 ADataRawSafeCntr "IMU acceleration data Counter";
CM_ SG_ 288 ALgtStdFromWhlSpdALgtStdFromWhlSpd "Longitudinal acceleration over ground.
end2endprotection=profile1A dataid= 12345 Longitudinal acceleration over ground";
CM_ SG_ 288 ALgtStdFromWhlSpdChks "Longitudinal acceleration over ground.
end2endprotection=profile1A dataid=12345 Checksum for longitudinal acceleration over ground";
CM_ SG_ 288 ALgtStdFromWhlSpdCntr "Longitudinal acceleration over ground.
end2endprotection=profile1A dataid=12345 Counter for longitudinal acceleration over ground";
CM_ SG_ 288 ALgtStdFromWhlSpdQf "Longitudinal acceleration over ground.
end2endprotection=profile1A dataid=12345 Qf for longitudinal acceleration over ground";
CM_ SG_ 288 AmbTRawAmbTVal "Unfiltered ambient temp raw data in deg C. Ambient temp value";
CM_ SG_ 288 AmbTRawQly "Unfiltered ambient temp raw data in deg C. Quality Factor of the ambient temp";
CM_ SG_ 288 AsyDataWithCmpSafeALat1Qf "IMU processed special data. Quality factor for Lateral acceleration signal";
CM_ SG_ 288 AsyDataWithCmpSafeALatWithCmp "IMU processed special data.  Compensated Lateral acceleration";
CM_ SG_ 288 AsyDataWithCmpSafeALgt1Qf "IMU processed special data. Quality factor for Longitudinal acceleration";
CM_ SG_ 288 AsyDataWithCmpSafeChks "IMU processed special data. Check sum";
CM_ SG_ 288 AsyDataWithCmpSafeCntr "IMU processed special data. Counter";
CM_ SG_ 288 AsyDataWithCmpSafeGrdtOfALgt "IMU processed special data. Derivative of Longitudinal acceleration";
CM_ SG_ 288 AsyDataWithCmpSafeYawRateQf "IMU processed special data. Quality Factor for Yaw Rate";
CM_ SG_ 288 AsyDataWithCmpSafeYawRateWithCmp "IMU processed special data. Compensated Yaw rate";
CM_ SG_ 288 BkpOfDstTrvld "total traveled distance.";
CM_ SG_ 288 CarTiGlb "Presents a tiime value that shall be used by all ECUs to time-stamp diagnsotic trouble codes (DTC) according to the requirements for Global DTC snapshot data.";
CM_ SG_ 288 DrvModReq "drive mode";
CM_ SG_ 288 PinionSteerAgGroupChks "Checksum for PinionSteerAgGroup";
CM_ SG_ 288 PinionSteerAgGroupCntr "Counter for PinionSteerAgGroup";
CM_ SG_ 288 PinionSteerAgGroupPinionSteerAg1 "Calculated pinion steer angle at the front steering device";
CM_ SG_ 288 PinionSteerAgGroupPinionSteerAg1Qf "Quality factor for PinionSteerAg1";
CM_ SG_ 288 PinionSteerAgGroupPinionSteerAgSpd1 "Calculated pinion steer angle speed at the front steering device ";
CM_ SG_ 288 PinionSteerAgGroupPinionSteerAgSpd1Qf "Quality factor for PinionSteerAgSpd1";
CM_ SG_ 288 PinionSteerAgGroupSteerWhlTq "Torque on steering wheel";
CM_ SG_ 288 PinionSteerAgGroupSteerWhlTqQf "Quality factor for SteerWhlTq";
CM_ SG_ 288 SteerWhlSnsrAg "Actual steering wheel angle from the actual centre position of the steering wheel. ";
CM_ SG_ 288 SteerWhlSnsrAgSpd "Actual steering wheel angle from the actual centre position of the steering wheel. Steering angle speed with steering wheel rotation direction.  ";
CM_ SG_ 288 SteerWhlSnsrChks "Checksum for steering wheel sensor data.";
CM_ SG_ 288 SteerWhlSnsrCntr "Counter value for steering wheel sensor data.";
CM_ SG_ 288 SteerWhlSnsrQf "Qf for steering wheel sensor information";
CM_ SG_ 288 VehBattUSysU "Vehicle System Voltage At 12V side";
CM_ SG_ 288 VehBattUSysUQf "Present vehicle voltage measured by CEM with QF";
CM_ SG_ 288 VehModMngtGlbSafe1CarModSts1 "CarMode Status";
CM_ SG_ 288 VehModMngtGlbSafe1CarModSubtypWdCarModSubtyp "CarMode substate status";
CM_ SG_ 288 VehModMngtGlbSafe1Chks "Checksum";
CM_ SG_ 288 VehModMngtGlbSafe1Cntr "Counter";
CM_ SG_ 288 VehModMngtGlbSafe1EgyLvlElecMai "Main energy level in the vehicle.";
CM_ SG_ 288 VehModMngtGlbSafe1EgyLvlElecSubtyp "Substate of the energy level in the vehicle.";
CM_ SG_ 288 VehModMngtGlbSafe1FltEgyCnsWdSts "High quiescent current detected by CEM via BMS.";
CM_ SG_ 288 VehModMngtGlbSafe1PwrLvlElecMai "Main Power level in the vehicle.";
CM_ SG_ 288 VehModMngtGlbSafe1PwrLvlElecSubtyp "Substate of the power level in the vehicle.";
CM_ SG_ 288 VehModMngtGlbSafe1UsgModSts "UsageMode Status";
CM_ SG_ 288 VehMtnStChks "Vehicle motion state information based on wheel speed sensors. Provides information about vehicle stand still and vehicle rolling direction. Checksum for vehicle motion state";
CM_ SG_ 288 VehMtnStCntr "Vehicle motion state information based on wheel speed sensors. Provides information about vehicle stand still and vehicle rolling direction. Counter for vehicle motion state";
CM_ SG_ 288 VehMtnStVehMtnSt "Vehicle motion state information based on wheel speed sensors. Provides information about vehicle stand still and vehicle rolling direction. Vehicle motion state";
CM_ SG_ 288 VehSpdLgtA "Vehicle speed longitudinal based on wheel speed sensors and longitudinal acceleration.";
CM_ SG_ 288 VehSpdLgtChks "Checksum";
CM_ SG_ 288 VehSpdLgtCntr "Counter";
CM_ SG_ 288 VehSpdLgtQf "Quality factor for vehicle speed as measured by wheel speed sensors and longitudinal acceleration.";
CM_ SG_ 288 WipgInfoWipgSpdInfo "Information regarding how the wipers are run";
CM_ SG_ 288 WipgInfoWiprActv " 0 No wiping, 1 Wiping";
CM_ SG_ 288 WipgInfoWiprInWipgAr " 0 Wiper in lower reversing area or parked, 1 Wiper in wiping area";
CM_ SG_ 1007 ReSideRdrLeVehPrmRdrVehPrmChks "CRC";
CM_ SG_ 1007 ReSideRdrLeVehPrmRdrVehPrmCntr "Counter";
CM_ SG_ 1007 ReSideRdrLeVehPrmRdrVehPrmRdrDynCalPrmForAgOffs "Angle offset due to facia effects";
CM_ SG_ 1007 ReSideRdrLeVehPrmRdrVehPrmRdrDynCalPrmForAxleDstReToVehFrnt "Distance from rear axel to vehicle front";
CM_ SG_ 1007 ReSideRdrLeVehPrmRdrVehPrmRdrDynCalPrmForPinoinAgRat "Ration between pinion angle and wheel angle";
CM_ SG_ 1007 ReSideRdrLeVehPrmRdrVehPrmRdrDynCalPrmForRollAgGain "the compliance of the rear corner suspension";
CM_ SG_ 1007 ReSideRdrLeVehPrmRdrVehPrmRdrDynCalPrmForSnsrDir "Sensor direction in relation to the vehicle driving direction";
CM_ SG_ 1007 ReSideRdrLeVehPrmRdrVehPrmRdrDynCalPrmForSnsrOrntn "Direction of Sensor connector point.";
CM_ SG_ 1007 ReSideRdrLeVehPrmRdrVehPrmRdrDynCalPrmForSnsrPosnLat "Sensor lateral position in relation to the vehicle reference point";
CM_ SG_ 1007 ReSideRdrLeVehPrmRdrVehPrmRdrDynCalPrmForSnsrPosnLgt "Sensor longitudinal position in relation to the vehicle reference point";
CM_ SG_ 1007 ReSideRdrLeVehPrmRdrVehPrmRdrDynCalPrmForSnsrPosnVert "Sensor vertical position in relation to ground";
CM_ SG_ 1007 ReSideRdrLeVehPrmRdrVehPrmRdrDynCalPrmForSnsrRot1 "Sensor rotation";
CM_ SG_ 1007 ReSideRdrLeVehPrmRdrVehPrmRdrDynCalPrmForVehLen "Vehicle length";
CM_ SG_ 1007 ReSideRdrLeVehPrmRdrVehPrmRdrDynCalPrmForVehTyp "Vehicle type";
CM_ SG_ 1007 ReSideRdrLeVehPrmRdrVehPrmRdrDynCalPrmForVehWidth "Vehicle width";
CM_ SG_ 1007 ReSideRdrLeVehPrmRdrVehPrmRdrDynCalPrmForVersMajor "Major version for dynamic calibration parameters.";
CM_ SG_ 1007 ReSideRdrLeVehPrmRdrVehPrmRdrDynCalPrmForVersMinor "Minor version for dynamic calibration parameters";
CM_ SG_ 1007 ReSideRdrLeVehPrmRdrVehPrmRdrDynCalPrmForWhlBas "Vehicle wheel base";
CM_ SG_ 1007 ReSideRdrLeVehPrmRdrVehPrmVld "Validity of data, if it is not valid, then set to 0";
CM_ SG_ 1007 ReSideRdrRiVehPrmRdrVehPrmChks "CRC";
CM_ SG_ 1007 ReSideRdrRiVehPrmRdrVehPrmCntr "Counter";
CM_ SG_ 1007 ReSideRdrRiVehPrmRdrVehPrmRdrDynCalPrmForAgOffs "Angle offset due to facia effects";
CM_ SG_ 1007 ReSideRdrRiVehPrmRdrVehPrmRdrDynCalPrmForAxleDstReToVehFrnt "Distance from rear axel to vehicle front";
CM_ SG_ 1007 ReSideRdrRiVehPrmRdrVehPrmRdrDynCalPrmForPinoinAgRat "Ration between pinion angle and wheel angle";
CM_ SG_ 1007 ReSideRdrRiVehPrmRdrVehPrmRdrDynCalPrmForRollAgGain "the compliance of the rear corner suspension";
CM_ SG_ 1007 ReSideRdrRiVehPrmRdrVehPrmRdrDynCalPrmForSnsrDir "Sensor direction in relation to the vehicle driving direction";
CM_ SG_ 1007 ReSideRdrRiVehPrmRdrVehPrmRdrDynCalPrmForSnsrOrntn "Direction of Sensor connector point.";
CM_ SG_ 1007 ReSideRdrRiVehPrmRdrVehPrmRdrDynCalPrmForSnsrPosnLat "Sensor lateral position in relation to the vehicle reference point";
CM_ SG_ 1007 ReSideRdrRiVehPrmRdrVehPrmRdrDynCalPrmForSnsrPosnLgt "Sensor longitudinal position in relation to the vehicle reference point";
CM_ SG_ 1007 ReSideRdrRiVehPrmRdrVehPrmRdrDynCalPrmForSnsrPosnVert "Sensor vertical position in relation to ground";
CM_ SG_ 1007 ReSideRdrRiVehPrmRdrVehPrmRdrDynCalPrmForSnsrRot1 "Sensor rotation";
CM_ SG_ 1007 ReSideRdrRiVehPrmRdrVehPrmRdrDynCalPrmForVehLen "Vehicle length";
CM_ SG_ 1007 ReSideRdrRiVehPrmRdrVehPrmRdrDynCalPrmForVehTyp "Vehicle type";
CM_ SG_ 1007 ReSideRdrRiVehPrmRdrVehPrmRdrDynCalPrmForVehWidth "Vehicle width";
CM_ SG_ 1007 ReSideRdrRiVehPrmRdrVehPrmRdrDynCalPrmForVersMajor "Major version for dynamic calibration parameters.";
CM_ SG_ 1007 ReSideRdrRiVehPrmRdrVehPrmRdrDynCalPrmForVersMinor "Minor version for dynamic calibration parameters";
CM_ SG_ 1007 ReSideRdrRiVehPrmRdrVehPrmRdrDynCalPrmForWhlBas "Vehicle wheel base";
CM_ SG_ 1007 ReSideRdrRiVehPrmRdrVehPrmVld "Validity of data, if it is not valid, then set to 0";
CM_ SG_ 297 ReSideRdrLeStsForDim "Rear side right radar state information which will be shown on DIM or IHU";
CM_ SG_ 297 ReSideRdrLeStsRdrNrDetn "Number of detections";
CM_ SG_ 297 ReSideRdrLeStsRdrNrObj "Number of objects";
CM_ SG_ 297 ReSideRdrLeStsRdrStsBlkd0bin "Blockage flag for 0bin";
CM_ SG_ 297 ReSideRdrLeStsRdrStsBlkdConf "Confidence of radar blockage";
CM_ SG_ 297 ReSideRdrLeStsRdrStsChks "Checksum";
CM_ SG_ 297 ReSideRdrLeStsRdrStsCntr "Counter";
CM_ SG_ 297 ReSideRdrLeStsRdrStsDstbc "Indication of radar interference, 0 means no interference, 100 means the radar fully saturated from interference";
CM_ SG_ 297 ReSideRdrLeStsRdrStsEna "Indication whether radar functionality is enabled";
CM_ SG_ 297 ReSideRdrLeStsRdrStsFaulty "Indication whether radar is faulty";
CM_ SG_ 297 ReSideRdrLeStsRdrStsIfVersMajor "Interface version major";
CM_ SG_ 297 ReSideRdrLeStsRdrStsIfVersMinor "Interface version major";
CM_ SG_ 297 ReSideRdrLeStsRdrStsLatency "The latency definition is the time instance starting from the end of the last measurement acquisition per cycle to the CAN-FD frames being outputted on the CAN-FD bus. The unit of latency is ms.";
CM_ SG_ 297 ReSideRdrLeStsRdrStsMisAlign "Indication whether 0, calibration not start. After the corner radar is assembled at the factory, RdrStsMisAlign is always in this state until the corner radar been calibrated successfully in factory. If the corner radar calibration failed, RdrStsMisAlign is still in this state. 1, calibration in progress. After the corner radar is calibrated by the factory, RdrStsMisAlign will be transferred to this state. this state has not yet met the state after the Auto-aligment calibration. 2, successfully calibrated. After the vehicle assembled with corner radar is delivered to the user, the user normally travels for several tens of kilometers, and the Auto-aligment condition is satisfied during the driving. When the corner radar calibration accuracy reaches the Auto-aligment calibration state, RdrStsMisAlign will be transferred to this state. 3, misalignment degree is larger than threshold, static calibration fail. 4, can not be calibrated statically cause other reason. 5, auto-calibrate fail (cause misalignment degree is larger than threshold or other reason). 6, misalignment degree is larger than threshold, dynamic calibration fail in factory or after-sales. 7, can not be calibrated dynamically cause other reason.";
CM_ SG_ 297 ReSideRdrLeStsRdrStsMissCom "Signal used to detect missing communication from radar. Reserved/";
CM_ SG_ 297 ReSideRdrLeStsRdrStsSftyFlt "Safety faulty status";
CM_ SG_ 297 ReSideRdrLeStsRdrStsTiStamp "Timestamp";
CM_ SG_ 297 ReSideRdrLeStsRdrStsTiStampStsGlbTiBas "Time synchronization status - synchronized to global time base";
CM_ SG_ 297 ReSideRdrLeStsRdrStsTiStampStsSyncToGatewy "Time synchronization status - synchronized to gateway";
CM_ SG_ 297 ReSideRdrLeStsRdrStsTiStampStsTiLeap "Time synchronization status - time leap";
CM_ SG_ 297 ReSideRdrLeStsRdrStsTiStampStsTiOut "Time synchronization status - time out";
CM_ SG_ 297 ReSideRdrLeStsRdrStsWhlSpdCmpFac "reserved, not use.";
CM_ SG_ 304 ReSideRdrLeDetn1RdrDetnAzi "Azimuth Angle";
CM_ SG_ 304 ReSideRdrLeDetn1RdrDetnChks "CRC";
CM_ SG_ 304 ReSideRdrLeDetn1RdrDetnCntr "Counter";
CM_ SG_ 304 ReSideRdrLeDetn1RdrDetnConf "Quality";
CM_ SG_ 304 ReSideRdrLeDetn1RdrDetnElevn "Elevation Angle";
CM_ SG_ 304 ReSideRdrLeDetn1RdrDetnPwr "Signal noise ratio";
CM_ SG_ 304 ReSideRdrLeDetn1RdrDetnRng "Range";
CM_ SG_ 304 ReSideRdrLeDetn1RdrDetnRngV "Range Velocity";
CM_ SG_ 304 ReSideRdrLeDetn1RdrDetnSts "Detection type";
CM_ SG_ 304 ReSideRdrLeDetn2RdrDetnAzi "Refer to the data element description in ReSideRdrLeDetn1 with the same data element name";
CM_ SG_ 304 ReSideRdrLeDetn2RdrDetnChks "Refer to the data element description in ReSideRdrLeDetn1 with the same data element name";
CM_ SG_ 304 ReSideRdrLeDetn2RdrDetnCntr "Refer to the data element description in ReSideRdrLeDetn1 with the same data element name";
CM_ SG_ 304 ReSideRdrLeDetn2RdrDetnConf "Refer to the data element description in ReSideRdrLeDetn1 with the same data element name";
CM_ SG_ 304 ReSideRdrLeDetn2RdrDetnElevn "Refer to the data element description in ReSideRdrLeDetn1 with the same data element name";
CM_ SG_ 304 ReSideRdrLeDetn2RdrDetnPwr "Refer to the data element description in ReSideRdrLeDetn1 with the same data element name";
CM_ SG_ 304 ReSideRdrLeDetn2RdrDetnRng "Refer to the data element description in ReSideRdrLeDetn1 with the same data element name";
CM_ SG_ 304 ReSideRdrLeDetn2RdrDetnRngV "Range Velocity";
CM_ SG_ 304 ReSideRdrLeDetn2RdrDetnSts "Refer to the data element description in ReSideRdrLeDetn1 with the same data element name";
CM_ SG_ 304 ReSideRdrLeDetn3RdrDetnAzi "Refer to the data element description in ReSideRdrLeDetn1 with the same data element name";
CM_ SG_ 304 ReSideRdrLeDetn3RdrDetnChks "Refer to the data element description in ReSideRdrLeDetn1 with the same data element name";
CM_ SG_ 304 ReSideRdrLeDetn3RdrDetnCntr "Refer to the data element description in ReSideRdrLeDetn1 with the same data element name";
CM_ SG_ 304 ReSideRdrLeDetn3RdrDetnConf "Refer to the data element description in ReSideRdrLeDetn1 with the same data element name";
CM_ SG_ 304 ReSideRdrLeDetn3RdrDetnElevn "Refer to the data element description in ReSideRdrLeDetn1 with the same data element name";
CM_ SG_ 304 ReSideRdrLeDetn3RdrDetnPwr "Refer to the data element description in ReSideRdrLeDetn1 with the same data element name";
CM_ SG_ 304 ReSideRdrLeDetn3RdrDetnRng "Refer to the data element description in ReSideRdrLeDetn1 with the same data element name";
CM_ SG_ 304 ReSideRdrLeDetn3RdrDetnRngV "Range Velocity";
CM_ SG_ 304 ReSideRdrLeDetn3RdrDetnSts "Refer to the data element description in ReSideRdrLeDetn1 with the same data element name";
CM_ SG_ 304 ReSideRdrLeDetn4RdrDetnAzi "Refer to the data element description in ReSideRdrLeDetn1 with the same data element name";
CM_ SG_ 304 ReSideRdrLeDetn4RdrDetnChks "Refer to the data element description in ReSideRdrLeDetn1 with the same data element name";
CM_ SG_ 304 ReSideRdrLeDetn4RdrDetnCntr "Refer to the data element description in ReSideRdrLeDetn1 with the same data element name";
CM_ SG_ 304 ReSideRdrLeDetn4RdrDetnConf "Refer to the data element description in ReSideRdrLeDetn1 with the same data element name";
CM_ SG_ 304 ReSideRdrLeDetn4RdrDetnElevn "Refer to the data element description in ReSideRdrLeDetn1 with the same data element name";
CM_ SG_ 304 ReSideRdrLeDetn4RdrDetnPwr "Refer to the data element description in ReSideRdrLeDetn1 with the same data element name";
CM_ SG_ 304 ReSideRdrLeDetn4RdrDetnRng "Refer to the data element description in ReSideRdrLeDetn1 with the same data element name";
CM_ SG_ 304 ReSideRdrLeDetn4RdrDetnRngV "Range Velocity";
CM_ SG_ 304 ReSideRdrLeDetn4RdrDetnSts "Refer to the data element description in ReSideRdrLeDetn1 with the same data element name";
CM_ SG_ 304 ReSideRdrLeDetn5RdrDetnAzi "Refer to the data element description in ReSideRdrLeDetn1 with the same data element name";
CM_ SG_ 304 ReSideRdrLeDetn5RdrDetnChks "Refer to the data element description in ReSideRdrLeDetn1 with the same data element name";
CM_ SG_ 304 ReSideRdrLeDetn5RdrDetnCntr "Refer to the data element description in ReSideRdrLeDetn1 with the same data element name";
CM_ SG_ 304 ReSideRdrLeDetn5RdrDetnConf "Refer to the data element description in ReSideRdrLeDetn1 with the same data element name";
CM_ SG_ 304 ReSideRdrLeDetn5RdrDetnElevn "Refer to the data element description in ReSideRdrLeDetn1 with the same data element name";
CM_ SG_ 304 ReSideRdrLeDetn5RdrDetnPwr "Refer to the data element description in ReSideRdrLeDetn1 with the same data element name";
CM_ SG_ 304 ReSideRdrLeDetn5RdrDetnRng "Refer to the data element description in ReSideRdrLeDetn1 with the same data element name";
CM_ SG_ 304 ReSideRdrLeDetn5RdrDetnRngV "Range Velocity";
CM_ SG_ 304 ReSideRdrLeDetn5RdrDetnSts "Refer to the data element description in ReSideRdrLeDetn1 with the same data element name";
CM_ SG_ 304 ReSideRdrLeDetn6RdrDetnAzi "Refer to the data element description in ReSideRdrLeDetn1 with the same data element name";
CM_ SG_ 304 ReSideRdrLeDetn6RdrDetnChks "Refer to the data element description in ReSideRdrLeDetn1 with the same data element name";
CM_ SG_ 304 ReSideRdrLeDetn6RdrDetnCntr "Refer to the data element description in ReSideRdrLeDetn1 with the same data element name";
CM_ SG_ 304 ReSideRdrLeDetn6RdrDetnConf "Refer to the data element description in ReSideRdrLeDetn1 with the same data element name";
CM_ SG_ 304 ReSideRdrLeDetn6RdrDetnElevn "Refer to the data element description in ReSideRdrLeDetn1 with the same data element name";
CM_ SG_ 304 ReSideRdrLeDetn6RdrDetnPwr "Refer to the data element description in ReSideRdrLeDetn1 with the same data element name";
CM_ SG_ 304 ReSideRdrLeDetn6RdrDetnRng "Refer to the data element description in ReSideRdrLeDetn1 with the same data element name";
CM_ SG_ 304 ReSideRdrLeDetn6RdrDetnRngV "Range Velocity";
CM_ SG_ 304 ReSideRdrLeDetn6RdrDetnSts "Refer to the data element description in ReSideRdrLeDetn1 with the same data element name";
CM_ SG_ 306 ReSideRdrLeDetn10RdrDetnAzi "Refer to the data element description in ReSideRdrLeDetn1 with the same data element name";
CM_ SG_ 306 ReSideRdrLeDetn10RdrDetnChks "Refer to the data element description in ReSideRdrLeDetn1 with the same data element name";
CM_ SG_ 306 ReSideRdrLeDetn10RdrDetnCntr "Refer to the data element description in ReSideRdrLeDetn1 with the same data element name";
CM_ SG_ 306 ReSideRdrLeDetn10RdrDetnConf "Refer to the data element description in ReSideRdrLeDetn1 with the same data element name";
CM_ SG_ 306 ReSideRdrLeDetn10RdrDetnElevn "Refer to the data element description in ReSideRdrLeDetn1 with the same data element name";
CM_ SG_ 306 ReSideRdrLeDetn10RdrDetnPwr "Refer to the data element description in ReSideRdrLeDetn1 with the same data element name";
CM_ SG_ 306 ReSideRdrLeDetn10RdrDetnRng "Refer to the data element description in ReSideRdrLeDetn1 with the same data element name";
CM_ SG_ 306 ReSideRdrLeDetn10RdrDetnRngV "Range Velocity";
CM_ SG_ 306 ReSideRdrLeDetn10RdrDetnSts "Refer to the data element description in ReSideRdrLeDetn1 with the same data element name";
CM_ SG_ 306 ReSideRdrLeDetn11RdrDetnAzi "Refer to the data element description in ReSideRdrLeDetn1 with the same data element name";
CM_ SG_ 306 ReSideRdrLeDetn11RdrDetnChks "Refer to the data element description in ReSideRdrLeDetn1 with the same data element name";
CM_ SG_ 306 ReSideRdrLeDetn11RdrDetnCntr "Refer to the data element description in ReSideRdrLeDetn1 with the same data element name";
CM_ SG_ 306 ReSideRdrLeDetn11RdrDetnConf "Refer to the data element description in ReSideRdrLeDetn1 with the same data element name";
CM_ SG_ 306 ReSideRdrLeDetn11RdrDetnElevn "Refer to the data element description in ReSideRdrLeDetn1 with the same data element name";
CM_ SG_ 306 ReSideRdrLeDetn11RdrDetnPwr "Refer to the data element description in ReSideRdrLeDetn1 with the same data element name";
CM_ SG_ 306 ReSideRdrLeDetn11RdrDetnRng "Refer to the data element description in ReSideRdrLeDetn1 with the same data element name";
CM_ SG_ 306 ReSideRdrLeDetn11RdrDetnRngV "Range Velocity";
CM_ SG_ 306 ReSideRdrLeDetn11RdrDetnSts "Refer to the data element description in ReSideRdrLeDetn1 with the same data element name";
CM_ SG_ 306 ReSideRdrLeDetn12RdrDetnAzi "Refer to the data element description in ReSideRdrLeDetn1 with the same data element name";
CM_ SG_ 306 ReSideRdrLeDetn12RdrDetnChks "Refer to the data element description in ReSideRdrLeDetn1 with the same data element name";
CM_ SG_ 306 ReSideRdrLeDetn12RdrDetnCntr "Refer to the data element description in ReSideRdrLeDetn1 with the same data element name";
CM_ SG_ 306 ReSideRdrLeDetn12RdrDetnConf "Refer to the data element description in ReSideRdrLeDetn1 with the same data element name";
CM_ SG_ 306 ReSideRdrLeDetn12RdrDetnElevn "Refer to the data element description in ReSideRdrLeDetn1 with the same data element name";
CM_ SG_ 306 ReSideRdrLeDetn12RdrDetnPwr "Refer to the data element description in ReSideRdrLeDetn1 with the same data element name";
CM_ SG_ 306 ReSideRdrLeDetn12RdrDetnRng "Refer to the data element description in ReSideRdrLeDetn1 with the same data element name";
CM_ SG_ 306 ReSideRdrLeDetn12RdrDetnRngV "Range Velocity";
CM_ SG_ 306 ReSideRdrLeDetn12RdrDetnSts "Refer to the data element description in ReSideRdrLeDetn1 with the same data element name";
CM_ SG_ 306 ReSideRdrLeDetn7RdrDetnAzi "Refer to the data element description in ReSideRdrLeDetn1 with the same data element name";
CM_ SG_ 306 ReSideRdrLeDetn7RdrDetnChks "Refer to the data element description in ReSideRdrLeDetn1 with the same data element name";
CM_ SG_ 306 ReSideRdrLeDetn7RdrDetnCntr "Refer to the data element description in ReSideRdrLeDetn1 with the same data element name";
CM_ SG_ 306 ReSideRdrLeDetn7RdrDetnConf "Refer to the data element description in ReSideRdrLeDetn1 with the same data element name";
CM_ SG_ 306 ReSideRdrLeDetn7RdrDetnElevn "Refer to the data element description in ReSideRdrLeDetn1 with the same data element name";
CM_ SG_ 306 ReSideRdrLeDetn7RdrDetnPwr "Refer to the data element description in ReSideRdrLeDetn1 with the same data element name";
CM_ SG_ 306 ReSideRdrLeDetn7RdrDetnRng "Refer to the data element description in ReSideRdrLeDetn1 with the same data element name";
CM_ SG_ 306 ReSideRdrLeDetn7RdrDetnRngV "Range Velocity";
CM_ SG_ 306 ReSideRdrLeDetn7RdrDetnSts "Refer to the data element description in ReSideRdrLeDetn1 with the same data element name";
CM_ SG_ 306 ReSideRdrLeDetn8RdrDetnAzi "Refer to the data element description in ReSideRdrLeDetn1 with the same data element name";
CM_ SG_ 306 ReSideRdrLeDetn8RdrDetnChks "Refer to the data element description in ReSideRdrLeDetn1 with the same data element name";
CM_ SG_ 306 ReSideRdrLeDetn8RdrDetnCntr "Refer to the data element description in ReSideRdrLeDetn1 with the same data element name";
CM_ SG_ 306 ReSideRdrLeDetn8RdrDetnConf "Refer to the data element description in ReSideRdrLeDetn1 with the same data element name";
CM_ SG_ 306 ReSideRdrLeDetn8RdrDetnElevn "Refer to the data element description in ReSideRdrLeDetn1 with the same data element name";
CM_ SG_ 306 ReSideRdrLeDetn8RdrDetnPwr "Refer to the data element description in ReSideRdrLeDetn1 with the same data element name";
CM_ SG_ 306 ReSideRdrLeDetn8RdrDetnRng "Refer to the data element description in ReSideRdrLeDetn1 with the same data element name";
CM_ SG_ 306 ReSideRdrLeDetn8RdrDetnRngV "Range Velocity";
CM_ SG_ 306 ReSideRdrLeDetn8RdrDetnSts "Refer to the data element description in ReSideRdrLeDetn1 with the same data element name";
CM_ SG_ 306 ReSideRdrLeDetn9RdrDetnAzi "Refer to the data element description in ReSideRdrLeDetn1 with the same data element name";
CM_ SG_ 306 ReSideRdrLeDetn9RdrDetnChks "Refer to the data element description in ReSideRdrLeDetn1 with the same data element name";
CM_ SG_ 306 ReSideRdrLeDetn9RdrDetnCntr "Refer to the data element description in ReSideRdrLeDetn1 with the same data element name";
CM_ SG_ 306 ReSideRdrLeDetn9RdrDetnConf "Refer to the data element description in ReSideRdrLeDetn1 with the same data element name";
CM_ SG_ 306 ReSideRdrLeDetn9RdrDetnElevn "Refer to the data element description in ReSideRdrLeDetn1 with the same data element name";
CM_ SG_ 306 ReSideRdrLeDetn9RdrDetnPwr "Refer to the data element description in ReSideRdrLeDetn1 with the same data element name";
CM_ SG_ 306 ReSideRdrLeDetn9RdrDetnRng "Refer to the data element description in ReSideRdrLeDetn1 with the same data element name";
CM_ SG_ 306 ReSideRdrLeDetn9RdrDetnRngV "Range Velocity";
CM_ SG_ 306 ReSideRdrLeDetn9RdrDetnSts "Refer to the data element description in ReSideRdrLeDetn1 with the same data element name";
CM_ SG_ 308 ReSideRdrLeDetn13RdrDetnAzi "Refer to the data element description in ReSideRdrLeDetn1 with the same data element name";
CM_ SG_ 308 ReSideRdrLeDetn13RdrDetnChks "Refer to the data element description in ReSideRdrLeDetn1 with the same data element name";
CM_ SG_ 308 ReSideRdrLeDetn13RdrDetnCntr "Refer to the data element description in ReSideRdrLeDetn1 with the same data element name";
CM_ SG_ 308 ReSideRdrLeDetn13RdrDetnConf "Refer to the data element description in ReSideRdrLeDetn1 with the same data element name";
CM_ SG_ 308 ReSideRdrLeDetn13RdrDetnElevn "Refer to the data element description in ReSideRdrLeDetn1 with the same data element name";
CM_ SG_ 308 ReSideRdrLeDetn13RdrDetnPwr "Refer to the data element description in ReSideRdrLeDetn1 with the same data element name";
CM_ SG_ 308 ReSideRdrLeDetn13RdrDetnRng "Refer to the data element description in ReSideRdrLeDetn1 with the same data element name";
CM_ SG_ 308 ReSideRdrLeDetn13RdrDetnRngV "Range Velocity";
CM_ SG_ 308 ReSideRdrLeDetn13RdrDetnSts "Refer to the data element description in ReSideRdrLeDetn1 with the same data element name";
CM_ SG_ 308 ReSideRdrLeDetn14RdrDetnAzi "Refer to the data element description in ReSideRdrLeDetn1 with the same data element name";
CM_ SG_ 308 ReSideRdrLeDetn14RdrDetnChks "Refer to the data element description in ReSideRdrLeDetn1 with the same data element name";
CM_ SG_ 308 ReSideRdrLeDetn14RdrDetnCntr "Refer to the data element description in ReSideRdrLeDetn1 with the same data element name";
CM_ SG_ 308 ReSideRdrLeDetn14RdrDetnConf "Refer to the data element description in ReSideRdrLeDetn1 with the same data element name";
CM_ SG_ 308 ReSideRdrLeDetn14RdrDetnElevn "Refer to the data element description in ReSideRdrLeDetn1 with the same data element name";
CM_ SG_ 308 ReSideRdrLeDetn14RdrDetnPwr "Refer to the data element description in ReSideRdrLeDetn1 with the same data element name";
CM_ SG_ 308 ReSideRdrLeDetn14RdrDetnRng "Refer to the data element description in ReSideRdrLeDetn1 with the same data element name";
CM_ SG_ 308 ReSideRdrLeDetn14RdrDetnRngV "Range Velocity";
CM_ SG_ 308 ReSideRdrLeDetn14RdrDetnSts "Refer to the data element description in ReSideRdrLeDetn1 with the same data element name";
CM_ SG_ 308 ReSideRdrLeDetn15RdrDetnAzi "Refer to the data element description in ReSideRdrLeDetn1 with the same data element name";
CM_ SG_ 308 ReSideRdrLeDetn15RdrDetnChks "Refer to the data element description in ReSideRdrLeDetn1 with the same data element name";
CM_ SG_ 308 ReSideRdrLeDetn15RdrDetnCntr "Refer to the data element description in ReSideRdrLeDetn1 with the same data element name";
CM_ SG_ 308 ReSideRdrLeDetn15RdrDetnConf "Refer to the data element description in ReSideRdrLeDetn1 with the same data element name";
CM_ SG_ 308 ReSideRdrLeDetn15RdrDetnElevn "Refer to the data element description in ReSideRdrLeDetn1 with the same data element name";
CM_ SG_ 308 ReSideRdrLeDetn15RdrDetnPwr "Refer to the data element description in ReSideRdrLeDetn1 with the same data element name";
CM_ SG_ 308 ReSideRdrLeDetn15RdrDetnRng "Refer to the data element description in ReSideRdrLeDetn1 with the same data element name";
CM_ SG_ 308 ReSideRdrLeDetn15RdrDetnRngV "Range Velocity";
CM_ SG_ 308 ReSideRdrLeDetn15RdrDetnSts "Refer to the data element description in ReSideRdrLeDetn1 with the same data element name";
CM_ SG_ 308 ReSideRdrLeDetn16RdrDetnAzi "Refer to the data element description in ReSideRdrLeDetn1 with the same data element name";
CM_ SG_ 308 ReSideRdrLeDetn16RdrDetnChks "Refer to the data element description in ReSideRdrLeDetn1 with the same data element name";
CM_ SG_ 308 ReSideRdrLeDetn16RdrDetnCntr "Refer to the data element description in ReSideRdrLeDetn1 with the same data element name";
CM_ SG_ 308 ReSideRdrLeDetn16RdrDetnConf "Refer to the data element description in ReSideRdrLeDetn1 with the same data element name";
CM_ SG_ 308 ReSideRdrLeDetn16RdrDetnElevn "Refer to the data element description in ReSideRdrLeDetn1 with the same data element name";
CM_ SG_ 308 ReSideRdrLeDetn16RdrDetnPwr "Refer to the data element description in ReSideRdrLeDetn1 with the same data element name";
CM_ SG_ 308 ReSideRdrLeDetn16RdrDetnRng "Refer to the data element description in ReSideRdrLeDetn1 with the same data element name";
CM_ SG_ 308 ReSideRdrLeDetn16RdrDetnRngV "Range Velocity";
CM_ SG_ 308 ReSideRdrLeDetn16RdrDetnSts "Refer to the data element description in ReSideRdrLeDetn1 with the same data element name";
CM_ SG_ 308 ReSideRdrLeDetn17RdrDetnAzi "Refer to the data element description in ReSideRdrLeDetn1 with the same data element name";
CM_ SG_ 308 ReSideRdrLeDetn17RdrDetnChks "Refer to the data element description in ReSideRdrLeDetn1 with the same data element name";
CM_ SG_ 308 ReSideRdrLeDetn17RdrDetnCntr "Refer to the data element description in ReSideRdrLeDetn1 with the same data element name";
CM_ SG_ 308 ReSideRdrLeDetn17RdrDetnConf "Refer to the data element description in ReSideRdrLeDetn1 with the same data element name";
CM_ SG_ 308 ReSideRdrLeDetn17RdrDetnElevn "Refer to the data element description in ReSideRdrLeDetn1 with the same data element name";
CM_ SG_ 308 ReSideRdrLeDetn17RdrDetnPwr "Refer to the data element description in ReSideRdrLeDetn1 with the same data element name";
CM_ SG_ 308 ReSideRdrLeDetn17RdrDetnRng "Refer to the data element description in ReSideRdrLeDetn1 with the same data element name";
CM_ SG_ 308 ReSideRdrLeDetn17RdrDetnRngV "Range Velocity";
CM_ SG_ 308 ReSideRdrLeDetn17RdrDetnSts "Refer to the data element description in ReSideRdrLeDetn1 with the same data element name";
CM_ SG_ 308 ReSideRdrLeDetn18RdrDetnAzi "Refer to the data element description in ReSideRdrLeDetn1 with the same data element name";
CM_ SG_ 308 ReSideRdrLeDetn18RdrDetnChks "Refer to the data element description in ReSideRdrLeDetn1 with the same data element name";
CM_ SG_ 308 ReSideRdrLeDetn18RdrDetnCntr "Refer to the data element description in ReSideRdrLeDetn1 with the same data element name";
CM_ SG_ 308 ReSideRdrLeDetn18RdrDetnConf "Refer to the data element description in ReSideRdrLeDetn1 with the same data element name";
CM_ SG_ 308 ReSideRdrLeDetn18RdrDetnElevn "Refer to the data element description in ReSideRdrLeDetn1 with the same data element name";
CM_ SG_ 308 ReSideRdrLeDetn18RdrDetnPwr "Refer to the data element description in ReSideRdrLeDetn1 with the same data element name";
CM_ SG_ 308 ReSideRdrLeDetn18RdrDetnRng "Refer to the data element description in ReSideRdrLeDetn1 with the same data element name";
CM_ SG_ 308 ReSideRdrLeDetn18RdrDetnRngV "Range Velocity";
CM_ SG_ 308 ReSideRdrLeDetn18RdrDetnSts "Refer to the data element description in ReSideRdrLeDetn1 with the same data element name";
CM_ SG_ 310 ReSideRdrLeDetn19RdrDetnAzi "Refer to the data element description in ReSideRdrLeDetn1 with the same data element name";
CM_ SG_ 310 ReSideRdrLeDetn19RdrDetnChks "Refer to the data element description in ReSideRdrLeDetn1 with the same data element name";
CM_ SG_ 310 ReSideRdrLeDetn19RdrDetnCntr "Refer to the data element description in ReSideRdrLeDetn1 with the same data element name";
CM_ SG_ 310 ReSideRdrLeDetn19RdrDetnConf "Refer to the data element description in ReSideRdrLeDetn1 with the same data element name";
CM_ SG_ 310 ReSideRdrLeDetn19RdrDetnElevn "Refer to the data element description in ReSideRdrLeDetn1 with the same data element name";
CM_ SG_ 310 ReSideRdrLeDetn19RdrDetnPwr "Refer to the data element description in ReSideRdrLeDetn1 with the same data element name";
CM_ SG_ 310 ReSideRdrLeDetn19RdrDetnRng "Refer to the data element description in ReSideRdrLeDetn1 with the same data element name";
CM_ SG_ 310 ReSideRdrLeDetn19RdrDetnRngV "Range Velocity";
CM_ SG_ 310 ReSideRdrLeDetn19RdrDetnSts "Refer to the data element description in ReSideRdrLeDetn1 with the same data element name";
CM_ SG_ 310 ReSideRdrLeDetn20RdrDetnAzi "Refer to the data element description in ReSideRdrLeDetn1 with the same data element name";
CM_ SG_ 310 ReSideRdrLeDetn20RdrDetnChks "Refer to the data element description in ReSideRdrLeDetn1 with the same data element name";
CM_ SG_ 310 ReSideRdrLeDetn20RdrDetnCntr "Refer to the data element description in ReSideRdrLeDetn1 with the same data element name";
CM_ SG_ 310 ReSideRdrLeDetn20RdrDetnConf "Refer to the data element description in ReSideRdrLeDetn1 with the same data element name";
CM_ SG_ 310 ReSideRdrLeDetn20RdrDetnElevn "Refer to the data element description in ReSideRdrLeDetn1 with the same data element name";
CM_ SG_ 310 ReSideRdrLeDetn20RdrDetnPwr "Refer to the data element description in ReSideRdrLeDetn1 with the same data element name";
CM_ SG_ 310 ReSideRdrLeDetn20RdrDetnRng "Refer to the data element description in ReSideRdrLeDetn1 with the same data element name";
CM_ SG_ 310 ReSideRdrLeDetn20RdrDetnRngV "Range Velocity";
CM_ SG_ 310 ReSideRdrLeDetn20RdrDetnSts "Refer to the data element description in ReSideRdrLeDetn1 with the same data element name";
CM_ SG_ 310 ReSideRdrLeDetn21RdrDetnAzi "Refer to the data element description in ReSideRdrLeDetn1 with the same data element name";
CM_ SG_ 310 ReSideRdrLeDetn21RdrDetnChks "Refer to the data element description in ReSideRdrLeDetn1 with the same data element name";
CM_ SG_ 310 ReSideRdrLeDetn21RdrDetnCntr "Refer to the data element description in ReSideRdrLeDetn1 with the same data element name";
CM_ SG_ 310 ReSideRdrLeDetn21RdrDetnConf "Refer to the data element description in ReSideRdrLeDetn1 with the same data element name";
CM_ SG_ 310 ReSideRdrLeDetn21RdrDetnElevn "Refer to the data element description in ReSideRdrLeDetn1 with the same data element name";
CM_ SG_ 310 ReSideRdrLeDetn21RdrDetnPwr "Refer to the data element description in ReSideRdrLeDetn1 with the same data element name";
CM_ SG_ 310 ReSideRdrLeDetn21RdrDetnRng "Refer to the data element description in ReSideRdrLeDetn1 with the same data element name";
CM_ SG_ 310 ReSideRdrLeDetn21RdrDetnRngV "Range Velocity";
CM_ SG_ 310 ReSideRdrLeDetn21RdrDetnSts "Refer to the data element description in ReSideRdrLeDetn1 with the same data element name";
CM_ SG_ 310 ReSideRdrLeDetn22RdrDetnAzi "Refer to the data element description in ReSideRdrLeDetn1 with the same data element name";
CM_ SG_ 310 ReSideRdrLeDetn22RdrDetnChks "Refer to the data element description in ReSideRdrLeDetn1 with the same data element name";
CM_ SG_ 310 ReSideRdrLeDetn22RdrDetnCntr "Refer to the data element description in ReSideRdrLeDetn1 with the same data element name";
CM_ SG_ 310 ReSideRdrLeDetn22RdrDetnConf "Refer to the data element description in ReSideRdrLeDetn1 with the same data element name";
CM_ SG_ 310 ReSideRdrLeDetn22RdrDetnElevn "Refer to the data element description in ReSideRdrLeDetn1 with the same data element name";
CM_ SG_ 310 ReSideRdrLeDetn22RdrDetnPwr "Refer to the data element description in ReSideRdrLeDetn1 with the same data element name";
CM_ SG_ 310 ReSideRdrLeDetn22RdrDetnRng "Refer to the data element description in ReSideRdrLeDetn1 with the same data element name";
CM_ SG_ 310 ReSideRdrLeDetn22RdrDetnRngV "Range Velocity";
CM_ SG_ 310 ReSideRdrLeDetn22RdrDetnSts "Refer to the data element description in ReSideRdrLeDetn1 with the same data element name";
CM_ SG_ 310 ReSideRdrLeDetn23RdrDetnAzi "Refer to the data element description in ReSideRdrLeDetn1 with the same data element name";
CM_ SG_ 310 ReSideRdrLeDetn23RdrDetnChks "Refer to the data element description in ReSideRdrLeDetn1 with the same data element name";
CM_ SG_ 310 ReSideRdrLeDetn23RdrDetnCntr "Refer to the data element description in ReSideRdrLeDetn1 with the same data element name";
CM_ SG_ 310 ReSideRdrLeDetn23RdrDetnConf "Refer to the data element description in ReSideRdrLeDetn1 with the same data element name";
CM_ SG_ 310 ReSideRdrLeDetn23RdrDetnElevn "Refer to the data element description in ReSideRdrLeDetn1 with the same data element name";
CM_ SG_ 310 ReSideRdrLeDetn23RdrDetnPwr "Refer to the data element description in ReSideRdrLeDetn1 with the same data element name";
CM_ SG_ 310 ReSideRdrLeDetn23RdrDetnRng "Refer to the data element description in ReSideRdrLeDetn1 with the same data element name";
CM_ SG_ 310 ReSideRdrLeDetn23RdrDetnRngV "Range Velocity";
CM_ SG_ 310 ReSideRdrLeDetn23RdrDetnSts "Refer to the data element description in ReSideRdrLeDetn1 with the same data element name";
CM_ SG_ 310 ReSideRdrLeDetn24RdrDetnAzi "Refer to the data element description in ReSideRdrLeDetn1 with the same data element name";
CM_ SG_ 310 ReSideRdrLeDetn24RdrDetnChks "Refer to the data element description in ReSideRdrLeDetn1 with the same data element name";
CM_ SG_ 310 ReSideRdrLeDetn24RdrDetnCntr "Refer to the data element description in ReSideRdrLeDetn1 with the same data element name";
CM_ SG_ 310 ReSideRdrLeDetn24RdrDetnConf "Refer to the data element description in ReSideRdrLeDetn1 with the same data element name";
CM_ SG_ 310 ReSideRdrLeDetn24RdrDetnElevn "Refer to the data element description in ReSideRdrLeDetn1 with the same data element name";
CM_ SG_ 310 ReSideRdrLeDetn24RdrDetnPwr "Refer to the data element description in ReSideRdrLeDetn1 with the same data element name";
CM_ SG_ 310 ReSideRdrLeDetn24RdrDetnRng "Refer to the data element description in ReSideRdrLeDetn1 with the same data element name";
CM_ SG_ 310 ReSideRdrLeDetn24RdrDetnRngV "Range Velocity";
CM_ SG_ 310 ReSideRdrLeDetn24RdrDetnSts "Refer to the data element description in ReSideRdrLeDetn1 with the same data element name";
CM_ SG_ 312 ReSideRdrLeDetn25RdrDetnAzi "Refer to the data element description in ReSideRdrLeDetn1 with the same data element name";
CM_ SG_ 312 ReSideRdrLeDetn25RdrDetnChks "Refer to the data element description in ReSideRdrLeDetn1 with the same data element name";
CM_ SG_ 312 ReSideRdrLeDetn25RdrDetnCntr "Refer to the data element description in ReSideRdrLeDetn1 with the same data element name";
CM_ SG_ 312 ReSideRdrLeDetn25RdrDetnConf "Refer to the data element description in ReSideRdrLeDetn1 with the same data element name";
CM_ SG_ 312 ReSideRdrLeDetn25RdrDetnElevn "Refer to the data element description in ReSideRdrLeDetn1 with the same data element name";
CM_ SG_ 312 ReSideRdrLeDetn25RdrDetnPwr "Refer to the data element description in ReSideRdrLeDetn1 with the same data element name";
CM_ SG_ 312 ReSideRdrLeDetn25RdrDetnRng "Refer to the data element description in ReSideRdrLeDetn1 with the same data element name";
CM_ SG_ 312 ReSideRdrLeDetn25RdrDetnRngV "Range Velocity";
CM_ SG_ 312 ReSideRdrLeDetn25RdrDetnSts "Refer to the data element description in ReSideRdrLeDetn1 with the same data element name";
CM_ SG_ 312 ReSideRdrLeDetn26RdrDetnAzi "Refer to the data element description in ReSideRdrLeDetn1 with the same data element name";
CM_ SG_ 312 ReSideRdrLeDetn26RdrDetnChks "Refer to the data element description in ReSideRdrLeDetn1 with the same data element name";
CM_ SG_ 312 ReSideRdrLeDetn26RdrDetnCntr "Refer to the data element description in ReSideRdrLeDetn1 with the same data element name";
CM_ SG_ 312 ReSideRdrLeDetn26RdrDetnConf "Refer to the data element description in ReSideRdrLeDetn1 with the same data element name";
CM_ SG_ 312 ReSideRdrLeDetn26RdrDetnElevn "Refer to the data element description in ReSideRdrLeDetn1 with the same data element name";
CM_ SG_ 312 ReSideRdrLeDetn26RdrDetnPwr "Refer to the data element description in ReSideRdrLeDetn1 with the same data element name";
CM_ SG_ 312 ReSideRdrLeDetn26RdrDetnRng "Refer to the data element description in ReSideRdrLeDetn1 with the same data element name";
CM_ SG_ 312 ReSideRdrLeDetn26RdrDetnRngV "Range Velocity";
CM_ SG_ 312 ReSideRdrLeDetn26RdrDetnSts "Refer to the data element description in ReSideRdrLeDetn1 with the same data element name";
CM_ SG_ 312 ReSideRdrLeDetn27RdrDetnAzi "Refer to the data element description in ReSideRdrLeDetn1 with the same data element name";
CM_ SG_ 312 ReSideRdrLeDetn27RdrDetnChks "Refer to the data element description in ReSideRdrLeDetn1 with the same data element name";
CM_ SG_ 312 ReSideRdrLeDetn27RdrDetnCntr "Refer to the data element description in ReSideRdrLeDetn1 with the same data element name";
CM_ SG_ 312 ReSideRdrLeDetn27RdrDetnConf "Refer to the data element description in ReSideRdrLeDetn1 with the same data element name";
CM_ SG_ 312 ReSideRdrLeDetn27RdrDetnElevn "Refer to the data element description in ReSideRdrLeDetn1 with the same data element name";
CM_ SG_ 312 ReSideRdrLeDetn27RdrDetnPwr "Refer to the data element description in ReSideRdrLeDetn1 with the same data element name";
CM_ SG_ 312 ReSideRdrLeDetn27RdrDetnRng "Refer to the data element description in ReSideRdrLeDetn1 with the same data element name";
CM_ SG_ 312 ReSideRdrLeDetn27RdrDetnRngV "Range Velocity";
CM_ SG_ 312 ReSideRdrLeDetn27RdrDetnSts "Refer to the data element description in ReSideRdrLeDetn1 with the same data element name";
CM_ SG_ 312 ReSideRdrLeDetn28RdrDetnAzi "Refer to the data element description in ReSideRdrLeDetn1 with the same data element name";
CM_ SG_ 312 ReSideRdrLeDetn28RdrDetnChks "Refer to the data element description in ReSideRdrLeDetn1 with the same data element name";
CM_ SG_ 312 ReSideRdrLeDetn28RdrDetnCntr "Refer to the data element description in ReSideRdrLeDetn1 with the same data element name";
CM_ SG_ 312 ReSideRdrLeDetn28RdrDetnConf "Refer to the data element description in ReSideRdrLeDetn1 with the same data element name";
CM_ SG_ 312 ReSideRdrLeDetn28RdrDetnElevn "Refer to the data element description in ReSideRdrLeDetn1 with the same data element name";
CM_ SG_ 312 ReSideRdrLeDetn28RdrDetnPwr "Refer to the data element description in ReSideRdrLeDetn1 with the same data element name";
CM_ SG_ 312 ReSideRdrLeDetn28RdrDetnRng "Refer to the data element description in ReSideRdrLeDetn1 with the same data element name";
CM_ SG_ 312 ReSideRdrLeDetn28RdrDetnRngV "Range Velocity";
CM_ SG_ 312 ReSideRdrLeDetn28RdrDetnSts "Refer to the data element description in ReSideRdrLeDetn1 with the same data element name";
CM_ SG_ 312 ReSideRdrLeDetn29RdrDetnAzi "Refer to the data element description in ReSideRdrLeDetn1 with the same data element name";
CM_ SG_ 312 ReSideRdrLeDetn29RdrDetnChks "Refer to the data element description in ReSideRdrLeDetn1 with the same data element name";
CM_ SG_ 312 ReSideRdrLeDetn29RdrDetnCntr "Refer to the data element description in ReSideRdrLeDetn1 with the same data element name";
CM_ SG_ 312 ReSideRdrLeDetn29RdrDetnConf "Refer to the data element description in ReSideRdrLeDetn1 with the same data element name";
CM_ SG_ 312 ReSideRdrLeDetn29RdrDetnElevn "Refer to the data element description in ReSideRdrLeDetn1 with the same data element name";
CM_ SG_ 312 ReSideRdrLeDetn29RdrDetnPwr "Refer to the data element description in ReSideRdrLeDetn1 with the same data element name";
CM_ SG_ 312 ReSideRdrLeDetn29RdrDetnRng "Refer to the data element description in ReSideRdrLeDetn1 with the same data element name";
CM_ SG_ 312 ReSideRdrLeDetn29RdrDetnRngV "Range Velocity";
CM_ SG_ 312 ReSideRdrLeDetn29RdrDetnSts "Refer to the data element description in ReSideRdrLeDetn1 with the same data element name";
CM_ SG_ 312 ReSideRdrLeDetn30RdrDetnAzi "Refer to the data element description in ReSideRdrLeDetn1 with the same data element name";
CM_ SG_ 312 ReSideRdrLeDetn30RdrDetnChks "Refer to the data element description in ReSideRdrLeDetn1 with the same data element name";
CM_ SG_ 312 ReSideRdrLeDetn30RdrDetnCntr "Refer to the data element description in ReSideRdrLeDetn1 with the same data element name";
CM_ SG_ 312 ReSideRdrLeDetn30RdrDetnConf "Refer to the data element description in ReSideRdrLeDetn1 with the same data element name";
CM_ SG_ 312 ReSideRdrLeDetn30RdrDetnElevn "Refer to the data element description in ReSideRdrLeDetn1 with the same data element name";
CM_ SG_ 312 ReSideRdrLeDetn30RdrDetnPwr "Refer to the data element description in ReSideRdrLeDetn1 with the same data element name";
CM_ SG_ 312 ReSideRdrLeDetn30RdrDetnRng "Refer to the data element description in ReSideRdrLeDetn1 with the same data element name";
CM_ SG_ 312 ReSideRdrLeDetn30RdrDetnRngV "Range Velocity";
CM_ SG_ 312 ReSideRdrLeDetn30RdrDetnSts "Refer to the data element description in ReSideRdrLeDetn1 with the same data element name";
CM_ SG_ 314 ReSideRdrLeDetn31RdrDetnAzi "Refer to the data element description in ReSideRdrLeDetn1 with the same data element name";
CM_ SG_ 314 ReSideRdrLeDetn31RdrDetnChks "Refer to the data element description in ReSideRdrLeDetn1 with the same data element name";
CM_ SG_ 314 ReSideRdrLeDetn31RdrDetnCntr "Refer to the data element description in ReSideRdrLeDetn1 with the same data element name";
CM_ SG_ 314 ReSideRdrLeDetn31RdrDetnConf "Refer to the data element description in ReSideRdrLeDetn1 with the same data element name";
CM_ SG_ 314 ReSideRdrLeDetn31RdrDetnElevn "Refer to the data element description in ReSideRdrLeDetn1 with the same data element name";
CM_ SG_ 314 ReSideRdrLeDetn31RdrDetnPwr "Refer to the data element description in ReSideRdrLeDetn1 with the same data element name";
CM_ SG_ 314 ReSideRdrLeDetn31RdrDetnRng "Refer to the data element description in ReSideRdrLeDetn1 with the same data element name";
CM_ SG_ 314 ReSideRdrLeDetn31RdrDetnRngV "Range Velocity";
CM_ SG_ 314 ReSideRdrLeDetn31RdrDetnSts "Refer to the data element description in ReSideRdrLeDetn1 with the same data element name";
CM_ SG_ 314 ReSideRdrLeDetn32RdrDetnAzi "Refer to the data element description in ReSideRdrLeDetn1 with the same data element name";
CM_ SG_ 314 ReSideRdrLeDetn32RdrDetnChks "Refer to the data element description in ReSideRdrLeDetn1 with the same data element name";
CM_ SG_ 314 ReSideRdrLeDetn32RdrDetnCntr "Refer to the data element description in ReSideRdrLeDetn1 with the same data element name";
CM_ SG_ 314 ReSideRdrLeDetn32RdrDetnConf "Refer to the data element description in ReSideRdrLeDetn1 with the same data element name";
CM_ SG_ 314 ReSideRdrLeDetn32RdrDetnElevn "Refer to the data element description in ReSideRdrLeDetn1 with the same data element name";
CM_ SG_ 314 ReSideRdrLeDetn32RdrDetnPwr "Refer to the data element description in ReSideRdrLeDetn1 with the same data element name";
CM_ SG_ 314 ReSideRdrLeDetn32RdrDetnRng "Refer to the data element description in ReSideRdrLeDetn1 with the same data element name";
CM_ SG_ 314 ReSideRdrLeDetn32RdrDetnRngV "Range Velocity";
CM_ SG_ 314 ReSideRdrLeDetn32RdrDetnSts "Refer to the data element description in ReSideRdrLeDetn1 with the same data element name";
CM_ SG_ 314 ReSideRdrLeDetn33RdrDetnAzi "Refer to the data element description in ReSideRdrLeDetn1 with the same data element name";
CM_ SG_ 314 ReSideRdrLeDetn33RdrDetnChks "Refer to the data element description in ReSideRdrLeDetn1 with the same data element name";
CM_ SG_ 314 ReSideRdrLeDetn33RdrDetnCntr "Refer to the data element description in ReSideRdrLeDetn1 with the same data element name";
CM_ SG_ 314 ReSideRdrLeDetn33RdrDetnConf "Refer to the data element description in ReSideRdrLeDetn1 with the same data element name";
CM_ SG_ 314 ReSideRdrLeDetn33RdrDetnElevn "Refer to the data element description in ReSideRdrLeDetn1 with the same data element name";
CM_ SG_ 314 ReSideRdrLeDetn33RdrDetnPwr "Refer to the data element description in ReSideRdrLeDetn1 with the same data element name";
CM_ SG_ 314 ReSideRdrLeDetn33RdrDetnRng "Refer to the data element description in ReSideRdrLeDetn1 with the same data element name";
CM_ SG_ 314 ReSideRdrLeDetn33RdrDetnRngV "Range Velocity";
CM_ SG_ 314 ReSideRdrLeDetn33RdrDetnSts "Refer to the data element description in ReSideRdrLeDetn1 with the same data element name";
CM_ SG_ 314 ReSideRdrLeDetn34RdrDetnAzi "Refer to the data element description in ReSideRdrLeDetn1 with the same data element name";
CM_ SG_ 314 ReSideRdrLeDetn34RdrDetnChks "Refer to the data element description in ReSideRdrLeDetn1 with the same data element name";
CM_ SG_ 314 ReSideRdrLeDetn34RdrDetnCntr "Refer to the data element description in ReSideRdrLeDetn1 with the same data element name";
CM_ SG_ 314 ReSideRdrLeDetn34RdrDetnConf "Refer to the data element description in ReSideRdrLeDetn1 with the same data element name";
CM_ SG_ 314 ReSideRdrLeDetn34RdrDetnElevn "Refer to the data element description in ReSideRdrLeDetn1 with the same data element name";
CM_ SG_ 314 ReSideRdrLeDetn34RdrDetnPwr "Refer to the data element description in ReSideRdrLeDetn1 with the same data element name";
CM_ SG_ 314 ReSideRdrLeDetn34RdrDetnRng "Refer to the data element description in ReSideRdrLeDetn1 with the same data element name";
CM_ SG_ 314 ReSideRdrLeDetn34RdrDetnRngV "Range Velocity";
CM_ SG_ 314 ReSideRdrLeDetn34RdrDetnSts "Refer to the data element description in ReSideRdrLeDetn1 with the same data element name";
CM_ SG_ 314 ReSideRdrLeDetn35RdrDetnAzi "Refer to the data element description in ReSideRdrLeDetn1 with the same data element name";
CM_ SG_ 314 ReSideRdrLeDetn35RdrDetnChks "Refer to the data element description in ReSideRdrLeDetn1 with the same data element name";
CM_ SG_ 314 ReSideRdrLeDetn35RdrDetnCntr "Refer to the data element description in ReSideRdrLeDetn1 with the same data element name";
CM_ SG_ 314 ReSideRdrLeDetn35RdrDetnConf "Refer to the data element description in ReSideRdrLeDetn1 with the same data element name";
CM_ SG_ 314 ReSideRdrLeDetn35RdrDetnElevn "Refer to the data element description in ReSideRdrLeDetn1 with the same data element name";
CM_ SG_ 314 ReSideRdrLeDetn35RdrDetnPwr "Refer to the data element description in ReSideRdrLeDetn1 with the same data element name";
CM_ SG_ 314 ReSideRdrLeDetn35RdrDetnRng "Refer to the data element description in ReSideRdrLeDetn1 with the same data element name";
CM_ SG_ 314 ReSideRdrLeDetn35RdrDetnRngV "Range Velocity";
CM_ SG_ 314 ReSideRdrLeDetn35RdrDetnSts "Refer to the data element description in ReSideRdrLeDetn1 with the same data element name";
CM_ SG_ 314 ReSideRdrLeDetn36RdrDetnAzi "Refer to the data element description in ReSideRdrLeDetn1 with the same data element name";
CM_ SG_ 314 ReSideRdrLeDetn36RdrDetnChks "Refer to the data element description in ReSideRdrLeDetn1 with the same data element name";
CM_ SG_ 314 ReSideRdrLeDetn36RdrDetnCntr "Refer to the data element description in ReSideRdrLeDetn1 with the same data element name";
CM_ SG_ 314 ReSideRdrLeDetn36RdrDetnConf "Refer to the data element description in ReSideRdrLeDetn1 with the same data element name";
CM_ SG_ 314 ReSideRdrLeDetn36RdrDetnElevn "Refer to the data element description in ReSideRdrLeDetn1 with the same data element name";
CM_ SG_ 314 ReSideRdrLeDetn36RdrDetnPwr "Refer to the data element description in ReSideRdrLeDetn1 with the same data element name";
CM_ SG_ 314 ReSideRdrLeDetn36RdrDetnRng "Refer to the data element description in ReSideRdrLeDetn1 with the same data element name";
CM_ SG_ 314 ReSideRdrLeDetn36RdrDetnRngV "Range Velocity";
CM_ SG_ 314 ReSideRdrLeDetn36RdrDetnSts "Refer to the data element description in ReSideRdrLeDetn1 with the same data element name";

// Attribute definitions
BA_DEF_  "Baudrate" INT 1000 1000000; // [bps]
BA_DEF_  "BaudRateCANFD" FLOAT 1000 10000000; // [bps]
BA_DEF_ BO_ "VFrameFormat" ENUM "StandardCAN","ExtendedCAN","reserved","J1939PG","reserved","reserved","reserved","reserved","reserved","reserved","reserved","reserved","reserved","reserved","StandardCAN_FD","ExtendedCAN_FD";
BA_DEF_ BO_ "CANFD_BRS" ENUM "0","1";
BA_DEF_ BO_ "GenMsgSendType" ENUM "cyclic", "spontaneous", "not-used", "not-used", "not-used", "cyclicAndSpontaneous", "not-used", "cyclicIfActive", "NoMsgSendType"; // [us]
BA_DEF_ BO_ "GenMsgCycleTime" INT 0 65536; // [ms]
BA_DEF_ BO_ "GenMsgStartDelayTime" INT 0 65536; // [ms]
BA_DEF_ BO_ "GenMsgDelayTime" INT 0 65536; // [ms]
BA_DEF_ SG_ "GenSigSendType" ENUM "Cyclic","OnWrite","OnWriteWithRepetition","OnChange","OnChangeWithRepetition","IfActive","IfActiveWithRepetition","NoSigSendType";
BA_DEF_ SG_ "GenSigStartValue" HEX 0 80000000;
BA_DEF_ BU_ "NmAsrNodeIdentifier" INT 0 255;
BA_DEF_  "DBName" STRING;
BA_DEF_  "BusType" STRING;
BA_DEF_  "ProtocolType" STRING;
BA_DEF_ BO_ "GenMsgILSupport" ENUM "No","Yes";
BA_DEF_ BO_ "NmAsrMessage" ENUM "No","Yes";
BA_DEF_  "NmAsrBaseAddress" HEX 0 536870911;
BA_DEF_  "NmAsrMessageCount" INT 0 255;
BA_DEF_ BU_ "NodeLayerModules" STRING;
BA_DEF_ BU_ "NmAsrNode" ENUM "No","Yes";
BA_DEF_ BU_ "ILused" ENUM "No","Yes";
BA_DEF_ SG_ "GenSigFuncType" ENUM "NoFunction","n/a","n/a","n/a","n/a","n/a","n/a","n/a","n/a","n/a","n/a","n/a","n/a","n/a","n/a","CHK","CNTR","n/a","n/a","n/a","CNTR_AR_01","CRC_AR_01_BOTH","CRC_AR_01_ALT","CRC_AR_01_LOW","CRC_AR_01_NIBBLE","CNTR_AR_04","CRC_AR_04A","CNTR_AR_05","CRC_AR_05";
BA_DEF_ SG_ "GenSigDataID" STRING;

BA_DEF_DEF_ "VFrameFormat" "J1939PG";
BA_DEF_DEF_ "CANFD_BRS" "1";
BA_DEF_DEF_ "GenSigStartValue" 0;
BA_DEF_DEF_ "GenSigSendType" "NoSigSendType";
BA_DEF_DEF_ "DBName" "";
BA_DEF_DEF_ "BusType" "";
BA_DEF_DEF_ "ProtocolType" "";
BA_DEF_DEF_ "GenMsgCycleTime" 0;
BA_DEF_DEF_ "GenMsgDelayTime" 0;
BA_DEF_DEF_ "GenMsgStartDelayTime" 0;
BA_DEF_DEF_ "GenMsgSendType" "NoMsgSendType";
BA_DEF_DEF_ "GenMsgILSupport" "Yes";
BA_DEF_DEF_ "NmAsrMessage" "No";
BA_DEF_DEF_ "NmAsrBaseAddress" 1280;
BA_DEF_DEF_ "NmAsrMessageCount" 64;
BA_DEF_DEF_ "NodeLayerModules" "CANoeILNLSPA.dll";
BA_DEF_DEF_ "NmAsrNode" "No";
BA_DEF_DEF_ "NmAsrNodeIdentifier" 0;
BA_DEF_DEF_ "ILused" "Yes";
BA_DEF_DEF_ "GenSigFuncType" "NoFunction";
BA_DEF_DEF_ "GenSigDataID" "";

// Network
BA_ "DBName" "SafetyCANFD3";
BA_ "BusType" "CAN FD";
BA_ "ProtocolType" "CAN";
BA_ "Baudrate" 500000;
BA_ "BaudRateCANFD" 2000000;
// ECU: ASDM
BA_ "NmAsrNodeIdentifier" BU_ ASDM 1;
BA_ "NmAsrNode" BU_ ASDM 1;
BA_ "NodeLayerModules" BU_ ASDM "CANoeILNLSPA.dll,AsrNM33.dll";
// ECU: ETC
BA_ "ILused" BU_ ETC 0;
// ECU: PAS
BA_ "ILused" BU_ PAS 0;
// ECU: SODL
BA_ "NmAsrNodeIdentifier" BU_ SODL 2;
BA_ "NmAsrNode" BU_ SODL 1;
BA_ "NodeLayerModules" BU_ SODL "CANoeILNLSPA.dll,AsrNM33.dll";
// ECU: SODR
BA_ "NmAsrNodeIdentifier" BU_ SODR 3;
BA_ "NmAsrNode" BU_ SODR 1;
BA_ "NodeLayerModules" BU_ SODR "CANoeILNLSPA.dll,AsrNM33.dll";
// Frame: ASDMCanFD3TimeSynchFr
BA_ "VFrameFormat" BO_ 33 14;
BA_ "GenMsgSendType" BO_ 33 1;
BA_ "GenMsgDelayTime" BO_ 33 50.000;
// Frame: ASDMSafetyCANFD3Frame1
BA_ "VFrameFormat" BO_ 288 14;
BA_ "GenMsgSendType" BO_ 288 0;
BA_ "GenMsgCycleTime" BO_ 288 50.000;
BA_ "GenSigSendType" SG_ 288 ADataRawSafeALat 0;
BA_ "GenSigStartValue" SG_ 288 ADataRawSafeALat1Qf 1;
BA_ "GenSigSendType" SG_ 288 ADataRawSafeALat1Qf 0;
BA_ "GenSigSendType" SG_ 288 ADataRawSafeALgt 0;
BA_ "GenSigStartValue" SG_ 288 ADataRawSafeALgt1Qf 1;
BA_ "GenSigSendType" SG_ 288 ADataRawSafeALgt1Qf 0;
BA_ "GenSigStartValue" SG_ 288 ADataRawSafeAVert 1155.059;
BA_ "GenSigSendType" SG_ 288 ADataRawSafeAVert 0;
BA_ "GenSigStartValue" SG_ 288 ADataRawSafeAVertQf 1;
BA_ "GenSigSendType" SG_ 288 ADataRawSafeAVertQf 0;
BA_ "GenSigStartValue" SG_ 288 ADataRawSafeChks 255;
BA_ "GenSigSendType" SG_ 288 ADataRawSafeChks 0;
BA_ "GenSigFuncType" SG_ 288 ADataRawSafeChks 15;
BA_ "GenSigDataID" SG_ 288 ADataRawSafeChks "0x22";
BA_ "GenSigSendType" SG_ 288 ADataRawSafeCntr 0;
BA_ "GenSigFuncType" SG_ 288 ADataRawSafeCntr 16;
BA_ "GenSigSendType" SG_ 288 ALgtStdFromWhlSpdALgtStdFromWhlSpd 0;
BA_ "GenSigSendType" SG_ 288 ALgtStdFromWhlSpdChks 0;
BA_ "GenSigFuncType" SG_ 288 ALgtStdFromWhlSpdChks 15;
BA_ "GenSigDataID" SG_ 288 ALgtStdFromWhlSpdChks "0x34";
BA_ "GenSigSendType" SG_ 288 ALgtStdFromWhlSpdCntr 0;
BA_ "GenSigFuncType" SG_ 288 ALgtStdFromWhlSpdCntr 16;
BA_ "GenSigStartValue" SG_ 288 ALgtStdFromWhlSpdQf 1;
BA_ "GenSigSendType" SG_ 288 ALgtStdFromWhlSpdQf 0;
BA_ "GenSigStartValue" SG_ 288 AmbTRawAmbTVal 700;
BA_ "GenSigSendType" SG_ 288 AmbTRawAmbTVal 0;
BA_ "GenSigSendType" SG_ 288 AmbTRawQly 0;
BA_ "GenSigStartValue" SG_ 288 AsyDataWithCmpSafeALat1Qf 1;
BA_ "GenSigSendType" SG_ 288 AsyDataWithCmpSafeALat1Qf 0;
BA_ "GenSigSendType" SG_ 288 AsyDataWithCmpSafeALatWithCmp 0;
BA_ "GenSigStartValue" SG_ 288 AsyDataWithCmpSafeALgt1Qf 1;
BA_ "GenSigSendType" SG_ 288 AsyDataWithCmpSafeALgt1Qf 0;
BA_ "GenSigStartValue" SG_ 288 AsyDataWithCmpSafeChks 255;
BA_ "GenSigSendType" SG_ 288 AsyDataWithCmpSafeChks 0;
BA_ "GenSigFuncType" SG_ 288 AsyDataWithCmpSafeChks 15;
BA_ "GenSigDataID" SG_ 288 AsyDataWithCmpSafeChks "0x24";
BA_ "GenSigSendType" SG_ 288 AsyDataWithCmpSafeCntr 0;
BA_ "GenSigFuncType" SG_ 288 AsyDataWithCmpSafeCntr 16;
BA_ "GenSigSendType" SG_ 288 AsyDataWithCmpSafeGrdtOfALgt 0;
BA_ "GenSigStartValue" SG_ 288 AsyDataWithCmpSafeYawRateQf 1;
BA_ "GenSigSendType" SG_ 288 AsyDataWithCmpSafeYawRateQf 0;
BA_ "GenSigSendType" SG_ 288 AsyDataWithCmpSafeYawRateWithCmp 0;
BA_ "GenSigSendType" SG_ 288 BkpOfDstTrvld 0;
BA_ "GenSigSendType" SG_ 288 CarTiGlb 0;
BA_ "GenSigSendType" SG_ 288 DrvModReq 0;
BA_ "GenSigSendType" SG_ 288 PinionSteerAgGroupChks 0;
BA_ "GenSigFuncType" SG_ 288 PinionSteerAgGroupChks 15;
BA_ "GenSigDataID" SG_ 288 PinionSteerAgGroupChks "0x40D";
BA_ "GenSigSendType" SG_ 288 PinionSteerAgGroupCntr 0;
BA_ "GenSigFuncType" SG_ 288 PinionSteerAgGroupCntr 16;
BA_ "GenSigSendType" SG_ 288 PinionSteerAgGroupPinionSteerAg1 0;
BA_ "GenSigStartValue" SG_ 288 PinionSteerAgGroupPinionSteerAg1Qf 1;
BA_ "GenSigSendType" SG_ 288 PinionSteerAgGroupPinionSteerAg1Qf 0;
BA_ "GenSigSendType" SG_ 288 PinionSteerAgGroupPinionSteerAgSpd1 0;
BA_ "GenSigStartValue" SG_ 288 PinionSteerAgGroupPinionSteerAgSpd1Qf 1;
BA_ "GenSigSendType" SG_ 288 PinionSteerAgGroupPinionSteerAgSpd1Qf 0;
BA_ "GenSigSendType" SG_ 288 PinionSteerAgGroupSteerWhlTq 0;
BA_ "GenSigStartValue" SG_ 288 PinionSteerAgGroupSteerWhlTqQf 1;
BA_ "GenSigSendType" SG_ 288 PinionSteerAgGroupSteerWhlTqQf 0;
BA_ "GenSigSendType" SG_ 288 SteerWhlSnsrAg 0;
BA_ "GenSigSendType" SG_ 288 SteerWhlSnsrAgSpd 0;
BA_ "GenSigSendType" SG_ 288 SteerWhlSnsrChks 0;
BA_ "GenSigFuncType" SG_ 288 SteerWhlSnsrChks 15;
BA_ "GenSigDataID" SG_ 288 SteerWhlSnsrChks "0x33";
BA_ "GenSigSendType" SG_ 288 SteerWhlSnsrCntr 0;
BA_ "GenSigFuncType" SG_ 288 SteerWhlSnsrCntr 16;
BA_ "GenSigStartValue" SG_ 288 SteerWhlSnsrQf 1;
BA_ "GenSigSendType" SG_ 288 SteerWhlSnsrQf 0;
BA_ "GenSigSendType" SG_ 288 VehBattUSysU 0;
BA_ "GenSigStartValue" SG_ 288 VehBattUSysUQf 1;
BA_ "GenSigSendType" SG_ 288 VehBattUSysUQf 0;
BA_ "GenSigSendType" SG_ 288 VehModMngtGlbSafe1CarModSts1 0;
BA_ "GenSigSendType" SG_ 288 VehModMngtGlbSafe1CarModSubtypWdCarModSubtyp 0;
BA_ "GenSigSendType" SG_ 288 VehModMngtGlbSafe1Chks 0;
BA_ "GenSigFuncType" SG_ 288 VehModMngtGlbSafe1Chks 15;
BA_ "GenSigDataID" SG_ 288 VehModMngtGlbSafe1Chks "0x74";
BA_ "GenSigSendType" SG_ 288 VehModMngtGlbSafe1Cntr 0;
BA_ "GenSigFuncType" SG_ 288 VehModMngtGlbSafe1Cntr 16;
BA_ "GenSigSendType" SG_ 288 VehModMngtGlbSafe1EgyLvlElecMai 0;
BA_ "GenSigSendType" SG_ 288 VehModMngtGlbSafe1EgyLvlElecSubtyp 0;
BA_ "GenSigSendType" SG_ 288 VehModMngtGlbSafe1FltEgyCnsWdSts 0;
BA_ "GenSigSendType" SG_ 288 VehModMngtGlbSafe1PwrLvlElecMai 0;
BA_ "GenSigSendType" SG_ 288 VehModMngtGlbSafe1PwrLvlElecSubtyp 0;
BA_ "GenSigStartValue" SG_ 288 VehModMngtGlbSafe1UsgModSts 1;
BA_ "GenSigSendType" SG_ 288 VehModMngtGlbSafe1UsgModSts 0;
BA_ "GenSigSendType" SG_ 288 VehMtnStChks 0;
BA_ "GenSigFuncType" SG_ 288 VehMtnStChks 15;
BA_ "GenSigDataID" SG_ 288 VehMtnStChks "0x36";
BA_ "GenSigSendType" SG_ 288 VehMtnStCntr 0;
BA_ "GenSigFuncType" SG_ 288 VehMtnStCntr 16;
BA_ "GenSigSendType" SG_ 288 VehMtnStVehMtnSt 0;
BA_ "GenSigSendType" SG_ 288 VehSpdLgtA 0;
BA_ "GenSigSendType" SG_ 288 VehSpdLgtChks 0;
BA_ "GenSigFuncType" SG_ 288 VehSpdLgtChks 15;
BA_ "GenSigDataID" SG_ 288 VehSpdLgtChks "0x37";
BA_ "GenSigSendType" SG_ 288 VehSpdLgtCntr 0;
BA_ "GenSigFuncType" SG_ 288 VehSpdLgtCntr 16;
BA_ "GenSigStartValue" SG_ 288 VehSpdLgtQf 1;
BA_ "GenSigSendType" SG_ 288 VehSpdLgtQf 0;
BA_ "GenSigSendType" SG_ 288 WipgInfoWipgSpdInfo 0;
BA_ "GenSigSendType" SG_ 288 WipgInfoWiprActv 0;
BA_ "GenSigSendType" SG_ 288 WipgInfoWiprInWipgAr 0;
// Frame: ASDMSafetyCANFD3Frame2
BA_ "VFrameFormat" BO_ 1007 14;
BA_ "GenMsgSendType" BO_ 1007 0;
BA_ "GenMsgCycleTime" BO_ 1007 500.000;
BA_ "GenSigSendType" SG_ 1007 ReSideRdrLeVehPrmRdrVehPrmChks 0;
BA_ "GenSigFuncType" SG_ 1007 ReSideRdrLeVehPrmRdrVehPrmChks 15;
BA_ "GenSigDataID" SG_ 1007 ReSideRdrLeVehPrmRdrVehPrmChks "0x811";
BA_ "GenSigSendType" SG_ 1007 ReSideRdrLeVehPrmRdrVehPrmCntr 0;
BA_ "GenSigFuncType" SG_ 1007 ReSideRdrLeVehPrmRdrVehPrmCntr 16;
BA_ "GenSigStartValue" SG_ 1007 ReSideRdrLeVehPrmRdrVehPrmRdrDynCalPrmForAgOffs 128;
BA_ "GenSigSendType" SG_ 1007 ReSideRdrLeVehPrmRdrVehPrmRdrDynCalPrmForAgOffs 0;
BA_ "GenSigStartValue" SG_ 1007 ReSideRdrLeVehPrmRdrVehPrmRdrDynCalPrmForAxleDstReToVehFrnt 250;
BA_ "GenSigSendType" SG_ 1007 ReSideRdrLeVehPrmRdrVehPrmRdrDynCalPrmForAxleDstReToVehFrnt 0;
BA_ "GenSigStartValue" SG_ 1007 ReSideRdrLeVehPrmRdrVehPrmRdrDynCalPrmForPinoinAgRat 140;
BA_ "GenSigSendType" SG_ 1007 ReSideRdrLeVehPrmRdrVehPrmRdrDynCalPrmForPinoinAgRat 0;
BA_ "GenSigStartValue" SG_ 1007 ReSideRdrLeVehPrmRdrVehPrmRdrDynCalPrmForRollAgGain 50;
BA_ "GenSigSendType" SG_ 1007 ReSideRdrLeVehPrmRdrVehPrmRdrDynCalPrmForRollAgGain 0;
BA_ "GenSigSendType" SG_ 1007 ReSideRdrLeVehPrmRdrVehPrmRdrDynCalPrmForSnsrDir 0;
BA_ "GenSigSendType" SG_ 1007 ReSideRdrLeVehPrmRdrVehPrmRdrDynCalPrmForSnsrOrntn 0;
BA_ "GenSigStartValue" SG_ 1007 ReSideRdrLeVehPrmRdrVehPrmRdrDynCalPrmForSnsrPosnLat 2000;
BA_ "GenSigSendType" SG_ 1007 ReSideRdrLeVehPrmRdrVehPrmRdrDynCalPrmForSnsrPosnLat 0;
BA_ "GenSigStartValue" SG_ 1007 ReSideRdrLeVehPrmRdrVehPrmRdrDynCalPrmForSnsrPosnLgt 5000;
BA_ "GenSigSendType" SG_ 1007 ReSideRdrLeVehPrmRdrVehPrmRdrDynCalPrmForSnsrPosnLgt 0;
BA_ "GenSigSendType" SG_ 1007 ReSideRdrLeVehPrmRdrVehPrmRdrDynCalPrmForSnsrPosnVert 0;
BA_ "GenSigStartValue" SG_ 1007 ReSideRdrLeVehPrmRdrVehPrmRdrDynCalPrmForSnsrRot1 900;
BA_ "GenSigSendType" SG_ 1007 ReSideRdrLeVehPrmRdrVehPrmRdrDynCalPrmForSnsrRot1 0;
BA_ "GenSigStartValue" SG_ 1007 ReSideRdrLeVehPrmRdrVehPrmRdrDynCalPrmForVehLen 500;
BA_ "GenSigSendType" SG_ 1007 ReSideRdrLeVehPrmRdrVehPrmRdrDynCalPrmForVehLen 0;
BA_ "GenSigSendType" SG_ 1007 ReSideRdrLeVehPrmRdrVehPrmRdrDynCalPrmForVehTyp 0;
BA_ "GenSigStartValue" SG_ 1007 ReSideRdrLeVehPrmRdrVehPrmRdrDynCalPrmForVehWidth 200;
BA_ "GenSigSendType" SG_ 1007 ReSideRdrLeVehPrmRdrVehPrmRdrDynCalPrmForVehWidth 0;
BA_ "GenSigSendType" SG_ 1007 ReSideRdrLeVehPrmRdrVehPrmRdrDynCalPrmForVersMajor 0;
BA_ "GenSigSendType" SG_ 1007 ReSideRdrLeVehPrmRdrVehPrmRdrDynCalPrmForVersMinor 0;
BA_ "GenSigSendType" SG_ 1007 ReSideRdrLeVehPrmRdrVehPrmRdrDynCalPrmForWhlBas 0;
BA_ "GenSigSendType" SG_ 1007 ReSideRdrLeVehPrmRdrVehPrmVld 0;
BA_ "GenSigSendType" SG_ 1007 ReSideRdrRiVehPrmRdrVehPrmChks 0;
BA_ "GenSigFuncType" SG_ 1007 ReSideRdrRiVehPrmRdrVehPrmChks 15;
BA_ "GenSigDataID" SG_ 1007 ReSideRdrRiVehPrmRdrVehPrmChks "0x812";
BA_ "GenSigSendType" SG_ 1007 ReSideRdrRiVehPrmRdrVehPrmCntr 0;
BA_ "GenSigFuncType" SG_ 1007 ReSideRdrRiVehPrmRdrVehPrmCntr 16;
BA_ "GenSigStartValue" SG_ 1007 ReSideRdrRiVehPrmRdrVehPrmRdrDynCalPrmForAgOffs 128;
BA_ "GenSigSendType" SG_ 1007 ReSideRdrRiVehPrmRdrVehPrmRdrDynCalPrmForAgOffs 0;
BA_ "GenSigStartValue" SG_ 1007 ReSideRdrRiVehPrmRdrVehPrmRdrDynCalPrmForAxleDstReToVehFrnt 250;
BA_ "GenSigSendType" SG_ 1007 ReSideRdrRiVehPrmRdrVehPrmRdrDynCalPrmForAxleDstReToVehFrnt 0;
BA_ "GenSigStartValue" SG_ 1007 ReSideRdrRiVehPrmRdrVehPrmRdrDynCalPrmForPinoinAgRat 140;
BA_ "GenSigSendType" SG_ 1007 ReSideRdrRiVehPrmRdrVehPrmRdrDynCalPrmForPinoinAgRat 0;
BA_ "GenSigStartValue" SG_ 1007 ReSideRdrRiVehPrmRdrVehPrmRdrDynCalPrmForRollAgGain 50;
BA_ "GenSigSendType" SG_ 1007 ReSideRdrRiVehPrmRdrVehPrmRdrDynCalPrmForRollAgGain 0;
BA_ "GenSigSendType" SG_ 1007 ReSideRdrRiVehPrmRdrVehPrmRdrDynCalPrmForSnsrDir 0;
BA_ "GenSigSendType" SG_ 1007 ReSideRdrRiVehPrmRdrVehPrmRdrDynCalPrmForSnsrOrntn 0;
BA_ "GenSigStartValue" SG_ 1007 ReSideRdrRiVehPrmRdrVehPrmRdrDynCalPrmForSnsrPosnLat 2000;
BA_ "GenSigSendType" SG_ 1007 ReSideRdrRiVehPrmRdrVehPrmRdrDynCalPrmForSnsrPosnLat 0;
BA_ "GenSigStartValue" SG_ 1007 ReSideRdrRiVehPrmRdrVehPrmRdrDynCalPrmForSnsrPosnLgt 5000;
BA_ "GenSigSendType" SG_ 1007 ReSideRdrRiVehPrmRdrVehPrmRdrDynCalPrmForSnsrPosnLgt 0;
BA_ "GenSigSendType" SG_ 1007 ReSideRdrRiVehPrmRdrVehPrmRdrDynCalPrmForSnsrPosnVert 0;
BA_ "GenSigStartValue" SG_ 1007 ReSideRdrRiVehPrmRdrVehPrmRdrDynCalPrmForSnsrRot1 900;
BA_ "GenSigSendType" SG_ 1007 ReSideRdrRiVehPrmRdrVehPrmRdrDynCalPrmForSnsrRot1 0;
BA_ "GenSigStartValue" SG_ 1007 ReSideRdrRiVehPrmRdrVehPrmRdrDynCalPrmForVehLen 500;
BA_ "GenSigSendType" SG_ 1007 ReSideRdrRiVehPrmRdrVehPrmRdrDynCalPrmForVehLen 0;
BA_ "GenSigSendType" SG_ 1007 ReSideRdrRiVehPrmRdrVehPrmRdrDynCalPrmForVehTyp 0;
BA_ "GenSigStartValue" SG_ 1007 ReSideRdrRiVehPrmRdrVehPrmRdrDynCalPrmForVehWidth 200;
BA_ "GenSigSendType" SG_ 1007 ReSideRdrRiVehPrmRdrVehPrmRdrDynCalPrmForVehWidth 0;
BA_ "GenSigSendType" SG_ 1007 ReSideRdrRiVehPrmRdrVehPrmRdrDynCalPrmForVersMajor 0;
BA_ "GenSigSendType" SG_ 1007 ReSideRdrRiVehPrmRdrVehPrmRdrDynCalPrmForVersMinor 0;
BA_ "GenSigSendType" SG_ 1007 ReSideRdrRiVehPrmRdrVehPrmRdrDynCalPrmForWhlBas 0;
BA_ "GenSigSendType" SG_ 1007 ReSideRdrRiVehPrmRdrVehPrmVld 0;
// Frame: AsdmSafetyCanFD3NmFr
BA_ "VFrameFormat" BO_ 1281 0;
BA_ "GenMsgSendType" BO_ 1281 1;
BA_ "GenMsgDelayTime" BO_ 1281 20.000;
BA_ "GenMsgILSupport" BO_ 1281 0;
BA_ "NmAsrMessage" BO_ 1281 1;
// Frame: AsdmToAllFuncSafetyCanFD3DiagReqFrame1
BA_ "VFrameFormat" BO_ 2047 14;
BA_ "GenMsgSendType" BO_ 2047 1;
BA_ "GenMsgDelayTime" BO_ 2047 5.000;
// Frame: AsdmToSodlSafetyCanFD3DiagReqFrame1
BA_ "VFrameFormat" BO_ 1872 14;
BA_ "GenMsgSendType" BO_ 1872 1;
BA_ "GenMsgDelayTime" BO_ 1872 5.000;
// Frame: AsdmToSodrSafetyCanFD3DiagReqFrame1
BA_ "VFrameFormat" BO_ 1873 14;
BA_ "GenMsgSendType" BO_ 1873 1;
BA_ "GenMsgDelayTime" BO_ 1873 5.000;
// Frame: EtcToSodlXcpFr01
BA_ "VFrameFormat" BO_ 1409 0;
BA_ "GenMsgSendType" BO_ 1409 1;
BA_ "GenMsgDelayTime" BO_ 1409 10.000;
// Frame: EtcToSodrXcpFr01
BA_ "VFrameFormat" BO_ 1410 0;
BA_ "GenMsgSendType" BO_ 1410 1;
BA_ "GenMsgDelayTime" BO_ 1410 10.000;
// Frame: SODLSafetyCANFD3Frame00
BA_ "VFrameFormat" BO_ 297 14;
BA_ "GenMsgSendType" BO_ 297 0;
BA_ "GenMsgCycleTime" BO_ 297 50.000;
BA_ "GenSigStartValue" SG_ 297 ReSideRdrLeStsForDim 1;
BA_ "GenSigSendType" SG_ 297 ReSideRdrLeStsForDim 0;
BA_ "GenSigSendType" SG_ 297 ReSideRdrLeStsRdrNrDetn 0;
BA_ "GenSigSendType" SG_ 297 ReSideRdrLeStsRdrNrObj 0;
BA_ "GenSigSendType" SG_ 297 ReSideRdrLeStsRdrStsBlkd0bin 0;
BA_ "GenSigSendType" SG_ 297 ReSideRdrLeStsRdrStsBlkdConf 0;
BA_ "GenSigSendType" SG_ 297 ReSideRdrLeStsRdrStsChks 0;
BA_ "GenSigFuncType" SG_ 297 ReSideRdrLeStsRdrStsChks 15;
BA_ "GenSigDataID" SG_ 297 ReSideRdrLeStsRdrStsChks "0xA3F";
BA_ "GenSigSendType" SG_ 297 ReSideRdrLeStsRdrStsCntr 0;
BA_ "GenSigFuncType" SG_ 297 ReSideRdrLeStsRdrStsCntr 16;
BA_ "GenSigSendType" SG_ 297 ReSideRdrLeStsRdrStsDstbc 0;
BA_ "GenSigSendType" SG_ 297 ReSideRdrLeStsRdrStsEna 0;
BA_ "GenSigSendType" SG_ 297 ReSideRdrLeStsRdrStsFaulty 0;
BA_ "GenSigSendType" SG_ 297 ReSideRdrLeStsRdrStsIfVersMajor 0;
BA_ "GenSigSendType" SG_ 297 ReSideRdrLeStsRdrStsIfVersMinor 0;
BA_ "GenSigStartValue" SG_ 297 ReSideRdrLeStsRdrStsLatency 65535;
BA_ "GenSigSendType" SG_ 297 ReSideRdrLeStsRdrStsLatency 0;
BA_ "GenSigSendType" SG_ 297 ReSideRdrLeStsRdrStsMisAlign 0;
BA_ "GenSigSendType" SG_ 297 ReSideRdrLeStsRdrStsMissCom 0;
BA_ "GenSigStartValue" SG_ 297 ReSideRdrLeStsRdrStsSftyFlt 1;
BA_ "GenSigSendType" SG_ 297 ReSideRdrLeStsRdrStsSftyFlt 0;
BA_ "GenSigSendType" SG_ 297 ReSideRdrLeStsRdrStsTiStamp 0;
BA_ "GenSigSendType" SG_ 297 ReSideRdrLeStsRdrStsTiStampStsGlbTiBas 0;
BA_ "GenSigSendType" SG_ 297 ReSideRdrLeStsRdrStsTiStampStsSyncToGatewy 0;
BA_ "GenSigSendType" SG_ 297 ReSideRdrLeStsRdrStsTiStampStsTiLeap 0;
BA_ "GenSigSendType" SG_ 297 ReSideRdrLeStsRdrStsTiStampStsTiOut 0;
BA_ "GenSigStartValue" SG_ 297 ReSideRdrLeStsRdrStsWhlSpdCmpFac 16;
BA_ "GenSigSendType" SG_ 297 ReSideRdrLeStsRdrStsWhlSpdCmpFac 0;
// Frame: SODLSafetyCANFD3Frame01
BA_ "VFrameFormat" BO_ 304 14;
BA_ "GenMsgSendType" BO_ 304 0;
BA_ "GenMsgCycleTime" BO_ 304 50.000;
BA_ "GenSigStartValue" SG_ 304 ReSideRdrLeDetn1RdrDetnAzi 900;
BA_ "GenSigSendType" SG_ 304 ReSideRdrLeDetn1RdrDetnAzi 0;
BA_ "GenSigSendType" SG_ 304 ReSideRdrLeDetn1RdrDetnChks 0;
BA_ "GenSigFuncType" SG_ 304 ReSideRdrLeDetn1RdrDetnChks 15;
BA_ "GenSigDataID" SG_ 304 ReSideRdrLeDetn1RdrDetnChks "0x992";
BA_ "GenSigSendType" SG_ 304 ReSideRdrLeDetn1RdrDetnCntr 0;
BA_ "GenSigFuncType" SG_ 304 ReSideRdrLeDetn1RdrDetnCntr 16;
BA_ "GenSigSendType" SG_ 304 ReSideRdrLeDetn1RdrDetnConf 0;
BA_ "GenSigStartValue" SG_ 304 ReSideRdrLeDetn1RdrDetnElevn 15;
BA_ "GenSigSendType" SG_ 304 ReSideRdrLeDetn1RdrDetnElevn 0;
BA_ "GenSigSendType" SG_ 304 ReSideRdrLeDetn1RdrDetnPwr 0;
BA_ "GenSigStartValue" SG_ 304 ReSideRdrLeDetn1RdrDetnRng 10050;
BA_ "GenSigSendType" SG_ 304 ReSideRdrLeDetn1RdrDetnRng 0;
BA_ "GenSigStartValue" SG_ 304 ReSideRdrLeDetn1RdrDetnRngV 4000;
BA_ "GenSigSendType" SG_ 304 ReSideRdrLeDetn1RdrDetnRngV 0;
BA_ "GenSigStartValue" SG_ 304 ReSideRdrLeDetn1RdrDetnSts 3;
BA_ "GenSigSendType" SG_ 304 ReSideRdrLeDetn1RdrDetnSts 0;
BA_ "GenSigStartValue" SG_ 304 ReSideRdrLeDetn2RdrDetnAzi 900;
BA_ "GenSigSendType" SG_ 304 ReSideRdrLeDetn2RdrDetnAzi 0;
BA_ "GenSigSendType" SG_ 304 ReSideRdrLeDetn2RdrDetnChks 0;
BA_ "GenSigFuncType" SG_ 304 ReSideRdrLeDetn2RdrDetnChks 15;
BA_ "GenSigDataID" SG_ 304 ReSideRdrLeDetn2RdrDetnChks "0x993";
BA_ "GenSigSendType" SG_ 304 ReSideRdrLeDetn2RdrDetnCntr 0;
BA_ "GenSigFuncType" SG_ 304 ReSideRdrLeDetn2RdrDetnCntr 16;
BA_ "GenSigSendType" SG_ 304 ReSideRdrLeDetn2RdrDetnConf 0;
BA_ "GenSigStartValue" SG_ 304 ReSideRdrLeDetn2RdrDetnElevn 15;
BA_ "GenSigSendType" SG_ 304 ReSideRdrLeDetn2RdrDetnElevn 0;
BA_ "GenSigSendType" SG_ 304 ReSideRdrLeDetn2RdrDetnPwr 0;
BA_ "GenSigStartValue" SG_ 304 ReSideRdrLeDetn2RdrDetnRng 10050;
BA_ "GenSigSendType" SG_ 304 ReSideRdrLeDetn2RdrDetnRng 0;
BA_ "GenSigStartValue" SG_ 304 ReSideRdrLeDetn2RdrDetnRngV 4000;
BA_ "GenSigSendType" SG_ 304 ReSideRdrLeDetn2RdrDetnRngV 0;
BA_ "GenSigStartValue" SG_ 304 ReSideRdrLeDetn2RdrDetnSts 3;
BA_ "GenSigSendType" SG_ 304 ReSideRdrLeDetn2RdrDetnSts 0;
BA_ "GenSigStartValue" SG_ 304 ReSideRdrLeDetn3RdrDetnAzi 900;
BA_ "GenSigSendType" SG_ 304 ReSideRdrLeDetn3RdrDetnAzi 0;
BA_ "GenSigSendType" SG_ 304 ReSideRdrLeDetn3RdrDetnChks 0;
BA_ "GenSigFuncType" SG_ 304 ReSideRdrLeDetn3RdrDetnChks 15;
BA_ "GenSigDataID" SG_ 304 ReSideRdrLeDetn3RdrDetnChks "0x994";
BA_ "GenSigSendType" SG_ 304 ReSideRdrLeDetn3RdrDetnCntr 0;
BA_ "GenSigFuncType" SG_ 304 ReSideRdrLeDetn3RdrDetnCntr 16;
BA_ "GenSigSendType" SG_ 304 ReSideRdrLeDetn3RdrDetnConf 0;
BA_ "GenSigStartValue" SG_ 304 ReSideRdrLeDetn3RdrDetnElevn 15;
BA_ "GenSigSendType" SG_ 304 ReSideRdrLeDetn3RdrDetnElevn 0;
BA_ "GenSigSendType" SG_ 304 ReSideRdrLeDetn3RdrDetnPwr 0;
BA_ "GenSigStartValue" SG_ 304 ReSideRdrLeDetn3RdrDetnRng 10050;
BA_ "GenSigSendType" SG_ 304 ReSideRdrLeDetn3RdrDetnRng 0;
BA_ "GenSigStartValue" SG_ 304 ReSideRdrLeDetn3RdrDetnRngV 4000;
BA_ "GenSigSendType" SG_ 304 ReSideRdrLeDetn3RdrDetnRngV 0;
BA_ "GenSigStartValue" SG_ 304 ReSideRdrLeDetn3RdrDetnSts 3;
BA_ "GenSigSendType" SG_ 304 ReSideRdrLeDetn3RdrDetnSts 0;
BA_ "GenSigStartValue" SG_ 304 ReSideRdrLeDetn4RdrDetnAzi 900;
BA_ "GenSigSendType" SG_ 304 ReSideRdrLeDetn4RdrDetnAzi 0;
BA_ "GenSigSendType" SG_ 304 ReSideRdrLeDetn4RdrDetnChks 0;
BA_ "GenSigFuncType" SG_ 304 ReSideRdrLeDetn4RdrDetnChks 15;
BA_ "GenSigDataID" SG_ 304 ReSideRdrLeDetn4RdrDetnChks "0x995";
BA_ "GenSigSendType" SG_ 304 ReSideRdrLeDetn4RdrDetnCntr 0;
BA_ "GenSigFuncType" SG_ 304 ReSideRdrLeDetn4RdrDetnCntr 16;
BA_ "GenSigSendType" SG_ 304 ReSideRdrLeDetn4RdrDetnConf 0;
BA_ "GenSigStartValue" SG_ 304 ReSideRdrLeDetn4RdrDetnElevn 15;
BA_ "GenSigSendType" SG_ 304 ReSideRdrLeDetn4RdrDetnElevn 0;
BA_ "GenSigSendType" SG_ 304 ReSideRdrLeDetn4RdrDetnPwr 0;
BA_ "GenSigStartValue" SG_ 304 ReSideRdrLeDetn4RdrDetnRng 10050;
BA_ "GenSigSendType" SG_ 304 ReSideRdrLeDetn4RdrDetnRng 0;
BA_ "GenSigStartValue" SG_ 304 ReSideRdrLeDetn4RdrDetnRngV 4000;
BA_ "GenSigSendType" SG_ 304 ReSideRdrLeDetn4RdrDetnRngV 0;
BA_ "GenSigStartValue" SG_ 304 ReSideRdrLeDetn4RdrDetnSts 3;
BA_ "GenSigSendType" SG_ 304 ReSideRdrLeDetn4RdrDetnSts 0;
BA_ "GenSigStartValue" SG_ 304 ReSideRdrLeDetn5RdrDetnAzi 900;
BA_ "GenSigSendType" SG_ 304 ReSideRdrLeDetn5RdrDetnAzi 0;
BA_ "GenSigSendType" SG_ 304 ReSideRdrLeDetn5RdrDetnChks 0;
BA_ "GenSigFuncType" SG_ 304 ReSideRdrLeDetn5RdrDetnChks 15;
BA_ "GenSigDataID" SG_ 304 ReSideRdrLeDetn5RdrDetnChks "0x996";
BA_ "GenSigSendType" SG_ 304 ReSideRdrLeDetn5RdrDetnCntr 0;
BA_ "GenSigFuncType" SG_ 304 ReSideRdrLeDetn5RdrDetnCntr 16;
BA_ "GenSigSendType" SG_ 304 ReSideRdrLeDetn5RdrDetnConf 0;
BA_ "GenSigStartValue" SG_ 304 ReSideRdrLeDetn5RdrDetnElevn 15;
BA_ "GenSigSendType" SG_ 304 ReSideRdrLeDetn5RdrDetnElevn 0;
BA_ "GenSigSendType" SG_ 304 ReSideRdrLeDetn5RdrDetnPwr 0;
BA_ "GenSigStartValue" SG_ 304 ReSideRdrLeDetn5RdrDetnRng 10050;
BA_ "GenSigSendType" SG_ 304 ReSideRdrLeDetn5RdrDetnRng 0;
BA_ "GenSigStartValue" SG_ 304 ReSideRdrLeDetn5RdrDetnRngV 4000;
BA_ "GenSigSendType" SG_ 304 ReSideRdrLeDetn5RdrDetnRngV 0;
BA_ "GenSigStartValue" SG_ 304 ReSideRdrLeDetn5RdrDetnSts 3;
BA_ "GenSigSendType" SG_ 304 ReSideRdrLeDetn5RdrDetnSts 0;
BA_ "GenSigStartValue" SG_ 304 ReSideRdrLeDetn6RdrDetnAzi 900;
BA_ "GenSigSendType" SG_ 304 ReSideRdrLeDetn6RdrDetnAzi 0;
BA_ "GenSigSendType" SG_ 304 ReSideRdrLeDetn6RdrDetnChks 0;
BA_ "GenSigFuncType" SG_ 304 ReSideRdrLeDetn6RdrDetnChks 15;
BA_ "GenSigDataID" SG_ 304 ReSideRdrLeDetn6RdrDetnChks "0x997";
BA_ "GenSigSendType" SG_ 304 ReSideRdrLeDetn6RdrDetnCntr 0;
BA_ "GenSigFuncType" SG_ 304 ReSideRdrLeDetn6RdrDetnCntr 16;
BA_ "GenSigSendType" SG_ 304 ReSideRdrLeDetn6RdrDetnConf 0;
BA_ "GenSigStartValue" SG_ 304 ReSideRdrLeDetn6RdrDetnElevn 15;
BA_ "GenSigSendType" SG_ 304 ReSideRdrLeDetn6RdrDetnElevn 0;
BA_ "GenSigSendType" SG_ 304 ReSideRdrLeDetn6RdrDetnPwr 0;
BA_ "GenSigStartValue" SG_ 304 ReSideRdrLeDetn6RdrDetnRng 10050;
BA_ "GenSigSendType" SG_ 304 ReSideRdrLeDetn6RdrDetnRng 0;
BA_ "GenSigStartValue" SG_ 304 ReSideRdrLeDetn6RdrDetnRngV 4000;
BA_ "GenSigSendType" SG_ 304 ReSideRdrLeDetn6RdrDetnRngV 0;
BA_ "GenSigStartValue" SG_ 304 ReSideRdrLeDetn6RdrDetnSts 3;
BA_ "GenSigSendType" SG_ 304 ReSideRdrLeDetn6RdrDetnSts 0;
// Frame: SODLSafetyCANFD3Frame02
BA_ "VFrameFormat" BO_ 306 14;
BA_ "GenMsgSendType" BO_ 306 0;
BA_ "GenMsgCycleTime" BO_ 306 50.000;
BA_ "GenSigStartValue" SG_ 306 ReSideRdrLeDetn10RdrDetnAzi 900;
BA_ "GenSigSendType" SG_ 306 ReSideRdrLeDetn10RdrDetnAzi 0;
BA_ "GenSigSendType" SG_ 306 ReSideRdrLeDetn10RdrDetnChks 0;
BA_ "GenSigFuncType" SG_ 306 ReSideRdrLeDetn10RdrDetnChks 15;
BA_ "GenSigDataID" SG_ 306 ReSideRdrLeDetn10RdrDetnChks "0x99B";
BA_ "GenSigSendType" SG_ 306 ReSideRdrLeDetn10RdrDetnCntr 0;
BA_ "GenSigFuncType" SG_ 306 ReSideRdrLeDetn10RdrDetnCntr 16;
BA_ "GenSigSendType" SG_ 306 ReSideRdrLeDetn10RdrDetnConf 0;
BA_ "GenSigStartValue" SG_ 306 ReSideRdrLeDetn10RdrDetnElevn 15;
BA_ "GenSigSendType" SG_ 306 ReSideRdrLeDetn10RdrDetnElevn 0;
BA_ "GenSigSendType" SG_ 306 ReSideRdrLeDetn10RdrDetnPwr 0;
BA_ "GenSigStartValue" SG_ 306 ReSideRdrLeDetn10RdrDetnRng 10050;
BA_ "GenSigSendType" SG_ 306 ReSideRdrLeDetn10RdrDetnRng 0;
BA_ "GenSigStartValue" SG_ 306 ReSideRdrLeDetn10RdrDetnRngV 4000;
BA_ "GenSigSendType" SG_ 306 ReSideRdrLeDetn10RdrDetnRngV 0;
BA_ "GenSigStartValue" SG_ 306 ReSideRdrLeDetn10RdrDetnSts 3;
BA_ "GenSigSendType" SG_ 306 ReSideRdrLeDetn10RdrDetnSts 0;
BA_ "GenSigStartValue" SG_ 306 ReSideRdrLeDetn11RdrDetnAzi 900;
BA_ "GenSigSendType" SG_ 306 ReSideRdrLeDetn11RdrDetnAzi 0;
BA_ "GenSigSendType" SG_ 306 ReSideRdrLeDetn11RdrDetnChks 0;
BA_ "GenSigFuncType" SG_ 306 ReSideRdrLeDetn11RdrDetnChks 15;
BA_ "GenSigDataID" SG_ 306 ReSideRdrLeDetn11RdrDetnChks "0x99C";
BA_ "GenSigSendType" SG_ 306 ReSideRdrLeDetn11RdrDetnCntr 0;
BA_ "GenSigFuncType" SG_ 306 ReSideRdrLeDetn11RdrDetnCntr 16;
BA_ "GenSigSendType" SG_ 306 ReSideRdrLeDetn11RdrDetnConf 0;
BA_ "GenSigStartValue" SG_ 306 ReSideRdrLeDetn11RdrDetnElevn 15;
BA_ "GenSigSendType" SG_ 306 ReSideRdrLeDetn11RdrDetnElevn 0;
BA_ "GenSigSendType" SG_ 306 ReSideRdrLeDetn11RdrDetnPwr 0;
BA_ "GenSigStartValue" SG_ 306 ReSideRdrLeDetn11RdrDetnRng 10050;
BA_ "GenSigSendType" SG_ 306 ReSideRdrLeDetn11RdrDetnRng 0;
BA_ "GenSigStartValue" SG_ 306 ReSideRdrLeDetn11RdrDetnRngV 4000;
BA_ "GenSigSendType" SG_ 306 ReSideRdrLeDetn11RdrDetnRngV 0;
BA_ "GenSigStartValue" SG_ 306 ReSideRdrLeDetn11RdrDetnSts 3;
BA_ "GenSigSendType" SG_ 306 ReSideRdrLeDetn11RdrDetnSts 0;
BA_ "GenSigStartValue" SG_ 306 ReSideRdrLeDetn12RdrDetnAzi 900;
BA_ "GenSigSendType" SG_ 306 ReSideRdrLeDetn12RdrDetnAzi 0;
BA_ "GenSigSendType" SG_ 306 ReSideRdrLeDetn12RdrDetnChks 0;
BA_ "GenSigFuncType" SG_ 306 ReSideRdrLeDetn12RdrDetnChks 15;
BA_ "GenSigDataID" SG_ 306 ReSideRdrLeDetn12RdrDetnChks "0x99D";
BA_ "GenSigSendType" SG_ 306 ReSideRdrLeDetn12RdrDetnCntr 0;
BA_ "GenSigFuncType" SG_ 306 ReSideRdrLeDetn12RdrDetnCntr 16;
BA_ "GenSigSendType" SG_ 306 ReSideRdrLeDetn12RdrDetnConf 0;
BA_ "GenSigStartValue" SG_ 306 ReSideRdrLeDetn12RdrDetnElevn 15;
BA_ "GenSigSendType" SG_ 306 ReSideRdrLeDetn12RdrDetnElevn 0;
BA_ "GenSigSendType" SG_ 306 ReSideRdrLeDetn12RdrDetnPwr 0;
BA_ "GenSigStartValue" SG_ 306 ReSideRdrLeDetn12RdrDetnRng 10050;
BA_ "GenSigSendType" SG_ 306 ReSideRdrLeDetn12RdrDetnRng 0;
BA_ "GenSigStartValue" SG_ 306 ReSideRdrLeDetn12RdrDetnRngV 4000;
BA_ "GenSigSendType" SG_ 306 ReSideRdrLeDetn12RdrDetnRngV 0;
BA_ "GenSigStartValue" SG_ 306 ReSideRdrLeDetn12RdrDetnSts 3;
BA_ "GenSigSendType" SG_ 306 ReSideRdrLeDetn12RdrDetnSts 0;
BA_ "GenSigStartValue" SG_ 306 ReSideRdrLeDetn7RdrDetnAzi 900;
BA_ "GenSigSendType" SG_ 306 ReSideRdrLeDetn7RdrDetnAzi 0;
BA_ "GenSigSendType" SG_ 306 ReSideRdrLeDetn7RdrDetnChks 0;
BA_ "GenSigFuncType" SG_ 306 ReSideRdrLeDetn7RdrDetnChks 15;
BA_ "GenSigDataID" SG_ 306 ReSideRdrLeDetn7RdrDetnChks "0x998";
BA_ "GenSigSendType" SG_ 306 ReSideRdrLeDetn7RdrDetnCntr 0;
BA_ "GenSigFuncType" SG_ 306 ReSideRdrLeDetn7RdrDetnCntr 16;
BA_ "GenSigSendType" SG_ 306 ReSideRdrLeDetn7RdrDetnConf 0;
BA_ "GenSigStartValue" SG_ 306 ReSideRdrLeDetn7RdrDetnElevn 15;
BA_ "GenSigSendType" SG_ 306 ReSideRdrLeDetn7RdrDetnElevn 0;
BA_ "GenSigSendType" SG_ 306 ReSideRdrLeDetn7RdrDetnPwr 0;
BA_ "GenSigStartValue" SG_ 306 ReSideRdrLeDetn7RdrDetnRng 10050;
BA_ "GenSigSendType" SG_ 306 ReSideRdrLeDetn7RdrDetnRng 0;
BA_ "GenSigStartValue" SG_ 306 ReSideRdrLeDetn7RdrDetnRngV 4000;
BA_ "GenSigSendType" SG_ 306 ReSideRdrLeDetn7RdrDetnRngV 0;
BA_ "GenSigStartValue" SG_ 306 ReSideRdrLeDetn7RdrDetnSts 3;
BA_ "GenSigSendType" SG_ 306 ReSideRdrLeDetn7RdrDetnSts 0;
BA_ "GenSigStartValue" SG_ 306 ReSideRdrLeDetn8RdrDetnAzi 900;
BA_ "GenSigSendType" SG_ 306 ReSideRdrLeDetn8RdrDetnAzi 0;
BA_ "GenSigSendType" SG_ 306 ReSideRdrLeDetn8RdrDetnChks 0;
BA_ "GenSigFuncType" SG_ 306 ReSideRdrLeDetn8RdrDetnChks 15;
BA_ "GenSigDataID" SG_ 306 ReSideRdrLeDetn8RdrDetnChks "0x999";
BA_ "GenSigSendType" SG_ 306 ReSideRdrLeDetn8RdrDetnCntr 0;
BA_ "GenSigFuncType" SG_ 306 ReSideRdrLeDetn8RdrDetnCntr 16;
BA_ "GenSigSendType" SG_ 306 ReSideRdrLeDetn8RdrDetnConf 0;
BA_ "GenSigStartValue" SG_ 306 ReSideRdrLeDetn8RdrDetnElevn 15;
BA_ "GenSigSendType" SG_ 306 ReSideRdrLeDetn8RdrDetnElevn 0;
BA_ "GenSigSendType" SG_ 306 ReSideRdrLeDetn8RdrDetnPwr 0;
BA_ "GenSigStartValue" SG_ 306 ReSideRdrLeDetn8RdrDetnRng 10050;
BA_ "GenSigSendType" SG_ 306 ReSideRdrLeDetn8RdrDetnRng 0;
BA_ "GenSigStartValue" SG_ 306 ReSideRdrLeDetn8RdrDetnRngV 4000;
BA_ "GenSigSendType" SG_ 306 ReSideRdrLeDetn8RdrDetnRngV 0;
BA_ "GenSigStartValue" SG_ 306 ReSideRdrLeDetn8RdrDetnSts 3;
BA_ "GenSigSendType" SG_ 306 ReSideRdrLeDetn8RdrDetnSts 0;
BA_ "GenSigStartValue" SG_ 306 ReSideRdrLeDetn9RdrDetnAzi 900;
BA_ "GenSigSendType" SG_ 306 ReSideRdrLeDetn9RdrDetnAzi 0;
BA_ "GenSigSendType" SG_ 306 ReSideRdrLeDetn9RdrDetnChks 0;
BA_ "GenSigFuncType" SG_ 306 ReSideRdrLeDetn9RdrDetnChks 15;
BA_ "GenSigDataID" SG_ 306 ReSideRdrLeDetn9RdrDetnChks "0x99A";
BA_ "GenSigSendType" SG_ 306 ReSideRdrLeDetn9RdrDetnCntr 0;
BA_ "GenSigFuncType" SG_ 306 ReSideRdrLeDetn9RdrDetnCntr 16;
BA_ "GenSigSendType" SG_ 306 ReSideRdrLeDetn9RdrDetnConf 0;
BA_ "GenSigStartValue" SG_ 306 ReSideRdrLeDetn9RdrDetnElevn 15;
BA_ "GenSigSendType" SG_ 306 ReSideRdrLeDetn9RdrDetnElevn 0;
BA_ "GenSigSendType" SG_ 306 ReSideRdrLeDetn9RdrDetnPwr 0;
BA_ "GenSigStartValue" SG_ 306 ReSideRdrLeDetn9RdrDetnRng 10050;
BA_ "GenSigSendType" SG_ 306 ReSideRdrLeDetn9RdrDetnRng 0;
BA_ "GenSigStartValue" SG_ 306 ReSideRdrLeDetn9RdrDetnRngV 4000;
BA_ "GenSigSendType" SG_ 306 ReSideRdrLeDetn9RdrDetnRngV 0;
BA_ "GenSigStartValue" SG_ 306 ReSideRdrLeDetn9RdrDetnSts 3;
BA_ "GenSigSendType" SG_ 306 ReSideRdrLeDetn9RdrDetnSts 0;
// Frame: SODLSafetyCANFD3Frame03
BA_ "VFrameFormat" BO_ 308 14;
BA_ "GenMsgSendType" BO_ 308 0;
BA_ "GenMsgCycleTime" BO_ 308 50.000;
BA_ "GenSigStartValue" SG_ 308 ReSideRdrLeDetn13RdrDetnAzi 900;
BA_ "GenSigSendType" SG_ 308 ReSideRdrLeDetn13RdrDetnAzi 0;
BA_ "GenSigSendType" SG_ 308 ReSideRdrLeDetn13RdrDetnChks 0;
BA_ "GenSigFuncType" SG_ 308 ReSideRdrLeDetn13RdrDetnChks 15;
BA_ "GenSigDataID" SG_ 308 ReSideRdrLeDetn13RdrDetnChks "0x99E";
BA_ "GenSigSendType" SG_ 308 ReSideRdrLeDetn13RdrDetnCntr 0;
BA_ "GenSigFuncType" SG_ 308 ReSideRdrLeDetn13RdrDetnCntr 16;
BA_ "GenSigSendType" SG_ 308 ReSideRdrLeDetn13RdrDetnConf 0;
BA_ "GenSigStartValue" SG_ 308 ReSideRdrLeDetn13RdrDetnElevn 15;
BA_ "GenSigSendType" SG_ 308 ReSideRdrLeDetn13RdrDetnElevn 0;
BA_ "GenSigSendType" SG_ 308 ReSideRdrLeDetn13RdrDetnPwr 0;
BA_ "GenSigStartValue" SG_ 308 ReSideRdrLeDetn13RdrDetnRng 10050;
BA_ "GenSigSendType" SG_ 308 ReSideRdrLeDetn13RdrDetnRng 0;
BA_ "GenSigStartValue" SG_ 308 ReSideRdrLeDetn13RdrDetnRngV 4000;
BA_ "GenSigSendType" SG_ 308 ReSideRdrLeDetn13RdrDetnRngV 0;
BA_ "GenSigStartValue" SG_ 308 ReSideRdrLeDetn13RdrDetnSts 3;
BA_ "GenSigSendType" SG_ 308 ReSideRdrLeDetn13RdrDetnSts 0;
BA_ "GenSigStartValue" SG_ 308 ReSideRdrLeDetn14RdrDetnAzi 900;
BA_ "GenSigSendType" SG_ 308 ReSideRdrLeDetn14RdrDetnAzi 0;
BA_ "GenSigSendType" SG_ 308 ReSideRdrLeDetn14RdrDetnChks 0;
BA_ "GenSigFuncType" SG_ 308 ReSideRdrLeDetn14RdrDetnChks 15;
BA_ "GenSigDataID" SG_ 308 ReSideRdrLeDetn14RdrDetnChks "0x99F";
BA_ "GenSigSendType" SG_ 308 ReSideRdrLeDetn14RdrDetnCntr 0;
BA_ "GenSigFuncType" SG_ 308 ReSideRdrLeDetn14RdrDetnCntr 16;
BA_ "GenSigSendType" SG_ 308 ReSideRdrLeDetn14RdrDetnConf 0;
BA_ "GenSigStartValue" SG_ 308 ReSideRdrLeDetn14RdrDetnElevn 15;
BA_ "GenSigSendType" SG_ 308 ReSideRdrLeDetn14RdrDetnElevn 0;
BA_ "GenSigSendType" SG_ 308 ReSideRdrLeDetn14RdrDetnPwr 0;
BA_ "GenSigStartValue" SG_ 308 ReSideRdrLeDetn14RdrDetnRng 10050;
BA_ "GenSigSendType" SG_ 308 ReSideRdrLeDetn14RdrDetnRng 0;
BA_ "GenSigStartValue" SG_ 308 ReSideRdrLeDetn14RdrDetnRngV 4000;
BA_ "GenSigSendType" SG_ 308 ReSideRdrLeDetn14RdrDetnRngV 0;
BA_ "GenSigStartValue" SG_ 308 ReSideRdrLeDetn14RdrDetnSts 3;
BA_ "GenSigSendType" SG_ 308 ReSideRdrLeDetn14RdrDetnSts 0;
BA_ "GenSigStartValue" SG_ 308 ReSideRdrLeDetn15RdrDetnAzi 900;
BA_ "GenSigSendType" SG_ 308 ReSideRdrLeDetn15RdrDetnAzi 0;
BA_ "GenSigSendType" SG_ 308 ReSideRdrLeDetn15RdrDetnChks 0;
BA_ "GenSigFuncType" SG_ 308 ReSideRdrLeDetn15RdrDetnChks 15;
BA_ "GenSigDataID" SG_ 308 ReSideRdrLeDetn15RdrDetnChks "0x9A0";
BA_ "GenSigSendType" SG_ 308 ReSideRdrLeDetn15RdrDetnCntr 0;
BA_ "GenSigFuncType" SG_ 308 ReSideRdrLeDetn15RdrDetnCntr 16;
BA_ "GenSigSendType" SG_ 308 ReSideRdrLeDetn15RdrDetnConf 0;
BA_ "GenSigStartValue" SG_ 308 ReSideRdrLeDetn15RdrDetnElevn 15;
BA_ "GenSigSendType" SG_ 308 ReSideRdrLeDetn15RdrDetnElevn 0;
BA_ "GenSigSendType" SG_ 308 ReSideRdrLeDetn15RdrDetnPwr 0;
BA_ "GenSigStartValue" SG_ 308 ReSideRdrLeDetn15RdrDetnRng 10050;
BA_ "GenSigSendType" SG_ 308 ReSideRdrLeDetn15RdrDetnRng 0;
BA_ "GenSigStartValue" SG_ 308 ReSideRdrLeDetn15RdrDetnRngV 4000;
BA_ "GenSigSendType" SG_ 308 ReSideRdrLeDetn15RdrDetnRngV 0;
BA_ "GenSigStartValue" SG_ 308 ReSideRdrLeDetn15RdrDetnSts 3;
BA_ "GenSigSendType" SG_ 308 ReSideRdrLeDetn15RdrDetnSts 0;
BA_ "GenSigStartValue" SG_ 308 ReSideRdrLeDetn16RdrDetnAzi 900;
BA_ "GenSigSendType" SG_ 308 ReSideRdrLeDetn16RdrDetnAzi 0;
BA_ "GenSigSendType" SG_ 308 ReSideRdrLeDetn16RdrDetnChks 0;
BA_ "GenSigFuncType" SG_ 308 ReSideRdrLeDetn16RdrDetnChks 15;
BA_ "GenSigDataID" SG_ 308 ReSideRdrLeDetn16RdrDetnChks "0x9A1";
BA_ "GenSigSendType" SG_ 308 ReSideRdrLeDetn16RdrDetnCntr 0;
BA_ "GenSigFuncType" SG_ 308 ReSideRdrLeDetn16RdrDetnCntr 16;
BA_ "GenSigSendType" SG_ 308 ReSideRdrLeDetn16RdrDetnConf 0;
BA_ "GenSigStartValue" SG_ 308 ReSideRdrLeDetn16RdrDetnElevn 15;
BA_ "GenSigSendType" SG_ 308 ReSideRdrLeDetn16RdrDetnElevn 0;
BA_ "GenSigSendType" SG_ 308 ReSideRdrLeDetn16RdrDetnPwr 0;
BA_ "GenSigStartValue" SG_ 308 ReSideRdrLeDetn16RdrDetnRng 10050;
BA_ "GenSigSendType" SG_ 308 ReSideRdrLeDetn16RdrDetnRng 0;
BA_ "GenSigStartValue" SG_ 308 ReSideRdrLeDetn16RdrDetnRngV 4000;
BA_ "GenSigSendType" SG_ 308 ReSideRdrLeDetn16RdrDetnRngV 0;
BA_ "GenSigStartValue" SG_ 308 ReSideRdrLeDetn16RdrDetnSts 3;
BA_ "GenSigSendType" SG_ 308 ReSideRdrLeDetn16RdrDetnSts 0;
BA_ "GenSigStartValue" SG_ 308 ReSideRdrLeDetn17RdrDetnAzi 900;
BA_ "GenSigSendType" SG_ 308 ReSideRdrLeDetn17RdrDetnAzi 0;
BA_ "GenSigSendType" SG_ 308 ReSideRdrLeDetn17RdrDetnChks 0;
BA_ "GenSigFuncType" SG_ 308 ReSideRdrLeDetn17RdrDetnChks 15;
BA_ "GenSigDataID" SG_ 308 ReSideRdrLeDetn17RdrDetnChks "0x9A2";
BA_ "GenSigSendType" SG_ 308 ReSideRdrLeDetn17RdrDetnCntr 0;
BA_ "GenSigFuncType" SG_ 308 ReSideRdrLeDetn17RdrDetnCntr 16;
BA_ "GenSigSendType" SG_ 308 ReSideRdrLeDetn17RdrDetnConf 0;
BA_ "GenSigStartValue" SG_ 308 ReSideRdrLeDetn17RdrDetnElevn 15;
BA_ "GenSigSendType" SG_ 308 ReSideRdrLeDetn17RdrDetnElevn 0;
BA_ "GenSigSendType" SG_ 308 ReSideRdrLeDetn17RdrDetnPwr 0;
BA_ "GenSigStartValue" SG_ 308 ReSideRdrLeDetn17RdrDetnRng 10050;
BA_ "GenSigSendType" SG_ 308 ReSideRdrLeDetn17RdrDetnRng 0;
BA_ "GenSigStartValue" SG_ 308 ReSideRdrLeDetn17RdrDetnRngV 4000;
BA_ "GenSigSendType" SG_ 308 ReSideRdrLeDetn17RdrDetnRngV 0;
BA_ "GenSigStartValue" SG_ 308 ReSideRdrLeDetn17RdrDetnSts 3;
BA_ "GenSigSendType" SG_ 308 ReSideRdrLeDetn17RdrDetnSts 0;
BA_ "GenSigStartValue" SG_ 308 ReSideRdrLeDetn18RdrDetnAzi 900;
BA_ "GenSigSendType" SG_ 308 ReSideRdrLeDetn18RdrDetnAzi 0;
BA_ "GenSigSendType" SG_ 308 ReSideRdrLeDetn18RdrDetnChks 0;
BA_ "GenSigFuncType" SG_ 308 ReSideRdrLeDetn18RdrDetnChks 15;
BA_ "GenSigDataID" SG_ 308 ReSideRdrLeDetn18RdrDetnChks "0x9A3";
BA_ "GenSigSendType" SG_ 308 ReSideRdrLeDetn18RdrDetnCntr 0;
BA_ "GenSigFuncType" SG_ 308 ReSideRdrLeDetn18RdrDetnCntr 16;
BA_ "GenSigSendType" SG_ 308 ReSideRdrLeDetn18RdrDetnConf 0;
BA_ "GenSigStartValue" SG_ 308 ReSideRdrLeDetn18RdrDetnElevn 15;
BA_ "GenSigSendType" SG_ 308 ReSideRdrLeDetn18RdrDetnElevn 0;
BA_ "GenSigSendType" SG_ 308 ReSideRdrLeDetn18RdrDetnPwr 0;
BA_ "GenSigStartValue" SG_ 308 ReSideRdrLeDetn18RdrDetnRng 10050;
BA_ "GenSigSendType" SG_ 308 ReSideRdrLeDetn18RdrDetnRng 0;
BA_ "GenSigStartValue" SG_ 308 ReSideRdrLeDetn18RdrDetnRngV 4000;
BA_ "GenSigSendType" SG_ 308 ReSideRdrLeDetn18RdrDetnRngV 0;
BA_ "GenSigStartValue" SG_ 308 ReSideRdrLeDetn18RdrDetnSts 3;
BA_ "GenSigSendType" SG_ 308 ReSideRdrLeDetn18RdrDetnSts 0;
// Frame: SODLSafetyCANFD3Frame04
BA_ "VFrameFormat" BO_ 310 14;
BA_ "GenMsgSendType" BO_ 310 0;
BA_ "GenMsgCycleTime" BO_ 310 50.000;
BA_ "GenSigStartValue" SG_ 310 ReSideRdrLeDetn19RdrDetnAzi 900;
BA_ "GenSigSendType" SG_ 310 ReSideRdrLeDetn19RdrDetnAzi 0;
BA_ "GenSigSendType" SG_ 310 ReSideRdrLeDetn19RdrDetnChks 0;
BA_ "GenSigFuncType" SG_ 310 ReSideRdrLeDetn19RdrDetnChks 15;
BA_ "GenSigDataID" SG_ 310 ReSideRdrLeDetn19RdrDetnChks "0x9A4";
BA_ "GenSigSendType" SG_ 310 ReSideRdrLeDetn19RdrDetnCntr 0;
BA_ "GenSigFuncType" SG_ 310 ReSideRdrLeDetn19RdrDetnCntr 16;
BA_ "GenSigSendType" SG_ 310 ReSideRdrLeDetn19RdrDetnConf 0;
BA_ "GenSigStartValue" SG_ 310 ReSideRdrLeDetn19RdrDetnElevn 15;
BA_ "GenSigSendType" SG_ 310 ReSideRdrLeDetn19RdrDetnElevn 0;
BA_ "GenSigSendType" SG_ 310 ReSideRdrLeDetn19RdrDetnPwr 0;
BA_ "GenSigStartValue" SG_ 310 ReSideRdrLeDetn19RdrDetnRng 10050;
BA_ "GenSigSendType" SG_ 310 ReSideRdrLeDetn19RdrDetnRng 0;
BA_ "GenSigStartValue" SG_ 310 ReSideRdrLeDetn19RdrDetnRngV 4000;
BA_ "GenSigSendType" SG_ 310 ReSideRdrLeDetn19RdrDetnRngV 0;
BA_ "GenSigStartValue" SG_ 310 ReSideRdrLeDetn19RdrDetnSts 3;
BA_ "GenSigSendType" SG_ 310 ReSideRdrLeDetn19RdrDetnSts 0;
BA_ "GenSigStartValue" SG_ 310 ReSideRdrLeDetn20RdrDetnAzi 900;
BA_ "GenSigSendType" SG_ 310 ReSideRdrLeDetn20RdrDetnAzi 0;
BA_ "GenSigSendType" SG_ 310 ReSideRdrLeDetn20RdrDetnChks 0;
BA_ "GenSigFuncType" SG_ 310 ReSideRdrLeDetn20RdrDetnChks 15;
BA_ "GenSigDataID" SG_ 310 ReSideRdrLeDetn20RdrDetnChks "0x9A5";
BA_ "GenSigSendType" SG_ 310 ReSideRdrLeDetn20RdrDetnCntr 0;
BA_ "GenSigFuncType" SG_ 310 ReSideRdrLeDetn20RdrDetnCntr 16;
BA_ "GenSigSendType" SG_ 310 ReSideRdrLeDetn20RdrDetnConf 0;
BA_ "GenSigStartValue" SG_ 310 ReSideRdrLeDetn20RdrDetnElevn 15;
BA_ "GenSigSendType" SG_ 310 ReSideRdrLeDetn20RdrDetnElevn 0;
BA_ "GenSigSendType" SG_ 310 ReSideRdrLeDetn20RdrDetnPwr 0;
BA_ "GenSigStartValue" SG_ 310 ReSideRdrLeDetn20RdrDetnRng 10050;
BA_ "GenSigSendType" SG_ 310 ReSideRdrLeDetn20RdrDetnRng 0;
BA_ "GenSigStartValue" SG_ 310 ReSideRdrLeDetn20RdrDetnRngV 4000;
BA_ "GenSigSendType" SG_ 310 ReSideRdrLeDetn20RdrDetnRngV 0;
BA_ "GenSigStartValue" SG_ 310 ReSideRdrLeDetn20RdrDetnSts 3;
BA_ "GenSigSendType" SG_ 310 ReSideRdrLeDetn20RdrDetnSts 0;
BA_ "GenSigStartValue" SG_ 310 ReSideRdrLeDetn21RdrDetnAzi 900;
BA_ "GenSigSendType" SG_ 310 ReSideRdrLeDetn21RdrDetnAzi 0;
BA_ "GenSigSendType" SG_ 310 ReSideRdrLeDetn21RdrDetnChks 0;
BA_ "GenSigFuncType" SG_ 310 ReSideRdrLeDetn21RdrDetnChks 15;
BA_ "GenSigDataID" SG_ 310 ReSideRdrLeDetn21RdrDetnChks "0x9A6";
BA_ "GenSigSendType" SG_ 310 ReSideRdrLeDetn21RdrDetnCntr 0;
BA_ "GenSigFuncType" SG_ 310 ReSideRdrLeDetn21RdrDetnCntr 16;
BA_ "GenSigSendType" SG_ 310 ReSideRdrLeDetn21RdrDetnConf 0;
BA_ "GenSigStartValue" SG_ 310 ReSideRdrLeDetn21RdrDetnElevn 15;
BA_ "GenSigSendType" SG_ 310 ReSideRdrLeDetn21RdrDetnElevn 0;
BA_ "GenSigSendType" SG_ 310 ReSideRdrLeDetn21RdrDetnPwr 0;
BA_ "GenSigStartValue" SG_ 310 ReSideRdrLeDetn21RdrDetnRng 10050;
BA_ "GenSigSendType" SG_ 310 ReSideRdrLeDetn21RdrDetnRng 0;
BA_ "GenSigStartValue" SG_ 310 ReSideRdrLeDetn21RdrDetnRngV 4000;
BA_ "GenSigSendType" SG_ 310 ReSideRdrLeDetn21RdrDetnRngV 0;
BA_ "GenSigStartValue" SG_ 310 ReSideRdrLeDetn21RdrDetnSts 3;
BA_ "GenSigSendType" SG_ 310 ReSideRdrLeDetn21RdrDetnSts 0;
BA_ "GenSigStartValue" SG_ 310 ReSideRdrLeDetn22RdrDetnAzi 900;
BA_ "GenSigSendType" SG_ 310 ReSideRdrLeDetn22RdrDetnAzi 0;
BA_ "GenSigSendType" SG_ 310 ReSideRdrLeDetn22RdrDetnChks 0;
BA_ "GenSigFuncType" SG_ 310 ReSideRdrLeDetn22RdrDetnChks 15;
BA_ "GenSigDataID" SG_ 310 ReSideRdrLeDetn22RdrDetnChks "0x9A7";
BA_ "GenSigSendType" SG_ 310 ReSideRdrLeDetn22RdrDetnCntr 0;
BA_ "GenSigFuncType" SG_ 310 ReSideRdrLeDetn22RdrDetnCntr 16;
BA_ "GenSigSendType" SG_ 310 ReSideRdrLeDetn22RdrDetnConf 0;
BA_ "GenSigStartValue" SG_ 310 ReSideRdrLeDetn22RdrDetnElevn 15;
BA_ "GenSigSendType" SG_ 310 ReSideRdrLeDetn22RdrDetnElevn 0;
BA_ "GenSigSendType" SG_ 310 ReSideRdrLeDetn22RdrDetnPwr 0;
BA_ "GenSigStartValue" SG_ 310 ReSideRdrLeDetn22RdrDetnRng 10050;
BA_ "GenSigSendType" SG_ 310 ReSideRdrLeDetn22RdrDetnRng 0;
BA_ "GenSigStartValue" SG_ 310 ReSideRdrLeDetn22RdrDetnRngV 4000;
BA_ "GenSigSendType" SG_ 310 ReSideRdrLeDetn22RdrDetnRngV 0;
BA_ "GenSigStartValue" SG_ 310 ReSideRdrLeDetn22RdrDetnSts 3;
BA_ "GenSigSendType" SG_ 310 ReSideRdrLeDetn22RdrDetnSts 0;
BA_ "GenSigStartValue" SG_ 310 ReSideRdrLeDetn23RdrDetnAzi 900;
BA_ "GenSigSendType" SG_ 310 ReSideRdrLeDetn23RdrDetnAzi 0;
BA_ "GenSigSendType" SG_ 310 ReSideRdrLeDetn23RdrDetnChks 0;
BA_ "GenSigFuncType" SG_ 310 ReSideRdrLeDetn23RdrDetnChks 15;
BA_ "GenSigDataID" SG_ 310 ReSideRdrLeDetn23RdrDetnChks "0x9A8";
BA_ "GenSigSendType" SG_ 310 ReSideRdrLeDetn23RdrDetnCntr 0;
BA_ "GenSigFuncType" SG_ 310 ReSideRdrLeDetn23RdrDetnCntr 16;
BA_ "GenSigSendType" SG_ 310 ReSideRdrLeDetn23RdrDetnConf 0;
BA_ "GenSigStartValue" SG_ 310 ReSideRdrLeDetn23RdrDetnElevn 15;
BA_ "GenSigSendType" SG_ 310 ReSideRdrLeDetn23RdrDetnElevn 0;
BA_ "GenSigSendType" SG_ 310 ReSideRdrLeDetn23RdrDetnPwr 0;
BA_ "GenSigStartValue" SG_ 310 ReSideRdrLeDetn23RdrDetnRng 10050;
BA_ "GenSigSendType" SG_ 310 ReSideRdrLeDetn23RdrDetnRng 0;
BA_ "GenSigStartValue" SG_ 310 ReSideRdrLeDetn23RdrDetnRngV 4000;
BA_ "GenSigSendType" SG_ 310 ReSideRdrLeDetn23RdrDetnRngV 0;
BA_ "GenSigStartValue" SG_ 310 ReSideRdrLeDetn23RdrDetnSts 3;
BA_ "GenSigSendType" SG_ 310 ReSideRdrLeDetn23RdrDetnSts 0;
BA_ "GenSigStartValue" SG_ 310 ReSideRdrLeDetn24RdrDetnAzi 900;
BA_ "GenSigSendType" SG_ 310 ReSideRdrLeDetn24RdrDetnAzi 0;
BA_ "GenSigSendType" SG_ 310 ReSideRdrLeDetn24RdrDetnChks 0;
BA_ "GenSigFuncType" SG_ 310 ReSideRdrLeDetn24RdrDetnChks 15;
BA_ "GenSigDataID" SG_ 310 ReSideRdrLeDetn24RdrDetnChks "0x9A9";
BA_ "GenSigSendType" SG_ 310 ReSideRdrLeDetn24RdrDetnCntr 0;
BA_ "GenSigFuncType" SG_ 310 ReSideRdrLeDetn24RdrDetnCntr 16;
BA_ "GenSigSendType" SG_ 310 ReSideRdrLeDetn24RdrDetnConf 0;
BA_ "GenSigStartValue" SG_ 310 ReSideRdrLeDetn24RdrDetnElevn 15;
BA_ "GenSigSendType" SG_ 310 ReSideRdrLeDetn24RdrDetnElevn 0;
BA_ "GenSigSendType" SG_ 310 ReSideRdrLeDetn24RdrDetnPwr 0;
BA_ "GenSigStartValue" SG_ 310 ReSideRdrLeDetn24RdrDetnRng 10050;
BA_ "GenSigSendType" SG_ 310 ReSideRdrLeDetn24RdrDetnRng 0;
BA_ "GenSigStartValue" SG_ 310 ReSideRdrLeDetn24RdrDetnRngV 4000;
BA_ "GenSigSendType" SG_ 310 ReSideRdrLeDetn24RdrDetnRngV 0;
BA_ "GenSigStartValue" SG_ 310 ReSideRdrLeDetn24RdrDetnSts 3;
BA_ "GenSigSendType" SG_ 310 ReSideRdrLeDetn24RdrDetnSts 0;
// Frame: SODLSafetyCANFD3Frame05
BA_ "VFrameFormat" BO_ 312 14;
BA_ "GenMsgSendType" BO_ 312 0;
BA_ "GenMsgCycleTime" BO_ 312 50.000;
BA_ "GenSigStartValue" SG_ 312 ReSideRdrLeDetn25RdrDetnAzi 900;
BA_ "GenSigSendType" SG_ 312 ReSideRdrLeDetn25RdrDetnAzi 0;
BA_ "GenSigSendType" SG_ 312 ReSideRdrLeDetn25RdrDetnChks 0;
BA_ "GenSigFuncType" SG_ 312 ReSideRdrLeDetn25RdrDetnChks 15;
BA_ "GenSigDataID" SG_ 312 ReSideRdrLeDetn25RdrDetnChks "0x9AA";
BA_ "GenSigSendType" SG_ 312 ReSideRdrLeDetn25RdrDetnCntr 0;
BA_ "GenSigFuncType" SG_ 312 ReSideRdrLeDetn25RdrDetnCntr 16;
BA_ "GenSigSendType" SG_ 312 ReSideRdrLeDetn25RdrDetnConf 0;
BA_ "GenSigStartValue" SG_ 312 ReSideRdrLeDetn25RdrDetnElevn 15;
BA_ "GenSigSendType" SG_ 312 ReSideRdrLeDetn25RdrDetnElevn 0;
BA_ "GenSigSendType" SG_ 312 ReSideRdrLeDetn25RdrDetnPwr 0;
BA_ "GenSigStartValue" SG_ 312 ReSideRdrLeDetn25RdrDetnRng 10050;
BA_ "GenSigSendType" SG_ 312 ReSideRdrLeDetn25RdrDetnRng 0;
BA_ "GenSigStartValue" SG_ 312 ReSideRdrLeDetn25RdrDetnRngV 4000;
BA_ "GenSigSendType" SG_ 312 ReSideRdrLeDetn25RdrDetnRngV 0;
BA_ "GenSigStartValue" SG_ 312 ReSideRdrLeDetn25RdrDetnSts 3;
BA_ "GenSigSendType" SG_ 312 ReSideRdrLeDetn25RdrDetnSts 0;
BA_ "GenSigStartValue" SG_ 312 ReSideRdrLeDetn26RdrDetnAzi 900;
BA_ "GenSigSendType" SG_ 312 ReSideRdrLeDetn26RdrDetnAzi 0;
BA_ "GenSigSendType" SG_ 312 ReSideRdrLeDetn26RdrDetnChks 0;
BA_ "GenSigFuncType" SG_ 312 ReSideRdrLeDetn26RdrDetnChks 15;
BA_ "GenSigDataID" SG_ 312 ReSideRdrLeDetn26RdrDetnChks "0x9AB";
BA_ "GenSigSendType" SG_ 312 ReSideRdrLeDetn26RdrDetnCntr 0;
BA_ "GenSigFuncType" SG_ 312 ReSideRdrLeDetn26RdrDetnCntr 16;
BA_ "GenSigSendType" SG_ 312 ReSideRdrLeDetn26RdrDetnConf 0;
BA_ "GenSigStartValue" SG_ 312 ReSideRdrLeDetn26RdrDetnElevn 15;
BA_ "GenSigSendType" SG_ 312 ReSideRdrLeDetn26RdrDetnElevn 0;
BA_ "GenSigSendType" SG_ 312 ReSideRdrLeDetn26RdrDetnPwr 0;
BA_ "GenSigStartValue" SG_ 312 ReSideRdrLeDetn26RdrDetnRng 10050;
BA_ "GenSigSendType" SG_ 312 ReSideRdrLeDetn26RdrDetnRng 0;
BA_ "GenSigStartValue" SG_ 312 ReSideRdrLeDetn26RdrDetnRngV 4000;
BA_ "GenSigSendType" SG_ 312 ReSideRdrLeDetn26RdrDetnRngV 0;
BA_ "GenSigStartValue" SG_ 312 ReSideRdrLeDetn26RdrDetnSts 3;
BA_ "GenSigSendType" SG_ 312 ReSideRdrLeDetn26RdrDetnSts 0;
BA_ "GenSigStartValue" SG_ 312 ReSideRdrLeDetn27RdrDetnAzi 900;
BA_ "GenSigSendType" SG_ 312 ReSideRdrLeDetn27RdrDetnAzi 0;
BA_ "GenSigSendType" SG_ 312 ReSideRdrLeDetn27RdrDetnChks 0;
BA_ "GenSigFuncType" SG_ 312 ReSideRdrLeDetn27RdrDetnChks 15;
BA_ "GenSigDataID" SG_ 312 ReSideRdrLeDetn27RdrDetnChks "0x9AC";
BA_ "GenSigSendType" SG_ 312 ReSideRdrLeDetn27RdrDetnCntr 0;
BA_ "GenSigFuncType" SG_ 312 ReSideRdrLeDetn27RdrDetnCntr 16;
BA_ "GenSigSendType" SG_ 312 ReSideRdrLeDetn27RdrDetnConf 0;
BA_ "GenSigStartValue" SG_ 312 ReSideRdrLeDetn27RdrDetnElevn 15;
BA_ "GenSigSendType" SG_ 312 ReSideRdrLeDetn27RdrDetnElevn 0;
BA_ "GenSigSendType" SG_ 312 ReSideRdrLeDetn27RdrDetnPwr 0;
BA_ "GenSigStartValue" SG_ 312 ReSideRdrLeDetn27RdrDetnRng 10050;
BA_ "GenSigSendType" SG_ 312 ReSideRdrLeDetn27RdrDetnRng 0;
BA_ "GenSigStartValue" SG_ 312 ReSideRdrLeDetn27RdrDetnRngV 4000;
BA_ "GenSigSendType" SG_ 312 ReSideRdrLeDetn27RdrDetnRngV 0;
BA_ "GenSigStartValue" SG_ 312 ReSideRdrLeDetn27RdrDetnSts 3;
BA_ "GenSigSendType" SG_ 312 ReSideRdrLeDetn27RdrDetnSts 0;
BA_ "GenSigStartValue" SG_ 312 ReSideRdrLeDetn28RdrDetnAzi 900;
BA_ "GenSigSendType" SG_ 312 ReSideRdrLeDetn28RdrDetnAzi 0;
BA_ "GenSigSendType" SG_ 312 ReSideRdrLeDetn28RdrDetnChks 0;
BA_ "GenSigFuncType" SG_ 312 ReSideRdrLeDetn28RdrDetnChks 15;
BA_ "GenSigDataID" SG_ 312 ReSideRdrLeDetn28RdrDetnChks "0x9AD";
BA_ "GenSigSendType" SG_ 312 ReSideRdrLeDetn28RdrDetnCntr 0;
BA_ "GenSigFuncType" SG_ 312 ReSideRdrLeDetn28RdrDetnCntr 16;
BA_ "GenSigSendType" SG_ 312 ReSideRdrLeDetn28RdrDetnConf 0;
BA_ "GenSigStartValue" SG_ 312 ReSideRdrLeDetn28RdrDetnElevn 15;
BA_ "GenSigSendType" SG_ 312 ReSideRdrLeDetn28RdrDetnElevn 0;
BA_ "GenSigSendType" SG_ 312 ReSideRdrLeDetn28RdrDetnPwr 0;
BA_ "GenSigStartValue" SG_ 312 ReSideRdrLeDetn28RdrDetnRng 10050;
BA_ "GenSigSendType" SG_ 312 ReSideRdrLeDetn28RdrDetnRng 0;
BA_ "GenSigStartValue" SG_ 312 ReSideRdrLeDetn28RdrDetnRngV 4000;
BA_ "GenSigSendType" SG_ 312 ReSideRdrLeDetn28RdrDetnRngV 0;
BA_ "GenSigStartValue" SG_ 312 ReSideRdrLeDetn28RdrDetnSts 3;
BA_ "GenSigSendType" SG_ 312 ReSideRdrLeDetn28RdrDetnSts 0;
BA_ "GenSigStartValue" SG_ 312 ReSideRdrLeDetn29RdrDetnAzi 900;
BA_ "GenSigSendType" SG_ 312 ReSideRdrLeDetn29RdrDetnAzi 0;
BA_ "GenSigSendType" SG_ 312 ReSideRdrLeDetn29RdrDetnChks 0;
BA_ "GenSigFuncType" SG_ 312 ReSideRdrLeDetn29RdrDetnChks 15;
BA_ "GenSigDataID" SG_ 312 ReSideRdrLeDetn29RdrDetnChks "0x9AE";
BA_ "GenSigSendType" SG_ 312 ReSideRdrLeDetn29RdrDetnCntr 0;
BA_ "GenSigFuncType" SG_ 312 ReSideRdrLeDetn29RdrDetnCntr 16;
BA_ "GenSigSendType" SG_ 312 ReSideRdrLeDetn29RdrDetnConf 0;
BA_ "GenSigStartValue" SG_ 312 ReSideRdrLeDetn29RdrDetnElevn 15;
BA_ "GenSigSendType" SG_ 312 ReSideRdrLeDetn29RdrDetnElevn 0;
BA_ "GenSigSendType" SG_ 312 ReSideRdrLeDetn29RdrDetnPwr 0;
BA_ "GenSigStartValue" SG_ 312 ReSideRdrLeDetn29RdrDetnRng 10050;
BA_ "GenSigSendType" SG_ 312 ReSideRdrLeDetn29RdrDetnRng 0;
BA_ "GenSigStartValue" SG_ 312 ReSideRdrLeDetn29RdrDetnRngV 4000;
BA_ "GenSigSendType" SG_ 312 ReSideRdrLeDetn29RdrDetnRngV 0;
BA_ "GenSigStartValue" SG_ 312 ReSideRdrLeDetn29RdrDetnSts 3;
BA_ "GenSigSendType" SG_ 312 ReSideRdrLeDetn29RdrDetnSts 0;
BA_ "GenSigStartValue" SG_ 312 ReSideRdrLeDetn30RdrDetnAzi 900;
BA_ "GenSigSendType" SG_ 312 ReSideRdrLeDetn30RdrDetnAzi 0;
BA_ "GenSigSendType" SG_ 312 ReSideRdrLeDetn30RdrDetnChks 0;
BA_ "GenSigFuncType" SG_ 312 ReSideRdrLeDetn30RdrDetnChks 15;
BA_ "GenSigDataID" SG_ 312 ReSideRdrLeDetn30RdrDetnChks "0x9AF";
BA_ "GenSigSendType" SG_ 312 ReSideRdrLeDetn30RdrDetnCntr 0;
BA_ "GenSigFuncType" SG_ 312 ReSideRdrLeDetn30RdrDetnCntr 16;
BA_ "GenSigSendType" SG_ 312 ReSideRdrLeDetn30RdrDetnConf 0;
BA_ "GenSigStartValue" SG_ 312 ReSideRdrLeDetn30RdrDetnElevn 15;
BA_ "GenSigSendType" SG_ 312 ReSideRdrLeDetn30RdrDetnElevn 0;
BA_ "GenSigSendType" SG_ 312 ReSideRdrLeDetn30RdrDetnPwr 0;
BA_ "GenSigStartValue" SG_ 312 ReSideRdrLeDetn30RdrDetnRng 10050;
BA_ "GenSigSendType" SG_ 312 ReSideRdrLeDetn30RdrDetnRng 0;
BA_ "GenSigStartValue" SG_ 312 ReSideRdrLeDetn30RdrDetnRngV 4000;
BA_ "GenSigSendType" SG_ 312 ReSideRdrLeDetn30RdrDetnRngV 0;
BA_ "GenSigStartValue" SG_ 312 ReSideRdrLeDetn30RdrDetnSts 3;
BA_ "GenSigSendType" SG_ 312 ReSideRdrLeDetn30RdrDetnSts 0;
// Frame: SODLSafetyCANFD3Frame06
BA_ "VFrameFormat" BO_ 314 14;
BA_ "GenMsgSendType" BO_ 314 0;
BA_ "GenMsgCycleTime" BO_ 314 50.000;
BA_ "GenSigStartValue" SG_ 314 ReSideRdrLeDetn31RdrDetnAzi 900;
BA_ "GenSigSendType" SG_ 314 ReSideRdrLeDetn31RdrDetnAzi 0;
BA_ "GenSigSendType" SG_ 314 ReSideRdrLeDetn31RdrDetnChks 0;
BA_ "GenSigFuncType" SG_ 314 ReSideRdrLeDetn31RdrDetnChks 15;
BA_ "GenSigDataID" SG_ 314 ReSideRdrLeDetn31RdrDetnChks "0x9B0";
BA_ "GenSigSendType" SG_ 314 ReSideRdrLeDetn31RdrDetnCntr 0;
BA_ "GenSigFuncType" SG_ 314 ReSideRdrLeDetn31RdrDetnCntr 16;
BA_ "GenSigSendType" SG_ 314 ReSideRdrLeDetn31RdrDetnConf 0;
BA_ "GenSigStartValue" SG_ 314 ReSideRdrLeDetn31RdrDetnElevn 15;
BA_ "GenSigSendType" SG_ 314 ReSideRdrLeDetn31RdrDetnElevn 0;
BA_ "GenSigSendType" SG_ 314 ReSideRdrLeDetn31RdrDetnPwr 0;
BA_ "GenSigStartValue" SG_ 314 ReSideRdrLeDetn31RdrDetnRng 10050;
BA_ "GenSigSendType" SG_ 314 ReSideRdrLeDetn31RdrDetnRng 0;
BA_ "GenSigStartValue" SG_ 314 ReSideRdrLeDetn31RdrDetnRngV 4000;
BA_ "GenSigSendType" SG_ 314 ReSideRdrLeDetn31RdrDetnRngV 0;
BA_ "GenSigStartValue" SG_ 314 ReSideRdrLeDetn31RdrDetnSts 3;
BA_ "GenSigSendType" SG_ 314 ReSideRdrLeDetn31RdrDetnSts 0;
BA_ "GenSigStartValue" SG_ 314 ReSideRdrLeDetn32RdrDetnAzi 900;
BA_ "GenSigSendType" SG_ 314 ReSideRdrLeDetn32RdrDetnAzi 0;
BA_ "GenSigSendType" SG_ 314 ReSideRdrLeDetn32RdrDetnChks 0;
BA_ "GenSigFuncType" SG_ 314 ReSideRdrLeDetn32RdrDetnChks 15;
BA_ "GenSigDataID" SG_ 314 ReSideRdrLeDetn32RdrDetnChks "0x9B1";
BA_ "GenSigSendType" SG_ 314 ReSideRdrLeDetn32RdrDetnCntr 0;
BA_ "GenSigFuncType" SG_ 314 ReSideRdrLeDetn32RdrDetnCntr 16;
BA_ "GenSigSendType" SG_ 314 ReSideRdrLeDetn32RdrDetnConf 0;
BA_ "GenSigStartValue" SG_ 314 ReSideRdrLeDetn32RdrDetnElevn 15;
BA_ "GenSigSendType" SG_ 314 ReSideRdrLeDetn32RdrDetnElevn 0;
BA_ "GenSigSendType" SG_ 314 ReSideRdrLeDetn32RdrDetnPwr 0;
BA_ "GenSigStartValue" SG_ 314 ReSideRdrLeDetn32RdrDetnRng 10050;
BA_ "GenSigSendType" SG_ 314 ReSideRdrLeDetn32RdrDetnRng 0;
BA_ "GenSigStartValue" SG_ 314 ReSideRdrLeDetn32RdrDetnRngV 4000;
BA_ "GenSigSendType" SG_ 314 ReSideRdrLeDetn32RdrDetnRngV 0;
BA_ "GenSigStartValue" SG_ 314 ReSideRdrLeDetn32RdrDetnSts 3;
BA_ "GenSigSendType" SG_ 314 ReSideRdrLeDetn32RdrDetnSts 0;
BA_ "GenSigStartValue" SG_ 314 ReSideRdrLeDetn33RdrDetnAzi 900;
BA_ "GenSigSendType" SG_ 314 ReSideRdrLeDetn33RdrDetnAzi 0;
BA_ "GenSigSendType" SG_ 314 ReSideRdrLeDetn33RdrDetnChks 0;
BA_ "GenSigFuncType" SG_ 314 ReSideRdrLeDetn33RdrDetnChks 15;
BA_ "GenSigDataID" SG_ 314 ReSideRdrLeDetn33RdrDetnChks "0x9B2";
BA_ "GenSigSendType" SG_ 314 ReSideRdrLeDetn33RdrDetnCntr 0;
BA_ "GenSigFuncType" SG_ 314 ReSideRdrLeDetn33RdrDetnCntr 16;
BA_ "GenSigSendType" SG_ 314 ReSideRdrLeDetn33RdrDetnConf 0;
BA_ "GenSigStartValue" SG_ 314 ReSideRdrLeDetn33RdrDetnElevn 15;
BA_ "GenSigSendType" SG_ 314 ReSideRdrLeDetn33RdrDetnElevn 0;
BA_ "GenSigSendType" SG_ 314 ReSideRdrLeDetn33RdrDetnPwr 0;
BA_ "GenSigStartValue" SG_ 314 ReSideRdrLeDetn33RdrDetnRng 10050;
BA_ "GenSigSendType" SG_ 314 ReSideRdrLeDetn33RdrDetnRng 0;
BA_ "GenSigStartValue" SG_ 314 ReSideRdrLeDetn33RdrDetnRngV 4000;
BA_ "GenSigSendType" SG_ 314 ReSideRdrLeDetn33RdrDetnRngV 0;
BA_ "GenSigStartValue" SG_ 314 ReSideRdrLeDetn33RdrDetnSts 3;
BA_ "GenSigSendType" SG_ 314 ReSideRdrLeDetn33RdrDetnSts 0;
BA_ "GenSigStartValue" SG_ 314 ReSideRdrLeDetn34RdrDetnAzi 900;
BA_ "GenSigSendType" SG_ 314 ReSideRdrLeDetn34RdrDetnAzi 0;
BA_ "GenSigSendType" SG_ 314 ReSideRdrLeDetn34RdrDetnChks 0;
BA_ "GenSigFuncType" SG_ 314 ReSideRdrLeDetn34RdrDetnChks 15;
BA_ "GenSigDataID" SG_ 314 ReSideRdrLeDetn34RdrDetnChks "0x9B3";
BA_ "GenSigSendType" SG_ 314 ReSideRdrLeDetn34RdrDetnCntr 0;
BA_ "GenSigFuncType" SG_ 314 ReSideRdrLeDetn34RdrDetnCntr 16;
BA_ "GenSigSendType" SG_ 314 ReSideRdrLeDetn34RdrDetnConf 0;
BA_ "GenSigStartValue" SG_ 314 ReSideRdrLeDetn34RdrDetnElevn 15;
BA_ "GenSigSendType" SG_ 314 ReSideRdrLeDetn34RdrDetnElevn 0;
BA_ "GenSigSendType" SG_ 314 ReSideRdrLeDetn34RdrDetnPwr 0;
BA_ "GenSigStartValue" SG_ 314 ReSideRdrLeDetn34RdrDetnRng 10050;
BA_ "GenSigSendType" SG_ 314 ReSideRdrLeDetn34RdrDetnRng 0;
BA_ "GenSigStartValue" SG_ 314 ReSideRdrLeDetn34RdrDetnRngV 4000;
BA_ "GenSigSendType" SG_ 314 ReSideRdrLeDetn34RdrDetnRngV 0;
BA_ "GenSigStartValue" SG_ 314 ReSideRdrLeDetn34RdrDetnSts 3;
BA_ "GenSigSendType" SG_ 314 ReSideRdrLeDetn34RdrDetnSts 0;
BA_ "GenSigStartValue" SG_ 314 ReSideRdrLeDetn35RdrDetnAzi 900;
BA_ "GenSigSendType" SG_ 314 ReSideRdrLeDetn35RdrDetnAzi 0;
BA_ "GenSigSendType" SG_ 314 ReSideRdrLeDetn35RdrDetnChks 0;
BA_ "GenSigFuncType" SG_ 314 ReSideRdrLeDetn35RdrDetnChks 15;
BA_ "GenSigDataID" SG_ 314 ReSideRdrLeDetn35RdrDetnChks "0x9B4";
BA_ "GenSigSendType" SG_ 314 ReSideRdrLeDetn35RdrDetnCntr 0;
BA_ "GenSigFuncType" SG_ 314 ReSideRdrLeDetn35RdrDetnCntr 16;
BA_ "GenSigSendType" SG_ 314 ReSideRdrLeDetn35RdrDetnConf 0;
BA_ "GenSigStartValue" SG_ 314 ReSideRdrLeDetn35RdrDetnElevn 15;
BA_ "GenSigSendType" SG_ 314 ReSideRdrLeDetn35RdrDetnElevn 0;
BA_ "GenSigSendType" SG_ 314 ReSideRdrLeDetn35RdrDetnPwr 0;
BA_ "GenSigStartValue" SG_ 314 ReSideRdrLeDetn35RdrDetnRng 10050;
BA_ "GenSigSendType" SG_ 314 ReSideRdrLeDetn35RdrDetnRng 0;
BA_ "GenSigStartValue" SG_ 314 ReSideRdrLeDetn35RdrDetnRngV 4000;
BA_ "GenSigSendType" SG_ 314 ReSideRdrLeDetn35RdrDetnRngV 0;
BA_ "GenSigStartValue" SG_ 314 ReSideRdrLeDetn35RdrDetnSts 3;
BA_ "GenSigSendType" SG_ 314 ReSideRdrLeDetn35RdrDetnSts 0;
BA_ "GenSigStartValue" SG_ 314 ReSideRdrLeDetn36RdrDetnAzi 900;
BA_ "GenSigSendType" SG_ 314 ReSideRdrLeDetn36RdrDetnAzi 0;
BA_ "GenSigSendType" SG_ 314 ReSideRdrLeDetn36RdrDetnChks 0;
BA_ "GenSigFuncType" SG_ 314 ReSideRdrLeDetn36RdrDetnChks 15;
BA_ "GenSigDataID" SG_ 314 ReSideRdrLeDetn36RdrDetnChks "0x9B5";
BA_ "GenSigSendType" SG_ 314 ReSideRdrLeDetn36RdrDetnCntr 0;
BA_ "GenSigFuncType" SG_ 314 ReSideRdrLeDetn36RdrDetnCntr 16;
BA_ "GenSigSendType" SG_ 314 ReSideRdrLeDetn36RdrDetnConf 0;
BA_ "GenSigStartValue" SG_ 314 ReSideRdrLeDetn36RdrDetnElevn 15;
BA_ "GenSigSendType" SG_ 314 ReSideRdrLeDetn36RdrDetnElevn 0;
BA_ "GenSigSendType" SG_ 314 ReSideRdrLeDetn36RdrDetnPwr 0;
BA_ "GenSigStartValue" SG_ 314 ReSideRdrLeDetn36RdrDetnRng 10050;
BA_ "GenSigSendType" SG_ 314 ReSideRdrLeDetn36RdrDetnRng 0;
BA_ "GenSigStartValue" SG_ 314 ReSideRdrLeDetn36RdrDetnRngV 4000;
BA_ "GenSigSendType" SG_ 314 ReSideRdrLeDetn36RdrDetnRngV 0;
BA_ "GenSigStartValue" SG_ 314 ReSideRdrLeDetn36RdrDetnSts 3;
BA_ "GenSigSendType" SG_ 314 ReSideRdrLeDetn36RdrDetnSts 0;

VAL_ 288 ADataRawSafeALat1Qf 0 "Qf1_DevOfDataUndefd" 1 "Qf1_DataTmpUndefdAndEvlnInProgs" 2 "Qf1_DevOfDataNotWithinRngAllwd" 3 "Qf1_DataCalcdWithDevDefd";
VAL_ 288 ADataRawSafeALgt1Qf 0 "Qf1_DevOfDataUndefd" 1 "Qf1_DataTmpUndefdAndEvlnInProgs" 2 "Qf1_DevOfDataNotWithinRngAllwd" 3 "Qf1_DataCalcdWithDevDefd";
VAL_ 288 ADataRawSafeAVertQf 0 "Qf1_DevOfDataUndefd" 1 "Qf1_DataTmpUndefdAndEvlnInProgs" 2 "Qf1_DevOfDataNotWithinRngAllwd" 3 "Qf1_DataCalcdWithDevDefd";
VAL_ 288 ALgtStdFromWhlSpdQf 0 "GenQf1_UndefindDataAccur" 1 "GenQf1_TmpUndefdData" 2 "GenQf1_DataAccurNotWithinSpcn" 3 "GenQf1_AccurData";
VAL_ 288 AmbTRawQly 0 "GenQf1_UndefindDataAccur" 1 "GenQf1_TmpUndefdData" 2 "GenQf1_DataAccurNotWithinSpcn" 3 "GenQf1_AccurData";
VAL_ 288 AsyDataWithCmpSafeALat1Qf 0 "Qf1_DevOfDataUndefd" 1 "Qf1_DataTmpUndefdAndEvlnInProgs" 2 "Qf1_DevOfDataNotWithinRngAllwd" 3 "Qf1_DataCalcdWithDevDefd";
VAL_ 288 AsyDataWithCmpSafeALgt1Qf 0 "Qf1_DevOfDataUndefd" 1 "Qf1_DataTmpUndefdAndEvlnInProgs" 2 "Qf1_DevOfDataNotWithinRngAllwd" 3 "Qf1_DataCalcdWithDevDefd";
VAL_ 288 AsyDataWithCmpSafeYawRateQf 0 "Qf1_DevOfDataUndefd" 1 "Qf1_DataTmpUndefdAndEvlnInProgs" 2 "Qf1_DevOfDataNotWithinRngAllwd" 3 "Qf1_DataCalcdWithDevDefd";
VAL_ 288 DrvModReq 0 "DrvModReqType1_Undefd" 1 "DrvModReqType1_ECO" 2 "DrvModReqType1_Comfort_Normal" 3 "DrvModReqType1_Dynamic_Sport" 4 "DrvModReqType1_Individual" 5 "DrvModReqType1_Offroad_CrossTerrain" 6 "DrvModReqType1_AWD" 7 "DrvModReqType1_Race" 8 "DrvModReqType1_Pure_EV" 9 "DrvModReqType1_Hybrid" 10 "DrvModReqType1_Power" 11 "DrvModReqType1_Snow" 12 "DrvModReqType1_Sand" 13 "DrvModReqType1_Mud" 14 "DrvModReqType1_Rock" 15 "DrvModReqType1_Err";
VAL_ 288 PinionSteerAgGroupPinionSteerAg1Qf 0 "GenQf1_UndefindDataAccur" 1 "GenQf1_TmpUndefdData" 2 "GenQf1_DataAccurNotWithinSpcn" 3 "GenQf1_AccurData";
VAL_ 288 PinionSteerAgGroupPinionSteerAgSpd1Qf 0 "GenQf1_UndefindDataAccur" 1 "GenQf1_TmpUndefdData" 2 "GenQf1_DataAccurNotWithinSpcn" 3 "GenQf1_AccurData";
VAL_ 288 PinionSteerAgGroupSteerWhlTqQf 0 "GenQf1_UndefindDataAccur" 1 "GenQf1_TmpUndefdData" 2 "GenQf1_DataAccurNotWithinSpcn" 3 "GenQf1_AccurData";
VAL_ 288 SteerWhlSnsrQf 0 "GenQf1_UndefindDataAccur" 1 "GenQf1_TmpUndefdData" 2 "GenQf1_DataAccurNotWithinSpcn" 3 "GenQf1_AccurData";
VAL_ 288 VehBattUSysUQf 0 "GenQf1_UndefindDataAccur" 1 "GenQf1_TmpUndefdData" 2 "GenQf1_DataAccurNotWithinSpcn" 3 "GenQf1_AccurData";
VAL_ 288 VehModMngtGlbSafe1CarModSts1 0 "CarModSts1_CarModNorm" 1 "CarModSts1_CarModTrnsp" 2 "CarModSts1_CarModFcy" 3 "CarModSts1_CarModCrash" 5 "CarModSts1_CarModDyno";
VAL_ 288 VehModMngtGlbSafe1FltEgyCnsWdSts 0 "FltEgyCns1_NoFlt" 1 "FltEgyCns1_Flt";
VAL_ 288 VehModMngtGlbSafe1UsgModSts 0 "UsgModSts1_UsgModAbdnd" 1 "UsgModSts1_UsgModInActv" 2 "UsgModSts1_UsgModCnvinc" 11 "UsgModSts1_UsgModActv" 13 "UsgModSts1_UsgModDrvg";
VAL_ 288 VehMtnStVehMtnSt 0 "VehMtnSt2_Ukwn" 1 "VehMtnSt2_StandStillVal1" 2 "VehMtnSt2_StandStillVal2" 3 "VehMtnSt2_StandStillVal3" 4 "VehMtnSt2_RollgFwdVal1" 5 "VehMtnSt2_RollgFwdVal2" 6 "VehMtnSt2_RollgBackwVal1" 7 "VehMtnSt2_RollgBackwVal2";
VAL_ 288 VehSpdLgtQf 0 "GenQf1_UndefindDataAccur" 1 "GenQf1_TmpUndefdData" 2 "GenQf1_DataAccurNotWithinSpcn" 3 "GenQf1_AccurData";
VAL_ 288 WipgInfoWipgSpdInfo 0 "WipgSpdInfo_Off" 1 "WipgSpdInfo_IntlLo" 2 "WipgSpdInfo_IntlHi" 3 "WipgSpdInfo_WipgSpd4045" 4 "WipgSpdInfo_WipgSpd4650" 5 "WipgSpdInfo_WipgSpd5155" 6 "WipgSpdInfo_WipgSpd5660" 7 "WipgSpdInfo_WiprErr";
VAL_ 288 WipgInfoWiprActv 0 "OnOff1_Off" 1 "OnOff1_On";
VAL_ 288 WipgInfoWiprInWipgAr 0 "OnOff1_Off" 1 "OnOff1_On";
VAL_ 1007 ReSideRdrLeVehPrmRdrVehPrmRdrDynCalPrmForSnsrDir 0 "YesNo2_No" 1 "YesNo2_Yes";
VAL_ 1007 ReSideRdrLeVehPrmRdrVehPrmRdrDynCalPrmForSnsrOrntn 0 "YesNo2_No" 1 "YesNo2_Yes";
VAL_ 1007 ReSideRdrLeVehPrmRdrVehPrmVld 0 "YesNo2_No" 1 "YesNo2_Yes";
VAL_ 1007 ReSideRdrRiVehPrmRdrVehPrmRdrDynCalPrmForSnsrDir 0 "YesNo2_No" 1 "YesNo2_Yes";
VAL_ 1007 ReSideRdrRiVehPrmRdrVehPrmRdrDynCalPrmForSnsrOrntn 0 "YesNo2_No" 1 "YesNo2_Yes";
VAL_ 1007 ReSideRdrRiVehPrmRdrVehPrmVld 0 "YesNo2_No" 1 "YesNo2_Yes";
VAL_ 297 ReSideRdrLeStsForDim 0 "RsdsMstSt_Cfg" 1 "RsdsMstSt_StrtUp" 2 "RsdsMstSt_Runng" 3 "RsdsMstSt_Blkd" 4 "RsdsMstSt_Faulty" 5 "RsdsMstSt_Shutdown" 6 "RsdsMstSt_Hot" 7 "RsdsMstSt_Cal";
VAL_ 297 ReSideRdrLeStsRdrStsBlkd0bin 0 "YesNo2_No" 1 "YesNo2_Yes";
VAL_ 297 ReSideRdrLeStsRdrStsEna 0 "YesNo2_No" 1 "YesNo2_Yes";
VAL_ 297 ReSideRdrLeStsRdrStsFaulty 0 "YesNo2_No" 1 "YesNo2_Yes";
VAL_ 297 ReSideRdrLeStsRdrStsMisAlign 0 "MisAlign_Unknown" 1 "MisAlign_RadarIsFullyCalibrated" 2 "MisAlign_RadarMisalignmentDetected" 3 "MisAlign_RadarCalibrationInProgress" 4 "MisAlign_RadarIsCompletelyMisalignedAndNotPossibleToCalibrateIt" 5 "MisAlign_Reserved1" 6 "MisAlign_Reserved2" 7 "MisAlign_Reserved3";
VAL_ 297 ReSideRdrLeStsRdrStsMissCom 0 "YesNo2_No" 1 "YesNo2_Yes";
VAL_ 297 ReSideRdrLeStsRdrStsSftyFlt 0 "SftyFlt_Undefined" 1 "SftyFlt_NoSafetyFault" 2 "SftyFlt_SafetyFault" 3 "SftyFlt_Reserved";
VAL_ 297 ReSideRdrLeStsRdrStsTiStampStsGlbTiBas 0 "YesNo2_No" 1 "YesNo2_Yes";
VAL_ 297 ReSideRdrLeStsRdrStsTiStampStsSyncToGatewy 0 "YesNo2_No" 1 "YesNo2_Yes";
VAL_ 297 ReSideRdrLeStsRdrStsTiStampStsTiLeap 0 "YesNo2_No" 1 "YesNo2_Yes";
VAL_ 297 ReSideRdrLeStsRdrStsTiStampStsTiOut 0 "YesNo2_No" 1 "YesNo2_Yes";
VAL_ 304 ReSideRdrLeDetn1RdrDetnSts 0 "RdrDetnSts_Ukwn" 1 "RdrDetnSts_Movg" 2 "RdrDetnSts_Staty" 3 "RdrDetnSts_Invalid";
VAL_ 304 ReSideRdrLeDetn2RdrDetnSts 0 "RdrDetnSts_Ukwn" 1 "RdrDetnSts_Movg" 2 "RdrDetnSts_Staty" 3 "RdrDetnSts_Invalid";
VAL_ 304 ReSideRdrLeDetn3RdrDetnSts 0 "RdrDetnSts_Ukwn" 1 "RdrDetnSts_Movg" 2 "RdrDetnSts_Staty" 3 "RdrDetnSts_Invalid";
VAL_ 304 ReSideRdrLeDetn4RdrDetnSts 0 "RdrDetnSts_Ukwn" 1 "RdrDetnSts_Movg" 2 "RdrDetnSts_Staty" 3 "RdrDetnSts_Invalid";
VAL_ 304 ReSideRdrLeDetn5RdrDetnSts 0 "RdrDetnSts_Ukwn" 1 "RdrDetnSts_Movg" 2 "RdrDetnSts_Staty" 3 "RdrDetnSts_Invalid";
VAL_ 304 ReSideRdrLeDetn6RdrDetnSts 0 "RdrDetnSts_Ukwn" 1 "RdrDetnSts_Movg" 2 "RdrDetnSts_Staty" 3 "RdrDetnSts_Invalid";
VAL_ 306 ReSideRdrLeDetn10RdrDetnSts 0 "RdrDetnSts_Ukwn" 1 "RdrDetnSts_Movg" 2 "RdrDetnSts_Staty" 3 "RdrDetnSts_Invalid";
VAL_ 306 ReSideRdrLeDetn11RdrDetnSts 0 "RdrDetnSts_Ukwn" 1 "RdrDetnSts_Movg" 2 "RdrDetnSts_Staty" 3 "RdrDetnSts_Invalid";
VAL_ 306 ReSideRdrLeDetn12RdrDetnSts 0 "RdrDetnSts_Ukwn" 1 "RdrDetnSts_Movg" 2 "RdrDetnSts_Staty" 3 "RdrDetnSts_Invalid";
VAL_ 306 ReSideRdrLeDetn7RdrDetnSts 0 "RdrDetnSts_Ukwn" 1 "RdrDetnSts_Movg" 2 "RdrDetnSts_Staty" 3 "RdrDetnSts_Invalid";
VAL_ 306 ReSideRdrLeDetn8RdrDetnSts 0 "RdrDetnSts_Ukwn" 1 "RdrDetnSts_Movg" 2 "RdrDetnSts_Staty" 3 "RdrDetnSts_Invalid";
VAL_ 306 ReSideRdrLeDetn9RdrDetnSts 0 "RdrDetnSts_Ukwn" 1 "RdrDetnSts_Movg" 2 "RdrDetnSts_Staty" 3 "RdrDetnSts_Invalid";
VAL_ 308 ReSideRdrLeDetn13RdrDetnSts 0 "RdrDetnSts_Ukwn" 1 "RdrDetnSts_Movg" 2 "RdrDetnSts_Staty" 3 "RdrDetnSts_Invalid";
VAL_ 308 ReSideRdrLeDetn14RdrDetnSts 0 "RdrDetnSts_Ukwn" 1 "RdrDetnSts_Movg" 2 "RdrDetnSts_Staty" 3 "RdrDetnSts_Invalid";
VAL_ 308 ReSideRdrLeDetn15RdrDetnSts 0 "RdrDetnSts_Ukwn" 1 "RdrDetnSts_Movg" 2 "RdrDetnSts_Staty" 3 "RdrDetnSts_Invalid";
VAL_ 308 ReSideRdrLeDetn16RdrDetnSts 0 "RdrDetnSts_Ukwn" 1 "RdrDetnSts_Movg" 2 "RdrDetnSts_Staty" 3 "RdrDetnSts_Invalid";
VAL_ 308 ReSideRdrLeDetn17RdrDetnSts 0 "RdrDetnSts_Ukwn" 1 "RdrDetnSts_Movg" 2 "RdrDetnSts_Staty" 3 "RdrDetnSts_Invalid";
VAL_ 308 ReSideRdrLeDetn18RdrDetnSts 0 "RdrDetnSts_Ukwn" 1 "RdrDetnSts_Movg" 2 "RdrDetnSts_Staty" 3 "RdrDetnSts_Invalid";
VAL_ 310 ReSideRdrLeDetn19RdrDetnSts 0 "RdrDetnSts_Ukwn" 1 "RdrDetnSts_Movg" 2 "RdrDetnSts_Staty" 3 "RdrDetnSts_Invalid";
VAL_ 310 ReSideRdrLeDetn20RdrDetnSts 0 "RdrDetnSts_Ukwn" 1 "RdrDetnSts_Movg" 2 "RdrDetnSts_Staty" 3 "RdrDetnSts_Invalid";
VAL_ 310 ReSideRdrLeDetn21RdrDetnSts 0 "RdrDetnSts_Ukwn" 1 "RdrDetnSts_Movg" 2 "RdrDetnSts_Staty" 3 "RdrDetnSts_Invalid";
VAL_ 310 ReSideRdrLeDetn22RdrDetnSts 0 "RdrDetnSts_Ukwn" 1 "RdrDetnSts_Movg" 2 "RdrDetnSts_Staty" 3 "RdrDetnSts_Invalid";
VAL_ 310 ReSideRdrLeDetn23RdrDetnSts 0 "RdrDetnSts_Ukwn" 1 "RdrDetnSts_Movg" 2 "RdrDetnSts_Staty" 3 "RdrDetnSts_Invalid";
VAL_ 310 ReSideRdrLeDetn24RdrDetnSts 0 "RdrDetnSts_Ukwn" 1 "RdrDetnSts_Movg" 2 "RdrDetnSts_Staty" 3 "RdrDetnSts_Invalid";
VAL_ 312 ReSideRdrLeDetn25RdrDetnSts 0 "RdrDetnSts_Ukwn" 1 "RdrDetnSts_Movg" 2 "RdrDetnSts_Staty" 3 "RdrDetnSts_Invalid";
VAL_ 312 ReSideRdrLeDetn26RdrDetnSts 0 "RdrDetnSts_Ukwn" 1 "RdrDetnSts_Movg" 2 "RdrDetnSts_Staty" 3 "RdrDetnSts_Invalid";
VAL_ 312 ReSideRdrLeDetn27RdrDetnSts 0 "RdrDetnSts_Ukwn" 1 "RdrDetnSts_Movg" 2 "RdrDetnSts_Staty" 3 "RdrDetnSts_Invalid";
VAL_ 312 ReSideRdrLeDetn28RdrDetnSts 0 "RdrDetnSts_Ukwn" 1 "RdrDetnSts_Movg" 2 "RdrDetnSts_Staty" 3 "RdrDetnSts_Invalid";
VAL_ 312 ReSideRdrLeDetn29RdrDetnSts 0 "RdrDetnSts_Ukwn" 1 "RdrDetnSts_Movg" 2 "RdrDetnSts_Staty" 3 "RdrDetnSts_Invalid";
VAL_ 312 ReSideRdrLeDetn30RdrDetnSts 0 "RdrDetnSts_Ukwn" 1 "RdrDetnSts_Movg" 2 "RdrDetnSts_Staty" 3 "RdrDetnSts_Invalid";
VAL_ 314 ReSideRdrLeDetn31RdrDetnSts 0 "RdrDetnSts_Ukwn" 1 "RdrDetnSts_Movg" 2 "RdrDetnSts_Staty" 3 "RdrDetnSts_Invalid";
VAL_ 314 ReSideRdrLeDetn32RdrDetnSts 0 "RdrDetnSts_Ukwn" 1 "RdrDetnSts_Movg" 2 "RdrDetnSts_Staty" 3 "RdrDetnSts_Invalid";
VAL_ 314 ReSideRdrLeDetn33RdrDetnSts 0 "RdrDetnSts_Ukwn" 1 "RdrDetnSts_Movg" 2 "RdrDetnSts_Staty" 3 "RdrDetnSts_Invalid";
VAL_ 314 ReSideRdrLeDetn34RdrDetnSts 0 "RdrDetnSts_Ukwn" 1 "RdrDetnSts_Movg" 2 "RdrDetnSts_Staty" 3 "RdrDetnSts_Invalid";
VAL_ 314 ReSideRdrLeDetn35RdrDetnSts 0 "RdrDetnSts_Ukwn" 1 "RdrDetnSts_Movg" 2 "RdrDetnSts_Staty" 3 "RdrDetnSts_Invalid";
VAL_ 314 ReSideRdrLeDetn36RdrDetnSts 0 "RdrDetnSts_Ukwn" 1 "RdrDetnSts_Movg" 2 "RdrDetnSts_Staty" 3 "RdrDetnSts_Invalid";
SIG_GROUP_ 288 ADataRawSafe 1 : ADataRawSafeALat ADataRawSafeALat1Qf ADataRawSafeALgt ADataRawSafeALgt1Qf ADataRawSafeAVert ADataRawSafeAVertQf ADataRawSafeChks ADataRawSafeCntr;
SIG_GROUP_ 288 ALgtStdFromWhlSpd 1 : ALgtStdFromWhlSpdALgtStdFromWhlSpd ALgtStdFromWhlSpdChks ALgtStdFromWhlSpdCntr ALgtStdFromWhlSpdQf;
SIG_GROUP_ 288 AmbTRaw 1 : AmbTRawAmbTVal AmbTRawQly;
SIG_GROUP_ 288 AsyDataWithCmpSafe 1 : AsyDataWithCmpSafeALat1Qf AsyDataWithCmpSafeALatWithCmp AsyDataWithCmpSafeALgt1Qf AsyDataWithCmpSafeChks AsyDataWithCmpSafeCntr AsyDataWithCmpSafeGrdtOfALgt AsyDataWithCmpSafeYawRateQf AsyDataWithCmpSafeYawRateWithCmp;
SIG_GROUP_ 288 PinionSteerAgGroup 1 : PinionSteerAgGroupChks PinionSteerAgGroupCntr PinionSteerAgGroupPinionSteerAg1 PinionSteerAgGroupPinionSteerAg1Qf PinionSteerAgGroupPinionSteerAgSpd1 PinionSteerAgGroupPinionSteerAgSpd1Qf PinionSteerAgGroupSteerWhlTq PinionSteerAgGroupSteerWhlTqQf;
SIG_GROUP_ 304 ReSideRdrLeDetn1 1 : ReSideRdrLeDetn1RdrDetnAzi ReSideRdrLeDetn1RdrDetnChks ReSideRdrLeDetn1RdrDetnCntr ReSideRdrLeDetn1RdrDetnConf ReSideRdrLeDetn1RdrDetnElevn ReSideRdrLeDetn1RdrDetnPwr ReSideRdrLeDetn1RdrDetnRng ReSideRdrLeDetn1RdrDetnRngV ReSideRdrLeDetn1RdrDetnSts;
SIG_GROUP_ 306 ReSideRdrLeDetn10 1 : ReSideRdrLeDetn10RdrDetnAzi ReSideRdrLeDetn10RdrDetnChks ReSideRdrLeDetn10RdrDetnCntr ReSideRdrLeDetn10RdrDetnConf ReSideRdrLeDetn10RdrDetnElevn ReSideRdrLeDetn10RdrDetnPwr ReSideRdrLeDetn10RdrDetnRng ReSideRdrLeDetn10RdrDetnRngV ReSideRdrLeDetn10RdrDetnSts;
SIG_GROUP_ 306 ReSideRdrLeDetn11 1 : ReSideRdrLeDetn11RdrDetnAzi ReSideRdrLeDetn11RdrDetnChks ReSideRdrLeDetn11RdrDetnCntr ReSideRdrLeDetn11RdrDetnConf ReSideRdrLeDetn11RdrDetnElevn ReSideRdrLeDetn11RdrDetnPwr ReSideRdrLeDetn11RdrDetnRng ReSideRdrLeDetn11RdrDetnRngV ReSideRdrLeDetn11RdrDetnSts;
SIG_GROUP_ 306 ReSideRdrLeDetn12 1 : ReSideRdrLeDetn12RdrDetnAzi ReSideRdrLeDetn12RdrDetnChks ReSideRdrLeDetn12RdrDetnCntr ReSideRdrLeDetn12RdrDetnConf ReSideRdrLeDetn12RdrDetnElevn ReSideRdrLeDetn12RdrDetnPwr ReSideRdrLeDetn12RdrDetnRng ReSideRdrLeDetn12RdrDetnRngV ReSideRdrLeDetn12RdrDetnSts;
SIG_GROUP_ 308 ReSideRdrLeDetn13 1 : ReSideRdrLeDetn13RdrDetnAzi ReSideRdrLeDetn13RdrDetnChks ReSideRdrLeDetn13RdrDetnCntr ReSideRdrLeDetn13RdrDetnConf ReSideRdrLeDetn13RdrDetnElevn ReSideRdrLeDetn13RdrDetnPwr ReSideRdrLeDetn13RdrDetnRng ReSideRdrLeDetn13RdrDetnRngV ReSideRdrLeDetn13RdrDetnSts;
SIG_GROUP_ 308 ReSideRdrLeDetn14 1 : ReSideRdrLeDetn14RdrDetnAzi ReSideRdrLeDetn14RdrDetnChks ReSideRdrLeDetn14RdrDetnCntr ReSideRdrLeDetn14RdrDetnConf ReSideRdrLeDetn14RdrDetnElevn ReSideRdrLeDetn14RdrDetnPwr ReSideRdrLeDetn14RdrDetnRng ReSideRdrLeDetn14RdrDetnRngV ReSideRdrLeDetn14RdrDetnSts;
SIG_GROUP_ 308 ReSideRdrLeDetn15 1 : ReSideRdrLeDetn15RdrDetnAzi ReSideRdrLeDetn15RdrDetnChks ReSideRdrLeDetn15RdrDetnCntr ReSideRdrLeDetn15RdrDetnConf ReSideRdrLeDetn15RdrDetnElevn ReSideRdrLeDetn15RdrDetnPwr ReSideRdrLeDetn15RdrDetnRng ReSideRdrLeDetn15RdrDetnRngV ReSideRdrLeDetn15RdrDetnSts;
SIG_GROUP_ 308 ReSideRdrLeDetn16 1 : ReSideRdrLeDetn16RdrDetnAzi ReSideRdrLeDetn16RdrDetnChks ReSideRdrLeDetn16RdrDetnCntr ReSideRdrLeDetn16RdrDetnConf ReSideRdrLeDetn16RdrDetnElevn ReSideRdrLeDetn16RdrDetnPwr ReSideRdrLeDetn16RdrDetnRng ReSideRdrLeDetn16RdrDetnRngV ReSideRdrLeDetn16RdrDetnSts;
SIG_GROUP_ 308 ReSideRdrLeDetn17 1 : ReSideRdrLeDetn17RdrDetnAzi ReSideRdrLeDetn17RdrDetnChks ReSideRdrLeDetn17RdrDetnCntr ReSideRdrLeDetn17RdrDetnConf ReSideRdrLeDetn17RdrDetnElevn ReSideRdrLeDetn17RdrDetnPwr ReSideRdrLeDetn17RdrDetnRng ReSideRdrLeDetn17RdrDetnRngV ReSideRdrLeDetn17RdrDetnSts;
SIG_GROUP_ 308 ReSideRdrLeDetn18 1 : ReSideRdrLeDetn18RdrDetnAzi ReSideRdrLeDetn18RdrDetnChks ReSideRdrLeDetn18RdrDetnCntr ReSideRdrLeDetn18RdrDetnConf ReSideRdrLeDetn18RdrDetnElevn ReSideRdrLeDetn18RdrDetnPwr ReSideRdrLeDetn18RdrDetnRng ReSideRdrLeDetn18RdrDetnRngV ReSideRdrLeDetn18RdrDetnSts;
SIG_GROUP_ 310 ReSideRdrLeDetn19 1 : ReSideRdrLeDetn19RdrDetnAzi ReSideRdrLeDetn19RdrDetnChks ReSideRdrLeDetn19RdrDetnCntr ReSideRdrLeDetn19RdrDetnConf ReSideRdrLeDetn19RdrDetnElevn ReSideRdrLeDetn19RdrDetnPwr ReSideRdrLeDetn19RdrDetnRng ReSideRdrLeDetn19RdrDetnRngV ReSideRdrLeDetn19RdrDetnSts;
SIG_GROUP_ 304 ReSideRdrLeDetn2 1 : ReSideRdrLeDetn2RdrDetnAzi ReSideRdrLeDetn2RdrDetnChks ReSideRdrLeDetn2RdrDetnCntr ReSideRdrLeDetn2RdrDetnConf ReSideRdrLeDetn2RdrDetnElevn ReSideRdrLeDetn2RdrDetnPwr ReSideRdrLeDetn2RdrDetnRng ReSideRdrLeDetn2RdrDetnRngV ReSideRdrLeDetn2RdrDetnSts;
SIG_GROUP_ 310 ReSideRdrLeDetn20 1 : ReSideRdrLeDetn20RdrDetnAzi ReSideRdrLeDetn20RdrDetnChks ReSideRdrLeDetn20RdrDetnCntr ReSideRdrLeDetn20RdrDetnConf ReSideRdrLeDetn20RdrDetnElevn ReSideRdrLeDetn20RdrDetnPwr ReSideRdrLeDetn20RdrDetnRng ReSideRdrLeDetn20RdrDetnRngV ReSideRdrLeDetn20RdrDetnSts;
SIG_GROUP_ 310 ReSideRdrLeDetn21 1 : ReSideRdrLeDetn21RdrDetnAzi ReSideRdrLeDetn21RdrDetnChks ReSideRdrLeDetn21RdrDetnCntr ReSideRdrLeDetn21RdrDetnConf ReSideRdrLeDetn21RdrDetnElevn ReSideRdrLeDetn21RdrDetnPwr ReSideRdrLeDetn21RdrDetnRng ReSideRdrLeDetn21RdrDetnRngV ReSideRdrLeDetn21RdrDetnSts;
SIG_GROUP_ 310 ReSideRdrLeDetn22 1 : ReSideRdrLeDetn22RdrDetnAzi ReSideRdrLeDetn22RdrDetnChks ReSideRdrLeDetn22RdrDetnCntr ReSideRdrLeDetn22RdrDetnConf ReSideRdrLeDetn22RdrDetnElevn ReSideRdrLeDetn22RdrDetnPwr ReSideRdrLeDetn22RdrDetnRng ReSideRdrLeDetn22RdrDetnRngV ReSideRdrLeDetn22RdrDetnSts;
SIG_GROUP_ 310 ReSideRdrLeDetn23 1 : ReSideRdrLeDetn23RdrDetnAzi ReSideRdrLeDetn23RdrDetnChks ReSideRdrLeDetn23RdrDetnCntr ReSideRdrLeDetn23RdrDetnConf ReSideRdrLeDetn23RdrDetnElevn ReSideRdrLeDetn23RdrDetnPwr ReSideRdrLeDetn23RdrDetnRng ReSideRdrLeDetn23RdrDetnRngV ReSideRdrLeDetn23RdrDetnSts;
SIG_GROUP_ 310 ReSideRdrLeDetn24 1 : ReSideRdrLeDetn24RdrDetnAzi ReSideRdrLeDetn24RdrDetnChks ReSideRdrLeDetn24RdrDetnCntr ReSideRdrLeDetn24RdrDetnConf ReSideRdrLeDetn24RdrDetnElevn ReSideRdrLeDetn24RdrDetnPwr ReSideRdrLeDetn24RdrDetnRng ReSideRdrLeDetn24RdrDetnRngV ReSideRdrLeDetn24RdrDetnSts;
SIG_GROUP_ 312 ReSideRdrLeDetn25 1 : ReSideRdrLeDetn25RdrDetnAzi ReSideRdrLeDetn25RdrDetnChks ReSideRdrLeDetn25RdrDetnCntr ReSideRdrLeDetn25RdrDetnConf ReSideRdrLeDetn25RdrDetnElevn ReSideRdrLeDetn25RdrDetnPwr ReSideRdrLeDetn25RdrDetnRng ReSideRdrLeDetn25RdrDetnRngV ReSideRdrLeDetn25RdrDetnSts;
SIG_GROUP_ 312 ReSideRdrLeDetn26 1 : ReSideRdrLeDetn26RdrDetnAzi ReSideRdrLeDetn26RdrDetnChks ReSideRdrLeDetn26RdrDetnCntr ReSideRdrLeDetn26RdrDetnConf ReSideRdrLeDetn26RdrDetnElevn ReSideRdrLeDetn26RdrDetnPwr ReSideRdrLeDetn26RdrDetnRng ReSideRdrLeDetn26RdrDetnRngV ReSideRdrLeDetn26RdrDetnSts;
SIG_GROUP_ 312 ReSideRdrLeDetn27 1 : ReSideRdrLeDetn27RdrDetnAzi ReSideRdrLeDetn27RdrDetnChks ReSideRdrLeDetn27RdrDetnCntr ReSideRdrLeDetn27RdrDetnConf ReSideRdrLeDetn27RdrDetnElevn ReSideRdrLeDetn27RdrDetnPwr ReSideRdrLeDetn27RdrDetnRng ReSideRdrLeDetn27RdrDetnRngV ReSideRdrLeDetn27RdrDetnSts;
SIG_GROUP_ 312 ReSideRdrLeDetn28 1 : ReSideRdrLeDetn28RdrDetnAzi ReSideRdrLeDetn28RdrDetnChks ReSideRdrLeDetn28RdrDetnCntr ReSideRdrLeDetn28RdrDetnConf ReSideRdrLeDetn28RdrDetnElevn ReSideRdrLeDetn28RdrDetnPwr ReSideRdrLeDetn28RdrDetnRng ReSideRdrLeDetn28RdrDetnRngV ReSideRdrLeDetn28RdrDetnSts;
SIG_GROUP_ 312 ReSideRdrLeDetn29 1 : ReSideRdrLeDetn29RdrDetnAzi ReSideRdrLeDetn29RdrDetnChks ReSideRdrLeDetn29RdrDetnCntr ReSideRdrLeDetn29RdrDetnConf ReSideRdrLeDetn29RdrDetnElevn ReSideRdrLeDetn29RdrDetnPwr ReSideRdrLeDetn29RdrDetnRng ReSideRdrLeDetn29RdrDetnRngV ReSideRdrLeDetn29RdrDetnSts;
SIG_GROUP_ 304 ReSideRdrLeDetn3 1 : ReSideRdrLeDetn3RdrDetnAzi ReSideRdrLeDetn3RdrDetnChks ReSideRdrLeDetn3RdrDetnCntr ReSideRdrLeDetn3RdrDetnConf ReSideRdrLeDetn3RdrDetnElevn ReSideRdrLeDetn3RdrDetnPwr ReSideRdrLeDetn3RdrDetnRng ReSideRdrLeDetn3RdrDetnRngV ReSideRdrLeDetn3RdrDetnSts;
SIG_GROUP_ 312 ReSideRdrLeDetn30 1 : ReSideRdrLeDetn30RdrDetnAzi ReSideRdrLeDetn30RdrDetnChks ReSideRdrLeDetn30RdrDetnCntr ReSideRdrLeDetn30RdrDetnConf ReSideRdrLeDetn30RdrDetnElevn ReSideRdrLeDetn30RdrDetnPwr ReSideRdrLeDetn30RdrDetnRng ReSideRdrLeDetn30RdrDetnRngV ReSideRdrLeDetn30RdrDetnSts;
SIG_GROUP_ 314 ReSideRdrLeDetn31 1 : ReSideRdrLeDetn31RdrDetnAzi ReSideRdrLeDetn31RdrDetnChks ReSideRdrLeDetn31RdrDetnCntr ReSideRdrLeDetn31RdrDetnConf ReSideRdrLeDetn31RdrDetnElevn ReSideRdrLeDetn31RdrDetnPwr ReSideRdrLeDetn31RdrDetnRng ReSideRdrLeDetn31RdrDetnRngV ReSideRdrLeDetn31RdrDetnSts;
SIG_GROUP_ 314 ReSideRdrLeDetn32 1 : ReSideRdrLeDetn32RdrDetnAzi ReSideRdrLeDetn32RdrDetnChks ReSideRdrLeDetn32RdrDetnCntr ReSideRdrLeDetn32RdrDetnConf ReSideRdrLeDetn32RdrDetnElevn ReSideRdrLeDetn32RdrDetnPwr ReSideRdrLeDetn32RdrDetnRng ReSideRdrLeDetn32RdrDetnRngV ReSideRdrLeDetn32RdrDetnSts;
SIG_GROUP_ 314 ReSideRdrLeDetn33 1 : ReSideRdrLeDetn33RdrDetnAzi ReSideRdrLeDetn33RdrDetnChks ReSideRdrLeDetn33RdrDetnCntr ReSideRdrLeDetn33RdrDetnConf ReSideRdrLeDetn33RdrDetnElevn ReSideRdrLeDetn33RdrDetnPwr ReSideRdrLeDetn33RdrDetnRng ReSideRdrLeDetn33RdrDetnRngV ReSideRdrLeDetn33RdrDetnSts;
SIG_GROUP_ 314 ReSideRdrLeDetn34 1 : ReSideRdrLeDetn34RdrDetnAzi ReSideRdrLeDetn34RdrDetnChks ReSideRdrLeDetn34RdrDetnCntr ReSideRdrLeDetn34RdrDetnConf ReSideRdrLeDetn34RdrDetnElevn ReSideRdrLeDetn34RdrDetnPwr ReSideRdrLeDetn34RdrDetnRng ReSideRdrLeDetn34RdrDetnRngV ReSideRdrLeDetn34RdrDetnSts;
SIG_GROUP_ 314 ReSideRdrLeDetn35 1 : ReSideRdrLeDetn35RdrDetnAzi ReSideRdrLeDetn35RdrDetnChks ReSideRdrLeDetn35RdrDetnCntr ReSideRdrLeDetn35RdrDetnConf ReSideRdrLeDetn35RdrDetnElevn ReSideRdrLeDetn35RdrDetnPwr ReSideRdrLeDetn35RdrDetnRng ReSideRdrLeDetn35RdrDetnRngV ReSideRdrLeDetn35RdrDetnSts;
SIG_GROUP_ 314 ReSideRdrLeDetn36 1 : ReSideRdrLeDetn36RdrDetnAzi ReSideRdrLeDetn36RdrDetnChks ReSideRdrLeDetn36RdrDetnCntr ReSideRdrLeDetn36RdrDetnConf ReSideRdrLeDetn36RdrDetnElevn ReSideRdrLeDetn36RdrDetnPwr ReSideRdrLeDetn36RdrDetnRng ReSideRdrLeDetn36RdrDetnRngV ReSideRdrLeDetn36RdrDetnSts;
SIG_GROUP_ 304 ReSideRdrLeDetn4 1 : ReSideRdrLeDetn4RdrDetnAzi ReSideRdrLeDetn4RdrDetnChks ReSideRdrLeDetn4RdrDetnCntr ReSideRdrLeDetn4RdrDetnConf ReSideRdrLeDetn4RdrDetnElevn ReSideRdrLeDetn4RdrDetnPwr ReSideRdrLeDetn4RdrDetnRng ReSideRdrLeDetn4RdrDetnRngV ReSideRdrLeDetn4RdrDetnSts;
SIG_GROUP_ 304 ReSideRdrLeDetn5 1 : ReSideRdrLeDetn5RdrDetnAzi ReSideRdrLeDetn5RdrDetnChks ReSideRdrLeDetn5RdrDetnCntr ReSideRdrLeDetn5RdrDetnConf ReSideRdrLeDetn5RdrDetnElevn ReSideRdrLeDetn5RdrDetnPwr ReSideRdrLeDetn5RdrDetnRng ReSideRdrLeDetn5RdrDetnRngV ReSideRdrLeDetn5RdrDetnSts;
SIG_GROUP_ 304 ReSideRdrLeDetn6 1 : ReSideRdrLeDetn6RdrDetnAzi ReSideRdrLeDetn6RdrDetnChks ReSideRdrLeDetn6RdrDetnCntr ReSideRdrLeDetn6RdrDetnConf ReSideRdrLeDetn6RdrDetnElevn ReSideRdrLeDetn6RdrDetnPwr ReSideRdrLeDetn6RdrDetnRng ReSideRdrLeDetn6RdrDetnRngV ReSideRdrLeDetn6RdrDetnSts;
SIG_GROUP_ 306 ReSideRdrLeDetn7 1 : ReSideRdrLeDetn7RdrDetnAzi ReSideRdrLeDetn7RdrDetnChks ReSideRdrLeDetn7RdrDetnCntr ReSideRdrLeDetn7RdrDetnConf ReSideRdrLeDetn7RdrDetnElevn ReSideRdrLeDetn7RdrDetnPwr ReSideRdrLeDetn7RdrDetnRng ReSideRdrLeDetn7RdrDetnRngV ReSideRdrLeDetn7RdrDetnSts;
SIG_GROUP_ 306 ReSideRdrLeDetn8 1 : ReSideRdrLeDetn8RdrDetnAzi ReSideRdrLeDetn8RdrDetnChks ReSideRdrLeDetn8RdrDetnCntr ReSideRdrLeDetn8RdrDetnConf ReSideRdrLeDetn8RdrDetnElevn ReSideRdrLeDetn8RdrDetnPwr ReSideRdrLeDetn8RdrDetnRng ReSideRdrLeDetn8RdrDetnRngV ReSideRdrLeDetn8RdrDetnSts;
SIG_GROUP_ 306 ReSideRdrLeDetn9 1 : ReSideRdrLeDetn9RdrDetnAzi ReSideRdrLeDetn9RdrDetnChks ReSideRdrLeDetn9RdrDetnCntr ReSideRdrLeDetn9RdrDetnConf ReSideRdrLeDetn9RdrDetnElevn ReSideRdrLeDetn9RdrDetnPwr ReSideRdrLeDetn9RdrDetnRng ReSideRdrLeDetn9RdrDetnRngV ReSideRdrLeDetn9RdrDetnSts;
SIG_GROUP_ 297 ReSideRdrLeSts 1 : ReSideRdrLeStsRdrNrDetn ReSideRdrLeStsRdrNrObj ReSideRdrLeStsRdrStsBlkd0bin ReSideRdrLeStsRdrStsBlkdConf ReSideRdrLeStsRdrStsChks ReSideRdrLeStsRdrStsCntr ReSideRdrLeStsRdrStsDstbc ReSideRdrLeStsRdrStsEna ReSideRdrLeStsRdrStsFaulty ReSideRdrLeStsRdrStsIfVersMajor ReSideRdrLeStsRdrStsIfVersMinor ReSideRdrLeStsRdrStsLatency ReSideRdrLeStsRdrStsMisAlign ReSideRdrLeStsRdrStsMissCom ReSideRdrLeStsRdrStsSftyFlt ReSideRdrLeStsRdrStsTiStamp ReSideRdrLeStsRdrStsTiStampStsGlbTiBas ReSideRdrLeStsRdrStsTiStampStsSyncToGatewy ReSideRdrLeStsRdrStsTiStampStsTiLeap ReSideRdrLeStsRdrStsTiStampStsTiOut ReSideRdrLeStsRdrStsWhlSpdCmpFac;
SIG_GROUP_ 1007 ReSideRdrLeVehPrm 1 : ReSideRdrLeVehPrmRdrVehPrmChks ReSideRdrLeVehPrmRdrVehPrmCntr ReSideRdrLeVehPrmRdrVehPrmRdrDynCalPrmForAgOffs ReSideRdrLeVehPrmRdrVehPrmRdrDynCalPrmForAxleDstReToVehFrnt ReSideRdrLeVehPrmRdrVehPrmRdrDynCalPrmForPinoinAgRat ReSideRdrLeVehPrmRdrVehPrmRdrDynCalPrmForRollAgGain ReSideRdrLeVehPrmRdrVehPrmRdrDynCalPrmForSnsrDir ReSideRdrLeVehPrmRdrVehPrmRdrDynCalPrmForSnsrOrntn ReSideRdrLeVehPrmRdrVehPrmRdrDynCalPrmForSnsrPosnLat ReSideRdrLeVehPrmRdrVehPrmRdrDynCalPrmForSnsrPosnLgt ReSideRdrLeVehPrmRdrVehPrmRdrDynCalPrmForSnsrPosnVert ReSideRdrLeVehPrmRdrVehPrmRdrDynCalPrmForSnsrRot1 ReSideRdrLeVehPrmRdrVehPrmRdrDynCalPrmForVehLen ReSideRdrLeVehPrmRdrVehPrmRdrDynCalPrmForVehTyp ReSideRdrLeVehPrmRdrVehPrmRdrDynCalPrmForVehWidth ReSideRdrLeVehPrmRdrVehPrmRdrDynCalPrmForVersMajor ReSideRdrLeVehPrmRdrVehPrmRdrDynCalPrmForVersMinor ReSideRdrLeVehPrmRdrVehPrmRdrDynCalPrmForWhlBas ReSideRdrLeVehPrmRdrVehPrmVld;
SIG_GROUP_ 1007 ReSideRdrRiVehPrm 1 : ReSideRdrRiVehPrmRdrVehPrmChks ReSideRdrRiVehPrmRdrVehPrmCntr ReSideRdrRiVehPrmRdrVehPrmRdrDynCalPrmForAgOffs ReSideRdrRiVehPrmRdrVehPrmRdrDynCalPrmForAxleDstReToVehFrnt ReSideRdrRiVehPrmRdrVehPrmRdrDynCalPrmForPinoinAgRat ReSideRdrRiVehPrmRdrVehPrmRdrDynCalPrmForRollAgGain ReSideRdrRiVehPrmRdrVehPrmRdrDynCalPrmForSnsrDir ReSideRdrRiVehPrmRdrVehPrmRdrDynCalPrmForSnsrOrntn ReSideRdrRiVehPrmRdrVehPrmRdrDynCalPrmForSnsrPosnLat ReSideRdrRiVehPrmRdrVehPrmRdrDynCalPrmForSnsrPosnLgt ReSideRdrRiVehPrmRdrVehPrmRdrDynCalPrmForSnsrPosnVert ReSideRdrRiVehPrmRdrVehPrmRdrDynCalPrmForSnsrRot1 ReSideRdrRiVehPrmRdrVehPrmRdrDynCalPrmForVehLen ReSideRdrRiVehPrmRdrVehPrmRdrDynCalPrmForVehTyp ReSideRdrRiVehPrmRdrVehPrmRdrDynCalPrmForVehWidth ReSideRdrRiVehPrmRdrVehPrmRdrDynCalPrmForVersMajor ReSideRdrRiVehPrmRdrVehPrmRdrDynCalPrmForVersMinor ReSideRdrRiVehPrmRdrVehPrmRdrDynCalPrmForWhlBas ReSideRdrRiVehPrmRdrVehPrmVld;
SIG_GROUP_ 288 SteerWhlSnsr 1 : SteerWhlSnsrAg SteerWhlSnsrAgSpd SteerWhlSnsrChks SteerWhlSnsrCntr SteerWhlSnsrQf;
SIG_GROUP_ 288 VehBattU 1 : VehBattUSysU VehBattUSysUQf;
SIG_GROUP_ 288 VehModMngtGlbSafe1 1 : VehModMngtGlbSafe1CarModSts1 VehModMngtGlbSafe1CarModSubtypWdCarModSubtyp VehModMngtGlbSafe1Chks VehModMngtGlbSafe1Cntr VehModMngtGlbSafe1EgyLvlElecMai VehModMngtGlbSafe1EgyLvlElecSubtyp VehModMngtGlbSafe1FltEgyCnsWdSts VehModMngtGlbSafe1PwrLvlElecMai VehModMngtGlbSafe1PwrLvlElecSubtyp VehModMngtGlbSafe1UsgModSts;
SIG_GROUP_ 288 VehMtnSt 1 : VehMtnStChks VehMtnStCntr VehMtnStVehMtnSt;
SIG_GROUP_ 288 VehSpdLgt 1 : VehSpdLgtA VehSpdLgtChks VehSpdLgtCntr VehSpdLgtQf;
SIG_GROUP_ 288 WipgInfo 1 : WipgInfoWipgSpdInfo WipgInfoWiprActv WipgInfoWiprInWipgAr;
